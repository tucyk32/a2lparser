ASAP2_VERSION 1 3
/begin PROJECT C177 "EDC16CP"
/begin HEADER "" VERSION "VCP7A3" PROJECT_NO C177 /end HEADER
/begin MODULE DIM ""
/begin MOD_COMMON "" BYTE_ORDER MSB_FIRST ALIGNMENT_BYTE 1 ALIGNMENT_WORD 2 ALIGNMENT_LONG 4 ALIGNMENT_FLOAT32_IEEE 4 /end MOD_COMMON
/begin CHARACTERISTIC ACCtl_drAccPedHi_C "obere Hystereseschwelle für Fahrpedaländerung (Abschaltbedingung BESCHLEUNIGUNG)" VALUE 0x1C2074 Kw_Ws16 32767.50 Prc_D20ms -16384.00 16383.50 FORMAT "%8.2" /end CHARACTERISTIC
/begin CHARACTERISTIC ACCtl_drAccPedLo_C "untere Hystereseschwelle für Fahrpedaländerung (Abschaltbedingung BESCHLEUNIGUNG)" VALUE 0x1C2076 Kw_Ws16 32767.50 Prc_D20ms -16384.00 16383.50 FORMAT "%8.2" /end CHARACTERISTIC
/begin CHARACTERISTIC ACCtl_nAccVehHi_C "obere Hystereseschwelle für Drehzahl (Abschaltbedingung BESCHLEUNIGUNG)" VALUE 0x1C2078 Kw_Ws16 65535.00 EngN -32768.00 32767.00 FORMAT "%8.2" /end CHARACTERISTIC
/begin CHARACTERISTIC ACCtl_nAccVehLo_C "untere Hystereseschwelle für Drehzahl (Abschaltbedingung BESCHLEUNIGUNG)" VALUE 0x1C207A Kw_Ws16 65535.00 EngN -32768.00 32767.00 FORMAT "%8.2" /end CHARACTERISTIC
/begin CHARACTERISTIC ACCtl_nDAEngHi_C "Obere Hysteresegrenze für Motordrehzahl" VALUE 0x1C207C Kw_Ws16 65535.00 EngN -32768.00 32767.00 FORMAT "%8.2" /end CHARACTERISTIC
/begin CHARACTERISTIC ACCtl_nDAEngLo_C "Untere Hysteresegrenze für Motordrehzahl" VALUE 0x1C207E Kw_Ws16 65535.00 EngN -32768.00 32767.00 FORMAT "%8.2" /end CHARACTERISTIC
/begin CHARACTERISTIC ACCtl_nKliIdlSpd_C "LL-Solldrehzahl bei Erhöhung durch Klimakompressor" VALUE 0x1C2154 Kw_Ws16 6000.000 EngN 0.00 6000.000 FORMAT "%8.3" EXTENDED_LIMITS -32768.00 32767.00 /end CHARACTERISTIC
/begin CHARACTERISTIC ACCtl_nLIGovHi_C "Obere Hysteresegrenze für Motordrehzahl (Abschaltbedingung UNTERSCHNEIDEN DER LEERLAUFDREHZAHL)" VALUE 0x1C2080 Kw_Ws16 65535.00 EngN -32768.00 32767.00 FORMAT "%8.2" /end CHARACTERISTIC
/begin CHARACTERISTIC ACCtl_nLIGovLo_C "Untere Hysteresegrenze für Motordrehzahl (Abschaltbedingung UNTERSCHNEIDEN DER LEERLAUFDREHZAHL)" VALUE 0x1C2082 Kw_Ws16 65535.00 EngN -32768.00 32767.00 FORMAT "%8.2" /end CHARACTERISTIC
/begin CHARACTERISTIC ACCtl_nSysErrHi_C "obere Hysteresegrenze für Motordrehzahl (Abschaltbedingung SYSTEMFEHLER)" VALUE 0x1C2084 Kw_Ws16 65535.00 EngN -32768.00 32767.00 FORMAT "%8.2" /end CHARACTERISTIC
/begin CHARACTERISTIC ACCtl_nSysErrLo_C "Untere Hysteresegrenze für Motordrehzahl (Abschaltbedingung SYSTEMFEHLER)" VALUE 0x1C2086 Kw_Ws16 65535.00 EngN -32768.00 32767.00 FORMAT "%8.2" /end CHARACTERISTIC
/begin CHARACTERISTIC ACCtl_pAccValHi_C "obere Hystereseschwelle für  Atmosphärendruck (Abschaltbedingung BESCHLEUNIGUNG)" VALUE 0x1C2088 Kw_Ws16 65535.00 Pres_hPa -32768.00 32767.00 FORMAT "%8.2" /end CHARACTERISTIC
/begin CHARACTERISTIC ACCtl_pAccValLo_C "untere Hystereseschwelle für  Atmosphärendruck (Abschaltbedingung BESCHLEUNIGUNG)" VALUE 0x1C208A Kw_Ws16 65535.00 Pres_hPa -32768.00 32767.00 FORMAT "%8.2" /end CHARACTERISTIC
/begin CHARACTERISTIC ACCtl_pACPMaxHi_C "obere Hystereseschwelle für  Kältemitteldruck (Abschaltbedingung KÄLTEMITTELDRUCK)" VALUE 0x1C208C Kw_Ws16 131070.0 PresAC_hPa -65536.00 65534.00 FORMAT "%8.2" /end CHARACTERISTIC
/begin CHARACTERISTIC ACCtl_pACPMaxLo_C "untere Hystereseschwelle für  Kältemitteldruck (Abschaltbedingung KÄLTEMITTELDRUCK)" VALUE 0x1C208E Kw_Ws16 131070.0 PresAC_hPa -65536.00 65534.00 FORMAT "%8.2" /end CHARACTERISTIC
/begin CHARACTERISTIC ACCtl_pACPMinHi_C "obere Hystereseschwelle für  Kältemitteldruck (Abschaltbedingung KÄLTEMITTELDRUCK)" VALUE 0x1C2090 Kw_Ws16 131070.0 PresAC_hPa -65536.00 65534.00 FORMAT "%8.2" /end CHARACTERISTIC
/begin CHARACTERISTIC ACCtl_pACPMinLo_C "untere Hystereseschwelle für  Kältemitteldruck (Abschaltbedingung KÄLTEMITTELDRUCK)" VALUE 0x1C2092 Kw_Ws16 131070.0 PresAC_hPa -65536.00 65534.00 FORMAT "%8.2" /end CHARACTERISTIC
/begin CHARACTERISTIC ACCtl_rAccPedHi_C "obere Hystereseschwelle für Fahrpedal (Abschaltbedingung ANFAHREN)" VALUE 0x1C2094 Kw_Ws16 655.3500 Prc -327.6800 327.6700 FORMAT "%8.4" /end CHARACTERISTIC
/begin CHARACTERISTIC ACCtl_rAccPedLo_C "untere Hystereseschwelle für Fahrpedal (Abschaltbedingung ANFAHREN)" VALUE 0x1C2096 Kw_Ws16 655.3500 Prc -327.6800 327.6700 FORMAT "%8.4" /end CHARACTERISTIC
/begin CHARACTERISTIC ACCtl_stDAGearHi_C "obere Hystereseschwelle für Gearbx_stGear (Abschaltbedingung ANFAHREN)" VALUE 0x1C2098 Kw_Ws8 255.0 OneToOne -128.0 127.0 FORMAT "%5.1" /end CHARACTERISTIC
/begin CHARACTERISTIC ACCtl_stDAGearLo_C "untere Hystereseschwelle für Gearbx_stGearl (Abschaltbedingung ANFAHREN)" VALUE 0x1C2099 Kw_Ws8 255.0 OneToOne -128.0 127.0 FORMAT "%5.1" /end CHARACTERISTIC
/begin CHARACTERISTIC ACCtl_swtEnableRequest_C "Freigabe der Klimaanforderungen für LL-Solldrehzahlerhöhung" VALUE 0x1C2156 Kw_Wu8 15.00 OneToOne 0.00 15.00 FORMAT "%5.2" EXTENDED_LIMITS 0.00 255.0 /end CHARACTERISTIC
/begin CHARACTERISTIC ACCtl_swtFanErrEna_C "Schalter zur Aktivierung der Abschaltbedingungen wegen Lüfterfehler" VALUE 0x1C209A Kw_Wu8 255.0 OneToOne 0.00 255.0 FORMAT "%5.1" /end CHARACTERISTIC
/begin CHARACTERISTIC ACCtl_swtoff_mode_C "Schalter: Abschaltung/Leistungsreduzierung" VALUE 0x1C2158 Kw_Wu16 65535.00 OneToOne 0.00 65535.00 FORMAT "%8.2" /end CHARACTERISTIC
/begin CHARACTERISTIC ACCtl_swtTempACOff_C "Schalter der Temperaturwert des Arrays auswählt" VALUE 0x1C209B Kw_Wu8 4.00000000000 EngTempFldSel 0.00 4.00000000000 FORMAT "%13.11" /end CHARACTERISTIC
/begin CHARACTERISTIC ACCtl_swtTempHys_C "Schalter derTemperaturwert des Arrays auswählt" VALUE 0x1C209C Kw_Wu8 4.00000000000 EngTempFldSel 0.00 4.00000000000 FORMAT "%13.11" /end CHARACTERISTIC
/begin CHARACTERISTIC ACCtl_swtVehStand_C "Schalter für Aktivierung der ""Fahrzeug Stillstand"" Erkennung für die Klimaanlage" VALUE 0x1C215A Kw_Wu8 1.000 OneToOne 0.00 1.000 FORMAT "%5.3" EXTENDED_LIMITS 0.00 255.0 /end CHARACTERISTIC
/begin CHARACTERISTIC ACCtl_tAccAir1Hi_C "obere Hystereseschwelle für Umgebungstemperatur (Abschaltbedingung BESCHLEUNIGUNG)" VALUE 0x1C209E Kw_Ws16 6553.500 Temp_Cels -3549.940 3003.560 FORMAT "%8.3" /end CHARACTERISTIC
/begin CHARACTERISTIC ACCtl_tAccAir1Lo_C "untere Hystereseschwelle für Umgebungstemperatur (Abschaltbedingung BESCHLEUNIGUNG)" VALUE 0x1C20A0 Kw_Ws16 6553.500 Temp_Cels -3549.940 3003.560 FORMAT "%8.3" /end CHARACTERISTIC
/begin CHARACTERISTIC ACCtl_tAccAir2Hi_C "obere Hystereseschwelle für Umgebungstemperatur (Abschaltbedingung BESCHLEUNIGUNG)" VALUE 0x1C20A2 Kw_Ws16 6553.500 Temp_Cels -3549.940 3003.560 FORMAT "%8.3" /end CHARACTERISTIC
/begin CHARACTERISTIC ACCtl_tAccAir2Lo_C "untere Hystereseschwelle für Umgebungstemperatur (Abschaltbedingung BESCHLEUNIGUNG)" VALUE 0x1C20A4 Kw_Ws16 6553.500 Temp_Cels -3549.940 3003.560 FORMAT "%8.3" /end CHARACTERISTIC
/begin CHARACTERISTIC ACCtl_tACPairHi_C "obere Hystereseschwelle für Umgebungstemperatur (Abschaltbedingung KÄLTEMITTELDRUCK)" VALUE 0x1C20A6 Kw_Ws16 6553.500 Temp_Cels -3549.940 3003.560 FORMAT "%8.3" /end CHARACTERISTIC
/begin CHARACTERISTIC ACCtl_tACPairLo_C "untere Hystereseschwelle für Umgebungstemperatur (Abschaltbedingung KÄLTEMITTELDRUCK)" VALUE 0x1C20A8 Kw_Ws16 6553.500 Temp_Cels -3549.940 3003.560 FORMAT "%8.3" /end CHARACTERISTIC
/begin CHARACTERISTIC ACCtl_tiAccAirMin_C "Mindestzeit die ACCtl_stLogicOut == 1 sein muß (Abschaltbedingung BESCHLEUNIGUNG)" VALUE 0x1C20AA Kw_Wu16 200000.0 Time_ms 0.00 200000.0 FORMAT "%8.1" EXTENDED_LIMITS 0.00 655350.0 /end CHARACTERISTIC
/begin CHARACTERISTIC ACCtl_tiAccMin_C "Mindestabschaltdauer durch Abschaltbedingung Beschleunigung" VALUE 0x1C20AC Kw_Wu16 200000.0 Time_ms 0.00 200000.0 FORMAT "%8.1" EXTENDED_LIMITS 0.00 655350.0 /end CHARACTERISTIC
/begin CHARACTERISTIC ACCtl_tiACOnDly_C "Klima EIN Verzögerung" VALUE 0x1C20AE Kw_Wu16 200000.0 Time_ms 0.00 200000.0 FORMAT "%8.1" EXTENDED_LIMITS 0.00 655350.0 /end CHARACTERISTIC
/begin CHARACTERISTIC ACCtl_tiACPmin_C "Mindestabschaltdauer durch Abschaltbedingung AC-KÄLTEMITTELDRUCK" VALUE 0x1C20B0 Kw_Wu16 200000.0 Time_ms 0.00 200000.0 FORMAT "%8.1" EXTENDED_LIMITS 0.00 655350.0 /end CHARACTERISTIC
/begin CHARACTERISTIC ACCtl_tiACStrtDly_CUR "Kennlinie: abhängig vom Klimadruck, die Startens der Klimaanlage zu bestimmen" CURVE 0x1C20B2 Kl_Xs16_Ws16 327570.0 Time_ms 0.00 327570.0 FORMAT "%8.1" EXTENDED_LIMITS -327680.0 327670.0
 /begin AXIS_DESCR STD_AXIS ACCD_p PresAC_hPa 4 0.00 50800.00 FORMAT "%8.2" EXTENDED_LIMITS -65536.00 65534.00 DEPOSIT ABSOLUTE /end AXIS_DESCR
/end CHARACTERISTIC
/begin CHARACTERISTIC ACCtl_tiCANESCU_C "Mindestabschaltdauer durch Abschaltbedingung CAN-ESCU" VALUE 0x1C20C4 Kw_Wu16 200000.0 Time_ms 0.00 200000.0 FORMAT "%8.1" EXTENDED_LIMITS 0.00 655350.0 /end CHARACTERISTIC
/begin CHARACTERISTIC ACCtl_tiCANGearbx_C "Mindestabschaltdauer durch Abschaltbedingung CAN-EGS" VALUE 0x1C20C6 Kw_Wu16 200000.0 Time_ms 0.00 200000.0 FORMAT "%8.1" EXTENDED_LIMITS 0.00 655350.0 /end CHARACTERISTIC
/begin CHARACTERISTIC ACCtl_tiDAmax_MAP "max Zeit für Abschalten AC beim Anfahren" MAP 0x1C20C8 Kf_Xs16_Ys16_Ws16 327570.0 Time_ms 0.00 327570.0 FORMAT "%8.1" EXTENDED_LIMITS -327680.0 327670.0
 /begin AXIS_DESCR STD_AXIS ACCtl_tACOff_mp Temp_Cels 4 -50.14000 199.8600 FORMAT "%8.4" EXTENDED_LIMITS -3549.940 3003.560 DEPOSIT ABSOLUTE /end AXIS_DESCR
 /begin AXIS_DESCR STD_AXIS APSCD_pVal Pres_hPa 4 0.00 3500.000 FORMAT "%8.3" EXTENDED_LIMITS -32768.00 32767.00 DEPOSIT ABSOLUTE /end AXIS_DESCR
/end CHARACTERISTIC
/begin CHARACTERISTIC ACCtl_tiDAmin_MAP "min Zeit für Abschalten AC beim Anfahren" MAP 0x1C20FC Kf_Xs16_Ys16_Ws16 327570.0 Time_ms 0.00 327570.0 FORMAT "%8.1" EXTENDED_LIMITS -327680.0 327670.0
 /begin AXIS_DESCR STD_AXIS ACCtl_tACOff_mp Temp_Cels 4 -50.14000 199.8600 FORMAT "%8.4" EXTENDED_LIMITS -3549.940 3003.560 DEPOSIT ABSOLUTE /end AXIS_DESCR
 /begin AXIS_DESCR STD_AXIS APSCD_pVal Pres_hPa 4 0.00 3500.000 FORMAT "%8.3" EXTENDED_LIMITS -32768.00 32767.00 DEPOSIT ABSOLUTE /end AXIS_DESCR
/end CHARACTERISTIC
/begin CHARACTERISTIC ACCtl_tiLIGov_C "Mindestabschaltdauer durch Abschaltbedingung UNTERSCHNEIDEN DER LEERLAUFDREHZAHL" VALUE 0x1C2130 Kw_Wu16 200000.0 Time_ms 0.00 200000.0 FORMAT "%8.1" EXTENDED_LIMITS 0.00 655350.0 /end CHARACTERISTIC
/begin CHARACTERISTIC ACCtl_tiMaxTSCfreezeReduction_C "maximale Einfrierzeit durch TSC Eingriff bei Leistungsreduzierung" VALUE 0x1C215C Kw_Ws16 200000.0 Time_ms 0.00 200000.0 FORMAT "%8.1" EXTENDED_LIMITS -327680.0 327670.0 /end CHARACTERISTIC
/begin CHARACTERISTIC ACCtl_tiMaxTSCfreeze_C "maximale Klimakompressorstatus - Einfrierzeit für TSC (EGS) Eingriff" VALUE 0x1C215E Kw_Ws16 200000.0 Time_ms 0.00 200000.0 FORMAT "%8.1" EXTENDED_LIMITS -327680.0 327670.0 /end CHARACTERISTIC
/begin CHARACTERISTIC ACCtl_tiMinSwitchOn_C "Mindesteinschaltdauer" VALUE 0x1C2160 Kw_Wu16 200000.0 Time_ms 0.00 200000.0 FORMAT "%8.1" EXTENDED_LIMITS 0.00 655350.0 /end CHARACTERISTIC
/begin CHARACTERISTIC ACCtl_tiMinSwitchReduction_C "Mindesteinschaltdauer für Leistungsdauer" VALUE 0x1C2162 Kw_Wu16 200000.0 Time_ms 0.00 200000.0 FORMAT "%8.1" EXTENDED_LIMITS 0.00 655350.0 /end CHARACTERISTIC
/begin CHARACTERISTIC ACCtl_tiSysErrmin_C "Mindestabschaltdauer durch Abschaltbedingung SYSTEM FEHLER" VALUE 0x1C2132 Kw_Wu16 200000.0 Time_ms 0.00 200000.0 FORMAT "%8.1" EXTENDED_LIMITS 0.00 655350.0 /end CHARACTERISTIC
/begin CHARACTERISTIC ACCtl_tiTempRedMin_C "minimale Zeit für Leistungsreduktion wegen Übertemperatur" VALUE 0x1C2134 Kw_Wu16 200000.0 Time_ms 0.00 200000.0 FORMAT "%8.1" EXTENDED_LIMITS 0.00 655350.0 /end CHARACTERISTIC
/begin CHARACTERISTIC ACCtl_tiWTmin_C "Mindestabschaltdauer durch Abschaltbedingung WASSERTEMPERATUR" VALUE 0x1C2136 Kw_Wu16 200000.0 Time_ms 0.00 200000.0 FORMAT "%8.1" EXTENDED_LIMITS 0.00 655350.0 /end CHARACTERISTIC
/begin CHARACTERISTIC ACCtl_tTempRedHi_C "obere Hystereseschwelle für Temperatur (Leistungsreduktion des  Klimakompressors)" VALUE 0x1C2138 Kw_Ws16 6553.500 Temp_Cels -3549.940 3003.560 FORMAT "%8.3" /end CHARACTERISTIC
/begin CHARACTERISTIC ACCtl_tTempRedLo_C "untere Hystereseschwelle für Temperatur (Leistungsreduktion des  Klimakompressors)" VALUE 0x1C213A Kw_Ws16 6553.500 Temp_Cels -3549.940 3003.560 FORMAT "%8.3" /end CHARACTERISTIC
/begin CHARACTERISTIC ACCtl_tWTHi_CUR "Geschwindigkeit / Temperatur Konverter - obere Hys. schwelle (Abschaltbedingung WASSERTEMPERATUR)" CURVE 0x1C213C Kl_Xs16_Ws16 200.0000 Temp_Cels -50.14000 149.8600 FORMAT "%8.4" EXTENDED_LIMITS -3549.940 3003.560
 /begin AXIS_DESCR STD_AXIS VSSCD_v Vel 3 0.00 300.0000 FORMAT "%8.4" EXTENDED_LIMITS -327.6800 327.6700 DEPOSIT ABSOLUTE /end AXIS_DESCR
/end CHARACTERISTIC
/begin CHARACTERISTIC ACCtl_tWTSubthresh_C "Hysteresebreite für Temperatur (aus Temperaturarray) Abschaltbedingung" VALUE 0x1C214A Kw_Ws16 6553.500 TempDiff_Kelv -3276.800 3276.700 FORMAT "%8.3" /end CHARACTERISTIC
/begin CHARACTERISTIC ACCtl_vAccVehHi_C "obere Hystereseschwelle für Fahrgeschwindigkeit (Abschaltbedingung BESCHLEUNIGUNG)" VALUE 0x1C214C Kw_Ws16 655.3500 Vel -327.6800 327.6700 FORMAT "%8.4" /end CHARACTERISTIC
/begin CHARACTERISTIC ACCtl_vAccVehLo_C "untere Hystereseschwelle für Fahrgeschwindigkeit (Abschaltbedingung BESCHLEUNIGUNG)" VALUE 0x1C214E Kw_Ws16 655.3500 Vel -327.6800 327.6700 FORMAT "%8.4" /end CHARACTERISTIC
/begin CHARACTERISTIC ACCtl_vDAVehHi_C "Obere Hysteresegrenze für Fahrzeuggeschwindigkeit" VALUE 0x1C2150 Kw_Ws16 655.3500 Vel -327.6800 327.6700 FORMAT "%8.4" /end CHARACTERISTIC
/begin CHARACTERISTIC ACCtl_vDAVehLo_C "Untere Hysteresegrenze für Fahrzeuggeschwindigkeit" VALUE 0x1C2152 Kw_Ws16 655.3500 Vel -327.6800 327.6700 FORMAT "%8.4" /end CHARACTERISTIC
/begin CHARACTERISTIC ACC_stCrCtl_Vector "Konfigurationslabel für Bypass" VALUE 0x1C0A10 Kw_Wu8 255.0 OneToOne 0.00 255.0 FORMAT "%5.1" /end CHARACTERISTIC
/begin CHARACTERISTIC ACC_stCrCtl_Channel "Konfigurationslabels für Bypass" VALUE 0x1C0A11 Kw_Wu8 255.0 OneToOne 0.00 255.0 FORMAT "%5.1" /end CHARACTERISTIC
/begin CHARACTERISTIC ACC_stDrvBrk_Vector "Konfigurationslabel für Bypass" VALUE 0x1C0A12 Kw_Wu8 255.0 OneToOne 0.00 255.0 FORMAT "%5.1" /end CHARACTERISTIC
/begin CHARACTERISTIC ACC_stDrvBrk_Channel "Konfigurationslabel für Bypass" VALUE 0x1C0A13 Kw_Wu8 255.0 OneToOne 0.00 255.0 FORMAT "%5.1" /end CHARACTERISTIC
/begin CHARACTERISTIC ACC_trqDes_Vector "Konfigurationslabel für Bypass" VALUE 0x1C0A14 Kw_Wu8 255.0 OneToOne 0.00 255.0 FORMAT "%5.1" /end CHARACTERISTIC
/begin CHARACTERISTIC ACC_trqDes_Channel "Konfigurationslabel für Bypass" VALUE 0x1C0A15 Kw_Wu8 255.0 OneToOne 0.00 255.0 FORMAT "%5.1" /end CHARACTERISTIC
/begin CHARACTERISTIC ACC_trqLead_Vector "Meßpunkt für Bypass" VALUE 0x1C0A16 Kw_Wu8 255.0 OneToOne 0.00 255.0 FORMAT "%5.1" /end CHARACTERISTIC
/begin CHARACTERISTIC ACC_trqLead_Channel "Konfigurationslabel für Bypass" VALUE 0x1C0A17 Kw_Wu8 255.0 OneToOne 0.00 255.0 FORMAT "%5.1" /end CHARACTERISTIC
/begin CHARACTERISTIC ACTrqC_tiDT1TrqDyn_C "Reziprokzeit T1 für DT1" VALUE 0x1C2164 Kw_Wu32 0.89999315 TimeDelay_s 0.099999239 0.99999239 FORMAT "%9.7" EXTENDED_LIMITS 0.0000010000000 4294.9673 /end CHARACTERISTIC
/begin CHARACTERISTIC ACTrqC_dDT1TrqDynfact_C "Verstärkungsfaktor für DT1" VALUE 0x1C2168 Kw_Ws32 0.00 Kd 1.00000000000 1.00000000000 FORMAT "%13.11" EXTENDED_LIMITS -32768.0000000 32767.9999847 /end CHARACTERISTIC
/begin CHARACTERISTIC ACTrqC_factDiv_C "Divisionsfaktor für Übersetzungsverhältnis (Motor / Kompressor)" VALUE 0x1C216C Kw_Ws16 255.0000 Fact1 0.00 255.0000 FORMAT "%8.4" EXTENDED_LIMITS -256.0000 255.9922 /end CHARACTERISTIC
/begin CHARACTERISTIC ACTrqC_factMul_C "Multiplikationsfaktor für Übersetzungsverhältnis (Motor / Kompressor)" VALUE 0x1C216E Kw_Ws16 255.0000 Fact1 0.00 255.0000 FORMAT "%8.4" EXTENDED_LIMITS -256.0000 255.9922 /end CHARACTERISTIC
/begin CHARACTERISTIC ACTrqC_swtCalc_C "Wert des Softwareschalters Eingangsgröße ACTrqC" VALUE 0x1C2170 Kw_Wu8 1.000 OneToOne 0.00 1.000 FORMAT "%5.3" EXTENDED_LIMITS 0.00 255.0 /end CHARACTERISTIC
/begin CHARACTERISTIC ACTrqC_swtCANtrq_C "Schalter für die Momentenanforderug via CAN" VALUE 0x1C2171 Kw_Wu8 255.0 OneToOne 0.00 255.0 FORMAT "%5.1" /end CHARACTERISTIC
/begin CHARACTERISTIC ACTrqC_trqConvp_MAP "Kennfeld für Reibmomentberechnung Über KÜhlmitteldruck" MAP 0x1C2172 Kf_Xs16_Ys16_Ws16 50.00000 Trq 0.00 50.00000 FORMAT "%8.5" EXTENDED_LIMITS -3276.800 3276.700
 /begin AXIS_DESCR STD_AXIS Eng_nAvrg EngN 8 0.00 6000.000 FORMAT "%8.3" EXTENDED_LIMITS -32768.00 32767.00 DEPOSIT ABSOLUTE /end AXIS_DESCR
 /begin AXIS_DESCR STD_AXIS ACCD_p PresAC_hPa 8 0.00 50800.00 FORMAT "%8.2" EXTENDED_LIMITS -65536.00 65534.00 DEPOSIT ABSOLUTE /end AXIS_DESCR
/end CHARACTERISTIC
/begin CHARACTERISTIC ACTrqC_trqConvt_MAP "Kennfeld für Reibmomentberechnung Über Luft-temperaturgeber" MAP 0x1C2216 Kf_Xs16_Ys16_Ws16 50.00000 Trq 0.00 50.00000 FORMAT "%8.5" EXTENDED_LIMITS -3276.800 3276.700
 /begin AXIS_DESCR STD_AXIS Eng_nAvrg EngN 8 0.00 6000.000 FORMAT "%8.3" EXTENDED_LIMITS -32768.00 32767.00 DEPOSIT ABSOLUTE /end AXIS_DESCR
 /begin AXIS_DESCR STD_AXIS IATSCD_tAir Temp_Cels 8 -50.14000 199.8600 FORMAT "%8.4" EXTENDED_LIMITS -3549.940 3003.560 DEPOSIT ABSOLUTE /end AXIS_DESCR
/end CHARACTERISTIC
/begin CHARACTERISTIC ADCMon_DebQueueDef_C "Fehlerentprellzeit für ADC-Queue-Fehler" VALUE 0x1C15FA Kw_Wu16 655350.0 Time_ms 0.00 655350.0 FORMAT "%8.1" /end CHARACTERISTIC
/begin CHARACTERISTIC ADCMon_DebRefVltgSRCDef_C "Fehlerentprellzeit für ADC-Referenzspannungsfehler" VALUE 0x1C15FC Kw_Wu16 655350.0 Time_ms 0.00 655350.0 FORMAT "%8.1" /end CHARACTERISTIC
/begin CHARACTERISTIC ADCMon_DebTstImpDef_C "Fehleranzahl für ADC-Testimpulsfehler (ereignisentprellt)" VALUE 0x1C15FE Kw_Wu16 65535.00 OneToOne 0.00 65535.00 FORMAT "%8.2" /end CHARACTERISTIC
/begin CHARACTERISTIC ADCMon_nQueueMon_C "Drehzahlschwelle für Ablaufkontrolle der ereignissynchronen ADC-Queueüberwachung" VALUE 0x1C1600 Kw_Ws16 6000.000 EngN 0.00 6000.000 FORMAT "%8.3" EXTENDED_LIMITS -32768.00 32767.00 /end CHARACTERISTIC
/begin CHARACTERISTIC ADCMon_swtHW_C "Hardware PIN Umschaltung" VALUE 0x1C1602 Kw_Wu8 1.000 OneToOne 0.00 1.000 FORMAT "%5.3" EXTENDED_LIMITS 0.00 255.0 /end CHARACTERISTIC
/begin CHARACTERISTIC ADCMon_tiQueueMon_C "Timeout für Ablaufkontrolle der ereignissynchronen ADC-Queueüberwachung" VALUE 0x1C1604 Kw_Wu16 1310700. Time_ms_20ms 0.00 1310700. FORMAT "%8.0" /end CHARACTERISTIC
/begin CHARACTERISTIC ADCMon_tiSendTstImp_C "Zeitabstand zwischen zwei ADC-Testimpulsen" VALUE 0x1C1606 Kw_Wu16 655330.0 Time_ms 20.00000 655350.0 FORMAT "%8.1" EXTENDED_LIMITS 0.00 655350.0 /end CHARACTERISTIC
/begin CHARACTERISTIC ADCMon_uRefSRCMax_C "Obere Grenze für ADC-Referenzspannung" VALUE 0x1C1608 Kw_Ws16 5200.391 Volt 0.00 5200.391 FORMAT "%8.3" EXTENDED_LIMITS -160156.4 160151.5 /end CHARACTERISTIC
/begin CHARACTERISTIC ADCMon_uRefSRCMin_C "Untere Grenze für ADC-Referenzspannung" VALUE 0x1C160A Kw_Ws16 5200.391 Volt 0.00 5200.391 FORMAT "%8.3" EXTENDED_LIMITS -160156.4 160151.5 /end CHARACTERISTIC
/begin CHARACTERISTIC ADCMon_uTstImpSRCMax_C "Obere Grenze für ADC-Testimpulsspannung" VALUE 0x1C160C Kw_Ws16 5200.391 Volt 0.00 5200.391 FORMAT "%8.3" EXTENDED_LIMITS -160156.4 160151.5 /end CHARACTERISTIC
/begin CHARACTERISTIC AddPCD_tiTnkLvlDebNeg_C "Entprellzeit für negative Flanken Additivtankleerschalter-Komponententreiber" VALUE 0x1C22F4 Kw_Wu16 2000.000 TimeDeb 0.00 2000.000 FORMAT "%8.3" EXTENDED_LIMITS 0.00 655350.0 /end CHARACTERISTIC
/begin CHARACTERISTIC AddPCD_tiTnkLvlDebPos_C "Entprellzeit für positive Flanken Additivtankleerschalter-Komponententreiber" VALUE 0x1C22F6 Kw_Wu16 2000.000 TimeDeb 0.00 2000.000 FORMAT "%8.3" EXTENDED_LIMITS 0.00 655350.0 /end CHARACTERISTIC
/begin CHARACTERISTIC AddPCD_tiDebSRCMaxDef_C "Entprellzeit für SRC-Max Fehler" VALUE 0x1C22F8 Kw_Wu16 655350.0 Time_ms 0.00 655350.0 FORMAT "%8.1" /end CHARACTERISTIC
/begin CHARACTERISTIC AddPCD_tiDebSRCMaxOk_C "Heilungsentprellzeit für SRC-Max Fehler" VALUE 0x1C22FA Kw_Wu16 655350.0 Time_ms 0.00 655350.0 FORMAT "%8.1" /end CHARACTERISTIC
/begin CHARACTERISTIC AddPCD_tiDebSRCMinDef_C "Entprellzeit für SRC-Min Fehler" VALUE 0x1C22FC Kw_Wu16 655350.0 Time_ms 0.00 655350.0 FORMAT "%8.1" /end CHARACTERISTIC
/begin CHARACTERISTIC AddPCD_tiDebSRCMinOk_C "Heilungsentprellzeit für SRC-Min Fehler" VALUE 0x1C22FE Kw_Wu16 655350.0 Time_ms 0.00 655350.0 FORMAT "%8.1" /end CHARACTERISTIC
/begin CHARACTERISTIC AddPCD_DebDefTnkLvl_C "Fehlerentprellzeit für Tank leer Fehler" VALUE 0x1C2300 Kw_Wu16 655350.0 Time_ms 0.00 655350.0 FORMAT "%8.1" /end CHARACTERISTIC
/begin CHARACTERISTIC AddPCD_DebOkTnkLvl_C "Heilungsentprellzeit für Tank leer Fehler" VALUE 0x1C2302 Kw_Wu16 655350.0 Time_ms 0.00 655350.0 FORMAT "%8.1" /end CHARACTERISTIC
/begin CHARACTERISTIC AddPCD_facStrkToVol_C "Kolbenhüber der Pumpe per Additivvolumen" VALUE 0x1C22BC Kw_Ws16 3276.700 stroke_pml 0.00 3276.700 FORMAT "%8.3" EXTENDED_LIMITS -3276.800 3276.700 /end CHARACTERISTIC
/begin CHARACTERISTIC AddPCD_stDflTnkLvl_C "Entprellter Ersatzwert des Leertankschalters bei endültigem" VALUE 0x1C2304 Kw_Wu8 1.000 OneToOne 0.00 1.000 FORMAT "%5.3" EXTENDED_LIMITS 0.00 255.0 /end CHARACTERISTIC
/begin CHARACTERISTIC AddPCD_stPwrStgActv_C "Spezifikation des Abschaltverhaltens der Endstufe" VALUE 0x1C22BE Kw_Wu8 255.0 OneToOne 0.00 255.0 FORMAT "%5.1" /end CHARACTERISTIC
/begin CHARACTERISTIC AddPCD_stPwrStgDia_C "Bit-Maske f.Deaktivierung Endstufendiagnose (0:immer aus 1:beim Start aus 2:im Nachlauf aus 3:aus bei niedriger Ubatt)" VALUE 0x1C22BF Kw_Wu8 255.0 OneToOne 0.00 255.0 FORMAT "%5.1" /end CHARACTERISTIC
/begin CHARACTERISTIC AddPCD_stTnkLvlInv_C "Invertierungsparameter des Eingangssignals Additivtankleerschalter-Komponententreiber" VALUE 0x1C2305 Kw_Wu8 1.000 OneToOne 0.00 1.000 FORMAT "%5.3" EXTENDED_LIMITS 0.00 255.0 /end CHARACTERISTIC
/begin CHARACTERISTIC AddPCD_swtTnkLvlSens_C "Tankleerschalter vorhanden (0 = NEIN; 1 = JA)" VALUE 0x1C2306 Kw_Wu8 1.000 OneToOne 0.00 1.000 FORMAT "%5.3" EXTENDED_LIMITS 0.00 255.0 /end CHARACTERISTIC
/begin CHARACTERISTIC AddPCD_tiDebExcTempDef_C "Additiv-Pumpe Entprellung Übertemperaturfehler defekt" VALUE 0x1C22C0 Kw_Wu16 655350.0 Time_ms 0.00 655350.0 FORMAT "%8.1" /end CHARACTERISTIC
/begin CHARACTERISTIC AddPCD_tiDebExcTempOk_C "Additiv-Pumpe Entprellung Übertemperaturfehler OK" VALUE 0x1C22C2 Kw_Wu16 655350.0 Time_ms 0.00 655350.0 FORMAT "%8.1" /end CHARACTERISTIC
/begin CHARACTERISTIC AddPCD_tiDebNoLoadDef_C "Additiv-Pumpe Entprellung Lastabfall defekt" VALUE 0x1C22C4 Kw_Wu16 655350.0 Time_ms 0.00 655350.0 FORMAT "%8.1" /end CHARACTERISTIC
/begin CHARACTERISTIC AddPCD_tiDebNoLoadOk_C "Additiv-Pumpe Entprellung Lastabfall OK" VALUE 0x1C22C6 Kw_Wu16 655350.0 Time_ms 0.00 655350.0 FORMAT "%8.1" /end CHARACTERISTIC
/begin CHARACTERISTIC AddPCD_tiDebShortCircBatDef_C "Additiv-Pumpe Entprellung KS Ubatt defekt" VALUE 0x1C22C8 Kw_Wu16 655350.0 Time_ms 0.00 655350.0 FORMAT "%8.1" /end CHARACTERISTIC
/begin CHARACTERISTIC AddPCD_tiDebShortCircBatOk_C "Additiv-Pumpe Entprellung KS Ubatt OK" VALUE 0x1C22CA Kw_Wu16 655350.0 Time_ms 0.00 655350.0 FORMAT "%8.1" /end CHARACTERISTIC
/begin CHARACTERISTIC AddPCD_tiDebShortCircGndDef_C "Additiv-Pumpe Entprellung KS Gnd defekt" VALUE 0x1C22CC Kw_Wu16 655350.0 Time_ms 0.00 655350.0 FORMAT "%8.1" /end CHARACTERISTIC
/begin CHARACTERISTIC AddPCD_tiDebShortCircGndOk_C "Additiv-Pumpe Entprellung KS Gnd OK" VALUE 0x1C22CE Kw_Wu16 655350.0 Time_ms 0.00 655350.0 FORMAT "%8.1" /end CHARACTERISTIC
/begin CHARACTERISTIC AddPCD_tiOn_CUR "Ausgangs-Puls Einschaltzeit = f(Ubatt)" CURVE 0x1C22D0 Kl_Xs16_Ws16 3000.000 Period 0.00 3000.000 FORMAT "%8.3" EXTENDED_LIMITS -3276.800 3276.700
 /begin AXIS_DESCR STD_AXIS BattCD_u Volt_Batt 8 0.00 20010.04 FORMAT "%8.2" EXTENDED_LIMITS -665674.1 665653.8 DEPOSIT ABSOLUTE /end AXIS_DESCR
/end CHARACTERISTIC
/begin CHARACTERISTIC AddPCD_tiStrkPer_C "Ausgangs-Puls Periodenzeit" VALUE 0x1C22F2 Kw_Ws16 3000.000 Period 0.00 3000.000 FORMAT "%8.3" EXTENDED_LIMITS -3276.800 3276.700 /end CHARACTERISTIC
/begin CHARACTERISTIC AddPCD_uSRCMin_C "Minimale Schwelle für SRC-Fehlererkennung" VALUE 0x1C2308 Kw_Ws16 5200.391 Volt 0.00 5200.391 FORMAT "%8.3" EXTENDED_LIMITS -160156.4 160151.5 /end CHARACTERISTIC
/begin CHARACTERISTIC AddPCD_uSRCMax_C "Maximale Schwelle für SRC-Fehlererkennung" VALUE 0x1C230A Kw_Ws16 5200.391 Volt 0.00 5200.391 FORMAT "%8.3" EXTENDED_LIMITS -160156.4 160151.5 /end CHARACTERISTIC
/begin CHARACTERISTIC AddPCD_stTnkLvlLin_CUR "Linearisierungskennlinie des Additivtankinhaltes" CURVE 0x1C230C Kl_Xs16_Ws16 5200.391 Volt 0.00 5200.391 FORMAT "%8.3" EXTENDED_LIMITS -160156.4 160151.5
 /begin AXIS_DESCR STD_AXIS AddPCD_uTnkLvlRawVal Volt 2 0.00 5200.391 FORMAT "%8.3" EXTENDED_LIMITS -160156.4 160151.5 DEPOSIT ABSOLUTE /end AXIS_DESCR
/end CHARACTERISTIC
/begin CHARACTERISTIC AddPCD_uHysHighTnkLvl_C "Obere Hystereseschwelle für Leertankschaltersignal aktiv" VALUE 0x1C2316 Kw_Ws16 320307.9 Volt -160156.4 160151.5 FORMAT "%8.1" /end CHARACTERISTIC
/begin CHARACTERISTIC AddPCD_uHysLowTnkLvl_C "Untere Hystereseschwelle für Leertankschaltersignal inaktiv" VALUE 0x1C2318 Kw_Ws16 320307.9 Volt -160156.4 160151.5 FORMAT "%8.1" /end CHARACTERISTIC
/begin CHARACTERISTIC AddPmp_rAdd_mp_Vector "Konfigurationslabel für Bypass message" VALUE 0x1C0A26 Kw_Wu8 255.0 OneToOne 0.00 255.0 FORMAT "%5.1" /end CHARACTERISTIC
/begin CHARACTERISTIC AddPmp_rAdd_mp_Channel "Konfigurationslabel für Bypass message" VALUE 0x1C0A27 Kw_Wu8 255.0 OneToOne 0.00 255.0 FORMAT "%5.1" /end CHARACTERISTIC
/begin CHARACTERISTIC AddPmp_swtAddReqd_C "Auswahl konstanter oder bedarfsgesteuerter Additivierung" VALUE 0x1C231C Kw_Wu8 1.000 OneToOne 0.00 1.000 FORMAT "%5.3" EXTENDED_LIMITS 0.00 255.0 /end CHARACTERISTIC
/begin CHARACTERISTIC AddPmp_swtServiceVal_C "Serviceschalters (Reinigung des Partikelfilters)" VALUE 0x1C231D Kw_Wu8 0.00 OneToOne 0.00 0.00 FORMAT "%5.2" EXTENDED_LIMITS 0.00 255.0 /end CHARACTERISTIC
/begin CHARACTERISTIC AddPmp_swtServiceType_C "Schalter zur Auswahl des Serviceschalters (Partikelfilterreinigung) vom Datensatz / EEPROM (2 = EEPROM)" VALUE 0x1C231E Kw_Wu8 1.000 OneToOne 1.000 2.000 FORMAT "%5.3" EXTENDED_LIMITS 0.00 255.0 /end CHARACTERISTIC
/begin CHARACTERISTIC AddPmp_volAddDemMax_C "Maximale Additivmenge einer Tankfüllung" VALUE 0x1C2320 Kw_Ws16 3276.700 volAdd_ml 0.00 3276.700 FORMAT "%8.3" EXTENDED_LIMITS -3276.800 3276.700 /end CHARACTERISTIC
/begin CHARACTERISTIC AddPmp_volAddDem_CUR "Kennlinie zur Ermittlung der Additivmenge" CURVE 0x1C2322 Kl_Xs16_Ws16 3276.700 volAdd_ml 0.00 3276.700 FORMAT "%8.3" EXTENDED_LIMITS -3276.800 3276.700
 /begin AXIS_DESCR STD_AXIS FlSys_volDetRefuel Fl_Half_L 4 0.00 300.0000 FORMAT "%8.4" EXTENDED_LIMITS -16384.00 16383.50 DEPOSIT ABSOLUTE /end AXIS_DESCR
/end CHARACTERISTIC
/begin CHARACTERISTIC AddPmp_volAddFirst_C "Auswahl der Additivmenge für die Entlüftung [ml]" VALUE 0x1C2334 Kw_Ws16 200.0000 volAdd_ml 0.00 200.0000 FORMAT "%8.4" EXTENDED_LIMITS -3276.800 3276.700 /end CHARACTERISTIC
/begin CHARACTERISTIC AddPmp_volAddTankMax_C "Max. Inhalt des Additivtankes" VALUE 0x1C2338 Kw_Ws32 2100000.00000 volAdd_ml_fine 0.00 2100000.00000 FORMAT "%13.5" EXTENDED_LIMITS -2147483.64800 2147483.64700 /end CHARACTERISTIC
/begin CHARACTERISTIC AddPmp_volAddTest_C "Auswahl der Additivmenge für den Stellgliedtest [ml]" VALUE 0x1C233C Kw_Ws16 2.000000 volAdd_ml_fine 0.00 2.000000 FORMAT "%8.6" EXTENDED_LIMITS -32.76800 32.76700 /end CHARACTERISTIC
/begin CHARACTERISTIC AddPmp_volAddTotDem_Vector "Konfigurationslabel für Bypass message" VALUE 0x1C0A28 Kw_Wu8 255.0 OneToOne 0.00 255.0 FORMAT "%5.1" /end CHARACTERISTIC
/begin CHARACTERISTIC AddPmp_volAddTotDem_Channel "Konfigurationslabel für Bypass message" VALUE 0x1C0A29 Kw_Wu8 255.0 OneToOne 0.00 255.0 FORMAT "%5.1" /end CHARACTERISTIC
/begin CHARACTERISTIC AddPmp_volDetRefuelMin_C "Min. erkannte Nachtankmenge damit eine Wunschadditivdosiermenge berechnet wird" VALUE 0x1C233E Kw_Ws16 300.0000 Fl_Half_L 0.00 300.0000 FORMAT "%8.4" EXTENDED_LIMITS -16384.00 16383.50 /end CHARACTERISTIC
/begin CHARACTERISTIC AFSCD_facSwtOnCor_C "MLB Anfangswert der HFM-Einschaltkorrektur" VALUE 0x1C2340 Kw_Ws16 3.000000 Fact 0.00 3.000000 FORMAT "%8.6" EXTENDED_LIMITS -4.000000 3.999878 /end CHARACTERISTIC
/begin CHARACTERISTIC AFSCD_tiDlySwtOnCor_C "MLB Zeitkonstante für die HFM-Einschaltkorrektur" VALUE 0x1C2342 Kw_Wu16 655140.0 Time_ms 0.00 655140.0 FORMAT "%8.1" EXTENDED_LIMITS 0.00 655350.0 /end CHARACTERISTIC
/begin CHARACTERISTIC AFSCD_stDcycInv_C "Schalter zur Invertierung des Tastverhältnisses der digitalen Lufttemperatur T1" VALUE 0x1C2700 Kw_Wu8 255.0 OneToOne 0.00 255.0 FORMAT "%5.1" /end CHARACTERISTIC
/begin CHARACTERISTIC AFSCD_tiRefSigPerMin_C "lower threshold for the SRC of the reference signal time period provided by the HFM6 sensor" VALUE 0x1C2702 Kw_Ws16 262.1400 Time_4us -131.0720 131.0680 FORMAT "%8.4" /end CHARACTERISTIC
/begin CHARACTERISTIC AFSCD_tiRefSigPerMax_C "upper threshold for the SRC of the reference signal time period for the HFM6 sensor" VALUE 0x1C2704 Kw_Ws16 262.1400 Time_4us -131.0720 131.0680 FORMAT "%8.4" /end CHARACTERISTIC
/begin CHARACTERISTIC AFSCD_dcycAirTempSigMin_C "minimum threshold for the SRC of the duty cycle of the air temperature signal from the HFM6 sensor" VALUE 0x1C2706 Kw_Ws16 655.3500 DtyCyc -327.6800 327.6700 FORMAT "%8.4" /end CHARACTERISTIC
/begin CHARACTERISTIC AFSCD_dcycAirTempSigMax_C "upper threshold for the SRC check of the duty cycle of the air temperature signal from the HFM6 sensor" VALUE 0x1C2708 Kw_Ws16 655.3500 DtyCyc -327.6800 327.6700 FORMAT "%8.4" /end CHARACTERISTIC
/begin CHARACTERISTIC AFSCD_DebPlHiOffsDrftDef_C "Fehlerentprellzeit fuer Plausibilitaetscheck des Offsetdrifts High" VALUE 0x1C2344 Kw_Wu16 655350.0 Time_ms 0.00 655350.0 FORMAT "%8.1" /end CHARACTERISTIC
/begin CHARACTERISTIC AFSCD_DebPlHiOffsDrftOk_C "Heilungsentprellzeit fuer Plausibilitaetscheck des Offsetdrifts High" VALUE 0x1C2346 Kw_Wu16 655350.0 Time_ms 0.00 655350.0 FORMAT "%8.1" /end CHARACTERISTIC
/begin CHARACTERISTIC AFSCD_DebPlHiSetyDrftDef_C "Defektentprellzeit für Plausibilisierung der oberen Luftmassnesensor-Empfindlichkeitsdriftgrenze" VALUE 0x1C276C Kw_Wu16 655350.0 Time_ms 0.00 655350.0 FORMAT "%8.1" /end CHARACTERISTIC
/begin CHARACTERISTIC AFSCD_DebPlHiSetyDrftOk_C "Heilungsentprellzeit für Plausibilisierung der oberen Luftmassensensor-Empfindlichkeitsdriftgrenze" VALUE 0x1C276E Kw_Wu16 655350.0 Time_ms 0.00 655350.0 FORMAT "%8.1" /end CHARACTERISTIC
/begin CHARACTERISTIC AFSCD_DebPlLoOffsDrftDef_C "LMM Plausibilitaet Offsetdrift HFM5 1ms Defekterkennungs-Zeit" VALUE 0x1C2348 Kw_Wu16 655350.0 Time_ms 0.00 655350.0 FORMAT "%8.1" /end CHARACTERISTIC
/begin CHARACTERISTIC AFSCD_DebPlLoOffsDrftOk_C "LMM Plausibilitaet Offsetdrift HFM5 1ms Intakterkennungs-Zeit" VALUE 0x1C234A Kw_Wu16 655350.0 Time_ms 0.00 655350.0 FORMAT "%8.1" /end CHARACTERISTIC
/begin CHARACTERISTIC AFSCD_DebPlLoSetyDrftDef_C "Defektentprellzeit für Plausibilisierung der unteren Luftmassensensor-Empfindlichkeitsdriftgrenze" VALUE 0x1C2770 Kw_Wu16 655350.0 Time_ms 0.00 655350.0 FORMAT "%8.1" /end CHARACTERISTIC
/begin CHARACTERISTIC AFSCD_DebPlLoSetyDrftOk_C "Heilungsentprellzeit für Plausibilisierung der unteren Luftmassensensor-Empfindlichkeitsdriftgrenze [ms]" VALUE 0x1C2772 Kw_Wu16 655350.0 Time_ms 0.00 655350.0 FORMAT "%8.1" /end CHARACTERISTIC
/begin CHARACTERISTIC AFSCD_DebRawAirmSigDef_C "defect debounce time for short circuit to battery, ground or signal cut-off error of the air mass signal" VALUE 0x1C234C Kw_Wu16 655350.0 Time_ms 0.00 655350.0 FORMAT "%8.1" /end CHARACTERISTIC
/begin CHARACTERISTIC AFSCD_DebRawAirmSigOk_C "defect healing time for short circuit to battery, ground or signal cut-off error of the air mass signal" VALUE 0x1C234E Kw_Wu16 655350.0 Time_ms 0.00 655350.0 FORMAT "%8.1" /end CHARACTERISTIC
/begin CHARACTERISTIC AFSCD_DebRefSigDef_C "defect debounce time for short circuit to battery, ground or signal cut-off error of the air temperature signal" VALUE 0x1C270A Kw_Wu16 655350.0 Time_ms 0.00 655350.0 FORMAT "%8.1" /end CHARACTERISTIC
/begin CHARACTERISTIC AFSCD_DebRefSigOk_C "defect healing time for short circuit to battery, ground or signal cut-off error of the air temperature signal" VALUE 0x1C270C Kw_Wu16 655350.0 Time_ms 0.00 655350.0 FORMAT "%8.1" /end CHARACTERISTIC
/begin CHARACTERISTIC AFSCD_DebSRCHiAirTempDef_C "defect debouncing time for the SRC high error for air temperature" VALUE 0x1C270E Kw_Wu16 655350.0 Time_ms 0.00 655350.0 FORMAT "%8.1" /end CHARACTERISTIC
/begin CHARACTERISTIC AFSCD_DebSRCHiAirTempOk_C "healing time for the SRC high error for the air temperature" VALUE 0x1C2710 Kw_Wu16 655350.0 Time_ms 0.00 655350.0 FORMAT "%8.1" /end CHARACTERISTIC
/begin CHARACTERISTIC AFSCD_DebSRCHiBattDef_C "defect debouncing time for the SRC high error for the battery voltage" VALUE 0x1C2350 Kw_Wu16 655350.0 Time_ms 0.00 655350.0 FORMAT "%8.1" /end CHARACTERISTIC
/begin CHARACTERISTIC AFSCD_DebSRCHiBattOk_C "healing time for the SRC high error for the battery voltage" VALUE 0x1C2352 Kw_Wu16 655350.0 Time_ms 0.00 655350.0 FORMAT "%8.1" /end CHARACTERISTIC
/begin CHARACTERISTIC AFSCD_DebSRCCorrAirmHiDef_C "defect debounce time for SRC high error of the corrected air mass signal" VALUE 0x1C2354 Kw_Wu16 655350.0 Time_ms 0.00 655350.0 FORMAT "%8.1" /end CHARACTERISTIC
/begin CHARACTERISTIC AFSCD_DebSRCCorrAirmHiOk_C "defect healing time for SRC high error of the corrected air mass signal" VALUE 0x1C2356 Kw_Wu16 655350.0 Time_ms 0.00 655350.0 FORMAT "%8.1" /end CHARACTERISTIC
/begin CHARACTERISTIC AFSCD_DebSRCRawAirmHiDef_C "defect debounce time for SRC high error of the raw air mass signal" VALUE 0x1C2358 Kw_Wu16 655350.0 Time_ms 0.00 655350.0 FORMAT "%8.1" /end CHARACTERISTIC
/begin CHARACTERISTIC AFSCD_DebSRCRawAirmHiOk_C "defect healing time for SRC high error of the raw air mass signal" VALUE 0x1C235A Kw_Wu16 655350.0 Time_ms 0.00 655350.0 FORMAT "%8.1" /end CHARACTERISTIC
/begin CHARACTERISTIC AFSCD_DebSRCRefSigHiDef_C "defect debounce time for SRC high error of the time period of the air temperature signal" VALUE 0x1C2712 Kw_Wu16 655350.0 Time_ms 0.00 655350.0 FORMAT "%8.1" /end CHARACTERISTIC
/begin CHARACTERISTIC AFSCD_DebSRCRefSigHiOk_C "defect healing time for SRC high error of the time period of the air temperature signal" VALUE 0x1C2714 Kw_Wu16 655350.0 Time_ms 0.00 655350.0 FORMAT "%8.1" /end CHARACTERISTIC
/begin CHARACTERISTIC AFSCD_DebSRCLoAirTempDef_C "defect debouncing time for the SRC low error for air temperature" VALUE 0x1C2716 Kw_Wu16 655350.0 Time_ms 0.00 655350.0 FORMAT "%8.1" /end CHARACTERISTIC
/begin CHARACTERISTIC AFSCD_DebSRCLoAirTempOk_C "healing time for the SRC low error for air temperature" VALUE 0x1C2718 Kw_Wu16 655350.0 Time_ms 0.00 655350.0 FORMAT "%8.1" /end CHARACTERISTIC
/begin CHARACTERISTIC AFSCD_DebSRCLoBattDef_C "defect debouncing time for the SRC low error for the battery voltage" VALUE 0x1C235C Kw_Wu16 655350.0 Time_ms 0.00 655350.0 FORMAT "%8.1" /end CHARACTERISTIC
/begin CHARACTERISTIC AFSCD_DebSRCLoBattOk_C "healing time for the SRC low error for the battery voltage" VALUE 0x1C235E Kw_Wu16 655350.0 Time_ms 0.00 655350.0 FORMAT "%8.1" /end CHARACTERISTIC
/begin CHARACTERISTIC AFSCD_DebSRCCorrAirmLoDef_C "defect debounce time for SRC low error of the corrected air mass signal" VALUE 0x1C2360 Kw_Wu16 655350.0 Time_ms 0.00 655350.0 FORMAT "%8.1" /end CHARACTERISTIC
/begin CHARACTERISTIC AFSCD_DebSRCCorrAirmLoOk_C "defect healing time for the SRC low error of the corrected air mass signal" VALUE 0x1C2362 Kw_Wu16 655350.0 Time_ms 0.00 655350.0 FORMAT "%8.1" /end CHARACTERISTIC
/begin CHARACTERISTIC AFSCD_DebSRCRawAirmLoDef_C "defect debounce time for the SRC low error of the raw air mass signal" VALUE 0x1C2364 Kw_Wu16 655350.0 Time_ms 0.00 655350.0 FORMAT "%8.1" /end CHARACTERISTIC
/begin CHARACTERISTIC AFSCD_DebSRCRawAirmLoOk_C "defect healing time for the SRC low error of the raw air mass signal" VALUE 0x1C2366 Kw_Wu16 655350.0 Time_ms 0.00 655350.0 FORMAT "%8.1" /end CHARACTERISTIC
/begin CHARACTERISTIC AFSCD_DebSRCRefSigLoDef_C "defect debounce time for SRC low error for the reference period time of air temperature signal" VALUE 0x1C271A Kw_Wu16 655350.0 Time_ms 0.00 655350.0 FORMAT "%8.1" /end CHARACTERISTIC
/begin CHARACTERISTIC AFSCD_DebSRCRefSigLoOk_C "defect healing time for the SRC low error of the reference signal time period of the air temperature signal" VALUE 0x1C271C Kw_Wu16 655350.0 Time_ms 0.00 655350.0 FORMAT "%8.1" /end CHARACTERISTIC
/begin CHARACTERISTIC AFSCD_DebSRCAirTempDcycMaxDef_C "defect debounce time for the SRC max error of the duty cycle of the air temperature signal" VALUE 0x1C271E Kw_Wu16 655350.0 Time_ms 0.00 655350.0 FORMAT "%8.1" /end CHARACTERISTIC
/begin CHARACTERISTIC AFSCD_DebSRCAirTempDcycMaxOk_C "defect healing time for the SRC max error of the duty cycle of air temperature signal" VALUE 0x1C2720 Kw_Wu16 655350.0 Time_ms 0.00 655350.0 FORMAT "%8.1" /end CHARACTERISTIC
/begin CHARACTERISTIC AFSCD_DebSRCAirTempDcycMinDef_C "defect debounce time for the SRC min error of the duty cycle of the air temperature signal" VALUE 0x1C2722 Kw_Wu16 655350.0 Time_ms 0.00 655350.0 FORMAT "%8.1" /end CHARACTERISTIC
/begin CHARACTERISTIC AFSCD_DebSRCAirTempDcycMinOk_C "defect healing time for SRC min error of the duty cycle of the air temperature signal" VALUE 0x1C2724 Kw_Wu16 655350.0 Time_ms 0.00 655350.0 FORMAT "%8.1" /end CHARACTERISTIC
/begin CHARACTERISTIC AFSCD_dmAirPerTimeDfl_C "Luftmasse pro Zeit Vorgabewert" VALUE 0x1C2368 Kw_Ws16 1000.000 AirMassPerTime 0.00 1000.000 FORMAT "%8.3" EXTENDED_LIMITS -3276.800 3276.700 /end CHARACTERISTIC
/begin CHARACTERISTIC AFSCD_dmAirPerTimeMax_C "maximum measurable air mass by the HFM6 sensor." VALUE 0x1C236C Kw_Ws32 429496729.500 AirMassPerTime -214748364.800 214748364.700 FORMAT "%13.3" /end CHARACTERISTIC
/begin CHARACTERISTIC AFSCD_dmAirPerTimeSclFac_C "scaling factor for the air mass" VALUE 0x1C2370 Kw_Wu16 6553.500 AirMassPerTime 0.00 6553.500 FORMAT "%8.3" /end CHARACTERISTIC
/begin CHARACTERISTIC AFSCD_dmAirSubsVal_MAP "Ersatzwert für Luftmassenstrom [kg/h]" MAP 0x1C2774 Kf_Xs16_Ys16_Ws16 1000.000 AirMassPerTime 0.00 1000.000 FORMAT "%8.3" EXTENDED_LIMITS -3276.800 3276.700
 /begin AXIS_DESCR STD_AXIS Eng_nAvrg EngN 16 0.00 6000.000 FORMAT "%8.3" EXTENDED_LIMITS -32768.00 32767.00 DEPOSIT ABSOLUTE /end AXIS_DESCR
 /begin AXIS_DESCR STD_AXIS InjCtl_qRaw InjMass 16 0.00 327.6700 FORMAT "%8.4" EXTENDED_LIMITS -327.6800 327.6700 DEPOSIT ABSOLUTE /end AXIS_DESCR
/end CHARACTERISTIC
/begin CHARACTERISTIC AFSCD_dmLin_CUR "Linearisierungkennline Sensorspannung in Luftmasse pro Zeit" CURVE 0x1C2372 Kl_Xs16_Ws16 1500.000 AirMassPerTime 0.00 1500.000 FORMAT "%8.3" EXTENDED_LIMITS -3276.800 3276.700
 /begin AXIS_DESCR STD_AXIS AFSCD_tiRaw Time_PwmHigh_Hfm6 57 40.00000 2000.000 FORMAT "%8.3" EXTENDED_LIMITS 0.00 6553.500 DEPOSIT ABSOLUTE /end AXIS_DESCR
/end CHARACTERISTIC
/begin CHARACTERISTIC AFSCD_facPerCor_C "rated correction factor for the raw air mass" VALUE 0x1C2458 Kw_Wu32 262143.999939 Fact_HFM6 0.00 262143.999939 FORMAT "%13.6" /end CHARACTERISTIC
/begin CHARACTERISTIC AFSCD_facPlsCor_MAP "Kennfeld für die Pulsationskorrektur" MAP 0x1C245C Kf_Xs16_Ys16_Ws16 1.000000 Fact 0.00 1.000000 FORMAT "%8.6" EXTENDED_LIMITS -4.000000 3.999878
 /begin AXIS_DESCR STD_AXIS Eng_nAvrg EngN 16 40.00000 6000.000 FORMAT "%8.3" EXTENDED_LIMITS -32768.00 32767.00 DEPOSIT ABSOLUTE /end AXIS_DESCR
 /begin AXIS_DESCR STD_AXIS InjCtl_qRaw InjMass 16 0.00 327.6700 FORMAT "%8.4" EXTENDED_LIMITS -327.6800 327.6700 DEPOSIT ABSOLUTE /end AXIS_DESCR
/end CHARACTERISTIC
/begin CHARACTERISTIC AFSCD_tiLPFiltPT1_C "Zeitkonstante fuer HFM Tiefpass-Filter" VALUE 0x1C26A0 Kw_Wu32 0.00 TimeDelay_ms 99.999239 99.999239 FORMAT "%9.5" EXTENDED_LIMITS 0.0010000000 4294967.3 /end CHARACTERISTIC
/begin CHARACTERISTIC AFSCD_tiThrHiPlOffsDrft_C "obere Schwelle der Plausibiltätsprüfung der Offsetdrift für HFM6" VALUE 0x1C26A4 Kw_Ws16 2000.000 Time_PwmHigh 0.00 2000.000 FORMAT "%8.3" EXTENDED_LIMITS -3276.800 3276.700 /end CHARACTERISTIC
/begin CHARACTERISTIC AFSCD_tiThrLoPlOffsDrft_C "untere Schwelle der Plausibiltätsprüfung der Offsetdrift für HFM6" VALUE 0x1C26A6 Kw_Ws16 2000.000 Time_PwmHigh 0.00 2000.000 FORMAT "%8.3" EXTENDED_LIMITS -3276.800 3276.700 /end CHARACTERISTIC
/begin CHARACTERISTIC AFSCD_tClntThrLo_C "Untere Kühlwassertemperaturschwelle für die Plausibilitätsprüfung der Driftempfindlichkeit des Luftmassenmessers" VALUE 0x1C29B8 Kw_Ws16 200.0000 Temp_Cels -50.14000 149.8600 FORMAT "%8.4" EXTENDED_LIMITS -3549.940 3003.560 /end CHARACTERISTIC
/begin CHARACTERISTIC AFSCD_tClntThrHi_C "Obere Kühlmitteltemperaturschwelle für Plausibilisierungsfreigabe der Luftmassensensor-Empfindlichkeitsdrift" VALUE 0x1C29BA Kw_Ws16 200.0000 Temp_Cels -50.14000 149.8600 FORMAT "%8.4" EXTENDED_LIMITS -3549.940 3003.560 /end CHARACTERISTIC
/begin CHARACTERISTIC AFSCD_rSwirlThrLo_C "Minimale Sollposition der Einlasskanalabschaltung für Plausibilisierungsfreigabe der Luftmassensensor-Empfindlichkeitsdrift" VALUE 0x1C29BC Kw_Ws16 100.0000 DtyCyc 0.00 100.0000 FORMAT "%8.4" EXTENDED_LIMITS -327.6800 327.6700 /end CHARACTERISTIC
/begin CHARACTERISTIC AFSCD_rSwirlThrHi_C "Maximale Sollpossition der Einlasskanalabschaltung für Plausibilisierungsfreigabe der  Luftmassensensor-Empfindlichkeitsdrift" VALUE 0x1C29BE Kw_Ws16 100.0000 DtyCyc 0.00 100.0000 FORMAT "%8.4" EXTENDED_LIMITS -327.6800 327.6700 /end CHARACTERISTIC
/begin CHARACTERISTIC AFSCD_rTVAThrLo_C "Minimale Sollposition des Drosselklappenstellers für Plausibilisierungsfreigabe der Luftmassensensor-Empfindlichkeitsdrift" VALUE 0x1C29C0 Kw_Ws16 100.0000 Prc 0.00 100.0000 FORMAT "%8.4" EXTENDED_LIMITS -327.6800 327.6700 /end CHARACTERISTIC
/begin CHARACTERISTIC AFSCD_rTVAThrHi_C "Maximale Sollposition des Drosselklappenstellers für Plausibilisierungsfreigabe der Luftmassensensor-Empfindlichkeitsdrift" VALUE 0x1C29C2 Kw_Ws16 100.0000 Prc 0.00 100.0000 FORMAT "%8.4" EXTENDED_LIMITS -327.6800 327.6700 /end CHARACTERISTIC
/begin CHARACTERISTIC AFSCD_pAirThrLo_C "untere Atmosphärendruckschwelle für die Plausibilitätsprüfung der Luftmassensensor-Empfindlichkeit" VALUE 0x1C29C4 Kw_Ws16 1000.000 Pres_hPa 500.0000 1500.000 FORMAT "%8.3" EXTENDED_LIMITS -32768.00 32767.00 /end CHARACTERISTIC
/begin CHARACTERISTIC AFSCD_qRawThrHi_C "Maximale Einspritzmenge für Plausibilisierungsfreigabe der Luftmassensensor-Empfindlichkeitsdrift" VALUE 0x1C29C6 Kw_Ws16 150.0000 InjMassCyc 0.00 150.0000 FORMAT "%8.4" EXTENDED_LIMITS -327.6800 327.6700 /end CHARACTERISTIC
/begin CHARACTERISTIC AFSCD_nAvrgThrLoPlHi_C "Untere Drehzahlschwelle für Plausibilisierung der oberen Luftmassensensor-Driftgrenze" VALUE 0x1C29C8 Kw_Ws16 6000.000 EngN 0.00 6000.000 FORMAT "%8.3" EXTENDED_LIMITS -32768.00 32767.00 /end CHARACTERISTIC
/begin CHARACTERISTIC AFSCD_nAvrgThrHiPlHi_C "Obere Drehzahlschwelle für Plausibilisierung der oberen Luftmassensensor-Driftgrenze" VALUE 0x1C29CA Kw_Ws16 6000.000 EngN 0.00 6000.000 FORMAT "%8.3" EXTENDED_LIMITS -32768.00 32767.00 /end CHARACTERISTIC
/begin CHARACTERISTIC AFSCD_pBstThrHiPlHi_C "Obere Ladedruckschwelle für Plausibilisierung der oberen Luftmassensensor-Driftgrenze" VALUE 0x1C29CC Kw_Ws16 3500.000 Pres_hPa 0.00 3500.000 FORMAT "%8.3" EXTENDED_LIMITS -32768.00 32767.00 /end CHARACTERISTIC
/begin CHARACTERISTIC AFSCD_rAirThrHiPlHi_C "Obere Normverhältnisschwelle für Plausibilisierung der oberen Luftmassensensor-Driftgrenze" VALUE 0x1C29CE Kw_Ws16 7.999878 Fact -4.000000 3.999878 FORMAT "%8.6" /end CHARACTERISTIC
/begin CHARACTERISTIC AFSCD_nAvrgThrLoPlLo_C "Untere Drehzahlschwelle für Plausibilisierung der unteren Luftmassensensor-Driftgrenze" VALUE 0x1C29D0 Kw_Ws16 6000.000 EngN 0.00 6000.000 FORMAT "%8.3" EXTENDED_LIMITS -32768.00 32767.00 /end CHARACTERISTIC
/begin CHARACTERISTIC AFSCD_nAvrgThrHiPlLo_C "Obere Drehzahlschwelle für Plausibilisierung der unteren Luftmassensensor-Driftgrenze" VALUE 0x1C29D2 Kw_Ws16 6000.000 EngN 0.00 6000.000 FORMAT "%8.3" EXTENDED_LIMITS -32768.00 32767.00 /end CHARACTERISTIC
/begin CHARACTERISTIC AFSCD_pBstThrLoPlLo_C "Untere Ladedruckschwelle für Plausibilisierung der unteren Luftmassensensor-Driftgrenze" VALUE 0x1C29D4 Kw_Ws16 3500.000 Pres_hPa 0.00 3500.000 FORMAT "%8.3" EXTENDED_LIMITS -32768.00 32767.00 /end CHARACTERISTIC
/begin CHARACTERISTIC AFSCD_rAirThrLoPlLo_C "Untere Normverhältnisschwelle für Plausibilisierung der unteren Luftmassensensor-Driftgrenze" VALUE 0x1C29D6 Kw_Ws16 7.999878 Fact -4.000000 3.999878 FORMAT "%8.6" /end CHARACTERISTIC
/begin CHARACTERISTIC AFSCD_rEGRPThrHi_C "Obere Schwelle der Stellgröße des AGR-Ventils für Plausibilisierungsfreigabe der Luftmassensensor-Empfindlichkeitsdrift" VALUE 0x1C29D8 Kw_Ws16 400.0000 Prc -200.0000 200.0000 FORMAT "%8.4" EXTENDED_LIMITS -327.6800 327.6700 /end CHARACTERISTIC
/begin CHARACTERISTIC AFSCD_tiDlyEGRPPlSetyDrft_C "Verzögerungszeit nach Veränderung der Abgasrückführung für Plausibilisierungsfreigabe der Luftmassensensor-Empfindlichkeitsdrift" VALUE 0x1C29DA Kw_Wu16 65540.00 Time_ms 0.00 65540.00 FORMAT "%8.2" EXTENDED_LIMITS 0.00 655350.0 /end CHARACTERISTIC
/begin CHARACTERISTIC AFSCD_tiDlyStrPlSetyDrft_C "Verzögerungszeit nach Motorstart für Plausibilisierungsfreigabe der Luftmassensensor-Empfindlichkeitsdrift" VALUE 0x1C29DC Kw_Wu16 65540.00 Time_ms 0.00 65540.00 FORMAT "%8.2" EXTENDED_LIMITS 0.00 655350.0 /end CHARACTERISTIC
/begin CHARACTERISTIC AFSCD_dtAirThres_C "Schwelle für Änderungsrate der Ladelufttemperatur" VALUE 0x1C29DE Kw_Ws16 65535.00 TempCels_100ms -32768.00 32767.00 FORMAT "%8.2" /end CHARACTERISTIC
/begin CHARACTERISTIC AFSCD_stInhRls_C "Bitmaske zur Unterdrückung der Plausibilisierung der Luftmassensensor-Empfindlichkeitsdrift bei Stellertest" VALUE 0x1C29E0 Kw_Wu16 65535.00 OneToOne 0.00 65535.00 FORMAT "%8.2" /end CHARACTERISTIC
/begin CHARACTERISTIC AFSCD_tiPT1_C "Zeitkonstante für PT1-Filter" VALUE 0x1C2728 Kw_Wu32 4294.9673 TimeDelay_s 0.0000010000000 4294.9673 FORMAT "%9.4" /end CHARACTERISTIC
/begin CHARACTERISTIC AFSCD_qAirmThrSRCHiActv_CUR "Mengenschwelle fuer SRC High der Luftmasse" CURVE 0x1C26A8 Kl_Xs16_Ws16 327.6700 InjMassCyc 0.00 327.6700 FORMAT "%8.4" EXTENDED_LIMITS -327.6800 327.6700
 /begin AXIS_DESCR STD_AXIS Eng_nAvrg EngN 12 0.00 6000.000 FORMAT "%8.3" EXTENDED_LIMITS -32768.00 32767.00 DEPOSIT ABSOLUTE /end AXIS_DESCR
/end CHARACTERISTIC
/begin CHARACTERISTIC AFSCD_dtRmpSlpUp_C "Ansauglufttemperatur (HFM): Rampensteigung bei Heilung/Vorgabewert für Lufttemperatur" VALUE 0x1C272C Kw_Wu32 6553589.99786 RmpTemp 10.0006103516 6553599.99847 FORMAT "%13.5" EXTENDED_LIMITS 0.00 6553599.99847 /end CHARACTERISTIC
/begin CHARACTERISTIC AFSCD_dtRmpSlpDwn_C "Ansauglufttemperatur (HFM): Rampensteigung bei Heilung/Vorgabewert für Lufttemperatur" VALUE 0x1C2730 Kw_Wu32 6553589.99786 RmpTemp 10.0006103516 6553599.99847 FORMAT "%13.5" EXTENDED_LIMITS 0.00 6553599.99847 /end CHARACTERISTIC
/begin CHARACTERISTIC AFSCD_nAvrgThrLoSRCLo_C "unterer Drehzahlschwellwert fuer den SRC Low der Luftmasse" VALUE 0x1C26DA Kw_Ws16 6000.000 EngN 0.00 6000.000 FORMAT "%8.3" EXTENDED_LIMITS -32768.00 32767.00 /end CHARACTERISTIC
/begin CHARACTERISTIC AFSCD_nAvrgThrHiSRCLo_C "oberer Drehzahlschwellwert fuer den SRC Low der Luftmasse" VALUE 0x1C26DC Kw_Ws16 6000.000 EngN 0.00 6000.000 FORMAT "%8.3" EXTENDED_LIMITS -32768.00 32767.00 /end CHARACTERISTIC
/begin CHARACTERISTIC AFSCD_tiDlyActvSRCHiAirm_C "Zeitkonstante fuer die Fehlererkennung des SRC High des Luftmassenmessers" VALUE 0x1C26DE Kw_Wu16 65540.00 Time_ms 0.00 65540.00 FORMAT "%8.2" EXTENDED_LIMITS 0.00 655350.0 /end CHARACTERISTIC
/begin CHARACTERISTIC AFSCD_stAirmErrDet_C "Fehlererkennungslabel in AFSCD_Co" VALUE 0x1C26E0 Kw_Wu8 255.0 OneToOne 0.00 255.0 FORMAT "%5.1" /end CHARACTERISTIC
/begin CHARACTERISTIC AFSCD_stAirTempErrDet_C "Fehlererkennungslabel in AFSCD_Co_T1" VALUE 0x1C2734 Kw_Wu8 255.0 OneToOne 0.00 255.0 FORMAT "%5.1" /end CHARACTERISTIC
/begin CHARACTERISTIC AFSCD_swtOffsTstSel_C "Auswahlschalter zwischen Offsetdrifttest im START oder AFTERRUN state." VALUE 0x1C26E1 Kw_Wu8 255.0 OneToOne 0.00 255.0 FORMAT "%5.1" /end CHARACTERISTIC
/begin CHARACTERISTIC AFSCD_swtOscSel_C "switch to select whether the HFM6 sensor is operated with an RC or a quartz oscillator" VALUE 0x1C26E2 Kw_Wu16 65535.00 OneToOne 0.00 65535.00 FORMAT "%8.2" /end CHARACTERISTIC
/begin CHARACTERISTIC AFSCD_swtSensInstVal_C "Schalter zur Bestimmung, ob der Luftmassensensor vorhanden ist oder nicht" VALUE 0x1C29E2 Kw_Wu8 1.000 OneToOne 0.00 1.000 FORMAT "%5.3" EXTENDED_LIMITS 0.00 255.0 /end CHARACTERISTIC
/begin CHARACTERISTIC AFSCD_swtSensInstType_C "Definition des SW-Schaltertyps (0=Datensatzwert, nicht applizierbar/1=EEPROM-Wert/2=Datensatzwert)" VALUE 0x1C29E3 Kw_Wu8 1.000 OneToOne 1.000 2.000 FORMAT "%5.3" EXTENDED_LIMITS 0.00 255.0 /end CHARACTERISTIC
/begin CHARACTERISTIC AFSCD_tAirThrSRCHi_C "upper threshold for SRC of physical air temperature value" VALUE 0x1C2736 Kw_Ws16 250.0000 Temp_Cels -50.14000 199.8600 FORMAT "%8.4" EXTENDED_LIMITS -3549.940 3003.560 /end CHARACTERISTIC
/begin CHARACTERISTIC AFSCD_tAirThrSRCLo_C "lower threshold for the SRC of the physical air temperature" VALUE 0x1C2738 Kw_Ws16 250.0000 Temp_Cels -50.14000 199.8600 FORMAT "%8.4" EXTENDED_LIMITS -3549.940 3003.560 /end CHARACTERISTIC
/begin CHARACTERISTIC AFSCD_tiCorrSRCHi_C "upper threshold for the SRC of the corrected air mass signal for the HFM6 sensor." VALUE 0x1C26E4 Kw_Ws32 2000.00000000 Time_PwmHigh 0.00 2000.00000000 FORMAT "%13.8" EXTENDED_LIMITS -214748364.800 214748364.700 /end CHARACTERISTIC
/begin CHARACTERISTIC AFSCD_tiCorrSRCLo_C "lower threshold for the SRC of the corrected air mass for the HFM6 sensor" VALUE 0x1C26E8 Kw_Ws32 2000.00000000 Time_PwmHigh 0.00 2000.00000000 FORMAT "%13.8" EXTENDED_LIMITS -214748364.800 214748364.700 /end CHARACTERISTIC
/begin CHARACTERISTIC AFSCD_tiOffsDrftTstDel_C "Verzögerungszeit im Nachlauf vor der Plausibilitätsprüfung der Offsetdrift" VALUE 0x1C26EC Kw_Wu16 655140.0 Time_ms 0.00 655140.0 FORMAT "%8.1" EXTENDED_LIMITS 0.00 655350.0 /end CHARACTERISTIC
/begin CHARACTERISTIC AFSCD_tiOffsDrftTstLim_C "Zeitdauer für die Plausibilitätsprüfung der Offsetdrift im Nachlauf" VALUE 0x1C26EE Kw_Wu16 655350.0 Time_ms 0.00 655350.0 FORMAT "%8.1" /end CHARACTERISTIC
/begin CHARACTERISTIC AFSCD_tiPerHFM6_C "time constant of the HFM6 sensor electronics" VALUE 0x1C26F0 Kw_Wu32 1048.57599976 Time_Period_HFM6 0.00 1048.57599976 FORMAT "%13.8" /end CHARACTERISTIC
/begin CHARACTERISTIC AFSCD_tiRawSRCHi_C "upper threshold for the SRC of the raw air mass signal for HFM6 sensor" VALUE 0x1C26F4 Kw_Ws32 2000.00000000 Time_PwmHigh 0.00 2000.00000000 FORMAT "%13.8" EXTENDED_LIMITS -214748364.800 214748364.700 /end CHARACTERISTIC
/begin CHARACTERISTIC AFSCD_tiRawSRCLo_C "lower threshold for the SRC of the raw air mass signal for HFM6 sensor" VALUE 0x1C26F8 Kw_Ws32 2000.00000000 Time_PwmHigh 0.00 2000.00000000 FORMAT "%13.8" EXTENDED_LIMITS -214748364.800 214748364.700 /end CHARACTERISTIC
/begin CHARACTERISTIC AFSCD_tLin_CUR "Ansauglufttemperatur T1: Linearisierungskennlinie Spannung nach Luftmassenrohwert" CURVE 0x1C273A Kl_Xs16_Ws16 250.0000 Temp_Cels -50.14000 199.8600 FORMAT "%8.4" EXTENDED_LIMITS -3549.940 3003.560
 /begin AXIS_DESCR STD_AXIS AFSCD_rAir DtyCyc 11 0.00 100.0000 FORMAT "%8.4" EXTENDED_LIMITS -327.6800 327.6700 DEPOSIT ABSOLUTE /end AXIS_DESCR
/end CHARACTERISTIC
/begin CHARACTERISTIC AFSCD_stSensIDWordAirTemp_C "Einstellung für das Übergangsverhalten der Lufttemperatur im Fehlerfall" VALUE 0x1C2768 Kw_Wu16 65535.00 OneToOne 0.00 65535.00 FORMAT "%8.2" /end CHARACTERISTIC
/begin CHARACTERISTIC AFSCD_tDfl_C "Ansauglufttemperatur (HFM): Vorgabewert der HFM-Lufttemperatur" VALUE 0x1C276A Kw_Ws16 6553.500 Temp_Cels -3549.940 3003.560 FORMAT "%8.3" /end CHARACTERISTIC
/begin CHARACTERISTIC AFSCD_uBattSRCMax_C "obere Schwelle für Prüfung der optimalen Batteriespannung" VALUE 0x1C26FC Kw_Wu16 27993.74 Volt_Batt 0.00 27993.74 FORMAT "%8.2" EXTENDED_LIMITS 0.00 1331328. /end CHARACTERISTIC
/begin CHARACTERISTIC AFSCD_uBattSRCMin_C "untere Schwelle für Prüfung der optimalen Batteriespannung" VALUE 0x1C26FE Kw_Ws16 27993.74 Volt_Batt 0.00 27993.74 FORMAT "%8.2" EXTENDED_LIMITS -665674.1 665653.8 /end CHARACTERISTIC
/begin CHARACTERISTIC AFVCD_DebExcTempDef_C "Fehlerentprellzeit Übertemperatur" VALUE 0x1C29E4 Kw_Wu16 655350.0 Time_ms 0.00 655350.0 FORMAT "%8.1" /end CHARACTERISTIC
/begin CHARACTERISTIC AFVCD_DebExcTempOk_C "Heilungsentprellzeit Übertemperatur" VALUE 0x1C29E6 Kw_Wu16 655350.0 Time_ms 0.00 655350.0 FORMAT "%8.1" /end CHARACTERISTIC
/begin CHARACTERISTIC AFVCD_DebNoLdDef_C "Fehlerentprellzeit keine Last" VALUE 0x1C29E8 Kw_Wu16 655350.0 Time_ms 0.00 655350.0 FORMAT "%8.1" /end CHARACTERISTIC
/begin CHARACTERISTIC AFVCD_DebNoLdOk_C "Heilungsentprellzeit keine Last" VALUE 0x1C29EA Kw_Wu16 655350.0 Time_ms 0.00 655350.0 FORMAT "%8.1" /end CHARACTERISTIC
/begin CHARACTERISTIC AFVCD_DebShCirBattDef_C "Fehlerentprellzeit Kurzschluß nach Batterie" VALUE 0x1C29EC Kw_Wu16 655350.0 Time_ms 0.00 655350.0 FORMAT "%8.1" /end CHARACTERISTIC
/begin CHARACTERISTIC AFVCD_DebShCirBattOk_C "Heilungsentprellzeit Kurzschluß nach Batterie" VALUE 0x1C29EE Kw_Wu16 655350.0 Time_ms 0.00 655350.0 FORMAT "%8.1" /end CHARACTERISTIC
/begin CHARACTERISTIC AFVCD_DebShCirGndDef_C "Fehlerentprellzeit Kurzschluß nach Masse" VALUE 0x1C29F0 Kw_Wu16 655350.0 Time_ms 0.00 655350.0 FORMAT "%8.1" /end CHARACTERISTIC
/begin CHARACTERISTIC AFVCD_DebShCirGndOk_C "Heilungsentprellzeit Kurzschluß nach Masse" VALUE 0x1C29F2 Kw_Wu16 655350.0 Time_ms 0.00 655350.0 FORMAT "%8.1" /end CHARACTERISTIC
/begin CHARACTERISTIC AFVCD_stActrInvOut_C "Invertierung des Ausgangs" VALUE 0x1C29F4 Kw_Wu8 1.000 OneToOne 0.00 1.000 FORMAT "%5.3" EXTENDED_LIMITS 0.00 255.0 /end CHARACTERISTIC
/begin CHARACTERISTIC AFVCD_stPwrStgActrActv_C "Statuswort zu Spezifikation des Abschaltverhaltens der Actr-Endstufe" VALUE 0x1C29F5 Kw_Wu8 255.0 OneToOne 0.00 255.0 FORMAT "%5.1" /end CHARACTERISTIC
/begin CHARACTERISTIC AFVCD_stPwrStgActrDia_C "such Statuswort zu Spezifikation des Abschaltverhaltens der Actr-Endstufendiagnose" VALUE 0x1C29F6 Kw_Wu8 255.0 OneToOne 0.00 255.0 FORMAT "%5.1" /end CHARACTERISTIC
/begin CHARACTERISTIC AFVCtl_dmAcouHighOff_C "Obere Schwelle für die Hysterese-Hoch => Akustikfunktion" VALUE 0x1C29F8 Kw_Ws16 2000.000 AirMassPerTime -1000.000 1000.000 FORMAT "%8.3" EXTENDED_LIMITS -3276.800 3276.700 /end CHARACTERISTIC
/begin CHARACTERISTIC AFVCtl_dmAcouHighOn_C "Untere Schwelle für die Hysterese-Hoch => Akustikfunktion" VALUE 0x1C29FA Kw_Ws16 2000.000 AirMassPerTime -1000.000 1000.000 FORMAT "%8.3" EXTENDED_LIMITS -3276.800 3276.700 /end CHARACTERISTIC
/begin CHARACTERISTIC AFVCtl_dmAcouLowOff_C "Untere Schwelle für die Hysterese-Niedrig => Akustikfunktion" VALUE 0x1C29FC Kw_Ws16 2000.000 AirMassPerTime -1000.000 1000.000 FORMAT "%8.3" EXTENDED_LIMITS -3276.800 3276.700 /end CHARACTERISTIC
/begin CHARACTERISTIC AFVCtl_dmAcouLowOn_C "Obere Schwelle für die Hysterese-Niedrig => Akustikfunktion" VALUE 0x1C29FE Kw_Ws16 2000.000 AirMassPerTime -1000.000 1000.000 FORMAT "%8.3" EXTENDED_LIMITS -3276.800 3276.700 /end CHARACTERISTIC
/begin CHARACTERISTIC AFVCtl_dmHeightOff_C "Untere Schwelle für die Hysterese => Höhenfunktion" VALUE 0x1C2A00 Kw_Ws16 2000.000 AirMassPerTime -1000.000 1000.000 FORMAT "%8.3" EXTENDED_LIMITS -3276.800 3276.700 /end CHARACTERISTIC
/begin CHARACTERISTIC AFVCtl_dmHeightOn_C "Obere Schwelle für die Hysterese => Höhenfunktion" VALUE 0x1C2A02 Kw_Ws16 2000.000 AirMassPerTime -1000.000 1000.000 FORMAT "%8.3" EXTENDED_LIMITS -3276.800 3276.700 /end CHARACTERISTIC
/begin CHARACTERISTIC AFVCtl_dmPwrOff_C "Untere Schwelle für die Hysterese => Leistungsfunktion" VALUE 0x1C2A04 Kw_Ws16 2000.000 AirMassPerTime -1000.000 1000.000 FORMAT "%8.3" EXTENDED_LIMITS -3276.800 3276.700 /end CHARACTERISTIC
/begin CHARACTERISTIC AFVCtl_dmPwrOn_C "Obere Schwelle für die Hysterese => Leistungsfunktion" VALUE 0x1C2A06 Kw_Ws16 2000.000 AirMassPerTime -1000.000 1000.000 FORMAT "%8.3" EXTENDED_LIMITS -3276.800 3276.700 /end CHARACTERISTIC
/begin CHARACTERISTIC AFVCtl_dmRainHighOff_C "Obere Schwelle für die Hysterese-Hoch" VALUE 0x1C2A08 Kw_Ws16 2000.000 AirMassPerTime -1000.000 1000.000 FORMAT "%8.3" EXTENDED_LIMITS -3276.800 3276.700 /end CHARACTERISTIC
/begin CHARACTERISTIC AFVCtl_dmRainHighOn_C "Untere Schwelle für die Hysterese-Hoch" VALUE 0x1C2A0A Kw_Ws16 2000.000 AirMassPerTime -1000.000 1000.000 FORMAT "%8.3" EXTENDED_LIMITS -3276.800 3276.700 /end CHARACTERISTIC
/begin CHARACTERISTIC AFVCtl_dmRainLowOff_C "Untere Schwelle für die Hysterese-Niedrig" VALUE 0x1C2A0C Kw_Ws16 2000.000 AirMassPerTime -1000.000 1000.000 FORMAT "%8.3" EXTENDED_LIMITS -3276.800 3276.700 /end CHARACTERISTIC
/begin CHARACTERISTIC AFVCtl_dmRainLowOn_C "Obere Schwelle für die Hysterese-Niedrig" VALUE 0x1C2A0E Kw_Ws16 2000.000 AirMassPerTime -1000.000 1000.000 FORMAT "%8.3" EXTENDED_LIMITS -3276.800 3276.700 /end CHARACTERISTIC
/begin CHARACTERISTIC AFVCtl_dmSnowHighOff_C "Obere Schwelle für die Hysterese-Hoch => Schneefunktion" VALUE 0x1C2A10 Kw_Ws16 2000.000 AirMassPerTime -1000.000 1000.000 FORMAT "%8.3" EXTENDED_LIMITS -3276.800 3276.700 /end CHARACTERISTIC
/begin CHARACTERISTIC AFVCtl_dmSnowHighOn_C "Untere Schwelle für die Hysterese-Hoch => Schneefunktion" VALUE 0x1C2A12 Kw_Ws16 2000.000 AirMassPerTime -1000.000 1000.000 FORMAT "%8.3" EXTENDED_LIMITS -3276.800 3276.700 /end CHARACTERISTIC
/begin CHARACTERISTIC AFVCtl_dmSnowLowOff_C "Untere Schwelle für die Hysterese-Niedrig => Schneefunktion" VALUE 0x1C2A14 Kw_Ws16 2000.000 AirMassPerTime -1000.000 1000.000 FORMAT "%8.3" EXTENDED_LIMITS -3276.800 3276.700 /end CHARACTERISTIC
/begin CHARACTERISTIC AFVCtl_dmSnowLowOn_C "Obere Schwelle für die Hysterese-Niedrig => Schneefunktion" VALUE 0x1C2A16 Kw_Ws16 2000.000 AirMassPerTime -1000.000 1000.000 FORMAT "%8.3" EXTENDED_LIMITS -3276.800 3276.700 /end CHARACTERISTIC
/begin CHARACTERISTIC AFVCtl_nAcouHighOff_C "Obere Schwelle für die Hysterese-Hoch => Akustikfunktion" VALUE 0x1C2A18 Kw_Ws16 5960.000 EngN 40.00000 6000.000 FORMAT "%8.3" EXTENDED_LIMITS -32768.00 32767.00 /end CHARACTERISTIC
/begin CHARACTERISTIC AFVCtl_nAcouHighOn_C "Untere Schwelle für die Hysterese-Hoch => Akustikfunktion" VALUE 0x1C2A1A Kw_Ws16 5960.000 EngN 40.00000 6000.000 FORMAT "%8.3" EXTENDED_LIMITS -32768.00 32767.00 /end CHARACTERISTIC
/begin CHARACTERISTIC AFVCtl_nAcouLowOff_C "Untere Schwelle für die Hysterese-Niedrig => Akustikfunktion" VALUE 0x1C2A1C Kw_Ws16 5960.000 EngN 40.00000 6000.000 FORMAT "%8.3" EXTENDED_LIMITS -32768.00 32767.00 /end CHARACTERISTIC
/begin CHARACTERISTIC AFVCtl_nAcouLowOn_C "Obere Schwelle für die Hysterese-Niedrig => Akustikfunktion" VALUE 0x1C2A1E Kw_Ws16 5960.000 EngN 40.00000 6000.000 FORMAT "%8.3" EXTENDED_LIMITS -32768.00 32767.00 /end CHARACTERISTIC
/begin CHARACTERISTIC AFVCtl_pHeightOff_C "Obere Schwelle für die Hysterese => Höhenfunktion" VALUE 0x1C2A20 Kw_Ws16 3500.000 Pres_hPa 0.00 3500.000 FORMAT "%8.3" EXTENDED_LIMITS -32768.00 32767.00 /end CHARACTERISTIC
/begin CHARACTERISTIC AFVCtl_pHeightOn_C "Untere Schwelle für die Hysterese => Höhenfunktion" VALUE 0x1C2A22 Kw_Ws16 3500.000 Pres_hPa 0.00 3500.000 FORMAT "%8.3" EXTENDED_LIMITS -32768.00 32767.00 /end CHARACTERISTIC
/begin CHARACTERISTIC AFVCtl_tiRainWiperHoldNeg_C "Entprellzeit für Scheibenwischer AUS" VALUE 0x1C2A24 Kw_Wu16 655350.0 TimeDeb 0.00 655350.0 FORMAT "%8.1" /end CHARACTERISTIC
/begin CHARACTERISTIC AFVCtl_tiRainWiperHoldPos_C "Entprellzeit für Scheibenwischer EIN" VALUE 0x1C2A26 Kw_Wu16 655350.0 TimeDeb 0.00 655350.0 FORMAT "%8.1" /end CHARACTERISTIC
/begin CHARACTERISTIC AFVCtl_tAirSnowOff_C "Obere Schwelle für die Hysterese => Schneefunktion" VALUE 0x1C2A28 Kw_Ws16 250.0000 Temp_Cels -50.14000 199.8600 FORMAT "%8.4" EXTENDED_LIMITS -3549.940 3003.560 /end CHARACTERISTIC
/begin CHARACTERISTIC AFVCtl_tAirSnowOn_C "Untere Schwelle für die Hysterese => Schneefunktion" VALUE 0x1C2A2A Kw_Ws16 250.0000 Temp_Cels -50.14000 199.8600 FORMAT "%8.4" EXTENDED_LIMITS -3549.940 3003.560 /end CHARACTERISTIC
/begin CHARACTERISTIC AFVCtl_tIndPwrOff_C "Untere Schwelle für die Hysterese-Niedrig => Leistungsfunktion" VALUE 0x1C2A2C Kw_Ws16 250.0000 Temp_Cels -50.14000 199.8600 FORMAT "%8.4" EXTENDED_LIMITS -3549.940 3003.560 /end CHARACTERISTIC
/begin CHARACTERISTIC AFVCtl_tIndPwrOn_C "Obere Schwelle für die Hysterese-Niedrig => Leistungsfunktion" VALUE 0x1C2A2E Kw_Ws16 250.0000 Temp_Cels -50.14000 199.8600 FORMAT "%8.4" EXTENDED_LIMITS -3549.940 3003.560 /end CHARACTERISTIC
/begin CHARACTERISTIC AFVCtl_tIndSnowOff_C "Obere Schwelle für die Hysterese => Schneefunktion" VALUE 0x1C2A30 Kw_Ws16 250.0000 Temp_Cels -50.14000 199.8600 FORMAT "%8.4" EXTENDED_LIMITS -3549.940 3003.560 /end CHARACTERISTIC
/begin CHARACTERISTIC AFVCtl_tIndSnowOn_C "Untere Schwelle für die Hysterese => Schneefunktion" VALUE 0x1C2A32 Kw_Ws16 250.0000 Temp_Cels -50.14000 199.8600 FORMAT "%8.4" EXTENDED_LIMITS -3549.940 3003.560 /end CHARACTERISTIC
/begin CHARACTERISTIC AFVCtl_vRainHighOff_C "Obere Schwelle für die Hysterese-Hoch" VALUE 0x1C2A34 Kw_Ws16 300.0000 Vel 0.00 300.0000 FORMAT "%8.4" EXTENDED_LIMITS -327.6800 327.6700 /end CHARACTERISTIC
/begin CHARACTERISTIC AFVCtl_vRainHighOn_C "Untere Schwelle für die Hysterese-Hoch" VALUE 0x1C2A36 Kw_Ws16 300.0000 Vel 0.00 300.0000 FORMAT "%8.4" EXTENDED_LIMITS -327.6800 327.6700 /end CHARACTERISTIC
/begin CHARACTERISTIC AFVCtl_vRainLowOff_C "Untere Schwelle für die Hysterese-Niedrig" VALUE 0x1C2A38 Kw_Ws16 300.0000 Vel 0.00 300.0000 FORMAT "%8.4" EXTENDED_LIMITS -327.6800 327.6700 /end CHARACTERISTIC
/begin CHARACTERISTIC AFVCtl_vRainLowOn_C "Obere Schwelle für die Hysterese-Niedrig" VALUE 0x1C2A3A Kw_Ws16 300.0000 Vel 0.00 300.0000 FORMAT "%8.4" EXTENDED_LIMITS -327.6800 327.6700 /end CHARACTERISTIC
/begin CHARACTERISTIC AFVCtl_vSnowHighOff_C "Obere Schwelle für die Hysterese-Hoch => Schneefunktion" VALUE 0x1C2A3C Kw_Ws16 300.0000 Vel 0.00 300.0000 FORMAT "%8.4" EXTENDED_LIMITS -327.6800 327.6700 /end CHARACTERISTIC
/begin CHARACTERISTIC AFVCtl_vSnowHighOn_C "Untere Schwelle für die Hysterese-Hoch => Schneefunktion" VALUE 0x1C2A3E Kw_Ws16 300.0000 Vel 0.00 300.0000 FORMAT "%8.4" EXTENDED_LIMITS -327.6800 327.6700 /end CHARACTERISTIC
/begin CHARACTERISTIC AFVCtl_vSnowLowOff_C "Untere Schwelle für die Hysterese-Niedrig => Schneefunktion" VALUE 0x1C2A40 Kw_Ws16 300.0000 Vel 0.00 300.0000 FORMAT "%8.4" EXTENDED_LIMITS -327.6800 327.6700 /end CHARACTERISTIC
/begin CHARACTERISTIC AFVCtl_vSnowLowOn_C "Obere Schwelle für die Hysterese-Niedrig => Schneefunktion" VALUE 0x1C2A42 Kw_Ws16 300.0000 Vel 0.00 300.0000 FORMAT "%8.4" EXTENDED_LIMITS -327.6800 327.6700 /end CHARACTERISTIC
/begin CHARACTERISTIC AirbCD_DebCrashCrCtlDef_C "Entprellzeit für Fehlerpfad Abschaltung CrCtl durch airbag" VALUE 0x1C2A44 Kw_Wu16 655350.0 Time_ms 0.00 655350.0 FORMAT "%8.1" /end CHARACTERISTIC
/begin CHARACTERISTIC AirbCD_DebCrashCrCtlOk_C "Entprellzeit für Fehlerpfad Abschaltung CrCtl durch Airbag" VALUE 0x1C2A46 Kw_Wu16 655350.0 Time_ms 0.00 655350.0 FORMAT "%8.1" /end CHARACTERISTIC
/begin CHARACTERISTIC AirbCD_DebCrashPSPDef_C "Entprellzeit für Fehlerpfad Abschaltung PSP durch Airbag" VALUE 0x1C2A48 Kw_Wu16 655350.0 Time_ms 0.00 655350.0 FORMAT "%8.1" /end CHARACTERISTIC
/begin CHARACTERISTIC AirbCD_DebCrashPSPOk_C "Entprellzeit für Fehlerpfad Abschaltung PSP durch Airbag" VALUE 0x1C2A4A Kw_Wu16 655350.0 Time_ms 0.00 655350.0 FORMAT "%8.1" /end CHARACTERISTIC
/begin CHARACTERISTIC AirbCD_DebCrashDef_C "Entprellzeit für Fehlerpfad tatsächlicher Crash von Airbag erkannt" VALUE 0x1C2A4C Kw_Wu16 655350.0 Time_ms 0.00 655350.0 FORMAT "%8.1" /end CHARACTERISTIC
/begin CHARACTERISTIC AirbCD_DebCrashOk_C "Entprellzeit für Fehlerpfad tatsächlicher Crash erkannt durch Airbag" VALUE 0x1C2A4E Kw_Wu16 655350.0 Time_ms 0.00 655350.0 FORMAT "%8.1" /end CHARACTERISTIC
/begin CHARACTERISTIC AirbCD_stAIRBCrCtl_C "Parameter zur Abschaltung der Fahrgeschwindigkeitsregelung" VALUE 0x1C2A50 Kw_Wu8 3.000 OneToOne 0.00 3.000 FORMAT "%5.3" EXTENDED_LIMITS 0.00 255.0 /end CHARACTERISTIC
/begin CHARACTERISTIC AirbCD_stAIRBFuel_C "Parameter zur Abschaltung der Kraftstoffvorförderpumpe" VALUE 0x1C2A51 Kw_Wu8 3.000 OneToOne 0.00 3.000 FORMAT "%5.3" EXTENDED_LIMITS 0.00 255.0 /end CHARACTERISTIC
/begin CHARACTERISTIC AirCtl_APCor_CUR "Kennlinie für Atmosphärendruckkorrektur" CURVE 0x1C36F8 Kl_Xs16_Ws16 3000.000 AirMassPerCyl -1500.000 1500.000 FORMAT "%8.3" EXTENDED_LIMITS -3276.800 3276.700
 /begin AXIS_DESCR STD_AXIS APSCD_pVal Pres_hPa 4 0.00 3500.000 FORMAT "%8.3" EXTENDED_LIMITS -32768.00 32767.00 DEPOSIT ABSOLUTE /end AXIS_DESCR
/end CHARACTERISTIC
/begin CHARACTERISTIC AirCtl_ATCor1_MAP "Kennfeld für drehzahl- und lufttemperaturabhängige Korrektur bei EGT-Status=Maske 1" MAP 0x1C370A Kf_Xs16_Ys16_Ws16 4.000000 Fact 0.00 4.000000 FORMAT "%8.6" EXTENDED_LIMITS -4.000000 3.999878
 /begin AXIS_DESCR STD_AXIS Eng_nAvrg EngN 2 0.00 6000.000 FORMAT "%8.3" EXTENDED_LIMITS -32768.00 32767.00 DEPOSIT ABSOLUTE /end AXIS_DESCR
 /begin AXIS_DESCR STD_AXIS IATSCD_tAir Temp_Cels 4 -50.14000 199.8600 FORMAT "%8.4" EXTENDED_LIMITS -3549.940 3003.560 DEPOSIT ABSOLUTE /end AXIS_DESCR
/end CHARACTERISTIC
/begin CHARACTERISTIC AirCtl_ATCor_MAP "Kennfeld für drehzahl- und lufttemperaturabhängige Korrektur" MAP 0x1C372A Kf_Xs16_Ys16_Ws16 4.000000 Fact 0.00 4.000000 FORMAT "%8.6" EXTENDED_LIMITS -4.000000 3.999878
 /begin AXIS_DESCR STD_AXIS Eng_nAvrg EngN 4 0.00 6000.000 FORMAT "%8.3" EXTENDED_LIMITS -32768.00 32767.00 DEPOSIT ABSOLUTE /end AXIS_DESCR
 /begin AXIS_DESCR STD_AXIS IATSCD_tAir Temp_Cels 6 -50.14000 199.8600 FORMAT "%8.4" EXTENDED_LIMITS -3549.940 3003.560 DEPOSIT ABSOLUTE /end AXIS_DESCR
/end CHARACTERISTIC
/begin CHARACTERISTIC AirCtl_CTCor1_CUR "Kennlinie für Mengenkorrekturwert ohne VE bei EGT-Status=Maske 2" CURVE 0x1C3772 Kl_Xs16_Ws16 4.000000 Fact 0.00 4.000000 FORMAT "%8.6" EXTENDED_LIMITS -4.000000 3.999878
 /begin AXIS_DESCR STD_AXIS AirCtl_qDes InjMass 5 0.00 327.6700 FORMAT "%8.4" EXTENDED_LIMITS -327.6800 327.6700 DEPOSIT ABSOLUTE /end AXIS_DESCR
/end CHARACTERISTIC
/begin CHARACTERISTIC AirCtl_CTCor_CUR "Kennlinie für Kühlwassertemperaturkorrektur für ARF" CURVE 0x1C3788 Kl_Xs16_Ws16 4.000000 Fact 0.00 4.000000 FORMAT "%8.6" EXTENDED_LIMITS -4.000000 3.999878
 /begin AXIS_DESCR STD_AXIS AirCtl_qDes InjMass 5 0.00 327.6700 FORMAT "%8.4" EXTENDED_LIMITS -327.6800 327.6700 DEPOSIT ABSOLUTE /end AXIS_DESCR
/end CHARACTERISTIC
/begin CHARACTERISTIC AirCtl_dqDesThr_C "Schwellwert der Wunschmengenänderungsgeschwindigkeit" VALUE 0x1C2A54 Kw_Ws16 3160.000 InjMassPerSec_20ms -160.0000 3000.000 FORMAT "%8.3" EXTENDED_LIMITS -16384.00 16383.50 /end CHARACTERISTIC
/begin CHARACTERISTIC AirCtl_drBPAThr_C "Schwellwert der Tastverhältnisänderungsgeschwindigkeit von PCR_rBPACD" VALUE 0x1C2A56 Kw_Ws16 32700.00 PrcPerSec_20ms -16350.00 16350.00 FORMAT "%8.2" EXTENDED_LIMITS -16384.00 16383.50 /end CHARACTERISTIC
/begin CHARACTERISTIC AirCtl_DT1CoNeg_C "Verzögerungszeitkonstante der dyn. Sollwertbildung bei kaltem Motor und negativem Wert des DT1-Ausgang" VALUE 0x1C37A0 Kw_Wu32 4294.9663 TimeDelay_s 0.0010000001 4294.9673 FORMAT "%9.4" EXTENDED_LIMITS 0.0000010000000 4294.9673 /end CHARACTERISTIC
/begin CHARACTERISTIC AirCtl_DT1_C "Zeitkonstante des DT1-Glieds bei der ARF" VALUE 0x1C46C4 Kw_Wu32 4294.9663 TimeDelay_s 0.0010000001 4294.9673 FORMAT "%9.4" EXTENDED_LIMITS 0.0000010000000 4294.9673 /end CHARACTERISTIC
/begin CHARACTERISTIC AirCtl_DKd_C "Grundwert der Verstärkung des DT1-Glieds bei Kleinsignalen" VALUE 0x1C46C8 Kw_Ws32 100.000000000 Kd_InjMass2Prc -50.0000000000 50.0000000000 FORMAT "%13.10" EXTENDED_LIMITS -32768.0000000 32767.9999847 /end CHARACTERISTIC
/begin CHARACTERISTIC AirCtl_DKdPos_C "Grundwert der Verstärkung des DT1-Glieds bei positiven Großsignalen" VALUE 0x1C46CC Kw_Ws32 100.000000000 Kd_InjMass2Prc -50.0000000000 50.0000000000 FORMAT "%13.10" EXTENDED_LIMITS -32768.0000000 32767.9999847 /end CHARACTERISTIC
/begin CHARACTERISTIC AirCtl_DKdNeg_C "Grundwert der Verstärkung des DT1-Glieds bei negativen Großsignalen" VALUE 0x1C46D0 Kw_Ws32 100.000000000 Kd_InjMass2Prc -50.0000000000 50.0000000000 FORMAT "%13.10" EXTENDED_LIMITS -32768.0000000 32767.9999847 /end CHARACTERISTIC
/begin CHARACTERISTIC AirCtl_dqDWinPos_C "obere Kleinsignalgrenze für das DT1- Glied" VALUE 0x1C46D4 Kw_Ws16 16383.50 InjMassPerSec_20ms 0.00 16383.50 FORMAT "%8.2" EXTENDED_LIMITS -16384.00 16383.50 /end CHARACTERISTIC
/begin CHARACTERISTIC AirCtl_dqDWinNeg_C "untere Kleinsignalgrenze für das DT1- Glied" VALUE 0x1C46D6 Kw_Ws16 16384.00 InjMassPerSec_20ms -16384.00 0.00 FORMAT "%8.2" EXTENDED_LIMITS -16384.00 16383.50 /end CHARACTERISTIC
/begin CHARACTERISTIC AirCtl_DT1WmNeg_C "Verzögerungszeitkonstante der dyn. Sollwertbildung bei warmem Motor und negativem Wert des DT1-Ausgangs" VALUE 0x1C37A4 Kw_Wu32 4294.9663 TimeDelay_s 0.0010000001 4294.9673 FORMAT "%9.4" EXTENDED_LIMITS 0.0000010000000 4294.9673 /end CHARACTERISTIC
/begin CHARACTERISTIC AirCtl_DT1CoPos_C "Verzögerungszeitkonstante der dyn. Sollwertbildung bei kaltem Motor und positivem Wert des DT1-Ausgang" VALUE 0x1C37A8 Kw_Wu32 4294.9663 TimeDelay_s 0.0010000001 4294.9673 FORMAT "%9.4" EXTENDED_LIMITS 0.0000010000000 4294.9673 /end CHARACTERISTIC
/begin CHARACTERISTIC AirCtl_DKdCo_C "Kleinsignalverstärkung der dyn. Sollwertbildung bei kaltem Motor" VALUE 0x1C37AC Kw_Ws32 65535.9999847 Kd -32768.0000000 32767.9999847 FORMAT "%13.7" /end CHARACTERISTIC
/begin CHARACTERISTIC AirCtl_DKdPosCo_C "positive Großsignalverstärkung der dyn. Sollwertbildung bei kaltem Motor" VALUE 0x1C37B0 Kw_Ws32 65535.9999847 Kd -32768.0000000 32767.9999847 FORMAT "%13.7" /end CHARACTERISTIC
/begin CHARACTERISTIC AirCtl_DKdNegCo_C "negative Großsignalverstärkung der dyn. Sollwertbildung bei kaltem Motor" VALUE 0x1C37B4 Kw_Ws32 65535.9999847 Kd -32768.0000000 32767.9999847 FORMAT "%13.7" /end CHARACTERISTIC
/begin CHARACTERISTIC AirCtl_dqDWinPosCo_C "positive Kleinsignalgrenze bei kaltem Motor" VALUE 0x1C37B8 Kw_Ws16 163835.0 AirMassPerTime_20ms 0.00 163835.0 FORMAT "%8.1" EXTENDED_LIMITS -163840.0 163835.0 /end CHARACTERISTIC
/begin CHARACTERISTIC AirCtl_dqDWinNegCo_C "negative Kleinsignalgrenze bei kaltem Motor" VALUE 0x1C37BA Kw_Ws16 163840.0 AirMassPerTime_20ms -163840.0 0.00 FORMAT "%8.1" EXTENDED_LIMITS -163840.0 163835.0 /end CHARACTERISTIC
/begin CHARACTERISTIC AirCtl_DT1WmPos_C "Verzögerungszeitkonstante der dyn. Sollwertbildung bei warmem Motor und positivem Wert des DT1-Ausgangs" VALUE 0x1C37BC Kw_Wu32 4294.9663 TimeDelay_s 0.0010000001 4294.9673 FORMAT "%9.4" EXTENDED_LIMITS 0.0000010000000 4294.9673 /end CHARACTERISTIC
/begin CHARACTERISTIC AirCtl_DKdWm_C "Kleinsignalverstärkung der dyn. Sollwertbildung bei warmem Motor" VALUE 0x1C37C0 Kw_Ws32 65535.9999847 Kd -32768.0000000 32767.9999847 FORMAT "%13.7" /end CHARACTERISTIC
/begin CHARACTERISTIC AirCtl_DKdPosWm_C "positive Großsignalverstärkung der dyn. Sollwertbildung bei warmem Motor" VALUE 0x1C37C4 Kw_Ws32 65535.9999847 Kd -32768.0000000 32767.9999847 FORMAT "%13.7" /end CHARACTERISTIC
/begin CHARACTERISTIC AirCtl_DKdNegWm_C "negative Großsignalverstärkung der dyn. Sollwertbildung bei warmem Motor" VALUE 0x1C37C8 Kw_Ws32 65535.9999847 Kd -32768.0000000 32767.9999847 FORMAT "%13.7" /end CHARACTERISTIC
/begin CHARACTERISTIC AirCtl_dqDWinPosWm_C "positive Kleinsignalgrenze bei warmem Motor" VALUE 0x1C37CC Kw_Ws16 163835.0 AirMassPerTime_20ms 0.00 163835.0 FORMAT "%8.1" EXTENDED_LIMITS -163840.0 163835.0 /end CHARACTERISTIC
/begin CHARACTERISTIC AirCtl_dqDWinNegWm_C "negative Kleinsignalgrenze bei warmem Motor" VALUE 0x1C37CE Kw_Ws16 163840.0 AirMassPerTime_20ms -163840.0 0.00 FORMAT "%8.1" EXTENDED_LIMITS -163840.0 163835.0 /end CHARACTERISTIC
/begin CHARACTERISTIC AirCtl_facATParAd_CUR "lufttemperaturabhängiger Faktor für Parameteradaption" CURVE 0x1C46D8 Kl_Xs16_Ws16 3.000000 Fact1 0.00 3.000000 FORMAT "%8.6" EXTENDED_LIMITS -256.0000 255.9922
 /begin AXIS_DESCR STD_AXIS IATSCD_tAir Temp_Cels 16 -100.1400 199.8600 FORMAT "%8.4" EXTENDED_LIMITS -3549.940 3003.560 DEPOSIT ABSOLUTE /end AXIS_DESCR
/end CHARACTERISTIC
/begin CHARACTERISTIC AirCtl_facBPAHold_CUR "drehzahlabhängiger Korrekturfaktor der maximalen Zeit der LDR-Abschaltung" CURVE 0x1C2A58 Kl_Xs16_Ws16 3.270020 Fact 0.00 3.270020 FORMAT "%8.6" EXTENDED_LIMITS -4.000000 3.999878
 /begin AXIS_DESCR STD_AXIS Eng_nAvrg EngN 8 0.00 6500.000 FORMAT "%8.3" EXTENDED_LIMITS -32768.00 32767.00 DEPOSIT ABSOLUTE /end AXIS_DESCR
/end CHARACTERISTIC
/begin CHARACTERISTIC AirCtl_facCtlRgn1_CUR "Kurve für die Berechnung der Steuergröße im Regenerationsbetrieb 1" CURVE 0x1C2B08 Kl_Xs16_Ws16 4.000000 Fact 0.00 4.000000 FORMAT "%8.6" EXTENDED_LIMITS -4.000000 3.999878
 /begin AXIS_DESCR STD_AXIS APSCD_pVal Pres_hPa 10 0.00 3500.000 FORMAT "%8.3" EXTENDED_LIMITS -32768.00 32767.00 DEPOSIT ABSOLUTE /end AXIS_DESCR
/end CHARACTERISTIC
/begin CHARACTERISTIC AirCtl_facCtlRgn2_CUR "Kurve für die Berechnung der Steuergröße im Regenerationsbetrieb 2" CURVE 0x1C2B32 Kl_Xs16_Ws16 4.000000 Fact 0.00 4.000000 FORMAT "%8.6" EXTENDED_LIMITS -4.000000 3.999878
 /begin AXIS_DESCR STD_AXIS APSCD_pVal Pres_hPa 10 0.00 3500.000 FORMAT "%8.3" EXTENDED_LIMITS -32768.00 32767.00 DEPOSIT ABSOLUTE /end AXIS_DESCR
/end CHARACTERISTIC
/begin CHARACTERISTIC AirCtl_facCtlRgn3_CUR "atmosphärendruckabhängige Steuerwertauswahl Regenerationsstufe 3" CURVE 0x1C2B5C Kl_Xs16_Ws16 4.000000 Fact 0.00 4.000000 FORMAT "%8.6" EXTENDED_LIMITS -4.000000 3.999878
 /begin AXIS_DESCR STD_AXIS APSCD_pVal Pres_hPa 10 0.00 3500.000 FORMAT "%8.3" EXTENDED_LIMITS -32768.00 32767.00 DEPOSIT ABSOLUTE /end AXIS_DESCR
/end CHARACTERISTIC
/begin CHARACTERISTIC AirCtl_facCtlRgn4_CUR "atmosphärendruckabhängige Steuerwertauswahl Regenerationsstufe 4" CURVE 0x1C2B86 Kl_Xs16_Ws16 4.000000 Fact 0.00 4.000000 FORMAT "%8.6" EXTENDED_LIMITS -4.000000 3.999878
 /begin AXIS_DESCR STD_AXIS APSCD_pVal Pres_hPa 2 0.00 3500.000 FORMAT "%8.3" EXTENDED_LIMITS -32768.00 32767.00 DEPOSIT ABSOLUTE /end AXIS_DESCR
/end CHARACTERISTIC
/begin CHARACTERISTIC AirCtl_facDesRgn1_CUR "Kurve für die Berechnung des Luftmassensollwertes im Regenerationsbetrieb 1" CURVE 0x1C37D0 Kl_Xs16_Ws16 4.000000 Fact 0.00 4.000000 FORMAT "%8.6" EXTENDED_LIMITS -4.000000 3.999878
 /begin AXIS_DESCR STD_AXIS APSCD_pVal Pres_hPa 10 0.00 3500.000 FORMAT "%8.3" EXTENDED_LIMITS -32768.00 32767.00 DEPOSIT ABSOLUTE /end AXIS_DESCR
/end CHARACTERISTIC
/begin CHARACTERISTIC AirCtl_facDesRgn2_CUR "Kurve für die Berechnung des Luftmassensollwertes im Regenerationsbetrieb 2" CURVE 0x1C37FA Kl_Xs16_Ws16 4.000000 Fact 0.00 4.000000 FORMAT "%8.6" EXTENDED_LIMITS -4.000000 3.999878
 /begin AXIS_DESCR STD_AXIS APSCD_pVal Pres_hPa 10 0.00 3500.000 FORMAT "%8.3" EXTENDED_LIMITS -32768.00 32767.00 DEPOSIT ABSOLUTE /end AXIS_DESCR
/end CHARACTERISTIC
/begin CHARACTERISTIC AirCtl_facDesRgn3_CUR "atmosphärendruckabhängige Sollwertauswahl Regenerationsstufe 3" CURVE 0x1C3824 Kl_Xs16_Ws16 4.000000 Fact 0.00 4.000000 FORMAT "%8.6" EXTENDED_LIMITS -4.000000 3.999878
 /begin AXIS_DESCR STD_AXIS APSCD_pVal Pres_hPa 10 0.00 3500.000 FORMAT "%8.3" EXTENDED_LIMITS -32768.00 32767.00 DEPOSIT ABSOLUTE /end AXIS_DESCR
/end CHARACTERISTIC
/begin CHARACTERISTIC AirCtl_facDesRgn4_CUR "atmosphärendruckabhängige Sollwertauswahl Regenerationsstufe 4" CURVE 0x1C384E Kl_Xs16_Ws16 4.000000 Fact 0.00 4.000000 FORMAT "%8.6" EXTENDED_LIMITS -4.000000 3.999878
 /begin AXIS_DESCR STD_AXIS APSCD_pVal Pres_hPa 2 0.00 3500.000 FORMAT "%8.3" EXTENDED_LIMITS -32768.00 32767.00 DEPOSIT ABSOLUTE /end AXIS_DESCR
/end CHARACTERISTIC
/begin CHARACTERISTIC AirCtl_facNQParAd_MAP "Kennfeld für Parameteradaption für ARF" MAP 0x1C471A Kf_Xs16_Ys16_Ws16 20.00000 Fact1 0.00 20.00000 FORMAT "%8.5" EXTENDED_LIMITS -256.0000 255.9922
 /begin AXIS_DESCR STD_AXIS Eng_nAvrg EngN 10 0.00 8000.000 FORMAT "%8.3" EXTENDED_LIMITS -32768.00 32767.00 DEPOSIT ABSOLUTE /end AXIS_DESCR
 /begin AXIS_DESCR STD_AXIS InjCtl_qCurr InjMass 10 0.00 100.0000 FORMAT "%8.4" EXTENDED_LIMITS -327.6800 327.6700 DEPOSIT ABSOLUTE /end AXIS_DESCR
/end CHARACTERISTIC
/begin CHARACTERISTIC AirCtl_IKi_C "Grundwert der I-Verstärkung des PI-Reglers bei Kleinsignalen" VALUE 0x1C4810 Kw_Wu32 4.99999150634 Ki_Ampc2Prc 0.00 4.99999150634 FORMAT "%13.11" EXTENDED_LIMITS 0.00 99999.9999767 /end CHARACTERISTIC
/begin CHARACTERISTIC AirCtl_IKiPos_C "Grundwert der I-Verstärkung des PI-Reglers bei positiven Großsignalen" VALUE 0x1C4814 Kw_Wu32 4.99999150634 Ki_Ampc2Prc 0.00 4.99999150634 FORMAT "%13.11" EXTENDED_LIMITS 0.00 99999.9999767 /end CHARACTERISTIC
/begin CHARACTERISTIC AirCtl_IKiNeg_C "Grundwert der I-Verstärkung des PI-Reglers bei negativen Großsignalen" VALUE 0x1C4818 Kw_Wu32 4.99999150634 Ki_Ampc2Prc 0.00 4.99999150634 FORMAT "%13.11" EXTENDED_LIMITS 0.00 99999.9999767 /end CHARACTERISTIC
/begin CHARACTERISTIC AirCtl_mIWinPos_C "obere Kleinsignalgrenze für den I-Kanal des PI-Reglers" VALUE 0x1C481C Kw_Ws16 1500.000 AirMassPerCyl 0.00 1500.000 FORMAT "%8.3" EXTENDED_LIMITS -3276.800 3276.700 /end CHARACTERISTIC
/begin CHARACTERISTIC AirCtl_mIWinNeg_C "untere Kleinsignalgrenze für den I-Kanal des PI-Reglers" VALUE 0x1C481E Kw_Ws16 1500.000 AirMassPerCyl -1500.000 0.00 FORMAT "%8.3" EXTENDED_LIMITS -3276.800 3276.700 /end CHARACTERISTIC
/begin CHARACTERISTIC AirCtl_mAirCBVHysHi_CUR "obere drehzahlabhängige Luftmassenschwellwertkennlinie für EGR Kühler Bypass" CURVE 0x1C2AB4 Kl_Xs16_Ws16 2000.000 AirMassPerCyl 0.00 2000.000 FORMAT "%8.3" EXTENDED_LIMITS -3276.800 3276.700
 /begin AXIS_DESCR STD_AXIS Eng_nAvrg EngN 8 0.00 6000.000 FORMAT "%8.3" EXTENDED_LIMITS -32768.00 32767.00 DEPOSIT ABSOLUTE /end AXIS_DESCR
/end CHARACTERISTIC
/begin CHARACTERISTIC AirCtl_mAirCBVHysLo_CUR "untere drehzahlabhängige Luftmassenschwellwertkennlinie für EGR Kühler Bypass" CURVE 0x1C2AD6 Kl_Xs16_Ws16 2000.000 AirMassPerCyl 0.00 2000.000 FORMAT "%8.3" EXTENDED_LIMITS -3276.800 3276.700
 /begin AXIS_DESCR STD_AXIS Eng_nAvrg EngN 8 0.00 6000.000 FORMAT "%8.3" EXTENDED_LIMITS -32768.00 32767.00 DEPOSIT ABSOLUTE /end AXIS_DESCR
/end CHARACTERISTIC
/begin CHARACTERISTIC AirCtl_mAPCorAfterStrt_CUR "Atmosphärendruckkorrektur" CURVE 0x1C3858 Kl_Xs16_Ws16 3000.000 AirMassPerCyl -1500.000 1500.000 FORMAT "%8.3" EXTENDED_LIMITS -3276.800 3276.700
 /begin AXIS_DESCR STD_AXIS APSCD_pVal Pres_hPa 6 0.00 3500.000 FORMAT "%8.3" EXTENDED_LIMITS -32768.00 32767.00 DEPOSIT ABSOLUTE /end AXIS_DESCR
/end CHARACTERISTIC
/begin CHARACTERISTIC AirCtl_MaxTrmVal_C "maximaler ARF-Abgleichwert" VALUE 0x1C3872 Kw_Ws16 3000.000 AirMassPerCyl -1500.000 1500.000 FORMAT "%8.3" EXTENDED_LIMITS -3276.800 3276.700 /end CHARACTERISTIC
/begin CHARACTERISTIC AirCtl_mCorAfterStart_C "Rampenendwert nach erreichen der Umdrehungszählerschwelle" VALUE 0x1C3874 Kw_Ws16 3000.000 AirMassPerCyl -1500.000 1500.000 FORMAT "%8.3" EXTENDED_LIMITS -3276.800 3276.700 /end CHARACTERISTIC
/begin CHARACTERISTIC AirCtl_mCorStrt_C "Vorgabewert während des Startvorgangs" VALUE 0x1C3876 Kw_Ws16 3000.000 AirMassPerCyl -1500.000 1500.000 FORMAT "%8.3" EXTENDED_LIMITS -3276.800 3276.700 /end CHARACTERISTIC
/begin CHARACTERISTIC AirCtl_mCor_CUR "Drehzahlkorrektur der Sollwertberechnung" CURVE 0x1C3878 Kl_Xs16_Ws16 1500.000 AirMassPerCyl 0.00 1500.000 FORMAT "%8.3" EXTENDED_LIMITS -3276.800 3276.700
 /begin AXIS_DESCR STD_AXIS Eng_nAvrg EngN 4 0.00 6000.000 FORMAT "%8.3" EXTENDED_LIMITS -32768.00 32767.00 DEPOSIT ABSOLUTE /end AXIS_DESCR
/end CHARACTERISTIC
/begin CHARACTERISTIC AirCtl_mDesBasePil_MAP "Zweites Kennfeld zur Bestimmung des stationären Basissoll-wertes" MAP 0x1C388A Kf_Xs16_Ys16_Ws16 3000.000 AirMassPerCyl -1500.000 1500.000 FORMAT "%8.3" EXTENDED_LIMITS -3276.800 3276.700
 /begin AXIS_DESCR STD_AXIS Eng_nAvrg EngN 16 0.00 6000.000 FORMAT "%8.3" EXTENDED_LIMITS -32768.00 32767.00 DEPOSIT ABSOLUTE /end AXIS_DESCR
 /begin AXIS_DESCR STD_AXIS AirCtl_qDes InjMass 16 0.00 327.6700 FORMAT "%8.4" EXTENDED_LIMITS -327.6800 327.6700 DEPOSIT ABSOLUTE /end AXIS_DESCR
/end CHARACTERISTIC
/begin CHARACTERISTIC AirCtl_mDesBase_MAP "Kennfeld zur Ermittlung des stationären Basissollwerts für ARF ohne VE" MAP 0x1C3ACE Kf_Xs16_Ys16_Ws16 3000.000 AirMassPerCyl -1500.000 1500.000 FORMAT "%8.3" EXTENDED_LIMITS -3276.800 3276.700
 /begin AXIS_DESCR STD_AXIS Eng_nAvrg EngN 16 0.00 6000.000 FORMAT "%8.3" EXTENDED_LIMITS -32768.00 32767.00 DEPOSIT ABSOLUTE /end AXIS_DESCR
 /begin AXIS_DESCR STD_AXIS AirCtl_qDes InjMass 16 0.00 327.6700 FORMAT "%8.4" EXTENDED_LIMITS -327.6800 327.6700 DEPOSIT ABSOLUTE /end AXIS_DESCR
/end CHARACTERISTIC
/begin CHARACTERISTIC AirCtl_mDesRgn1a_MAP "Kennfeld für den Luftmassensollwert A der Partikelfilterregeneration 1" MAP 0x1C3D12 Kf_Xs16_Ys16_Ws16 3000.000 AirMassPerCyl -1500.000 1500.000 FORMAT "%8.3" EXTENDED_LIMITS -3276.800 3276.700
 /begin AXIS_DESCR STD_AXIS Eng_nAvrg EngN 10 0.00 6000.000 FORMAT "%8.3" EXTENDED_LIMITS -32768.00 32767.00 DEPOSIT ABSOLUTE /end AXIS_DESCR
 /begin AXIS_DESCR STD_AXIS AirCtl_qDes InjMass 10 0.00 327.6700 FORMAT "%8.4" EXTENDED_LIMITS -327.6800 327.6700 DEPOSIT ABSOLUTE /end AXIS_DESCR
/end CHARACTERISTIC
/begin CHARACTERISTIC AirCtl_mDesRgn1b_MAP "Kennfeld für den Luftmassensollwert B der Partikelfilterregeneration 1" MAP 0x1C3E06 Kf_Xs16_Ys16_Ws16 3000.000 AirMassPerCyl -1500.000 1500.000 FORMAT "%8.3" EXTENDED_LIMITS -3276.800 3276.700
 /begin AXIS_DESCR STD_AXIS Eng_nAvrg EngN 10 0.00 6000.000 FORMAT "%8.3" EXTENDED_LIMITS -32768.00 32767.00 DEPOSIT ABSOLUTE /end AXIS_DESCR
 /begin AXIS_DESCR STD_AXIS AirCtl_qDes InjMass 10 0.00 327.6700 FORMAT "%8.4" EXTENDED_LIMITS -327.6800 327.6700 DEPOSIT ABSOLUTE /end AXIS_DESCR
/end CHARACTERISTIC
/begin CHARACTERISTIC AirCtl_mDesRgn2a_MAP "Kennfeld für den Luftmassensollwert A der Partikelfilterregeneration 2" MAP 0x1C3EFA Kf_Xs16_Ys16_Ws16 3000.000 AirMassPerCyl -1500.000 1500.000 FORMAT "%8.3" EXTENDED_LIMITS -3276.800 3276.700
 /begin AXIS_DESCR STD_AXIS Eng_nAvrg EngN 10 0.00 6000.000 FORMAT "%8.3" EXTENDED_LIMITS -32768.00 32767.00 DEPOSIT ABSOLUTE /end AXIS_DESCR
 /begin AXIS_DESCR STD_AXIS AirCtl_qDes InjMass 10 0.00 327.6700 FORMAT "%8.4" EXTENDED_LIMITS -327.6800 327.6700 DEPOSIT ABSOLUTE /end AXIS_DESCR
/end CHARACTERISTIC
/begin CHARACTERISTIC AirCtl_mDesRgn2b_MAP "Kennfeld für den Luftmassensollwert B der Partikelfilterregeneration 2" MAP 0x1C3FEE Kf_Xs16_Ys16_Ws16 3000.000 AirMassPerCyl -1500.000 1500.000 FORMAT "%8.3" EXTENDED_LIMITS -3276.800 3276.700
 /begin AXIS_DESCR STD_AXIS Eng_nAvrg EngN 10 0.00 6000.000 FORMAT "%8.3" EXTENDED_LIMITS -32768.00 32767.00 DEPOSIT ABSOLUTE /end AXIS_DESCR
 /begin AXIS_DESCR STD_AXIS AirCtl_qDes InjMass 10 0.00 327.6700 FORMAT "%8.4" EXTENDED_LIMITS -327.6800 327.6700 DEPOSIT ABSOLUTE /end AXIS_DESCR
/end CHARACTERISTIC
/begin CHARACTERISTIC AirCtl_mDesRgn3a_MAP "Sollwert Regenerationsstufe 3 bei Atmosphärendruck ""a""" MAP 0x1C40E2 Kf_Xs16_Ys16_Ws16 3000.000 AirMassPerCyl -1500.000 1500.000 FORMAT "%8.3" EXTENDED_LIMITS -3276.800 3276.700
 /begin AXIS_DESCR STD_AXIS Eng_nAvrg EngN 10 0.00 6000.000 FORMAT "%8.3" EXTENDED_LIMITS -32768.00 32767.00 DEPOSIT ABSOLUTE /end AXIS_DESCR
 /begin AXIS_DESCR STD_AXIS AirCtl_qDes InjMass 10 0.00 327.6700 FORMAT "%8.4" EXTENDED_LIMITS -327.6800 327.6700 DEPOSIT ABSOLUTE /end AXIS_DESCR
/end CHARACTERISTIC
/begin CHARACTERISTIC AirCtl_mDesRgn3b_MAP "Sollwert Regenerationsstufe 3 bei Atmosphärendruck ""b""" MAP 0x1C41D6 Kf_Xs16_Ys16_Ws16 3000.000 AirMassPerCyl -1500.000 1500.000 FORMAT "%8.3" EXTENDED_LIMITS -3276.800 3276.700
 /begin AXIS_DESCR STD_AXIS Eng_nAvrg EngN 10 0.00 6000.000 FORMAT "%8.3" EXTENDED_LIMITS -32768.00 32767.00 DEPOSIT ABSOLUTE /end AXIS_DESCR
 /begin AXIS_DESCR STD_AXIS AirCtl_qDes InjMass 10 0.00 327.6700 FORMAT "%8.4" EXTENDED_LIMITS -327.6800 327.6700 DEPOSIT ABSOLUTE /end AXIS_DESCR
/end CHARACTERISTIC
/begin CHARACTERISTIC AirCtl_mDesRgn4a_MAP "Sollwert Regenerationsstufe 4 bei Atmosphärendruck ""a""" MAP 0x1C42CA Kf_Xs16_Ys16_Ws16 3000.000 AirMassPerCyl -1500.000 1500.000 FORMAT "%8.3" EXTENDED_LIMITS -3276.800 3276.700
 /begin AXIS_DESCR STD_AXIS Eng_nAvrg EngN 2 0.00 6000.000 FORMAT "%8.3" EXTENDED_LIMITS -32768.00 32767.00 DEPOSIT ABSOLUTE /end AXIS_DESCR
 /begin AXIS_DESCR STD_AXIS AirCtl_qDes InjMass 2 0.00 327.6700 FORMAT "%8.4" EXTENDED_LIMITS -327.6800 327.6700 DEPOSIT ABSOLUTE /end AXIS_DESCR
/end CHARACTERISTIC
/begin CHARACTERISTIC AirCtl_mDesRgn4b_MAP "Sollwert Regenerationsstufe 4 bei Atmosphärendruck ""b""" MAP 0x1C42DE Kf_Xs16_Ys16_Ws16 3000.000 AirMassPerCyl -1500.000 1500.000 FORMAT "%8.3" EXTENDED_LIMITS -3276.800 3276.700
 /begin AXIS_DESCR STD_AXIS Eng_nAvrg EngN 2 0.00 6000.000 FORMAT "%8.3" EXTENDED_LIMITS -32768.00 32767.00 DEPOSIT ABSOLUTE /end AXIS_DESCR
 /begin AXIS_DESCR STD_AXIS AirCtl_qDes InjMass 2 0.00 327.6700 FORMAT "%8.4" EXTENDED_LIMITS -327.6800 327.6700 DEPOSIT ABSOLUTE /end AXIS_DESCR
/end CHARACTERISTIC
/begin CHARACTERISTIC AirCtl_mDesValAdd_Vector "Bypass-Label für additiven Bypass von AirCtl_mDesVal (Nicht verstellen!)" VALUE 0x1C0A2E Kw_Wu8 255.0 OneToOne 0.00 255.0 FORMAT "%5.1" /end CHARACTERISTIC
/begin CHARACTERISTIC AirCtl_mDesValAdd_Channel "Bypass-Label für additiven Bypass von AirCtl_mDesVal (Nicht verstellen!)" VALUE 0x1C0A2F Kw_Wu8 255.0 OneToOne 0.00 255.0 FORMAT "%5.1" /end CHARACTERISTIC
/begin CHARACTERISTIC AirCtl_mDesVal_Vector "Bypass-Label für AirCtl_mDesVal (Nicht verstellen!)" VALUE 0x1C0A30 Kw_Wu8 255.0 OneToOne 0.00 255.0 FORMAT "%5.1" /end CHARACTERISTIC
/begin CHARACTERISTIC AirCtl_mDesVal_Channel "Bypass-Label für AirCtl_mDesVal (Nicht verstellen!)" VALUE 0x1C0A31 Kw_Wu8 255.0 OneToOne 0.00 255.0 FORMAT "%5.1" /end CHARACTERISTIC
/begin CHARACTERISTIC AirCtl_MinTrmVal_C "minimaler ARF-Abgleichwert" VALUE 0x1C42F2 Kw_Ws16 3000.000 AirMassPerCyl -1500.000 1500.000 FORMAT "%8.3" EXTENDED_LIMITS -3276.800 3276.700 /end CHARACTERISTIC
/begin CHARACTERISTIC AirCtl_mMaxDesVal_C "maximaler Luftmassensollwert" VALUE 0x1C42F4 Kw_Ws16 1500.000 AirMassPerCyl 0.00 1500.000 FORMAT "%8.3" EXTENDED_LIMITS -3276.800 3276.700 /end CHARACTERISTIC
/begin CHARACTERISTIC AirCtl_mMinDesVal_C "minimaler Luftmassensollwert" VALUE 0x1C42F6 Kw_Ws16 1500.000 AirMassPerCyl 0.00 1500.000 FORMAT "%8.3" EXTENDED_LIMITS -3276.800 3276.700 /end CHARACTERISTIC
/begin CHARACTERISTIC AirCtl_dmRampStepUp_C "Schrittweite der Rampe in steigender Richtung" VALUE 0x1C42F8 Kw_Wu32 1494.99969482 RmpAirMassPerCyl 5.00030517578 1500.00000000 FORMAT "%13.8" EXTENDED_LIMITS 0.00 6553599.99847 /end CHARACTERISTIC
/begin CHARACTERISTIC AirCtl_dmRampStepDown_C "Schrittweite der Rampe in fallender Richtung" VALUE 0x1C42FC Kw_Wu32 1494.99969482 RmpAirMassPerCyl 5.00030517578 1500.00000000 FORMAT "%13.8" EXTENDED_LIMITS 0.00 6553599.99847 /end CHARACTERISTIC
/begin CHARACTERISTIC AirCtl_NQAPCor_MAP "Kennfeld für Luftdruckkorrektur für ARF" MAP 0x1C4300 Kf_Xs16_Ys16_Ws16 4.000000 Fact 0.00 4.000000 FORMAT "%8.6" EXTENDED_LIMITS -4.000000 3.999878
 /begin AXIS_DESCR STD_AXIS Eng_nAvrg EngN 8 0.00 6000.000 FORMAT "%8.3" EXTENDED_LIMITS -32768.00 32767.00 DEPOSIT ABSOLUTE /end AXIS_DESCR
 /begin AXIS_DESCR STD_AXIS AirCtl_qDes InjMass 8 0.00 327.6700 FORMAT "%8.4" EXTENDED_LIMITS -327.6800 327.6700 DEPOSIT ABSOLUTE /end AXIS_DESCR
/end CHARACTERISTIC
/begin CHARACTERISTIC AirCtl_NQCTCor1_MAP "Kennfeld für drehzahl- und motortemperaturabhängige Kühlwassertemperaturkorrektur ohne VE bei EGT-Status=Maske 1" MAP 0x1C43A4 Kf_Xs16_Ys16_Ws16 3000.000 AirMassPerCyl -1500.000 1500.000 FORMAT "%8.3" EXTENDED_LIMITS -3276.800 3276.700
 /begin AXIS_DESCR STD_AXIS Eng_nAvrg EngN 10 0.00 6000.000 FORMAT "%8.3" EXTENDED_LIMITS -32768.00 32767.00 DEPOSIT ABSOLUTE /end AXIS_DESCR
 /begin AXIS_DESCR STD_AXIS Eng_tEng Temp_Cels 8 -50.14000 199.8600 FORMAT "%8.4" EXTENDED_LIMITS -3549.940 3003.560 DEPOSIT ABSOLUTE /end AXIS_DESCR
/end CHARACTERISTIC
/begin CHARACTERISTIC AirCtl_NQCTCor2_MAP "Kennfeld für drehzahl- und motortemperaturabhängige Kühlwassertemperaturkorrektur ohne VE bei EGT-Status=Maske 2" MAP 0x1C446C Kf_Xs16_Ys16_Ws16 3000.000 AirMassPerCyl -1500.000 1500.000 FORMAT "%8.3" EXTENDED_LIMITS -3276.800 3276.700
 /begin AXIS_DESCR STD_AXIS Eng_nAvrg EngN 10 0.00 6000.000 FORMAT "%8.3" EXTENDED_LIMITS -32768.00 32767.00 DEPOSIT ABSOLUTE /end AXIS_DESCR
 /begin AXIS_DESCR STD_AXIS Eng_tEng Temp_Cels 8 -50.14000 199.8600 FORMAT "%8.4" EXTENDED_LIMITS -3549.940 3003.560 DEPOSIT ABSOLUTE /end AXIS_DESCR
/end CHARACTERISTIC
/begin CHARACTERISTIC AirCtl_NQCTCor3_MAP "Kennfeld für drehzahl- und motortemperaturabhängige Kühlwassertemperaturkorrektur ohne VE bei EGT-Status=Maske 3" MAP 0x1C4534 Kf_Xs16_Ys16_Ws16 3000.000 AirMassPerCyl -1500.000 1500.000 FORMAT "%8.3" EXTENDED_LIMITS -3276.800 3276.700
 /begin AXIS_DESCR STD_AXIS Eng_nAvrg EngN 2 0.00 6000.000 FORMAT "%8.3" EXTENDED_LIMITS -32768.00 32767.00 DEPOSIT ABSOLUTE /end AXIS_DESCR
 /begin AXIS_DESCR STD_AXIS Eng_tEng Temp_Cels 2 -50.14000 199.8600 FORMAT "%8.4" EXTENDED_LIMITS -3549.940 3003.560 DEPOSIT ABSOLUTE /end AXIS_DESCR
/end CHARACTERISTIC
/begin CHARACTERISTIC AirCtl_NQCTCor_MAP "Kennfeld für Kühlwassertemperaturkorrektur für ARF ohne VE" MAP 0x1C4548 Kf_Xs16_Ys16_Ws16 3000.000 AirMassPerCyl -1500.000 1500.000 FORMAT "%8.3" EXTENDED_LIMITS -3276.800 3276.700
 /begin AXIS_DESCR STD_AXIS Eng_nAvrg EngN 10 0.00 6000.000 FORMAT "%8.3" EXTENDED_LIMITS -32768.00 32767.00 DEPOSIT ABSOLUTE /end AXIS_DESCR
 /begin AXIS_DESCR STD_AXIS Eng_tEng Temp_Cels 8 -50.14000 199.8600 FORMAT "%8.4" EXTENDED_LIMITS -3549.940 3003.560 DEPOSIT ABSOLUTE /end AXIS_DESCR
/end CHARACTERISTIC
/begin CHARACTERISTIC AirCtl_nWinHi_C "obere Grenze des Drehzahlfensters" VALUE 0x1C2A7A Kw_Ws16 6500.000 EngN 0.00 6500.000 FORMAT "%8.3" EXTENDED_LIMITS -32768.00 32767.00 /end CHARACTERISTIC
/begin CHARACTERISTIC AirCtl_nWinLow_C "untere Grenze des Drehzahlfensters" VALUE 0x1C2A7C Kw_Ws16 6500.000 EngN 0.00 6500.000 FORMAT "%8.3" EXTENDED_LIMITS -32768.00 32767.00 /end CHARACTERISTIC
/begin CHARACTERISTIC AirCtl_pCor_MAP "Ansauglufttemperatur-korrigierter Atmospherendruck" MAP 0x1C2B90 Kf_Xs16_Ys16_Ws16 3500.000 Pres_hPa 0.00 3500.000 FORMAT "%8.3" EXTENDED_LIMITS -32768.00 32767.00
 /begin AXIS_DESCR STD_AXIS APSCD_pVal Pres_hPa 16 0.00 3500.000 FORMAT "%8.3" EXTENDED_LIMITS -32768.00 32767.00 DEPOSIT ABSOLUTE /end AXIS_DESCR
 /begin AXIS_DESCR STD_AXIS IATSCD_tAir Temp_Cels 10 -50.14000 199.8600 FORMAT "%8.4" EXTENDED_LIMITS -3549.940 3003.560 DEPOSIT ABSOLUTE /end AXIS_DESCR
/end CHARACTERISTIC
/begin CHARACTERISTIC AirCtl_PKp_C "Grundwert der P-Verstärkung des PI-Reglers bei Kleinsignalen" VALUE 0x1C4820 Kw_Wu32 10.0000000000 Kp_Ampc2Prc 0.00 10.0000000000 FORMAT "%13.10" EXTENDED_LIMITS 0.00 6553.59999847 /end CHARACTERISTIC
/begin CHARACTERISTIC AirCtl_PKpPos_C "Grundwert der P-Verstärkung des PI-Reglers bei positiven Großsignalen" VALUE 0x1C4824 Kw_Wu32 10.0000000000 Kp_Ampc2Prc 0.00 10.0000000000 FORMAT "%13.10" EXTENDED_LIMITS 0.00 6553.59999847 /end CHARACTERISTIC
/begin CHARACTERISTIC AirCtl_PKpNeg_C "Grundwert der P-Verstärkung des PI-Reglers bei negativen Großsignalen" VALUE 0x1C4828 Kw_Wu32 10.0000000000 Kp_Ampc2Prc 0.00 10.0000000000 FORMAT "%13.10" EXTENDED_LIMITS 0.00 6553.59999847 /end CHARACTERISTIC
/begin CHARACTERISTIC AirCtl_mPWinPos_C "obere Kleinsignalgrenze für den P-Kanal des PI-Reglers" VALUE 0x1C482C Kw_Ws16 1500.000 AirMassPerCyl 0.00 1500.000 FORMAT "%8.3" EXTENDED_LIMITS -3276.800 3276.700 /end CHARACTERISTIC
/begin CHARACTERISTIC AirCtl_mPWinNeg_C "untere Kleinsignalgrenze für den P-Kanal des PI-Reglers" VALUE 0x1C482E Kw_Ws16 1500.000 AirMassPerCyl -1500.000 0.00 FORMAT "%8.3" EXTENDED_LIMITS -3276.800 3276.700 /end CHARACTERISTIC
/begin CHARACTERISTIC AirCtl_qCurrMax_C "obere Grenze des Bereichs der aktuellen Wunschmenge" VALUE 0x1C2A7E Kw_Ws16 70.00000 InjMass 0.00 70.00000 FORMAT "%8.5" EXTENDED_LIMITS -327.6800 327.6700 /end CHARACTERISTIC
/begin CHARACTERISTIC AirCtl_qCurrMin_C "untere Grenze des Bereichs der aktuellen Wunschmenge" VALUE 0x1C2A80 Kw_Ws16 70.00000 InjMass 0.00 70.00000 FORMAT "%8.5" EXTENDED_LIMITS -327.6800 327.6700 /end CHARACTERISTIC
/begin CHARACTERISTIC AirCtl_qRpOilCorr_CUR "Einspritzmengen Korrektur für RME" CURVE 0x1C467C Kl_Xs16_Ws16 327.6700 InjMass 0.00 327.6700 FORMAT "%8.4" EXTENDED_LIMITS -327.6800 327.6700
 /begin AXIS_DESCR STD_AXIS InjCtl_qRaw InjMass 16 0.00 327.6700 FORMAT "%8.4" EXTENDED_LIMITS -327.6800 327.6700 DEPOSIT ABSOLUTE /end AXIS_DESCR
/end CHARACTERISTIC
/begin CHARACTERISTIC AirCtl_rAPCor_MAP "Atmosphärendruck- und drehzahlabhängiger Korrekturwert von AirCtl_rCtlVal" MAP 0x1C2D08 Kf_Xs16_Ys16_Ws16 100.0000 Prc 0.00 100.0000 FORMAT "%8.4" EXTENDED_LIMITS -327.6800 327.6700
 /begin AXIS_DESCR STD_AXIS Eng_nAvrg EngN 10 0.00 6000.000 FORMAT "%8.3" EXTENDED_LIMITS -32768.00 32767.00 DEPOSIT ABSOLUTE /end AXIS_DESCR
 /begin AXIS_DESCR STD_AXIS AirCtl_pCor Pres_hPa 4 0.00 3500.000 FORMAT "%8.3" EXTENDED_LIMITS -32768.00 32767.00 DEPOSIT ABSOLUTE /end AXIS_DESCR
/end CHARACTERISTIC
/begin CHARACTERISTIC AirCtl_rCtlBase_MAP "Basiswert der parallelen Steuerung" MAP 0x1C2D78 Kf_Xs16_Ys16_Ws16 100.0000 Prc 0.00 100.0000 FORMAT "%8.4" EXTENDED_LIMITS -327.6800 327.6700
 /begin AXIS_DESCR STD_AXIS Eng_nAvrg EngN 16 0.00 6000.000 FORMAT "%8.3" EXTENDED_LIMITS -32768.00 32767.00 DEPOSIT ABSOLUTE /end AXIS_DESCR
 /begin AXIS_DESCR STD_AXIS AirCtl_qCtl InjMass 13 0.00 327.6700 FORMAT "%8.4" EXTENDED_LIMITS -327.6800 327.6700 DEPOSIT ABSOLUTE /end AXIS_DESCR
/end CHARACTERISTIC
/begin CHARACTERISTIC AirCtl_rCtlRgn1a_MAP "Kennfeld für den Steuerungswert  A der Partikelfilterregeneration 1" MAP 0x1C2F56 Kf_Xs16_Ys16_Ws16 800.0000 Prc -400.0000 400.0000 FORMAT "%8.4" EXTENDED_LIMITS -327.6800 327.6700
 /begin AXIS_DESCR STD_AXIS Eng_nAvrg EngN 10 0.00 6000.000 FORMAT "%8.3" EXTENDED_LIMITS -32768.00 32767.00 DEPOSIT ABSOLUTE /end AXIS_DESCR
 /begin AXIS_DESCR STD_AXIS AirCtl_qCtl InjMass 10 0.00 327.6700 FORMAT "%8.4" EXTENDED_LIMITS -327.6800 327.6700 DEPOSIT ABSOLUTE /end AXIS_DESCR
/end CHARACTERISTIC
/begin CHARACTERISTIC AirCtl_rCtlRgn1b_MAP "Kennfeld für den Steuerungswert  B der Partikelfilterregeneration 1" MAP 0x1C304A Kf_Xs16_Ys16_Ws16 800.0000 Prc -400.0000 400.0000 FORMAT "%8.4" EXTENDED_LIMITS -327.6800 327.6700
 /begin AXIS_DESCR STD_AXIS Eng_nAvrg EngN 10 0.00 6000.000 FORMAT "%8.3" EXTENDED_LIMITS -32768.00 32767.00 DEPOSIT ABSOLUTE /end AXIS_DESCR
 /begin AXIS_DESCR STD_AXIS AirCtl_qCtl InjMass 10 0.00 327.6700 FORMAT "%8.4" EXTENDED_LIMITS -327.6800 327.6700 DEPOSIT ABSOLUTE /end AXIS_DESCR
/end CHARACTERISTIC
/begin CHARACTERISTIC AirCtl_rCtlRgn2a_MAP "Kennfeld für den Steuerungswert  A der Partikelfilterregeneration 2" MAP 0x1C313E Kf_Xs16_Ys16_Ws16 800.0000 Prc -400.0000 400.0000 FORMAT "%8.4" EXTENDED_LIMITS -327.6800 327.6700
 /begin AXIS_DESCR STD_AXIS Eng_nAvrg EngN 10 0.00 6000.000 FORMAT "%8.3" EXTENDED_LIMITS -32768.00 32767.00 DEPOSIT ABSOLUTE /end AXIS_DESCR
 /begin AXIS_DESCR STD_AXIS AirCtl_qCtl InjMass 10 0.00 327.6700 FORMAT "%8.4" EXTENDED_LIMITS -327.6800 327.6700 DEPOSIT ABSOLUTE /end AXIS_DESCR
/end CHARACTERISTIC
/begin CHARACTERISTIC AirCtl_rCtlRgn2b_MAP "Kennfeld für den Steuerungswert  B der Partikelfilterregeneration 2" MAP 0x1C3232 Kf_Xs16_Ys16_Ws16 800.0000 Prc -400.0000 400.0000 FORMAT "%8.4" EXTENDED_LIMITS -327.6800 327.6700
 /begin AXIS_DESCR STD_AXIS Eng_nAvrg EngN 10 0.00 6000.000 FORMAT "%8.3" EXTENDED_LIMITS -32768.00 32767.00 DEPOSIT ABSOLUTE /end AXIS_DESCR
 /begin AXIS_DESCR STD_AXIS AirCtl_qCtl InjMass 10 0.00 327.6700 FORMAT "%8.4" EXTENDED_LIMITS -327.6800 327.6700 DEPOSIT ABSOLUTE /end AXIS_DESCR
/end CHARACTERISTIC
/begin CHARACTERISTIC AirCtl_rCtlRgn3a_MAP "Steuerwert Regenerationsstufe 3 bei Atmosphärendruck ""a""" MAP 0x1C3326 Kf_Xs16_Ys16_Ws16 800.0000 Prc -400.0000 400.0000 FORMAT "%8.4" EXTENDED_LIMITS -327.6800 327.6700
 /begin AXIS_DESCR STD_AXIS Eng_nAvrg EngN 10 0.00 6000.000 FORMAT "%8.3" EXTENDED_LIMITS -32768.00 32767.00 DEPOSIT ABSOLUTE /end AXIS_DESCR
 /begin AXIS_DESCR STD_AXIS AirCtl_qCtl InjMass 10 0.00 327.6700 FORMAT "%8.4" EXTENDED_LIMITS -327.6800 327.6700 DEPOSIT ABSOLUTE /end AXIS_DESCR
/end CHARACTERISTIC
/begin CHARACTERISTIC AirCtl_rCtlRgn3b_MAP "Steuerwert Regenerationsstufe 3 bei Atmosphärendruck ""b""" MAP 0x1C341A Kf_Xs16_Ys16_Ws16 800.0000 Prc -400.0000 400.0000 FORMAT "%8.4" EXTENDED_LIMITS -327.6800 327.6700
 /begin AXIS_DESCR STD_AXIS Eng_nAvrg EngN 10 0.00 6000.000 FORMAT "%8.3" EXTENDED_LIMITS -32768.00 32767.00 DEPOSIT ABSOLUTE /end AXIS_DESCR
 /begin AXIS_DESCR STD_AXIS AirCtl_qCtl InjMass 10 0.00 327.6700 FORMAT "%8.4" EXTENDED_LIMITS -327.6800 327.6700 DEPOSIT ABSOLUTE /end AXIS_DESCR
/end CHARACTERISTIC
/begin CHARACTERISTIC AirCtl_rCtlRgn4a_MAP "Steuerwert Regenerationsstufe 4 bei Atmosphärendruck ""a""" MAP 0x1C350E Kf_Xs16_Ys16_Ws16 800.0000 Prc -400.0000 400.0000 FORMAT "%8.4" EXTENDED_LIMITS -327.6800 327.6700
 /begin AXIS_DESCR STD_AXIS Eng_nAvrg EngN 2 0.00 6000.000 FORMAT "%8.3" EXTENDED_LIMITS -32768.00 32767.00 DEPOSIT ABSOLUTE /end AXIS_DESCR
 /begin AXIS_DESCR STD_AXIS AirCtl_qCtl InjMass 2 0.00 327.6700 FORMAT "%8.4" EXTENDED_LIMITS -327.6800 327.6700 DEPOSIT ABSOLUTE /end AXIS_DESCR
/end CHARACTERISTIC
/begin CHARACTERISTIC AirCtl_rCtlRgn4b_MAP "Steuerwert Regenerationsstufe 4 bei Atmosphärendruck ""b""" MAP 0x1C3522 Kf_Xs16_Ys16_Ws16 800.0000 Prc -400.0000 400.0000 FORMAT "%8.4" EXTENDED_LIMITS -327.6800 327.6700
 /begin AXIS_DESCR STD_AXIS Eng_nAvrg EngN 2 0.00 6000.000 FORMAT "%8.3" EXTENDED_LIMITS -32768.00 32767.00 DEPOSIT ABSOLUTE /end AXIS_DESCR
 /begin AXIS_DESCR STD_AXIS AirCtl_qCtl InjMass 2 0.00 327.6700 FORMAT "%8.4" EXTENDED_LIMITS -327.6800 327.6700 DEPOSIT ABSOLUTE /end AXIS_DESCR
/end CHARACTERISTIC
/begin CHARACTERISTIC AirCtl_rCtlVal_Vector "Bypass-Label für Bypass von AirCtl_rCtlVal (NICHT veraendern!)" VALUE 0x1C0A2C Kw_Wu8 255.0 OneToOne 0.00 255.0 FORMAT "%5.1" /end CHARACTERISTIC
/begin CHARACTERISTIC AirCtl_rCtlVal_Channel "Bypass-Label für Bypass von AirCtl_rCtlVal (NICHT veraendern!)" VALUE 0x1C0A2D Kw_Wu8 255.0 OneToOne 0.00 255.0 FORMAT "%5.1" /end CHARACTERISTIC
/begin CHARACTERISTIC AirCtl_rEGR2LimMax_C "Maximalwert für AGR-Tastverhältnis linkes System" VALUE 0x1C4830 Kw_Ws16 300.0000 Prc -100.0000 200.0000 FORMAT "%8.4" EXTENDED_LIMITS -327.6800 327.6700 /end CHARACTERISTIC
/begin CHARACTERISTIC AirCtl_rEGR2LimMin_C "Minimalwert für AGR-Tastverhältnis linkes System" VALUE 0x1C4832 Kw_Ws16 300.0000 Prc -100.0000 200.0000 FORMAT "%8.4" EXTENDED_LIMITS -327.6800 327.6700 /end CHARACTERISTIC
/begin CHARACTERISTIC AirCtl_rEGRLimMax_C "Maximaler Wert für das AGR- Tastverhältnis rechtes System" VALUE 0x1C4834 Kw_Ws16 300.0000 Prc -100.0000 200.0000 FORMAT "%8.4" EXTENDED_LIMITS -327.6800 327.6700 /end CHARACTERISTIC
/begin CHARACTERISTIC AirCtl_rEGRLimMin_C "Minimalwert für AGR-Tastverhältnis rechtes System" VALUE 0x1C4836 Kw_Ws16 300.0000 Prc -100.0000 200.0000 FORMAT "%8.4" EXTENDED_LIMITS -327.6800 327.6700 /end CHARACTERISTIC
/begin CHARACTERISTIC AirCtl_rEGRMax_C "Maximales Tastverhältnis von AirCtl_rEGR der Ladedruckanforderung" VALUE 0x1C2A82 Kw_Ws16 400.0000 DtyCyc -200.0000 200.0000 FORMAT "%8.4" EXTENDED_LIMITS -327.6800 327.6700 /end CHARACTERISTIC
/begin CHARACTERISTIC AirCtl_RevThres_CUR "Kühlmitteltemperaturabhängiger Schwellwert für den Umdrehungszähler seit Startabwurf" CURVE 0x1C4610 Kl_Xs16_Ws16 32760.00 OneToOne 0.00 32760.00 FORMAT "%8.2" EXTENDED_LIMITS -32768.00 32767.00
 /begin AXIS_DESCR STD_AXIS AirCtl_tRevThres_mp Temp_Cels 8 -50.14000 149.8600 FORMAT "%8.4" EXTENDED_LIMITS -3549.940 3003.560 DEPOSIT ABSOLUTE /end AXIS_DESCR
/end CHARACTERISTIC
/begin CHARACTERISTIC AirCtl_RgnDT1_C "Zeitkonstante des DT1-Glieds bei der ARF für Partikelfilter Regeneration" VALUE 0x1C4838 Kw_Wu32 4294.9663 TimeDelay_s 0.0010000001 4294.9673 FORMAT "%9.4" EXTENDED_LIMITS 0.0000010000000 4294.9673 /end CHARACTERISTIC
/begin CHARACTERISTIC AirCtl_RgnDKd_C "Grundwert der Verstärkung des DT1-Glieds bei Kleinsignalen für Partikelfilter Regeneration" VALUE 0x1C483C Kw_Ws32 100.000000000 Kd_InjMass2Prc -50.0000000000 50.0000000000 FORMAT "%13.10" EXTENDED_LIMITS -32768.0000000 32767.9999847 /end CHARACTERISTIC
/begin CHARACTERISTIC AirCtl_RgnDKdPos_C "Grundwert der Verstärkung des DT1-Glieds bei positiven Großsignalen für partikelfilter Regeneration" VALUE 0x1C4840 Kw_Ws32 100.000000000 Kd_InjMass2Prc -50.0000000000 50.0000000000 FORMAT "%13.10" EXTENDED_LIMITS -32768.0000000 32767.9999847 /end CHARACTERISTIC
/begin CHARACTERISTIC AirCtl_RgnDKdNeg_C "Grundwert der Verstärkung des DT1-Glieds bei negativen Großsignalen für Partikelfilter Regeneration" VALUE 0x1C4844 Kw_Ws32 100.000000000 Kd_InjMass2Prc -50.0000000000 50.0000000000 FORMAT "%13.10" EXTENDED_LIMITS -32768.0000000 32767.9999847 /end CHARACTERISTIC
/begin CHARACTERISTIC AirCtl_dqRgnDWinPos_C "obere Kleinsignalgrenze für das DT1- Glied für Partikelfilter Regeneration" VALUE 0x1C4848 Kw_Ws16 16383.50 InjMassPerSec_20ms 0.00 16383.50 FORMAT "%8.2" EXTENDED_LIMITS -16384.00 16383.50 /end CHARACTERISTIC
/begin CHARACTERISTIC AirCtl_dqRgnDWinNeg_C "untere Kleinsignalgrenze für das DT1- Glied für Partikelfilter Regeneration" VALUE 0x1C484A Kw_Ws16 16384.00 InjMassPerSec_20ms -16384.00 0.00 FORMAT "%8.2" EXTENDED_LIMITS -16384.00 16383.50 /end CHARACTERISTIC
/begin CHARACTERISTIC AirCtl_RgnIKi_C "Grundwert der I-Verstärkung des PI-Reglers bei Kleinsignalen für Partikelfilter Regeneration" VALUE 0x1C484C Kw_Wu32 4.99999150634 Ki_Ampc2Prc 0.00 4.99999150634 FORMAT "%13.11" EXTENDED_LIMITS 0.00 99999.9999767 /end CHARACTERISTIC
/begin CHARACTERISTIC AirCtl_RgnIKiPos_C "Grundwert der I-Verstärkung des PI-Reglers bei positiven Großsignalen für Partikelfilter Regeneration" VALUE 0x1C4850 Kw_Wu32 4.99999150634 Ki_Ampc2Prc 0.00 4.99999150634 FORMAT "%13.11" EXTENDED_LIMITS 0.00 99999.9999767 /end CHARACTERISTIC
/begin CHARACTERISTIC AirCtl_RgnIKiNeg_C "Grundwert der I-Verstärkung des PI-Reglers bei negativen Großsignalen für Partikelfilter Regeneration" VALUE 0x1C4854 Kw_Wu32 4.99999150634 Ki_Ampc2Prc 0.00 4.99999150634 FORMAT "%13.11" EXTENDED_LIMITS 0.00 99999.9999767 /end CHARACTERISTIC
/begin CHARACTERISTIC AirCtl_mRgnIWinPos_C "obere Kleinsignalgrenze für den I-Kanal des PI-Reglers für Partikelfilter Regeneration" VALUE 0x1C4858 Kw_Ws16 1500.000 AirMassPerCyl 0.00 1500.000 FORMAT "%8.3" EXTENDED_LIMITS -3276.800 3276.700 /end CHARACTERISTIC
/begin CHARACTERISTIC AirCtl_mRgnIWinNeg_C "untere Kleinsignalgrenze für den I-Kanal des PI-Reglers für Partikelfilter Regeneration" VALUE 0x1C485A Kw_Ws16 1500.000 AirMassPerCyl -1500.000 0.00 FORMAT "%8.3" EXTENDED_LIMITS -3276.800 3276.700 /end CHARACTERISTIC
/begin CHARACTERISTIC AirCtl_RgnPKp_C "Grundwert der P-Verstärkung des PI-Reglers bei Kleinsignalen für Partikelfilter Regeneration" VALUE 0x1C485C Kw_Wu32 10.0000000000 Kp_Ampc2Prc 0.00 10.0000000000 FORMAT "%13.10" EXTENDED_LIMITS 0.00 6553.59999847 /end CHARACTERISTIC
/begin CHARACTERISTIC AirCtl_RgnPKpPos_C "Grundwert der P-Verstärkung des PI-Reglers bei positiven Großsignalen für Partikelfilter Regeneration" VALUE 0x1C4860 Kw_Wu32 10.0000000000 Kp_Ampc2Prc 0.00 10.0000000000 FORMAT "%13.10" EXTENDED_LIMITS 0.00 6553.59999847 /end CHARACTERISTIC
/begin CHARACTERISTIC AirCtl_RgnPKpNeg_C "Grundwert der P-Verstärkung des PI-Reglers bei negativen Großsignalen für Partikelfilter Regeneration" VALUE 0x1C4864 Kw_Wu32 10.0000000000 Kp_Ampc2Prc 0.00 10.0000000000 FORMAT "%13.10" EXTENDED_LIMITS 0.00 6553.59999847 /end CHARACTERISTIC
/begin CHARACTERISTIC AirCtl_mRgnPWinPos_C "obere Kleinsignalgrenze für den P-Kanal des PI-Reglers für Partikelfilter Regeneration" VALUE 0x1C4868 Kw_Ws16 1500.000 AirMassPerCyl 0.00 1500.000 FORMAT "%8.3" EXTENDED_LIMITS -3276.800 3276.700 /end CHARACTERISTIC
/begin CHARACTERISTIC AirCtl_mRgnPWinNeg_C "untere Kleinsignalgrenze für den P-Kanal des PI-Reglers für Partikelfilter Regeneration" VALUE 0x1C486A Kw_Ws16 1500.000 AirMassPerCyl -1500.000 0.00 FORMAT "%8.3" EXTENDED_LIMITS -3276.800 3276.700 /end CHARACTERISTIC
/begin CHARACTERISTIC AirCtl_rGovMax_C "maximal zulässige Reglerstellgröße" VALUE 0x1C486C Kw_Ws16 300.0000 Prc -100.0000 200.0000 FORMAT "%8.4" EXTENDED_LIMITS -327.6800 327.6700 /end CHARACTERISTIC
/begin CHARACTERISTIC AirCtl_rGovMin_C "minimal zulässige Reglerstellgröße" VALUE 0x1C486E Kw_Ws16 300.0000 Prc -100.0000 200.0000 FORMAT "%8.4" EXTENDED_LIMITS -327.6800 327.6700 /end CHARACTERISTIC
/begin CHARACTERISTIC AirCtl_rIDflGearShft_C "Initialisierungswert des Reglers bei Abschaltursache Schaltvorgang" VALUE 0x1C4870 Kw_Ws16 300.0000 Prc -100.0000 200.0000 FORMAT "%8.4" EXTENDED_LIMITS -327.6800 327.6700 /end CHARACTERISTIC
/begin CHARACTERISTIC AirCtl_rIDflOvrRun_C "Initialisierungswert des Reglers bei Abschaltursache Schubbetrieb" VALUE 0x1C4872 Kw_Ws16 300.0000 Prc -100.0000 200.0000 FORMAT "%8.4" EXTENDED_LIMITS -327.6800 327.6700 /end CHARACTERISTIC
/begin CHARACTERISTIC AirCtl_rIDflShOff_C "Initialisierungswert des Reglers bei Abschaltung" VALUE 0x1C4874 Kw_Ws16 300.0000 Prc -100.0000 200.0000 FORMAT "%8.4" EXTENDED_LIMITS -327.6800 327.6700 /end CHARACTERISTIC
/begin CHARACTERISTIC AirCtl_tiPT1BPA_C "Zeitkonstante des PT1-Gliedes für die Filterung des TV des Ladedruckstellers" VALUE 0x1C2A84 Kw_Wu32 4294.9673 TimeDelay_s 0.0000010000000 4294.9673 FORMAT "%9.4" /end CHARACTERISTIC
/begin CHARACTERISTIC AirCtl_tiPT1EGR_C "Zeitkonstante des PT1-Gliedes für die Filterung des TV des Abgasrückführstellers" VALUE 0x1C2A88 Kw_Wu32 4294.9673 TimeDelay_s 0.0000010000000 4294.9673 FORMAT "%9.4" /end CHARACTERISTIC
/begin CHARACTERISTIC AirCtl_rTEngCor1_MAP "Konvertierungskurve 1 Temp_Kelv -> %, Korrektur durch Motortemperatur" MAP 0x1C3536 Kf_Xs16_Ys16_Ws16 100.0000 Prc 0.00 100.0000 FORMAT "%8.4" EXTENDED_LIMITS -327.6800 327.6700
 /begin AXIS_DESCR STD_AXIS Eng_nAvrg EngN 10 0.00 6000.000 FORMAT "%8.3" EXTENDED_LIMITS -32768.00 32767.00 DEPOSIT ABSOLUTE /end AXIS_DESCR
 /begin AXIS_DESCR STD_AXIS Eng_tEng Temp_Cels 8 -50.14000 199.8600 FORMAT "%8.4" EXTENDED_LIMITS -3549.940 3003.560 DEPOSIT ABSOLUTE /end AXIS_DESCR
/end CHARACTERISTIC
/begin CHARACTERISTIC AirCtl_rTEngCor_MAP "Kühlmitteltemperaturabhängige Korrektur" MAP 0x1C35FE Kf_Xs16_Ys16_Ws16 100.0000 Prc 0.00 100.0000 FORMAT "%8.4" EXTENDED_LIMITS -327.6800 327.6700
 /begin AXIS_DESCR STD_AXIS Eng_nAvrg EngN 10 0.00 6000.000 FORMAT "%8.3" EXTENDED_LIMITS -32768.00 32767.00 DEPOSIT ABSOLUTE /end AXIS_DESCR
 /begin AXIS_DESCR STD_AXIS Eng_tEng Temp_Cels 8 -50.14000 199.8600 FORMAT "%8.4" EXTENDED_LIMITS -3549.940 3003.560 DEPOSIT ABSOLUTE /end AXIS_DESCR
/end CHARACTERISTIC
/begin CHARACTERISTIC AirCtl_rTrmValCor_CUR "Konvertierung Luftmasse nach Prozent und Korrekturwert" CURVE 0x1C36C6 Kl_Xs16_Ws16 800.0000 Prc -400.0000 400.0000 FORMAT "%8.4" EXTENDED_LIMITS -327.6800 327.6700
 /begin AXIS_DESCR STD_AXIS AirCtl_TrmValLim AirMassPerCyl 5 -400.0000 400.0000 FORMAT "%8.4" EXTENDED_LIMITS -3276.800 3276.700 DEPOSIT ABSOLUTE /end AXIS_DESCR
/end CHARACTERISTIC
/begin CHARACTERISTIC AirCtl_stAftRunValCBV_C "Vorgabewert für EGR Kühler Bypass Ansteuerung im Nachlauf" VALUE 0x1C2AF8 Kw_Wu8 1.000 OneToOne 0.00 1.000 FORMAT "%5.3" EXTENDED_LIMITS 0.00 255.0 /end CHARACTERISTIC
/begin CHARACTERISTIC AirCtl_stATCorMsk_C "Maske für EGT-Status" VALUE 0x1C4634 Kw_Wu32 4294967295.00 OneToOne 0.00 4294967295.00 FORMAT "%13.2" /end CHARACTERISTIC
/begin CHARACTERISTIC AirCtl_stCTCorMsk_C "Maske für EGT-Status" VALUE 0x1C4638 Kw_Wu32 4294967295.00 OneToOne 0.00 4294967295.00 FORMAT "%13.2" /end CHARACTERISTIC
/begin CHARACTERISTIC AirCtl_stCtlRgnMsk1_C "Maske zur Umschaltung Steuergröße für Partikelfilter Regeneration 1" VALUE 0x1C36DC Kw_Wu32 4294967295.00 OneToOne 0.00 4294967295.00 FORMAT "%13.2" /end CHARACTERISTIC
/begin CHARACTERISTIC AirCtl_stCtlRgnMsk2_C "Maske zur Umschaltung Steuergröße für Partikelfilter Regeneration 2" VALUE 0x1C36E0 Kw_Wu32 4294967295.00 OneToOne 0.00 4294967295.00 FORMAT "%13.2" /end CHARACTERISTIC
/begin CHARACTERISTIC AirCtl_stCtlRgnMsk3_C "applizierbare Bimaske für 3. Regenerationsstufe" VALUE 0x1C36E4 Kw_Wu32 4294967295.00 OneToOne 0.00 4294967295.00 FORMAT "%13.2" /end CHARACTERISTIC
/begin CHARACTERISTIC AirCtl_stCtlRgnMsk4_C "applizierbare Bimaske für 4. Regenerationsstufe" VALUE 0x1C36E8 Kw_Wu32 4294967295.00 OneToOne 0.00 4294967295.00 FORMAT "%13.2" /end CHARACTERISTIC
/begin CHARACTERISTIC AirCtl_stDesBaseMsk_C "Bitmaske für die Einspritzcharakterabhängige Kennfeldum-schaltung." VALUE 0x1C463C Kw_Wu8 255.0 OneToOne 0.00 255.0 FORMAT "%5.1" /end CHARACTERISTIC
/begin CHARACTERISTIC AirCtl_stDesRgnMsk1_C "Maske zur Umschaltung Sollwert für Partikelfilter Regeneration 1" VALUE 0x1C4640 Kw_Wu32 4294967295.00 OneToOne 0.00 4294967295.00 FORMAT "%13.2" /end CHARACTERISTIC
/begin CHARACTERISTIC AirCtl_stDesRgnMsk2_C "Maske zur Umschaltung Sollwert für Partikelfilter Regeneration 2" VALUE 0x1C4644 Kw_Wu32 4294967295.00 OneToOne 0.00 4294967295.00 FORMAT "%13.2" /end CHARACTERISTIC
/begin CHARACTERISTIC AirCtl_stDesRgnMsk3_C "applizierbare Bitmaske für 3. Regenerationsstufe" VALUE 0x1C4648 Kw_Wu32 4294967295.00 OneToOne 0.00 4294967295.00 FORMAT "%13.2" /end CHARACTERISTIC
/begin CHARACTERISTIC AirCtl_stDesRgnMsk4_C "applizierbare Bitmaske für 4. Regenerationsstufe" VALUE 0x1C464C Kw_Wu32 4294967295.00 OneToOne 0.00 4294967295.00 FORMAT "%13.2" /end CHARACTERISTIC
/begin CHARACTERISTIC AirCtl_stDflValCBV_C "Vorgabewert für EGR Kühler bypass" VALUE 0x1C2AF9 Kw_Wu8 1.000 OneToOne 0.00 1.000 FORMAT "%5.3" EXTENDED_LIMITS 0.00 255.0 /end CHARACTERISTIC
/begin CHARACTERISTIC AirCtl_stDiagStartCBV_C "Ausgang des EGR-Kühler Bypass nach Start" VALUE 0x1C2AFA Kw_Wu8 1.000 OneToOne 0.00 1.000 FORMAT "%5.3" EXTENDED_LIMITS 0.00 255.0 /end CHARACTERISTIC
/begin CHARACTERISTIC AirCtl_stEGRClgBypVlv_Vector "Konfigurationslabel für Bypass Freischnitt" VALUE 0x1C0A2A Kw_Wu8 255.0 OneToOne 0.00 255.0 FORMAT "%5.1" /end CHARACTERISTIC
/begin CHARACTERISTIC AirCtl_stEGRClgBypVlv_Channel "Konfigurationslabel für Bypass Freischnitt" VALUE 0x1C0A2B Kw_Wu8 255.0 OneToOne 0.00 255.0 FORMAT "%5.1" /end CHARACTERISTIC
/begin CHARACTERISTIC AirCtl_stInitGovRgnMsk_C "Bitmaske für Initialisierung der AGR Regelung" VALUE 0x1C4878 Kw_Wu32 4294967295.00 OneToOne 0.00 4294967295.00 FORMAT "%13.2" /end CHARACTERISTIC
/begin CHARACTERISTIC AirCtl_stNQCTCorMsk1_C "Maske 1 für EGT-Status" VALUE 0x1C4650 Kw_Wu32 4294967295.00 OneToOne 0.00 4294967295.00 FORMAT "%13.2" /end CHARACTERISTIC
/begin CHARACTERISTIC AirCtl_stNQCTCorMsk2_C "Maske 2 für EGT-Status" VALUE 0x1C4654 Kw_Wu32 4294967295.00 OneToOne 0.00 4294967295.00 FORMAT "%13.2" /end CHARACTERISTIC
/begin CHARACTERISTIC AirCtl_stNQCTCorMsk3_C "Maske 3 für EGT-Status" VALUE 0x1C4658 Kw_Wu32 4294967295.00 OneToOne 0.00 4294967295.00 FORMAT "%13.2" /end CHARACTERISTIC
/begin CHARACTERISTIC AirCtl_strTEngCorMsk_C "Maske für Luftmassenkorrektur" VALUE 0x1C36EC Kw_Wu32 4294967295.00 OneToOne 0.00 4294967295.00 FORMAT "%13.2" /end CHARACTERISTIC
/begin CHARACTERISTIC AirCtl_swtAPCorVal_C "Schalterwert für add./mult. Atmosphärendruckkorrektur" VALUE 0x1C465C Kw_Wu8 1.000 OneToOne 0.00 1.000 FORMAT "%5.3" EXTENDED_LIMITS 0.00 255.0 READ_ONLY /end CHARACTERISTIC
/begin CHARACTERISTIC AirCtl_swtAPCorType_C "Schaltertyp für add./mult. Atmosphärendruckkorrektur" VALUE 0x1C465D Kw_Wu8 0.00 OneToOne 0.00 0.00 FORMAT "%5.2" EXTENDED_LIMITS 0.00 255.0 READ_ONLY /end CHARACTERISTIC
/begin CHARACTERISTIC AirCtl_swtATCorVal_C "Schalterwert für add./mult. Lufttemperaturkorrektur" VALUE 0x1C465E Kw_Wu8 1.000 OneToOne 0.00 1.000 FORMAT "%5.3" EXTENDED_LIMITS 0.00 255.0 READ_ONLY /end CHARACTERISTIC
/begin CHARACTERISTIC AirCtl_swtATCorType_C "Schaltertyp für add./mult. Lufttemperaturkorrektur" VALUE 0x1C465F Kw_Wu8 0.00 OneToOne 0.00 0.00 FORMAT "%5.2" EXTENDED_LIMITS 0.00 255.0 READ_ONLY /end CHARACTERISTIC
/begin CHARACTERISTIC AirCtl_swtCorrActv_C "Umschalter zum Wechseln der Korrekturstrategie" VALUE 0x1C4660 Kw_Wu8 1.000 OneToOne 0.00 1.000 FORMAT "%5.3" EXTENDED_LIMITS 0.00 255.0 /end CHARACTERISTIC
/begin CHARACTERISTIC AirCtl_swtGovEGRSep_C "Auswahl der getrennten AGR Regelung" VALUE 0x1C487C Kw_Wu8 1.000 OneToOne 0.00 1.000 FORMAT "%5.3" EXTENDED_LIMITS 0.00 255.0 /end CHARACTERISTIC
/begin CHARACTERISTIC AirCtl_swtGovVal_C "Schalterwert für Reglerabschaltung (0=Gov OFF; 1=Gov ON)" VALUE 0x1C487D Kw_Wu8 1.000 OneToOne 0.00 1.000 FORMAT "%5.3" EXTENDED_LIMITS 0.00 255.0 /end CHARACTERISTIC
/begin CHARACTERISTIC AirCtl_swtGovType_C "Schaltertyp für Reglerabschaltung" VALUE 0x1C487E Kw_Wu8 1.000 OneToOne 1.000 2.000 FORMAT "%5.3" EXTENDED_LIMITS 0.00 255.0 /end CHARACTERISTIC
/begin CHARACTERISTIC AirCtl_swtMAirPerCyl_C "Schalter für Istwert Luftmassenregelung 0: HFM, 1: ASMod" VALUE 0x1C487F Kw_Wu8 1.000 OneToOne 0.00 1.000 FORMAT "%5.3" EXTENDED_LIMITS 0.00 255.0 /end CHARACTERISTIC
/begin CHARACTERISTIC AirCtl_swtRpOilCtl_C "Korrigierte Einspritzmengen Wahlschalter" VALUE 0x1C46BE Kw_Wu8 255.0 OneToOne 0.00 255.0 FORMAT "%5.1" /end CHARACTERISTIC
/begin CHARACTERISTIC AirCtl_swtRpOilDes_C "Korrigierte Einspritzmengen Wahlschalter" VALUE 0x1C46BF Kw_Wu8 255.0 OneToOne 0.00 255.0 FORMAT "%5.1" /end CHARACTERISTIC
/begin CHARACTERISTIC AirCtl_swtRpOilGov_C "Korrigierte Einspritzmengen Wahlschalter" VALUE 0x1C46C0 Kw_Wu8 255.0 OneToOne 0.00 255.0 FORMAT "%5.1" /end CHARACTERISTIC
/begin CHARACTERISTIC AirCtl_swtRpOilMon_C "Korrigierte Einspritzmengen Wahlschalter" VALUE 0x1C46C1 Kw_Wu8 255.0 OneToOne 0.00 255.0 FORMAT "%5.1" /end CHARACTERISTIC
/begin CHARACTERISTIC AirCtl_swtTempRevThres_C "Schalter der Temperaturwert des Arrays auswählt" VALUE 0x1C4661 Kw_Wu8 4.00000000000 EngTempFldSel 0.00 4.00000000000 FORMAT "%13.11" /end CHARACTERISTIC
/begin CHARACTERISTIC AirCtl_swtTrmVal_C "Schalterwert für add./mult. Abgleichkorrektur" VALUE 0x1C4662 Kw_Wu8 1.000 OneToOne 0.00 1.000 FORMAT "%5.3" EXTENDED_LIMITS 0.00 255.0 READ_ONLY /end CHARACTERISTIC
/begin CHARACTERISTIC AirCtl_swtTrmType_C "Schaltertyp für add./mult. Abgleichkorrektur" VALUE 0x1C4663 Kw_Wu8 0.00 OneToOne 0.00 0.00 FORMAT "%5.2" EXTENDED_LIMITS 0.00 255.0 READ_ONLY /end CHARACTERISTIC
/begin CHARACTERISTIC AirCtl_tAirCBVHysHi_C "Obere Grenze für Ansauglufttemperatur" VALUE 0x1C2AFC Kw_Ws16 250.0000 Temp_Cels -50.14000 199.8600 FORMAT "%8.4" EXTENDED_LIMITS -3549.940 3003.560 /end CHARACTERISTIC
/begin CHARACTERISTIC AirCtl_tAirCBVHysLo_C "Untere Grenze für Ansauglufttemperatur" VALUE 0x1C2AFE Kw_Ws16 250.0000 Temp_Cels -50.14000 199.8600 FORMAT "%8.4" EXTENDED_LIMITS -3549.940 3003.560 /end CHARACTERISTIC
/begin CHARACTERISTIC AirCtl_tClntCBVHysHi_C "obere Schwelle der Kühlmitteltemperaturhysterese für den EGR-Kühler Bypass" VALUE 0x1C2B00 Kw_Ws16 200.0000 Temp_Cels -50.14000 149.8600 FORMAT "%8.4" EXTENDED_LIMITS -3549.940 3003.560 /end CHARACTERISTIC
/begin CHARACTERISTIC AirCtl_tClntCBVHysLo_C "untere Schwelle der Kühlmitteltemperaturhysterese für den EGR-Kühler Bypass" VALUE 0x1C2B02 Kw_Ws16 200.0000 Temp_Cels -50.14000 149.8600 FORMAT "%8.4" EXTENDED_LIMITS -3549.940 3003.560 /end CHARACTERISTIC
/begin CHARACTERISTIC AirCtl_tCThreshold_C "Kühlwassertemperaturschwelle für Parameterumschaltung der dyn. Sollwertbildung" VALUE 0x1C4664 Kw_Ws16 6553.500 Temp_Cels -3549.940 3003.560 FORMAT "%8.3" /end CHARACTERISTIC
/begin CHARACTERISTIC AirCtl_tiATCorRmp_C "Zeit für rampenförmigen Sprung bei Wechel EGT-Status" VALUE 0x1C4668 Kw_Wu32 65535999.9847 Rmp 0.00 65535999.9847 FORMAT "%13.4" /end CHARACTERISTIC
/begin CHARACTERISTIC AirCtl_tiBPAHold_CUR "maximale Zeit der LDR-Abschaltung" CURVE 0x1C2A8C Kl_Xs16_Ws16 134200.0 Time_ms 0.00 134200.0 FORMAT "%8.1" EXTENDED_LIMITS -327680.0 327670.0
 /begin AXIS_DESCR STD_AXIS AirCtl_rPT1EGR_mp DtyCyc 8 0.00 100.0000 FORMAT "%8.4" EXTENDED_LIMITS -327.6800 327.6700 DEPOSIT ABSOLUTE /end AXIS_DESCR
/end CHARACTERISTIC
/begin CHARACTERISTIC AirCtl_tiCTCorRmp_C "Zeit für rampenförmigen Sprung bei Wechel EGT-Status" VALUE 0x1C466C Kw_Wu32 65535999.9847 Rmp 0.00 65535999.9847 FORMAT "%13.4" /end CHARACTERISTIC
/begin CHARACTERISTIC AirCtl_tiCtlRgnRmp_C "Rampenzeit für die Umschaltung der Steuergröße für Partikelfilter Regeneration" VALUE 0x1C36F0 Kw_Wu32 31.775030303030302 TimeEGTRmp 0.99296969696969695 32.768000000000001 FORMAT "%19.16" EXTENDED_LIMITS 0.000000015258789066052715 65.536000000000001 /end CHARACTERISTIC
/begin CHARACTERISTIC AirCtl_tiDesRgnRmp_C "Rampenzeit für die Umschaltung des Sollwertes für Partikelfilter Regeneration" VALUE 0x1C4670 Kw_Wu32 31.775030303030302 TimeEGTRmp 0.99296969696969695 32.768000000000001 FORMAT "%19.16" EXTENDED_LIMITS 0.000000015258789066052715 65.536000000000001 /end CHARACTERISTIC
/begin CHARACTERISTIC AirCtl_tiEGRHold_C "Minimale Zeit der ARF-Abschaltung" VALUE 0x1C2AAE Kw_Wu16 268430.0 Time_ms 0.00 268430.0 FORMAT "%8.1" EXTENDED_LIMITS 0.00 655350.0 /end CHARACTERISTIC
/begin CHARACTERISTIC AirCtl_tiInitGovRgn_C "Wartezeit für Initialisierung der AGR Regelung bei Umschalten in/von Regenerationsbetrieb" VALUE 0x1C4880 Kw_Wu16 655140.0 Time_ms 0.00 655140.0 FORMAT "%8.1" EXTENDED_LIMITS 0.00 655350.0 /end CHARACTERISTIC
/begin CHARACTERISTIC AirCtl_tiNQCTCorRmp_C "Zeit für rampenförmigen Sprung bei Wechel EGT-Status" VALUE 0x1C4674 Kw_Wu32 65535999.9847 Rmp 0.00 65535999.9847 FORMAT "%13.4" /end CHARACTERISTIC
/begin CHARACTERISTIC AirCtl_tiPT1qDes_C "Zeitkonstante des PT1-Glieds für die Wunscheinspritzmenge." VALUE 0x1C2AB0 Kw_Wu32 4294.9663 TimeDelay_s 0.0010000001 4294.9673 FORMAT "%9.4" EXTENDED_LIMITS 0.0000010000000 4294.9673 /end CHARACTERISTIC
/begin CHARACTERISTIC AirCtl_tirTEngCorRmp_C "Zeit für rampenförmigen Sprung bei Wechel EGT-Status" VALUE 0x1C36F4 Kw_Wu32 65535999.9847 Rmp 0.00 65535999.9847 FORMAT "%13.4" /end CHARACTERISTIC
/begin CHARACTERISTIC AirCtl_tiSwtDiagStartCBV_C "Zeit für die Ansteuerung des EGR-Kühler Bypass nach Start" VALUE 0x1C2B04 Kw_Wu16 1000.000 Time_ms 0.00 1000.000 FORMAT "%8.3" EXTENDED_LIMITS 0.00 655350.0 /end CHARACTERISTIC
/begin CHARACTERISTIC AirCtl_TrmVal_C "ARF-Abgleichwert" VALUE 0x1C4678 Kw_Ws16 3000.000 AirMassPerCyl -1500.000 1500.000 FORMAT "%8.3" EXTENDED_LIMITS -3276.800 3276.700 /end CHARACTERISTIC
/begin MEASUREMENT ACCtl_stACPressDem_mp "Abschaltanforderung durch Kältemitteldruck (vor Zeitbegrenzung)" UBYTE OneToOne 1 100 0.00 255.0 FORMAT "%5.1" ECU_ADDRESS 0x801E92 /end MEASUREMENT
/begin MEASUREMENT ACCtl_stACRequest "Anforderung Leerlaufsolldrehzahlanhebung durch Klima" UBYTE OneToOne 1 100 0.00 255.0 FORMAT "%5.1" ECU_ADDRESS 0x7F92ED /end MEASUREMENT
/begin MEASUREMENT ACCtl_stBitStructure "Status der verschiedenen Abschaltbedingungen" UWORD OneToOne 1 100 0.00 65535.00 FORMAT "%8.2" ECU_ADDRESS 0x7F954E /end MEASUREMENT
/begin MEASUREMENT ACCtl_stHys "Statusinformation zur Klimakompressoransteuerung" UWORD OneToOne 1 100 0.00 65535.00 FORMAT "%8.2" ECU_ADDRESS 0x7F9550 /end MEASUREMENT
/begin MEASUREMENT ACCtl_stLogicOut "Status der aktiven Abschaltbedingungen für Klimakompressor" UBYTE OneToOne 1 100 0.00 255.0 FORMAT "%5.1" ECU_ADDRESS 0x7F92EE /end MEASUREMENT
/begin MEASUREMENT ACCtl_stLogicReduction "Status der Klimakompressor Leistungsreduzierung" UBYTE OneToOne 1 100 0.00 255.0 FORMAT "%5.1" ECU_ADDRESS 0x7F92EF /end MEASUREMENT
/begin MEASUREMENT ACCtl_stLowByte_mp "LowByte von ACCtl_stBitStructure" UBYTE OneToOne 1 100 0.00 255.0 FORMAT "%5.1" ECU_ADDRESS 0x801E93 /end MEASUREMENT
/begin MEASUREMENT ACCtl_stTSCfreezeReduction_mp "Einfrieren der Klimakompressor-Leistungsreduzierung durch TSC" UBYTE OneToOne 1 100 0.00 255.0 FORMAT "%5.1" ECU_ADDRESS 0x801EA2 /end MEASUREMENT
/begin MEASUREMENT ACCtl_stTSCfreeze_mp "Ausgangsstatus der zeitlichen Begrenzung für TSC (ehem. EGS) Eingriff" UBYTE OneToOne 1 100 0.00 255.0 FORMAT "%5.1" ECU_ADDRESS 0x801EA3 /end MEASUREMENT
/begin MEASUREMENT ACCtl_stVehicleStand "Status von stillstehenden Fahrzeug" UBYTE OneToOne 1 100 0.00 255.0 FORMAT "%5.1" ECU_ADDRESS 0x7F92F0 /end MEASUREMENT
/begin MEASUREMENT ACCtl_stVehStand_mp "Fahrzeug im ""sicheren"" Stillstand" UBYTE OneToOne 1 100 0.00 255.0 FORMAT "%5.1" ECU_ADDRESS 0x801EA4 /end MEASUREMENT
/begin MEASUREMENT ACCtl_tACOff_mp "Temperaturwert von dem Array Eng_tFld" SWORD Temp_Cels 1 100 -3549.940 3003.560 FORMAT "%8.3" ECU_ADDRESS 0x801E94 /end MEASUREMENT
/begin MEASUREMENT ACCtl_tEngHys_mp "Temperaturwert von dem Array Eng_tFld" SWORD Temp_Cels 1 100 -3549.940 3003.560 FORMAT "%8.3" ECU_ADDRESS 0x801E96 /end MEASUREMENT
/begin MEASUREMENT ACCtl_tiACOnDly_mp "Zeitverzögerung nach Motorstart für Freigabe des Klimakompressors bei eingeschalteter Klimaanlage" UWORD Time_ms 1 100 0.00 655350.0 FORMAT "%8.1" ECU_ADDRESS 0x801E98 /end MEASUREMENT
/begin MEASUREMENT ACCtl_tiACStrtDly_mp "Zeitverzögerung nach Motorstart für Freigabe des Klimakompressors" UWORD Time_ms 1 100 0.00 655350.0 FORMAT "%8.1" ECU_ADDRESS 0x801E9A /end MEASUREMENT
/begin MEASUREMENT ACCtl_tiDAmax_mp "	max Zeit für Abschalten AC beim Anfahren" UWORD Time_ms 1 100 0.00 655350.0 FORMAT "%8.1" ECU_ADDRESS 0x801E9C /end MEASUREMENT
/begin MEASUREMENT ACCtl_tiDAmin_mp "min Zeit für Abschalten AC beim Anfahren" UWORD Time_ms 1 100 0.00 655350.0 FORMAT "%8.1" ECU_ADDRESS 0x801E9E /end MEASUREMENT
/begin MEASUREMENT ACCtl_tWTHi_mp "obere Hysteresschwelle für die Abschaltbedingung WASSERTEMPERATUR" SWORD Temp_Cels 1 100 -3549.940 3003.560 FORMAT "%8.3" ECU_ADDRESS 0x801EA0 /end MEASUREMENT
/begin MEASUREMENT ACC_stCrCtl "Zustand ACC" UBYTE OneToOne 1 100 0.00 255.0 FORMAT "%5.1" ECU_ADDRESS 0x7F92EB /end MEASUREMENT
/begin MEASUREMENT ACC_stCrCtlByp_mp "Bypass message für ACC_stCrCtl" UBYTE OneToOne 1 100 0.00 255.0 FORMAT "%5.1" ECU_ADDRESS 0x801E0A /end MEASUREMENT
/begin MEASUREMENT ACC_stDrvBrk "Status Fahrer bremst" UBYTE OneToOne 1 100 0.00 255.0 FORMAT "%5.1" ECU_ADDRESS 0x7F92EC /end MEASUREMENT
/begin MEASUREMENT ACC_stDrvBrkByp_mp "Meßpunkt für Bypass" UBYTE OneToOne 1 100 0.00 255.0 FORMAT "%5.1" ECU_ADDRESS 0x801E0B /end MEASUREMENT
/begin MEASUREMENT ACC_stShutOff_mp "Meßpunkt des the ir-reversible shut-off status" UWORD OneToOne 1 100 0.00 65535.00 FORMAT "%8.2" ECU_ADDRESS 0x801E0C /end MEASUREMENT
/begin MEASUREMENT ACC_stState_mp "Meßpunkt für Zustand des ACC-Zustandsautomaten" UBYTE OneToOne 1 100 0.00 255.0 FORMAT "%5.1" ECU_ADDRESS 0x801E0E /end MEASUREMENT
/begin MEASUREMENT ACC_stTrqRel_mp "Meßpunkt des torque release errors" UBYTE OneToOne 1 100 0.00 255.0 FORMAT "%5.1" ECU_ADDRESS 0x801E0F /end MEASUREMENT
/begin MEASUREMENT ACC_trqDes "gewünschtes ACC-Moment" SWORD TrqPrp 1 100 -32768.00 32767.00 FORMAT "%8.2" ECU_ADDRESS 0x7F954A /end MEASUREMENT
/begin MEASUREMENT ACC_trqDesByp_mp "Meßpunkt für Bypass" SWORD TrqPrp 1 100 -32768.00 32767.00 FORMAT "%8.2" ECU_ADDRESS 0x801E10 /end MEASUREMENT
/begin MEASUREMENT ACC_trqLead "ACC-Vorhaltemoment" SWORD TrqPrp 1 100 -32768.00 32767.00 FORMAT "%8.2" ECU_ADDRESS 0x7F954C /end MEASUREMENT
/begin MEASUREMENT ACC_trqLeadByp_mp "Meßpunkt für Bypass" SWORD TrqPrp 1 100 -32768.00 32767.00 FORMAT "%8.2" ECU_ADDRESS 0x801E12 /end MEASUREMENT
/begin MEASUREMENT ACTrqC_trqDes "Momentenforderung Klimakompressor" SWORD Trq 1 100 -3276.800 3276.700 FORMAT "%8.3" ECU_ADDRESS 0x7F9552 /end MEASUREMENT
/begin MEASUREMENT ACTrqC_trqDyn_mp "Messpunkt für den dynamischen Momentenanforderungsanteil (Ausgang DT1)" SWORD Trq 1 100 -3276.800 3276.700 FORMAT "%8.3" ECU_ADDRESS 0x801EA6 /end MEASUREMENT
/begin MEASUREMENT ACTrqC_trqLead "Momentenvorhalt Klimakompressor" SWORD Trq 1 100 -3276.800 3276.700 FORMAT "%8.3" ECU_ADDRESS 0x7F9554 /end MEASUREMENT
/begin MEASUREMENT ACTrqC_trqStat_mp "Momentenbedarf Klimakompressor im statischen Betrieb" SWORD Trq 1 100 -3276.800 3276.700 FORMAT "%8.3" ECU_ADDRESS 0x801EA8 /end MEASUREMENT
/begin MEASUREMENT AC_nACComp_mp "Messpunkt Drehzahl Klimakompressor" SWORD OneToOne 1 100 -32768.00 32767.00 FORMAT "%8.2" ECU_ADDRESS 0x801E06 /end MEASUREMENT
/begin MEASUREMENT AC_pwrAdjVal_mp "Abgleichwert zur Berechnung der Klimaleistung" SWORD Fact 1 100 -4.000000 3.999878 FORMAT "%8.6" ECU_ADDRESS 0x801E08 /end MEASUREMENT
/begin MEASUREMENT AC_pwrDes "Leistungsanforderung Wunsch Klimakompressor" SWORD Pwr 1 100 -308831.1 308821.7 FORMAT "%8.1" ECU_ADDRESS 0x7F9556 /end MEASUREMENT
/begin MEASUREMENT AC_pwrLead "Leistungsanforderung Vorhalt Klimakompressor" SWORD Pwr 1 100 -308831.1 308821.7 FORMAT "%8.1" ECU_ADDRESS 0x7F9558 /end MEASUREMENT
/begin MEASUREMENT ADCMon_ctQueueNSync_mp "Zähler zur Lebenderkennung der ereignissynchronen Queue" UWORD OneToOne 1 100 0.00 65535.00 FORMAT "%8.2" ECU_ADDRESS 0x801EAA /end MEASUREMENT
/begin MEASUREMENT ADCMon_ctQueueTSync_mp "Zähler zur Lebenderkennung der zeitsynchronen Queue" UWORD OneToOne 1 100 0.00 65535.00 FORMAT "%8.2" ECU_ADDRESS 0x801EAC /end MEASUREMENT
/begin MEASUREMENT ADCMon_stADCMon "Status der ADC-Überwachung" UWORD OneToOne 1 100 0.00 65535.00 FORMAT "%8.2" ECU_ADDRESS 0x7F955A /end MEASUREMENT
/begin MEASUREMENT ADCMon_stQueue_mp "Wandlungsstatus der ADC-Queues" UBYTE OneToOne 1 100 0.00 255.0 FORMAT "%5.1" ECU_ADDRESS 0x801EAE /end MEASUREMENT
/begin MEASUREMENT ADCMon_uRefRaw_mp "Rohwert der ADC-Referenzspannung" SWORD Volt 1 100 -160156.4 160151.5 FORMAT "%8.1" ECU_ADDRESS 0x801EB0 /end MEASUREMENT
/begin MEASUREMENT ADCMon_uTstImpRaw_mp "Rohwert der ADC-Testimpulsspannung" SWORD Volt 1 100 -160156.4 160151.5 FORMAT "%8.1" ECU_ADDRESS 0x801EB2 /end MEASUREMENT
/begin MEASUREMENT AddPCD_numStrkDem_mp "gewünschte Anzahl von Hüben der Additivpumpe" SWORD OneToOne 1 100 -32768.00 32767.00 FORMAT "%8.2" ECU_ADDRESS 0x801EB4 /end MEASUREMENT
/begin MEASUREMENT AddPCD_numStrkRem_mp "verbliebene Anzahl von Hüben der Additivpumpe" SWORD OneToOne 1 100 -32768.00 32767.00 FORMAT "%8.2" ECU_ADDRESS 0x801EB6 /end MEASUREMENT
/begin MEASUREMENT AddPCD_rOn_mp "Tastverhältnis für Additivpumpenansteuerung" SWORD DtyCyc 1 100 -327.6800 327.6700 FORMAT "%8.4" ECU_ADDRESS 0x801EB8 /end MEASUREMENT
/begin MEASUREMENT AddPCD_stCD_mp "Zustand des Additivpumpen Komponententreibers" UBYTE OneToOne 1 100 0.00 255.0 FORMAT "%5.1" ECU_ADDRESS 0x801EBA /end MEASUREMENT
/begin MEASUREMENT AddPCD_stTnkLvlDebVal "Status des Additivtankleerschalters" UBYTE OneToOne 1 100 0.00 255.0 FORMAT "%5.1" ECU_ADDRESS 0x7F9317 /end MEASUREMENT
/begin MEASUREMENT AddPCD_stTnkLvlRawVal "Unentprellter Wert des Eingangssignals Additivtankleerschalter-Komponententreiber" UBYTE OneToOne 1 100 0.00 255.0 FORMAT "%5.1" ECU_ADDRESS 0x7F9318 /end MEASUREMENT
/begin MEASUREMENT AddPCD_tiOn_mp "Ausgangs-Puls Einschaltzeit = f(Ubatt)" SWORD Period 1 100 -3276.800 3276.700 FORMAT "%8.3" ECU_ADDRESS 0x801EBC /end MEASUREMENT
/begin MEASUREMENT AddPCD_uTnkLvlRawVal "Analoger Leertankschalter - Rohwert" SWORD Volt 1 100 -160156.4 160151.5 FORMAT "%8.1" ECU_ADDRESS 0x7F95E6 /end MEASUREMENT
/begin MEASUREMENT AddPCD_volAddInj_mp "aktuelle eingespritzte Additiv-Menge" SLONG volAdd_ml_fine 1 100 -2147483.64800 2147483.64700 FORMAT "%13.5" ECU_ADDRESS 0x801EC0 /end MEASUREMENT
/begin MEASUREMENT AddPCD_volAddTot "Eingespritztes Gesamt-Additivvolumen (grobe Auflösung)" SLONG volAdd_ml_fine 1 100 -2147483.64800 2147483.64700 FORMAT "%13.5" ECU_ADDRESS 0x7F9C2C /end MEASUREMENT
/begin MEASUREMENT AddPCD_volAdd_mp "aktuelle Additiv-Menge" SLONG volAdd_ml_fine 1 100 -2147483.64800 2147483.64700 FORMAT "%13.5" ECU_ADDRESS 0x801EC4 /end MEASUREMENT
/begin MEASUREMENT AddPmp_rAdd_mp "Konzentration des Additiv im Kraftstoff" SWORD mlToL 1 100 -327.6800 327.6700 FORMAT "%8.4" ECU_ADDRESS 0x801EC8 /end MEASUREMENT
/begin MEASUREMENT AddPmp_rAdd_mpByp_mp "Bypass message for AddPmp_rAdd_mp" SWORD mlToL 1 100 -327.6800 327.6700 FORMAT "%8.4" ECU_ADDRESS 0x801ECA /end MEASUREMENT
/begin MEASUREMENT AddPmp_stAddMet "Zustand der Additivdosierung" UBYTE OneToOne 1 100 0.00 255.0 FORMAT "%5.1" ECU_ADDRESS 0x7F9319 /end MEASUREMENT
/begin MEASUREMENT AddPmp_stAddReqd_mp "Status der Additivdosierung intern" UBYTE OneToOne 1 100 0.00 255.0 FORMAT "%5.1" ECU_ADDRESS 0x801ECC /end MEASUREMENT
/begin MEASUREMENT AddPmp_stAddUpd_mp "Additivzumessung erforderlich" SWORD OneToOne 1 100 -32768.00 32767.00 FORMAT "%8.2" ECU_ADDRESS 0x801ECE /end MEASUREMENT
/begin MEASUREMENT AddPmp_stAftRunDelDem "Statusbit der Additivdosierung zur Verzögerung des Steuergeräte-Nachlaufs" UBYTE OneToOne 1 100 0.00 255.0 FORMAT "%5.1" ECU_ADDRESS 0x7F931A /end MEASUREMENT
/begin MEASUREMENT AddPmp_swtService "Zustand des Serviceschalters (Reinigung des Partikelfilters)" UBYTE OneToOne 1 100 0.00 255.0 FORMAT "%5.1" ECU_ADDRESS 0x7F931B /end MEASUREMENT
/begin MEASUREMENT AddPmp_volAddDem_mp "gewünschte Additiv-Menge" SWORD volAdd_ml 1 100 -3276.800 3276.700 FORMAT "%8.3" ECU_ADDRESS 0x801ED0 /end MEASUREMENT
/begin MEASUREMENT AddPmp_volAddDia_mp "Laufend berechnete Additivmenge für Diagnose [ml]" UWORD volAdd_ml 1 100 0.00 6553.500 FORMAT "%8.3" ECU_ADDRESS 0x801ED2 /end MEASUREMENT
/begin MEASUREMENT AddPmp_volAddTot "eingespritzte Gesamtadditivmenge seit letzter Filterreinigung" SLONG volAdd_ml_fine 1 100 -2147483.64800 2147483.64700 FORMAT "%13.5" ECU_ADDRESS 0x7F9C30 /end MEASUREMENT
/begin MEASUREMENT AddPmp_volAddTotDem "Angefordertes Gesamt-Additivvolumen" SLONG volAdd_ml_fine 1 100 -2147483.64800 2147483.64700 FORMAT "%13.5" ECU_ADDRESS 0x7F9C34 /end MEASUREMENT
/begin MEASUREMENT AddPmp_volAddTotDemByp_mp "Bypass message für AddPmp_volAddTotDem" SLONG volAdd_ml_fine 1 100 -2147483.64800 2147483.64700 FORMAT "%13.5" ECU_ADDRESS 0x801ED4 /end MEASUREMENT
/begin MEASUREMENT AddPmp_volAddTotDia_mp "Absolute Additivmenge seit letzter Filterreinigung für Diagnose [ml]" SLONG volAdd_ml 1 100 -214748364.800 214748364.700 FORMAT "%13.3" ECU_ADDRESS 0x801ED8 /end MEASUREMENT
/begin MEASUREMENT AddPmp_volFuelRef_mp "Tankinhalt vor Nachtankung" SWORD Fl_Half_L 1 100 -16384.00 16383.50 FORMAT "%8.2" ECU_ADDRESS 0x801EDC /end MEASUREMENT
/begin MEASUREMENT AFSCD_dmAirDrftComp "Korrekturluftmassenstrom zur Driftkompensation" SWORD AirMassPerTime 1 100 -3276.800 3276.700 FORMAT "%8.3" ECU_ADDRESS 0x7F955C /end MEASUREMENT
/begin MEASUREMENT AFSCD_dmAirNorm "Normalisierte Luftmasse" SWORD AirMassPerTime 1 100 -3276.800 3276.700 FORMAT "%8.3" ECU_ADDRESS 0x7F955E /end MEASUREMENT
/begin MEASUREMENT AFSCD_dmAirPerTime "HFM Luftmassenstrom" SWORD AirMassPerTime 1 100 -3276.800 3276.700 FORMAT "%8.3" ECU_ADDRESS 0x7F9560 /end MEASUREMENT
/begin MEASUREMENT AFSCD_dmAirPerTimeHold "letzter gueltiger Wert der Luftmasse pro Zeiteinheit" SWORD AirMassPerTime 1 100 -3276.800 3276.700 FORMAT "%8.3" ECU_ADDRESS 0x7F9564 /end MEASUREMENT
/begin MEASUREMENT AFSCD_dmAirRawPerTime "Rohwert der Luftmasse vom HFM" SWORD AirMassPerTime 1 100 -3276.800 3276.700 FORMAT "%8.3" ECU_ADDRESS 0x7F9568 /end MEASUREMENT
/begin MEASUREMENT AFSCD_dmAirSens "Luftmassenstrom des Luftmassensensors" SWORD AirMassPerTime 1 100 -3276.800 3276.700 FORMAT "%8.3" ECU_ADDRESS 0x7F956C /end MEASUREMENT
/begin MEASUREMENT AFSCD_dmAirSensCorr_mp "Korrigierte angesaugte Luftmasse pro Zeit" SWORD AirMassPerTime 1 100 -3276.800 3276.700 FORMAT "%8.3" ECU_ADDRESS 0x801EE0 /end MEASUREMENT
/begin MEASUREMENT AFSCD_dmAirSensRaw_mp "Value of airmass per unit time before error correction." SWORD AirMassPerTime 1 100 -3276.800 3276.700 FORMAT "%8.3" ECU_ADDRESS 0x801EEA /end MEASUREMENT
/begin MEASUREMENT AFSCD_dmAirSubsVal_mp "Ersatzwert für Luftmassenstrom aus Kennfeld" SWORD AirMassPerTime 1 100 -3276.800 3276.700 FORMAT "%8.3" ECU_ADDRESS 0x801EE2 /end MEASUREMENT
/begin MEASUREMENT AFSCD_facPlsCor_mp "Pulsationskorrekturfaktor" SWORD Fact 1 100 -4.000000 3.999878 FORMAT "%8.6" ECU_ADDRESS 0x801EEC /end MEASUREMENT
/begin MEASUREMENT AFSCD_facSwtOnCor_mp "Faktor der Einschaltkorrektur" SWORD Fact 1 100 -4.000000 3.999878 FORMAT "%8.6" ECU_ADDRESS 0x801EEE /end MEASUREMENT
/begin MEASUREMENT AFSCD_mAirPerCyl "angesaugte Luftmasse pro Zylinder" SWORD AirMassPerCyl 1 100 -3276.800 3276.700 FORMAT "%8.3" ECU_ADDRESS 0x7F956E /end MEASUREMENT
/begin MEASUREMENT AFSCD_mAirPerCylFlt "PT1 gefilterte Luftmasse pro Zylinder" SWORD AirMassPerCyl 1 100 -3276.800 3276.700 FORMAT "%8.3" ECU_ADDRESS 0x7F9574 /end MEASUREMENT
/begin MEASUREMENT AFSCD_mAirPerCyl_mp "Berechnete Luftmasse pro Zylinder" SWORD AirMassPerCyl 1 100 -3276.800 3276.700 FORMAT "%8.3" ECU_ADDRESS 0x801EE4 /end MEASUREMENT
/begin MEASUREMENT AFSCD_qAirmThrSRCHiActv_mp "Mengenschwelle zur Unterdrueckung SRC HIGH(HFM5 1ms) Schwelle = f(n)" SWORD InjMass 1 100 -327.6800 327.6700 FORMAT "%8.4" ECU_ADDRESS 0x801EF0 /end MEASUREMENT
/begin MEASUREMENT AFSCD_rAir "duty cycle of the air temparature signal" SWORD DtyCyc 1 100 -327.6800 327.6700 FORMAT "%8.4" ECU_ADDRESS 0x7F9576 /end MEASUREMENT
/begin MEASUREMENT AFSCD_rAirNorm "Verhältnis von normalisiertem Luftmassenstrom zu Sensorluftmassenstrom" SWORD Fact 1 100 -4.000000 3.999878 FORMAT "%8.6" ECU_ADDRESS 0x7F9578 /end MEASUREMENT
/begin MEASUREMENT AFSCD_stDebSRCAirm_mp "Meßpunkt um den Wert des SRC vom Luftmassemesser sichtbar zu machen" UBYTE OneToOne 1 100 0.00 255.0 FORMAT "%5.1" ECU_ADDRESS 0x801EF2 /end MEASUREMENT
/begin MEASUREMENT AFSCD_stDrftComp "Statuswort der Driftkompensation" UBYTE OneToOne 1 100 0.00 255.0 FORMAT "%5.1" ECU_ADDRESS 0x7F92F1 /end MEASUREMENT
/begin MEASUREMENT AFSCD_stDrftMonRls "Teilfreigabe der Empfindlichkeitsdriftüberwachung" UBYTE OneToOne 1 100 0.00 255.0 FORMAT "%5.1" ECU_ADDRESS 0x7F92F2 /end MEASUREMENT
/begin MEASUREMENT AFSCD_stDrftMonRls_mp "Freigabestatus der Empfindlichkeitsdriftüberwachung" UBYTE OneToOne 1 100 0.00 255.0 FORMAT "%5.1" ECU_ADDRESS 0x801EE6 /end MEASUREMENT
/begin MEASUREMENT AFSCD_stErrAirm "Fehlerstatus des Sensorsignals (HFM6)" UWORD OneToOne 1 100 0.00 65535.00 FORMAT "%8.2" ECU_ADDRESS 0x7F957C /end MEASUREMENT
/begin MEASUREMENT AFSCD_stErrAirTemp "Fehlerstatus des Lufttemperatursignals" UWORD OneToOne 1 100 0.00 65535.00 FORMAT "%8.2" ECU_ADDRESS 0x7F957A /end MEASUREMENT
/begin MEASUREMENT AFSCD_stOffsTst "Status 'Test beendet' der Plausibilitätsprüfung der Offsetdrift" UBYTE OneToOne 1 100 0.00 255.0 FORMAT "%5.1" ECU_ADDRESS 0x7F92F3 /end MEASUREMENT
/begin MEASUREMENT AFSCD_stPlSetyDrftRls_mp "Freigabestatus der Plausibilitätsprüfung der Empfindlichkeitsdrift" UBYTE OneToOne 1 100 0.00 255.0 FORMAT "%5.1" ECU_ADDRESS 0x801EE7 /end MEASUREMENT
/begin MEASUREMENT AFSCD_stPlSetyDrft_mp "Freigabestatus der Plausibilitätsprüfung der Empfindlichkeitsdrift" UBYTE OneToOne 1 100 0.00 255.0 FORMAT "%5.1" ECU_ADDRESS 0x801EE8 /end MEASUREMENT
/begin MEASUREMENT AFSCD_stSRCHiTstRls_mp "Freigabestatus des SRC High des Sensorsignals" UBYTE OneToOne 1 100 0.00 255.0 FORMAT "%5.1" ECU_ADDRESS 0x801EF3 /end MEASUREMENT
/begin MEASUREMENT AFSCD_stSRCLoTstRls_mp "Freigabestatus des SRC Low des Sensorsignals" UBYTE OneToOne 1 100 0.00 255.0 FORMAT "%5.1" ECU_ADDRESS 0x801EF4 /end MEASUREMENT
/begin MEASUREMENT AFSCD_swtSensInst "Schalter zur Anzeige, ob der Luftmassensensor vorhanden ist oder nicht" UBYTE OneToOne 1 100 0.00 255.0 FORMAT "%5.1" ECU_ADDRESS 0x7F92F6 /end MEASUREMENT
/begin MEASUREMENT AFSCD_tAir "Ansauglufttemperatur T1 am HFM" SWORD Temp_Cels 1 100 -3549.940 3003.560 FORMAT "%8.3" ECU_ADDRESS 0x7F957E /end MEASUREMENT
/begin MEASUREMENT AFSCD_tAir_mp "linearisierte Ansauglufttemperatur T1 vor Fehlerbehandlung" SWORD Temp_Cels 1 100 -3549.940 3003.560 FORMAT "%8.3" ECU_ADDRESS 0x801EDE /end MEASUREMENT
/begin MEASUREMENT AFSCD_tiRaw "Periodendauerrohwert des Luftmassensensors" SWORD Time_PwmHigh_Hfm6 1 100 0.00 6553.500 FORMAT "%8.3" ECU_ADDRESS 0x7F9580 /end MEASUREMENT
/begin MEASUREMENT AFSCD_tiRawAvrgVal_mp "Mittelwert des aktuellen und letzten Periodendauerrohwerts des Luftmassensensors" SWORD Time_PwmHigh 1 100 -3276.800 3276.700 FORMAT "%8.3" ECU_ADDRESS 0x801EF6 /end MEASUREMENT
/begin MEASUREMENT AFSCD_tiRawLast "last value of the raw air mass signal" SWORD Time_PwmHigh_Hfm6 1 100 0.00 6553.500 FORMAT "%8.3" ECU_ADDRESS 0x7F9582 /end MEASUREMENT
/begin MEASUREMENT AFSCD_tiSwtOnCor_mp "Timerwert der ""Einschaltkorrektur""" UWORD Time_ms 1 100 0.00 655350.0 FORMAT "%8.1" ECU_ADDRESS 0x801EF8 /end MEASUREMENT
/begin MEASUREMENT AFVCD_stHWEActrOut_mp "Messpunkt für Status der Luftfilterklappen- Endstufe" UBYTE OneToOne 1 100 0.00 255.0 FORMAT "%5.1" ECU_ADDRESS 0x801EFA /end MEASUREMENT
/begin MEASUREMENT AFVCtl_stLogic_mp "Luftfilterklappenansteuerungsstatus" UBYTE OneToOne 1 100 0.00 255.0 FORMAT "%5.1" ECU_ADDRESS 0x801EFB /end MEASUREMENT
/begin MEASUREMENT AFVCtl_stOut "Luftfilterklappenansteuerungsstatus" UBYTE OneToOne 1 100 0.00 255.0 FORMAT "%5.1" ECU_ADDRESS 0x7F92F7 /end MEASUREMENT
/begin MEASUREMENT AFVCtl_stPwrIndThres_mp "Temperaturzustand des Ansaugluftsystems unter der applizierbaren Schwelle von der Leistungsfunktion" UBYTE OneToOne 1 100 0.00 255.0 FORMAT "%5.1" ECU_ADDRESS 0x801EFC /end MEASUREMENT
/begin MEASUREMENT AFVCtl_stSnowIndThres_mp "Temperaturzustand des Ansaugluftsystems unter der applizierbaren Schwelle von der Schneefunktion" UBYTE OneToOne 1 100 0.00 255.0 FORMAT "%5.1" ECU_ADDRESS 0x801EFD /end MEASUREMENT
/begin MEASUREMENT AirbCD_st "Abschaltanforderungen für Airbag/Überrollbügel" UBYTE OneToOne 1 100 0.00 255.0 FORMAT "%5.1" ECU_ADDRESS 0x7F9326 /end MEASUREMENT
/begin MEASUREMENT AirCtl_facATParAd_mp "lufttemperaturabhängiger Faktor für Parameteradaption" SWORD Fact1 1 100 -256.0000 255.9922 FORMAT "%8.4" ECU_ADDRESS 0x801F70 /end MEASUREMENT
/begin MEASUREMENT AirCtl_facDesRgnCorr1_mp "Rampenfaktor für Lufttemperaturkorrektur" ULONG facRmpEGT32 1 100 0.00 262.143999939 FORMAT "%13.9" ECU_ADDRESS 0x801F30 /end MEASUREMENT
/begin MEASUREMENT AirCtl_facDesRgnCorr2_mp "Rampenfaktor für Motortemperaturkorrektur" ULONG facRmpEGT32 1 100 0.00 262.143999939 FORMAT "%13.9" ECU_ADDRESS 0x801F34 /end MEASUREMENT
/begin MEASUREMENT AirCtl_facNQParAd_mp "Faktor für Parameteradaption for ARF" SWORD Fact1 1 100 -256.0000 255.9922 FORMAT "%8.4" ECU_ADDRESS 0x801F72 /end MEASUREMENT
/begin MEASUREMENT AirCtl_facParAd_mp "Gesamtfaktor für Parameteradaption für ARF" SWORD Fact1 1 100 -256.0000 255.9922 FORMAT "%8.4" ECU_ADDRESS 0x801F74 /end MEASUREMENT
/begin MEASUREMENT AirCtl_facParRgn_mp "Rampe zur Parameterumschaltung für die Partikelfilter Regeneration" ULONG facRmpEGT32 1 100 0.00 262.143999939 FORMAT "%13.9" ECU_ADDRESS 0x801F78 /end MEASUREMENT
/begin MEASUREMENT AirCtl_facSelRgnCorr_mp "Rampenfaktor für Korrektur" ULONG facRmpEGT32 1 100 0.00 262.143999939 FORMAT "%13.9" ECU_ADDRESS 0x801F0C /end MEASUREMENT
/begin MEASUREMENT AirCtl_mAPCor_mp "Korrigierter Atmosphäarendruck" SWORD AirMassPerCyl 1 100 -3276.800 3276.700 FORMAT "%8.3" ECU_ADDRESS 0x801F38 /end MEASUREMENT
/begin MEASUREMENT AirCtl_mCorAfterStart_mp "errechneter Korrekturwert der Verstellung in der Höhe nach Start" SWORD AirMassPerCyl 1 100 -3276.800 3276.700 FORMAT "%8.3" ECU_ADDRESS 0x801F3A /end MEASUREMENT
/begin MEASUREMENT AirCtl_mDesBase_mp "stationärer Basissollwert für ARF" SWORD AirMassPerCyl 1 100 -3276.800 3276.700 FORMAT "%8.3" ECU_ADDRESS 0x801F3C /end MEASUREMENT
/begin MEASUREMENT AirCtl_mDesCorr_mp "korrigierter Luftmassensollwert" SWORD AirMassPerCyl 1 100 -3276.800 3276.700 FORMAT "%8.3" ECU_ADDRESS 0x801F3E /end MEASUREMENT
/begin MEASUREMENT AirCtl_mDesDyn_mp "dynamischer Anteil des Luftmassensollwerts für Abgasrückführung" SWORD AirMassPerCyl 1 100 -3276.800 3276.700 FORMAT "%8.3" ECU_ADDRESS 0x801F40 /end MEASUREMENT
/begin MEASUREMENT AirCtl_mDesRaw_mp "stationärer Rohwert des Luftmassensollwertes" SWORD AirMassPerCyl 1 100 -3276.800 3276.700 FORMAT "%8.3" ECU_ADDRESS 0x801F42 /end MEASUREMENT
/begin MEASUREMENT AirCtl_mDesRgn0_mp "stationärer Basissollwert des Luftmassensollwertes" SWORD AirMassPerCyl 1 100 -3276.800 3276.700 FORMAT "%8.3" ECU_ADDRESS 0x801F44 /end MEASUREMENT
/begin MEASUREMENT AirCtl_mDesRgn1_mp "stationaerer Sollwert aus Regenerationskennfeld-1" SWORD AirMassPerCyl 1 100 -3276.800 3276.700 FORMAT "%8.3" ECU_ADDRESS 0x801F46 /end MEASUREMENT
/begin MEASUREMENT AirCtl_mDesRgn2_mp "stationaerer Sollwert aus Regenerationskennfeld-2" SWORD AirMassPerCyl 1 100 -3276.800 3276.700 FORMAT "%8.3" ECU_ADDRESS 0x801F48 /end MEASUREMENT
/begin MEASUREMENT AirCtl_mDesRgn3_mp "Luftmassensollwert im Regenerationsbetrieb 3" SWORD AirMassPerCyl 1 100 -3276.800 3276.700 FORMAT "%8.3" ECU_ADDRESS 0x801F4A /end MEASUREMENT
/begin MEASUREMENT AirCtl_mDesRgn4_mp "Luftmassensollwert im Regenerationsbetrieb 4" SWORD AirMassPerCyl 1 100 -3276.800 3276.700 FORMAT "%8.3" ECU_ADDRESS 0x801F4C /end MEASUREMENT
/begin MEASUREMENT AirCtl_mDesStat_mp "stationärer Luftmassensollwert" SWORD AirMassPerCyl 1 100 -3276.800 3276.700 FORMAT "%8.3" ECU_ADDRESS 0x801F4E /end MEASUREMENT
/begin MEASUREMENT AirCtl_mDesVal "Luftmassensollwert" SWORD AirMassPerCyl 1 100 -3276.800 3276.700 FORMAT "%8.3" ECU_ADDRESS 0x7F95EA /end MEASUREMENT
/begin MEASUREMENT AirCtl_mDesValByp_mp "Bypass-Label, Kopie von AirCtl_mDesVal" SWORD AirMassPerCyl 1 100 -3276.800 3276.700 FORMAT "%8.3" ECU_ADDRESS 0x801F50 /end MEASUREMENT
/begin MEASUREMENT AirCtl_mDesVal_1_mp "stationärer Sollwert mit Abgleichkorrektur für ARF" SWORD AirMassPerCyl 1 100 -3276.800 3276.700 FORMAT "%8.3" ECU_ADDRESS 0x801F52 /end MEASUREMENT
/begin MEASUREMENT AirCtl_mDesVal_2_mp "stationärer Sollwert mit Atmosphärendruckkorrektur für ARF" SWORD AirMassPerCyl 1 100 -3276.800 3276.700 FORMAT "%8.3" ECU_ADDRESS 0x801F54 /end MEASUREMENT
/begin MEASUREMENT AirCtl_mDesVal_3_mp "stationärer Sollwert mit Lufttemperaturkorrektur für ARF" SWORD AirMassPerCyl 1 100 -3276.800 3276.700 FORMAT "%8.3" ECU_ADDRESS 0x801F56 /end MEASUREMENT
/begin MEASUREMENT AirCtl_mDesVal_4_mp "stationärer Sollwert mit Kühlwassertemperaturkorrektur" SWORD AirMassPerCyl 1 100 -3276.800 3276.700 FORMAT "%8.3" ECU_ADDRESS 0x801F58 /end MEASUREMENT
/begin MEASUREMENT AirCtl_mDesVal_5_mp "drehzahlabhängige Luftmassenkorrektur" SWORD AirMassPerCyl 1 100 -3276.800 3276.700 FORMAT "%8.3" ECU_ADDRESS 0x801F5A /end MEASUREMENT
/begin MEASUREMENT AirCtl_mDesVal_mp "Ausgang Rampenschalter" SWORD AirMassPerCyl 1 100 -3276.800 3276.700 FORMAT "%8.3" ECU_ADDRESS 0x801F5C /end MEASUREMENT
/begin MEASUREMENT AirCtl_mGovDev "Regelabweichung bei ARF" SWORD AirMassPerCyl 1 100 -3276.800 3276.700 FORMAT "%8.3" ECU_ADDRESS 0x7F95EC /end MEASUREMENT
/begin MEASUREMENT AirCtl_NQCTCor_mp "Rampenausgang für Kühlertemperaturkorrektur" SWORD AirMassPerCyl 1 100 -3276.800 3276.700 FORMAT "%8.3" ECU_ADDRESS 0x801F5E /end MEASUREMENT
/begin MEASUREMENT AirCtl_pCor "Lufttemperatur-korrigierter Atmosphärendruck" SWORD Pres_hPa 1 100 -32768.00 32767.00 FORMAT "%8.2" ECU_ADDRESS 0x7F95EE /end MEASUREMENT
/begin MEASUREMENT AirCtl_qCtl "Einspritzmenge roh" SWORD InjMass 1 100 -327.6800 327.6700 FORMAT "%8.4" ECU_ADDRESS 0x7F95F0 /end MEASUREMENT
/begin MEASUREMENT AirCtl_qDes "Korrigierte Einspritzmenge" SWORD InjMass 1 100 -327.6800 327.6700 FORMAT "%8.4" ECU_ADDRESS 0x7F95F2 /end MEASUREMENT
/begin MEASUREMENT AirCtl_qGov "Korrigierte Einspritzmenge" SWORD InjMass 1 100 -327.6800 327.6700 FORMAT "%8.4" ECU_ADDRESS 0x7F95F4 /end MEASUREMENT
/begin MEASUREMENT AirCtl_qMon "Korrigierte Einspritzmenge" SWORD InjMass 1 100 -327.6800 327.6700 FORMAT "%8.4" ECU_ADDRESS 0x7F95F6 /end MEASUREMENT
/begin MEASUREMENT AirCtl_qRpOilCorr_mp "Meßpunkt für korrigierte Einspritzmenge für RME" SWORD InjMass 1 100 -327.6800 327.6700 FORMAT "%8.4" ECU_ADDRESS 0x801F6C /end MEASUREMENT
/begin MEASUREMENT AirCtl_rBalGov1_mp "gewählter Lambdagleichregelungswert" SWORD Prc 1 100 -327.6800 327.6700 FORMAT "%8.4" ECU_ADDRESS 0x801F7C /end MEASUREMENT
/begin MEASUREMENT AirCtl_rCtl1_mp "Ergebnis der Addition von AirCtl_rCtlBase_MAP mit AirCtl_rTrmValCor_CUR" SWORD Prc 1 100 -327.6800 327.6700 FORMAT "%8.4" ECU_ADDRESS 0x801F10 /end MEASUREMENT
/begin MEASUREMENT AirCtl_rCtl2_mp "Ergebnis der Addition von airCtl_rCtl1_mp mit AirCtl_rClntCor_MAP" SWORD Prc 1 100 -327.6800 327.6700 FORMAT "%8.4" ECU_ADDRESS 0x801F12 /end MEASUREMENT
/begin MEASUREMENT AirCtl_rCtlBase_mp "Ermitteltes Grundtastverhältnis" SWORD Prc 1 100 -327.6800 327.6700 FORMAT "%8.4" ECU_ADDRESS 0x801F14 /end MEASUREMENT
/begin MEASUREMENT AirCtl_rCtlCorr_mp "korrigierter Steuerwert für Luftmasse" SWORD Prc 1 100 -327.6800 327.6700 FORMAT "%8.4" ECU_ADDRESS 0x801F16 /end MEASUREMENT
/begin MEASUREMENT AirCtl_rCtlCorVal_mp "Ausgang der ""Korrekturrampe""-Rampe" SWORD Prc 1 100 -327.6800 327.6700 FORMAT "%8.4" ECU_ADDRESS 0x801F18 /end MEASUREMENT
/begin MEASUREMENT AirCtl_rCtlRaw_mp "Rohwert des Steuerwertes für Luftmasse" SWORD Prc 1 100 -327.6800 327.6700 FORMAT "%8.4" ECU_ADDRESS 0x801F1A /end MEASUREMENT
/begin MEASUREMENT AirCtl_rCtlRgn0_mp "Ermitteltes Grundtastverhältnis" SWORD Prc 1 100 -327.6800 327.6700 FORMAT "%8.4" ECU_ADDRESS 0x801F1C /end MEASUREMENT
/begin MEASUREMENT AirCtl_rCtlRgn1_mp "stationaerer Sollwert aus Regenerationskennfeld-1" SWORD Prc 1 100 -327.6800 327.6700 FORMAT "%8.4" ECU_ADDRESS 0x801F1E /end MEASUREMENT
/begin MEASUREMENT AirCtl_rCtlRgn2_mp "stationaerer Sollwert aus Regenerationskennfeld-2" SWORD Prc 1 100 -327.6800 327.6700 FORMAT "%8.4" ECU_ADDRESS 0x801F20 /end MEASUREMENT
/begin MEASUREMENT AirCtl_rCtlRgn3_mp "Steuerwert im Regenerationsbetrieb 3" SWORD Prc 1 100 -327.6800 327.6700 FORMAT "%8.4" ECU_ADDRESS 0x801F22 /end MEASUREMENT
/begin MEASUREMENT AirCtl_rCtlRgn4_mp "Steuerwert im Regenerationsbetrieb 4" SWORD Prc 1 100 -327.6800 327.6700 FORMAT "%8.4" ECU_ADDRESS 0x801F24 /end MEASUREMENT
/begin MEASUREMENT AirCtl_rCtlVal "stationärer Steueranteil der Stellgröße" SWORD Prc 1 100 -327.6800 327.6700 FORMAT "%8.4" ECU_ADDRESS 0x7F95FA /end MEASUREMENT
/begin MEASUREMENT AirCtl_rCtlValByp_mp "Bypass message für AirCtl_rCtlVal" SWORD Prc 1 100 -327.6800 327.6700 FORMAT "%8.4" ECU_ADDRESS 0x801F26 /end MEASUREMENT
/begin MEASUREMENT AirCtl_rCtlVal_mp "Ausgang Rampenschalter" SWORD Prc 1 100 -327.6800 327.6700 FORMAT "%8.4" ECU_ADDRESS 0x801F28 /end MEASUREMENT
/begin MEASUREMENT AirCtl_RevThres_mp "ermittelter Schwellwert des Umdrehungszählers" SWORD OneToOne 1 100 -32768.00 32767.00 FORMAT "%8.2" ECU_ADDRESS 0x801F60 /end MEASUREMENT
/begin MEASUREMENT AirCtl_rGovEGR "Reglerstellgröße für Abgasrückführventil" SWORD Prc 1 100 -327.6800 327.6700 FORMAT "%8.4" ECU_ADDRESS 0x7F9600 /end MEASUREMENT
/begin MEASUREMENT AirCtl_rGovEGR2 "Reglerausgang 2 von EGR" SWORD Prc 1 100 -327.6800 327.6700 FORMAT "%8.4" ECU_ADDRESS 0x7F9602 /end MEASUREMENT
/begin MEASUREMENT AirCtl_rGovEGRUnSplit "Reglerausgang vor Aufteilung auf AGR- und Drosselklappe" SWORD Prc 1 100 -327.6800 327.6700 FORMAT "%8.4" ECU_ADDRESS 0x7F9604 /end MEASUREMENT
/begin MEASUREMENT AirCtl_rGovOut_mp "Ausgang des Reglers - Reglerstellgröße" SWORD Prc 1 100 -327.6800 327.6700 FORMAT "%8.4" ECU_ADDRESS 0x801F7E /end MEASUREMENT
/begin MEASUREMENT AirCtl_rGovTVA "Reglerstellgröße für Drosselklappe" SWORD Prc 1 100 -327.6800 327.6700 FORMAT "%8.4" ECU_ADDRESS 0x7F9606 /end MEASUREMENT
/begin MEASUREMENT AirCtl_rOutD_mp "dynamisches Steuersignal - Ausgang DT1-Glied" SWORD Prc 1 100 -327.6800 327.6700 FORMAT "%8.4" ECU_ADDRESS 0x801F80 /end MEASUREMENT
/begin MEASUREMENT AirCtl_rOutI_mp "Ausgang des Regler-I-Kanals bei der ARF" SWORD Prc 1 100 -327.6800 327.6700 FORMAT "%8.4" ECU_ADDRESS 0x801F82 /end MEASUREMENT
/begin MEASUREMENT AirCtl_rOutP_mp "Ausgang des Regler-P-Kanals bei der ARF" SWORD Prc 1 100 -327.6800 327.6700 FORMAT "%8.4" ECU_ADDRESS 0x801F84 /end MEASUREMENT
/begin MEASUREMENT AirCtl_rPT1EGR_mp "PT1 gefilterter Wert von AirCtl_rEGR" SWORD DtyCyc 1 100 -327.6800 327.6700 FORMAT "%8.4" ECU_ADDRESS 0x801EFE /end MEASUREMENT
/begin MEASUREMENT AirCtl_stATCorMsk_mp "Statusbyte der Korrektur durch Lufttemperatur" UBYTE OneToOne 1 100 0.00 255.0 FORMAT "%5.1" ECU_ADDRESS 0x801F62 /end MEASUREMENT
/begin MEASUREMENT AirCtl_stBPDem "Status der Ladedruckanforderung" UBYTE OneToOne 1 100 0.00 255.0 FORMAT "%5.1" ECU_ADDRESS 0x7F931C /end MEASUREMENT
/begin MEASUREMENT AirCtl_stBypValvAirMass_mp "Abschaltanforderung für EGR Kühler Bypass von Luftmassensollwert" UBYTE OneToOne 1 100 0.00 255.0 FORMAT "%5.1" ECU_ADDRESS 0x801F04 /end MEASUREMENT
/begin MEASUREMENT AirCtl_stBypValvtAir_mp "Status der Ansauglufttemperatur" UBYTE OneToOne 1 100 0.00 255.0 FORMAT "%5.1" ECU_ADDRESS 0x801F05 /end MEASUREMENT
/begin MEASUREMENT AirCtl_stBypValvtClnt_mp "Abschaltanforderung für EGR Kühler Bypass von Kühlwassertemperatur" UBYTE OneToOne 1 100 0.00 255.0 FORMAT "%5.1" ECU_ADDRESS 0x801F06 /end MEASUREMENT
/begin MEASUREMENT AirCtl_stCBVAftRun_mp "Status der Stelleranforderung im Nachlauf" UBYTE OneToOne 1 100 0.00 255.0 FORMAT "%5.1" ECU_ADDRESS 0x801F07 /end MEASUREMENT
/begin MEASUREMENT AirCtl_stCTCorMsk_mp "Statusbyte der Korrektur Einspritzmenge" UBYTE OneToOne 1 100 0.00 255.0 FORMAT "%5.1" ECU_ADDRESS 0x801F63 /end MEASUREMENT
/begin MEASUREMENT AirCtl_stCtlCurrRgn_mp "Aktive Eingänge des Rampenschalters" UBYTE OneToOne 1 100 0.00 255.0 FORMAT "%5.1" ECU_ADDRESS 0x801F2A /end MEASUREMENT
/begin MEASUREMENT AirCtl_stCtlRgnMsk_mp "Status des Eingriffs der Partikelfilter Regeneration" UBYTE OneToOne 1 100 0.00 255.0 FORMAT "%5.1" ECU_ADDRESS 0x801F2B /end MEASUREMENT
/begin MEASUREMENT AirCtl_stDesCurrRgn_mp "Aktive Eingänge des Rampenschalters" UBYTE OneToOne 1 100 0.00 255.0 FORMAT "%5.1" ECU_ADDRESS 0x801F64 /end MEASUREMENT
/begin MEASUREMENT AirCtl_stDesRgnMsk_mp "Status des Eingriffs der Partikelfilter Regeneration" UBYTE OneToOne 1 100 0.00 255.0 FORMAT "%5.1" ECU_ADDRESS 0x801F65 /end MEASUREMENT
/begin MEASUREMENT AirCtl_stDiagStartCBV_mp "Status der Stellenanforderung nach Klemme 15 ein" UBYTE OneToOne 1 100 0.00 255.0 FORMAT "%5.1" ECU_ADDRESS 0x801F08 /end MEASUREMENT
/begin MEASUREMENT AirCtl_stEGRClgBypVlv "Status des EGR-Kühler Bypass Ventils" UBYTE OneToOne 1 100 0.00 255.0 FORMAT "%5.1" ECU_ADDRESS 0x7F931F /end MEASUREMENT
/begin MEASUREMENT AirCtl_stEGRClgBypVlvByp_mp "Meßpunkt für Bypass Freischnitt" UBYTE OneToOne 1 100 0.00 255.0 FORMAT "%5.1" ECU_ADDRESS 0x801F09 /end MEASUREMENT
/begin MEASUREMENT AirCtl_stFlSel_mp "Kraftstoff Auswahlschalter Status" SWORD OneToOne 1 100 -32768.00 32767.00 FORMAT "%8.2" ECU_ADDRESS 0x801F6E /end MEASUREMENT
/begin MEASUREMENT AirCtl_stNQCTCorMsk_mp "Maske für Kühlmitteltemperaturkorrektur" UBYTE OneToOne 1 100 0.00 255.0 FORMAT "%5.1" ECU_ADDRESS 0x801F66 /end MEASUREMENT
/begin MEASUREMENT AirCtl_strTEngCorMsk_mp "Maske für Luftmassenkorrektur" UBYTE OneToOne 1 100 0.00 255.0 FORMAT "%5.1" ECU_ADDRESS 0x801F2C /end MEASUREMENT
/begin MEASUREMENT AirCtl_stStartTmr_mp "Statusbits der Schaltbedingungen" UBYTE OneToOne 1 100 0.00 255.0 FORMAT "%5.1" ECU_ADDRESS 0x801F00 /end MEASUREMENT
/begin MEASUREMENT AirCtl_swtAPCor "Schalter für add./mult. Atmosphärendruckkorrektur" UBYTE OneToOne 1 100 0.00 255.0 FORMAT "%5.1" ECU_ADDRESS 0x7F9322 /end MEASUREMENT
/begin MEASUREMENT AirCtl_swtATCor "Schalter für add./mult. Lufttemperaturkorrektur" UBYTE OneToOne 1 100 0.00 255.0 FORMAT "%5.1" ECU_ADDRESS 0x7F9323 /end MEASUREMENT
/begin MEASUREMENT AirCtl_swtGov "Schalter für Reglerabschaltung" UBYTE OneToOne 1 100 0.00 255.0 FORMAT "%5.1" ECU_ADDRESS 0x7F9324 /end MEASUREMENT
/begin MEASUREMENT AirCtl_swtTrm "Schalter für add./mult. Abgleichkorrektur" UBYTE OneToOne 1 100 0.00 255.0 FORMAT "%5.1" ECU_ADDRESS 0x7F9325 /end MEASUREMENT
/begin MEASUREMENT AirCtl_tiBPAHold_mp "ermittelte Einfrierzeit für den Ladedruckregler" SWORD Time_ms 1 100 -327680.0 327670.0 FORMAT "%8.1" ECU_ADDRESS 0x801F02 /end MEASUREMENT
/begin MEASUREMENT AirCtl_tRevThres_mp "Temperaturwert von dem Array Eng_tFld" SWORD Temp_Cels 1 100 -3549.940 3003.560 FORMAT "%8.3" ECU_ADDRESS 0x801F68 /end MEASUREMENT
/begin MEASUREMENT AirCtl_TrmValLim "Abgleichwert für Luftmassensoll- und steuerwert" SWORD AirMassPerCyl 1 100 -3276.800 3276.700 FORMAT "%8.3" ECU_ADDRESS 0x7F95E8 /end MEASUREMENT
/begin MEASUREMENT AirCtl_TrmVal_mp "Abgleichwert für ARF" SWORD AirMassPerCyl 1 100 -3276.800 3276.700 FORMAT "%8.3" ECU_ADDRESS 0x801F6A /end MEASUREMENT
/begin FUNCTION acctl_hys "Abschaltbedingungen des Klimakompressors"
 /begin DEF_CHARACTERISTIC ACCtl_drAccPedHi_C ACCtl_drAccPedLo_C ACCtl_nAccVehHi_C ACCtl_nAccVehLo_C ACCtl_nDAEngHi_C ACCtl_nDAEngLo_C ACCtl_nLIGovHi_C ACCtl_nLIGovLo_C ACCtl_nSysErrHi_C ACCtl_nSysErrLo_C ACCtl_pAccValHi_C ACCtl_pAccValLo_C ACCtl_pACPMaxHi_C ACCtl_pACPMaxLo_C ACCtl_pACPMinHi_C ACCtl_pACPMinLo_C ACCtl_rAccPedHi_C ACCtl_rAccPedLo_C ACCtl_stDAGearHi_C ACCtl_stDAGearLo_C ACCtl_swtFanErrEna_C ACCtl_swtTempACOff_C ACCtl_swtTempHys_C ACCtl_tAccAir1Hi_C ACCtl_tAccAir1Lo_C ACCtl_tAccAir2Hi_C ACCtl_tAccAir2Lo_C ACCtl_tACPairHi_C ACCtl_tACPairLo_C ACCtl_tiAccAirMin_C ACCtl_tiAccMin_C ACCtl_tiACOnDly_C ACCtl_tiACPmin_C ACCtl_tiACStrtDly_CUR ACCtl_tiCANESCU_C ACCtl_tiCANGearbx_C ACCtl_tiDAmax_MAP ACCtl_tiDAmin_MAP ACCtl_tiLIGov_C ACCtl_tiSysErrmin_C ACCtl_tiTempRedMin_C ACCtl_tiWTmin_C ACCtl_tTempRedHi_C ACCtl_tTempRedLo_C ACCtl_tWTHi_CUR ACCtl_tWTSubthresh_C ACCtl_vAccVehHi_C ACCtl_vAccVehLo_C ACCtl_vDAVehHi_C ACCtl_vDAVehLo_C /end DEF_CHARACTERISTIC
 /begin IN_MEASUREMENT ACCD_p ACCtl_tACOff_mp APSCD_pVal VSSCD_v /end IN_MEASUREMENT
/end FUNCTION
/begin FUNCTION acctl_hys_msg "" /begin OUT_MEASUREMENT ACCtl_stBitStructure ACCtl_stHys /end OUT_MEASUREMENT /end FUNCTION
/begin FUNCTION acctl_hys_uic ""
 /begin OUT_MEASUREMENT ACCtl_stACPressDem_mp ACCtl_stLowByte_mp ACCtl_tACOff_mp ACCtl_tEngHys_mp ACCtl_tiACOnDly_mp ACCtl_tiACStrtDly_mp ACCtl_tiDAmax_mp ACCtl_tiDAmin_mp ACCtl_tWTHi_mp /end OUT_MEASUREMENT
/end FUNCTION
/begin FUNCTION acctl_logic "Klimakompressor Zustandssteuerung"
 /begin DEF_CHARACTERISTIC ACCtl_nKliIdlSpd_C ACCtl_swtEnableRequest_C ACCtl_swtoff_mode_C ACCtl_swtVehStand_C ACCtl_tiMaxTSCfreezeReduction_C ACCtl_tiMaxTSCfreeze_C ACCtl_tiMinSwitchOn_C ACCtl_tiMinSwitchReduction_C /end DEF_CHARACTERISTIC
/end FUNCTION
/begin FUNCTION acctl_logic_msg ""
 /begin OUT_MEASUREMENT ACCtl_stACRequest ACCtl_stLogicOut ACCtl_stLogicReduction ACCtl_stVehicleStand /end OUT_MEASUREMENT
/end FUNCTION
/begin FUNCTION acctl_logic_uic ""
 /begin OUT_MEASUREMENT ACCtl_stTSCfreezeReduction_mp ACCtl_stTSCfreeze_mp ACCtl_stVehStand_mp /end OUT_MEASUREMENT
/end FUNCTION
/begin FUNCTION acc_msg "" /begin OUT_MEASUREMENT ACC_stCrCtl ACC_stDrvBrk ACC_trqDes ACC_trqLead /end OUT_MEASUREMENT /end FUNCTION
/begin FUNCTION acc_uic ""
 /begin DEF_CHARACTERISTIC ACC_stCrCtl_Vector ACC_stCrCtl_Channel ACC_stDrvBrk_Vector ACC_stDrvBrk_Channel ACC_trqDes_Vector ACC_trqDes_Channel ACC_trqLead_Vector ACC_trqLead_Channel /end DEF_CHARACTERISTIC
 /begin OUT_MEASUREMENT ACC_stCrCtlByp_mp ACC_stDrvBrkByp_mp ACC_stShutOff_mp ACC_stState_mp ACC_stTrqRel_mp ACC_trqDesByp_mp ACC_trqLeadByp_mp /end OUT_MEASUREMENT
/end FUNCTION
/begin FUNCTION actrqc "Klimaanlage Momentenregelung"
 /begin DEF_CHARACTERISTIC ACTrqC_tiDT1TrqDyn_C ACTrqC_dDT1TrqDynfact_C ACTrqC_factDiv_C ACTrqC_factMul_C ACTrqC_swtCalc_C ACTrqC_swtCANtrq_C ACTrqC_trqConvp_MAP ACTrqC_trqConvt_MAP /end DEF_CHARACTERISTIC
 /begin IN_MEASUREMENT ACCD_p Eng_nAvrg IATSCD_tAir /end IN_MEASUREMENT
/end FUNCTION
/begin FUNCTION actrqc_msg "" /begin OUT_MEASUREMENT ACTrqC_trqDes ACTrqC_trqLead /end OUT_MEASUREMENT /end FUNCTION
/begin FUNCTION actrqc_uic "" /begin OUT_MEASUREMENT ACTrqC_trqDyn_mp ACTrqC_trqStat_mp /end OUT_MEASUREMENT /end FUNCTION
/begin FUNCTION ac_msg "" /begin OUT_MEASUREMENT AC_pwrDes AC_pwrLead /end OUT_MEASUREMENT /end FUNCTION
/begin FUNCTION ac_uic "" /begin OUT_MEASUREMENT AC_nACComp_mp AC_pwrAdjVal_mp /end OUT_MEASUREMENT /end FUNCTION
/begin FUNCTION adcmon "ADC Überwachung"
 /begin DEF_CHARACTERISTIC ADCMon_DebQueueDef_C ADCMon_DebRefVltgSRCDef_C ADCMon_DebTstImpDef_C ADCMon_nQueueMon_C ADCMon_swtHW_C ADCMon_tiQueueMon_C ADCMon_tiSendTstImp_C ADCMon_uRefSRCMax_C ADCMon_uRefSRCMin_C ADCMon_uTstImpSRCMax_C /end DEF_CHARACTERISTIC
/end FUNCTION
/begin FUNCTION adcmon_msg "" /begin OUT_MEASUREMENT ADCMon_stADCMon /end OUT_MEASUREMENT /end FUNCTION
/begin FUNCTION adcmon_uic ""
 /begin OUT_MEASUREMENT ADCMon_ctQueueNSync_mp ADCMon_ctQueueTSync_mp ADCMon_stQueue_mp ADCMon_uRefRaw_mp ADCMon_uTstImpRaw_mp /end OUT_MEASUREMENT
/end FUNCTION
/begin FUNCTION addpcd_actrout "Ansteuerung für Additivpumpe"
 /begin DEF_CHARACTERISTIC AddPCD_facStrkToVol_C AddPCD_stPwrStgActv_C AddPCD_stPwrStgDia_C AddPCD_tiDebExcTempDef_C AddPCD_tiDebExcTempOk_C AddPCD_tiDebNoLoadDef_C AddPCD_tiDebNoLoadOk_C AddPCD_tiDebShortCircBatDef_C AddPCD_tiDebShortCircBatOk_C AddPCD_tiDebShortCircGndDef_C AddPCD_tiDebShortCircGndOk_C AddPCD_tiOn_CUR AddPCD_tiStrkPer_C /end DEF_CHARACTERISTIC
 /begin IN_MEASUREMENT BattCD_u /end IN_MEASUREMENT
/end FUNCTION
/begin FUNCTION addpcd_actrout_msg "" /begin OUT_MEASUREMENT AddPCD_volAddTot /end OUT_MEASUREMENT /end FUNCTION
/begin FUNCTION addpcd_actrout_uic ""
 /begin OUT_MEASUREMENT AddPCD_numStrkDem_mp AddPCD_numStrkRem_mp AddPCD_rOn_mp AddPCD_stCD_mp AddPCD_tiOn_mp AddPCD_volAddInj_mp AddPCD_volAdd_mp /end OUT_MEASUREMENT
/end FUNCTION
/begin FUNCTION addpcd_getlvlswt "Komponententreiber für den Additivtankleerschalter"
 /begin DEF_CHARACTERISTIC AddPCD_tiTnkLvlDebNeg_C AddPCD_tiTnkLvlDebPos_C AddPCD_tiDebSRCMaxDef_C AddPCD_tiDebSRCMaxOk_C AddPCD_tiDebSRCMinDef_C AddPCD_tiDebSRCMinOk_C AddPCD_DebDefTnkLvl_C AddPCD_DebOkTnkLvl_C AddPCD_stDflTnkLvl_C AddPCD_stTnkLvlInv_C AddPCD_swtTnkLvlSens_C AddPCD_uSRCMin_C AddPCD_uSRCMax_C AddPCD_stTnkLvlLin_CUR AddPCD_uHysHighTnkLvl_C AddPCD_uHysLowTnkLvl_C /end DEF_CHARACTERISTIC
 /begin IN_MEASUREMENT AddPCD_uTnkLvlRawVal /end IN_MEASUREMENT
/end FUNCTION
/begin FUNCTION addpcd_getlvlswt_msg ""
 /begin OUT_MEASUREMENT AddPCD_stTnkLvlDebVal AddPCD_stTnkLvlRawVal AddPCD_uTnkLvlRawVal /end OUT_MEASUREMENT
/end FUNCTION
/begin FUNCTION addpcd_getlvlswt_uic "" /end FUNCTION
/begin FUNCTION addpmp_addmet "Additivpumpenansteuerung"
 /begin DEF_CHARACTERISTIC AddPmp_swtAddReqd_C AddPmp_swtServiceVal_C AddPmp_swtServiceType_C AddPmp_volAddDemMax_C AddPmp_volAddDem_CUR AddPmp_volAddFirst_C AddPmp_volAddTankMax_C AddPmp_volAddTest_C AddPmp_volDetRefuelMin_C /end DEF_CHARACTERISTIC
 /begin IN_MEASUREMENT FlSys_volDetRefuel /end IN_MEASUREMENT
/end FUNCTION
/begin FUNCTION addpmp_addmet_msg ""
 /begin OUT_MEASUREMENT AddPmp_stAddMet AddPmp_stAftRunDelDem AddPmp_swtService AddPmp_volAddTot AddPmp_volAddTotDem /end OUT_MEASUREMENT
/end FUNCTION
/begin FUNCTION addpmp_addmet_uic ""
 /begin DEF_CHARACTERISTIC AddPmp_rAdd_mp_Vector AddPmp_rAdd_mp_Channel AddPmp_volAddTotDem_Vector AddPmp_volAddTotDem_Channel /end DEF_CHARACTERISTIC
 /begin OUT_MEASUREMENT AddPmp_rAdd_mp AddPmp_rAdd_mpByp_mp AddPmp_stAddReqd_mp AddPmp_stAddUpd_mp AddPmp_volAddDem_mp AddPmp_volAddDia_mp AddPmp_volAddTotDemByp_mp AddPmp_volAddTotDia_mp AddPmp_volFuelRef_mp /end OUT_MEASUREMENT
/end FUNCTION
/begin FUNCTION afscd "Luftmassenmesser"
 /begin DEF_CHARACTERISTIC AFSCD_facSwtOnCor_C AFSCD_tiDlySwtOnCor_C AFSCD_DebPlHiOffsDrftDef_C AFSCD_DebPlHiOffsDrftOk_C AFSCD_DebPlLoOffsDrftDef_C AFSCD_DebPlLoOffsDrftOk_C AFSCD_DebRawAirmSigDef_C AFSCD_DebRawAirmSigOk_C AFSCD_DebSRCHiBattDef_C AFSCD_DebSRCHiBattOk_C AFSCD_DebSRCCorrAirmHiDef_C AFSCD_DebSRCCorrAirmHiOk_C AFSCD_DebSRCRawAirmHiDef_C AFSCD_DebSRCRawAirmHiOk_C AFSCD_DebSRCLoBattDef_C AFSCD_DebSRCLoBattOk_C AFSCD_DebSRCCorrAirmLoDef_C AFSCD_DebSRCCorrAirmLoOk_C AFSCD_DebSRCRawAirmLoDef_C AFSCD_DebSRCRawAirmLoOk_C AFSCD_dmAirPerTimeDfl_C AFSCD_dmAirPerTimeMax_C AFSCD_dmAirPerTimeSclFac_C AFSCD_dmLin_CUR AFSCD_facPerCor_C AFSCD_facPlsCor_MAP AFSCD_tiLPFiltPT1_C AFSCD_tiThrHiPlOffsDrft_C AFSCD_tiThrLoPlOffsDrft_C AFSCD_qAirmThrSRCHiActv_CUR AFSCD_nAvrgThrLoSRCLo_C AFSCD_nAvrgThrHiSRCLo_C AFSCD_tiDlyActvSRCHiAirm_C AFSCD_stAirmErrDet_C AFSCD_swtOffsTstSel_C AFSCD_swtOscSel_C AFSCD_tiCorrSRCHi_C AFSCD_tiCorrSRCLo_C AFSCD_tiOffsDrftTstDel_C AFSCD_tiOffsDrftTstLim_C AFSCD_tiPerHFM6_C AFSCD_tiRawSRCHi_C AFSCD_tiRawSRCLo_C AFSCD_uBattSRCMax_C AFSCD_uBattSRCMin_C /end DEF_CHARACTERISTIC
 /begin IN_MEASUREMENT AFSCD_tiRaw Eng_nAvrg InjCtl_qRaw /end IN_MEASUREMENT
/end FUNCTION
/begin FUNCTION afscd_corvalcalc "Korrekturwertberechnung" /end FUNCTION
/begin FUNCTION afscd_corvalcalc_msg "" /begin OUT_MEASUREMENT AFSCD_dmAirDrftComp /end OUT_MEASUREMENT /end FUNCTION
/begin FUNCTION afscd_corvalcalc_uic "" /end FUNCTION
/begin FUNCTION afscd_co_t1 "Air Temperature component driver for T1 Sensor (on HFM)"
 /begin DEF_CHARACTERISTIC AFSCD_stDcycInv_C AFSCD_tiRefSigPerMin_C AFSCD_tiRefSigPerMax_C AFSCD_dcycAirTempSigMin_C AFSCD_dcycAirTempSigMax_C AFSCD_DebRefSigDef_C AFSCD_DebRefSigOk_C AFSCD_DebSRCHiAirTempDef_C AFSCD_DebSRCHiAirTempOk_C AFSCD_DebSRCRefSigHiDef_C AFSCD_DebSRCRefSigHiOk_C AFSCD_DebSRCLoAirTempDef_C AFSCD_DebSRCLoAirTempOk_C AFSCD_DebSRCRefSigLoDef_C AFSCD_DebSRCRefSigLoOk_C AFSCD_DebSRCAirTempDcycMaxDef_C AFSCD_DebSRCAirTempDcycMaxOk_C AFSCD_DebSRCAirTempDcycMinDef_C AFSCD_DebSRCAirTempDcycMinOk_C AFSCD_tiPT1_C AFSCD_dtRmpSlpUp_C AFSCD_dtRmpSlpDwn_C AFSCD_stAirTempErrDet_C AFSCD_tAirThrSRCHi_C AFSCD_tAirThrSRCLo_C AFSCD_tLin_CUR AFSCD_stSensIDWordAirTemp_C AFSCD_tDfl_C /end DEF_CHARACTERISTIC
 /begin IN_MEASUREMENT AFSCD_rAir /end IN_MEASUREMENT
/end FUNCTION
/begin FUNCTION afscd_co_t1_msg "" /begin OUT_MEASUREMENT AFSCD_rAir AFSCD_stErrAirTemp AFSCD_tAir /end OUT_MEASUREMENT /end FUNCTION
/begin FUNCTION afscd_co_t1_uic "" /begin OUT_MEASUREMENT AFSCD_tAir_mp /end OUT_MEASUREMENT /end FUNCTION
/begin FUNCTION afscd_drftcomp "Driftkompensation" /end FUNCTION
/begin FUNCTION afscd_drftcomp_msg "" /begin OUT_MEASUREMENT AFSCD_stDrftComp /end OUT_MEASUREMENT /end FUNCTION
/begin FUNCTION afscd_drftcomp_uic "" /end FUNCTION
/begin FUNCTION afscd_flt "Luftmassenfilterung" /end FUNCTION
/begin FUNCTION afscd_flt_msg "" /begin OUT_MEASUREMENT AFSCD_mAirPerCylFlt /end OUT_MEASUREMENT /end FUNCTION
/begin FUNCTION afscd_flt_uic "" /end FUNCTION
/begin FUNCTION afscd_mon "AFSCD Monitoring fucntion"
 /begin DEF_CHARACTERISTIC AFSCD_DebPlHiSetyDrftDef_C AFSCD_DebPlHiSetyDrftOk_C AFSCD_DebPlLoSetyDrftDef_C AFSCD_DebPlLoSetyDrftOk_C AFSCD_dmAirSubsVal_MAP AFSCD_tClntThrLo_C AFSCD_tClntThrHi_C AFSCD_rSwirlThrLo_C AFSCD_rSwirlThrHi_C AFSCD_rTVAThrLo_C AFSCD_rTVAThrHi_C AFSCD_pAirThrLo_C AFSCD_qRawThrHi_C AFSCD_nAvrgThrLoPlHi_C AFSCD_nAvrgThrHiPlHi_C AFSCD_pBstThrHiPlHi_C AFSCD_rAirThrHiPlHi_C AFSCD_nAvrgThrLoPlLo_C AFSCD_nAvrgThrHiPlLo_C AFSCD_pBstThrLoPlLo_C AFSCD_rAirThrLoPlLo_C AFSCD_rEGRPThrHi_C AFSCD_tiDlyEGRPPlSetyDrft_C AFSCD_tiDlyStrPlSetyDrft_C AFSCD_dtAirThres_C AFSCD_stInhRls_C AFSCD_swtSensInstVal_C AFSCD_swtSensInstType_C /end DEF_CHARACTERISTIC
 /begin IN_MEASUREMENT Eng_nAvrg InjCtl_qRaw /end IN_MEASUREMENT
/end FUNCTION
/begin FUNCTION afscd_mon_msg ""
 /begin OUT_MEASUREMENT AFSCD_dmAirNorm AFSCD_dmAirPerTime AFSCD_mAirPerCyl AFSCD_rAirNorm AFSCD_stDrftMonRls AFSCD_swtSensInst /end OUT_MEASUREMENT
/end FUNCTION
/begin FUNCTION afscd_mon_uic ""
 /begin OUT_MEASUREMENT AFSCD_dmAirSensCorr_mp AFSCD_dmAirSubsVal_mp AFSCD_mAirPerCyl_mp AFSCD_stDrftMonRls_mp AFSCD_stPlSetyDrftRls_mp AFSCD_stPlSetyDrft_mp /end OUT_MEASUREMENT
/end FUNCTION
/begin FUNCTION afscd_msg ""
 /begin OUT_MEASUREMENT AFSCD_dmAirPerTimeHold AFSCD_dmAirRawPerTime AFSCD_dmAirSens AFSCD_stErrAirm AFSCD_stOffsTst AFSCD_tiRaw AFSCD_tiRawLast /end OUT_MEASUREMENT
/end FUNCTION
/begin FUNCTION afscd_uic ""
 /begin OUT_MEASUREMENT AFSCD_dmAirSensRaw_mp AFSCD_facPlsCor_mp AFSCD_facSwtOnCor_mp AFSCD_qAirmThrSRCHiActv_mp AFSCD_stDebSRCAirm_mp AFSCD_stSRCHiTstRls_mp AFSCD_stSRCLoTstRls_mp AFSCD_tiRawAvrgVal_mp AFSCD_tiSwtOnCor_mp /end OUT_MEASUREMENT
/end FUNCTION
/begin FUNCTION afscd_var "" /end FUNCTION
/begin FUNCTION afvcd "Luftfilterventil Komponententreiber"
 /begin DEF_CHARACTERISTIC AFVCD_DebExcTempDef_C AFVCD_DebExcTempOk_C AFVCD_DebNoLdDef_C AFVCD_DebNoLdOk_C AFVCD_DebShCirBattDef_C AFVCD_DebShCirBattOk_C AFVCD_DebShCirGndDef_C AFVCD_DebShCirGndOk_C AFVCD_stActrInvOut_C AFVCD_stPwrStgActrActv_C AFVCD_stPwrStgActrDia_C /end DEF_CHARACTERISTIC
/end FUNCTION
/begin FUNCTION afvcd_msg "" /end FUNCTION
/begin FUNCTION afvcd_uic "" /begin OUT_MEASUREMENT AFVCD_stHWEActrOut_mp /end OUT_MEASUREMENT /end FUNCTION
/begin FUNCTION afvctl "Luftfilterventilsteuerung"
 /begin DEF_CHARACTERISTIC AFVCtl_dmAcouHighOff_C AFVCtl_dmAcouHighOn_C AFVCtl_dmAcouLowOff_C AFVCtl_dmAcouLowOn_C AFVCtl_dmHeightOff_C AFVCtl_dmHeightOn_C AFVCtl_dmPwrOff_C AFVCtl_dmPwrOn_C AFVCtl_dmRainHighOff_C AFVCtl_dmRainHighOn_C AFVCtl_dmRainLowOff_C AFVCtl_dmRainLowOn_C AFVCtl_dmSnowHighOff_C AFVCtl_dmSnowHighOn_C AFVCtl_dmSnowLowOff_C AFVCtl_dmSnowLowOn_C AFVCtl_nAcouHighOff_C AFVCtl_nAcouHighOn_C AFVCtl_nAcouLowOff_C AFVCtl_nAcouLowOn_C AFVCtl_pHeightOff_C AFVCtl_pHeightOn_C AFVCtl_tiRainWiperHoldNeg_C AFVCtl_tiRainWiperHoldPos_C AFVCtl_tAirSnowOff_C AFVCtl_tAirSnowOn_C AFVCtl_tIndPwrOff_C AFVCtl_tIndPwrOn_C AFVCtl_tIndSnowOff_C AFVCtl_tIndSnowOn_C AFVCtl_vRainHighOff_C AFVCtl_vRainHighOn_C AFVCtl_vRainLowOff_C AFVCtl_vRainLowOn_C AFVCtl_vSnowHighOff_C AFVCtl_vSnowHighOn_C AFVCtl_vSnowLowOff_C AFVCtl_vSnowLowOn_C /end DEF_CHARACTERISTIC
/end FUNCTION
/begin FUNCTION afvctl_msg "" /begin OUT_MEASUREMENT AFVCtl_stOut /end OUT_MEASUREMENT /end FUNCTION
/begin FUNCTION afvctl_uic ""
 /begin OUT_MEASUREMENT AFVCtl_stLogic_mp AFVCtl_stPwrIndThres_mp AFVCtl_stSnowIndThres_mp /end OUT_MEASUREMENT
/end FUNCTION
/begin FUNCTION airbcd "Komponententreiber Airbagsignalerfassung"
 /begin DEF_CHARACTERISTIC AirbCD_DebCrashCrCtlDef_C AirbCD_DebCrashCrCtlOk_C AirbCD_DebCrashPSPDef_C AirbCD_DebCrashPSPOk_C AirbCD_DebCrashDef_C AirbCD_DebCrashOk_C AirbCD_stAIRBCrCtl_C AirbCD_stAIRBFuel_C /end DEF_CHARACTERISTIC
/end FUNCTION
/begin FUNCTION airbcd_msg "" /begin OUT_MEASUREMENT AirbCD_st /end OUT_MEASUREMENT /end FUNCTION
/begin FUNCTION airbcd_uic "" /end FUNCTION
/begin FUNCTION airctl_bpdem "Ladedruckanforderung"
 /begin DEF_CHARACTERISTIC AirCtl_dqDesThr_C AirCtl_drBPAThr_C AirCtl_facBPAHold_CUR AirCtl_nWinHi_C AirCtl_nWinLow_C AirCtl_qCurrMax_C AirCtl_qCurrMin_C AirCtl_rEGRMax_C AirCtl_tiPT1BPA_C AirCtl_tiPT1EGR_C AirCtl_tiBPAHold_CUR AirCtl_tiEGRHold_C AirCtl_tiPT1qDes_C /end DEF_CHARACTERISTIC
 /begin IN_MEASUREMENT AirCtl_rPT1EGR_mp Eng_nAvrg /end IN_MEASUREMENT
/end FUNCTION
/begin FUNCTION airctl_bpdem_msg "" /begin OUT_MEASUREMENT AirCtl_stBPDem /end OUT_MEASUREMENT /end FUNCTION
/begin FUNCTION airctl_bpdem_uic "" /begin OUT_MEASUREMENT AirCtl_rPT1EGR_mp AirCtl_stStartTmr_mp AirCtl_tiBPAHold_mp /end OUT_MEASUREMENT /end FUNCTION
/begin FUNCTION airctl_clntbyp "Berechnung der Ansteuerung des EGR-Kühler Bypass Ventils"
 /begin DEF_CHARACTERISTIC AirCtl_mAirCBVHysHi_CUR AirCtl_mAirCBVHysLo_CUR AirCtl_stAftRunValCBV_C AirCtl_stDflValCBV_C AirCtl_stDiagStartCBV_C AirCtl_tAirCBVHysHi_C AirCtl_tAirCBVHysLo_C AirCtl_tClntCBVHysHi_C AirCtl_tClntCBVHysLo_C AirCtl_tiSwtDiagStartCBV_C /end DEF_CHARACTERISTIC
 /begin IN_MEASUREMENT Eng_nAvrg /end IN_MEASUREMENT
/end FUNCTION
/begin FUNCTION airctl_clntbyp_msg "" /begin OUT_MEASUREMENT AirCtl_stEGRClgBypVlv /end OUT_MEASUREMENT /end FUNCTION
/begin FUNCTION airctl_clntbyp_uic "" /begin DEF_CHARACTERISTIC AirCtl_stEGRClgBypVlv_Vector AirCtl_stEGRClgBypVlv_Channel /end DEF_CHARACTERISTIC
 /begin OUT_MEASUREMENT AirCtl_stBypValvAirMass_mp AirCtl_stBypValvtAir_mp AirCtl_stBypValvtClnt_mp AirCtl_stCBVAftRun_mp AirCtl_stDiagStartCBV_mp AirCtl_stEGRClgBypVlvByp_mp /end OUT_MEASUREMENT
/end FUNCTION
/begin FUNCTION airctl_ctlvalcalc "Abgasrückführung - Steuerung"
 /begin DEF_CHARACTERISTIC AirCtl_facCtlRgn1_CUR AirCtl_facCtlRgn2_CUR AirCtl_facCtlRgn3_CUR AirCtl_facCtlRgn4_CUR AirCtl_pCor_MAP AirCtl_rAPCor_MAP AirCtl_rCtlBase_MAP AirCtl_rCtlRgn1a_MAP AirCtl_rCtlRgn1b_MAP AirCtl_rCtlRgn2a_MAP AirCtl_rCtlRgn2b_MAP AirCtl_rCtlRgn3a_MAP AirCtl_rCtlRgn3b_MAP AirCtl_rCtlRgn4a_MAP AirCtl_rCtlRgn4b_MAP AirCtl_rTEngCor1_MAP AirCtl_rTEngCor_MAP AirCtl_rTrmValCor_CUR AirCtl_stCtlRgnMsk1_C AirCtl_stCtlRgnMsk2_C AirCtl_stCtlRgnMsk3_C AirCtl_stCtlRgnMsk4_C AirCtl_strTEngCorMsk_C AirCtl_tiCtlRgnRmp_C AirCtl_tirTEngCorRmp_C /end DEF_CHARACTERISTIC
 /begin IN_MEASUREMENT AirCtl_pCor AirCtl_qCtl AirCtl_TrmValLim APSCD_pVal Eng_nAvrg Eng_tEng IATSCD_tAir /end IN_MEASUREMENT
/end FUNCTION
/begin FUNCTION airctl_ctlvalcalc_msg "" /begin OUT_MEASUREMENT AirCtl_pCor AirCtl_rCtlVal /end OUT_MEASUREMENT /end FUNCTION
/begin FUNCTION airctl_ctlvalcalc_uic "" /begin DEF_CHARACTERISTIC AirCtl_rCtlVal_Vector AirCtl_rCtlVal_Channel /end DEF_CHARACTERISTIC
 /begin OUT_MEASUREMENT AirCtl_facSelRgnCorr_mp AirCtl_rCtl1_mp AirCtl_rCtl2_mp AirCtl_rCtlBase_mp AirCtl_rCtlCorr_mp AirCtl_rCtlCorVal_mp AirCtl_rCtlRaw_mp AirCtl_rCtlRgn0_mp AirCtl_rCtlRgn1_mp AirCtl_rCtlRgn2_mp AirCtl_rCtlRgn3_mp AirCtl_rCtlRgn4_mp AirCtl_rCtlValByp_mp AirCtl_rCtlVal_mp AirCtl_stCtlCurrRgn_mp AirCtl_stCtlRgnMsk_mp AirCtl_strTEngCorMsk_mp /end OUT_MEASUREMENT
/end FUNCTION
/begin FUNCTION airctl_desvalcalc "Abgasrückführung - Sollwertbildung"
 /begin DEF_CHARACTERISTIC AirCtl_APCor_CUR AirCtl_ATCor1_MAP AirCtl_ATCor_MAP AirCtl_CTCor1_CUR AirCtl_CTCor_CUR AirCtl_DT1CoNeg_C AirCtl_DT1WmNeg_C AirCtl_DT1CoPos_C AirCtl_DKdCo_C AirCtl_DKdPosCo_C AirCtl_DKdNegCo_C AirCtl_dqDWinPosCo_C AirCtl_dqDWinNegCo_C AirCtl_DT1WmPos_C AirCtl_DKdWm_C AirCtl_DKdPosWm_C AirCtl_DKdNegWm_C AirCtl_dqDWinPosWm_C AirCtl_dqDWinNegWm_C AirCtl_facDesRgn1_CUR AirCtl_facDesRgn2_CUR AirCtl_facDesRgn3_CUR AirCtl_facDesRgn4_CUR AirCtl_mAPCorAfterStrt_CUR AirCtl_MaxTrmVal_C AirCtl_mCorAfterStart_C AirCtl_mCorStrt_C AirCtl_mCor_CUR AirCtl_mDesBasePil_MAP AirCtl_mDesBase_MAP AirCtl_mDesRgn1a_MAP AirCtl_mDesRgn1b_MAP AirCtl_mDesRgn2a_MAP AirCtl_mDesRgn2b_MAP AirCtl_mDesRgn3a_MAP AirCtl_mDesRgn3b_MAP AirCtl_mDesRgn4a_MAP AirCtl_mDesRgn4b_MAP AirCtl_mDesValAdd_Vector AirCtl_mDesValAdd_Channel AirCtl_mDesVal_Vector AirCtl_mDesVal_Channel AirCtl_MinTrmVal_C AirCtl_mMaxDesVal_C AirCtl_mMinDesVal_C AirCtl_dmRampStepUp_C AirCtl_dmRampStepDown_C AirCtl_NQAPCor_MAP AirCtl_NQCTCor1_MAP AirCtl_NQCTCor2_MAP AirCtl_NQCTCor3_MAP AirCtl_NQCTCor_MAP AirCtl_RevThres_CUR AirCtl_stATCorMsk_C AirCtl_stCTCorMsk_C AirCtl_stDesBaseMsk_C AirCtl_stDesRgnMsk1_C AirCtl_stDesRgnMsk2_C AirCtl_stDesRgnMsk3_C AirCtl_stDesRgnMsk4_C AirCtl_stNQCTCorMsk1_C AirCtl_stNQCTCorMsk2_C AirCtl_stNQCTCorMsk3_C AirCtl_swtAPCorVal_C AirCtl_swtAPCorType_C AirCtl_swtATCorVal_C AirCtl_swtATCorType_C AirCtl_swtCorrActv_C AirCtl_swtTempRevThres_C AirCtl_swtTrmVal_C AirCtl_swtTrmType_C AirCtl_tCThreshold_C AirCtl_tiATCorRmp_C AirCtl_tiCTCorRmp_C AirCtl_tiDesRgnRmp_C AirCtl_tiNQCTCorRmp_C AirCtl_TrmVal_C /end DEF_CHARACTERISTIC
 /begin IN_MEASUREMENT AirCtl_qDes AirCtl_tRevThres_mp APSCD_pVal Eng_nAvrg Eng_tEng IATSCD_tAir /end IN_MEASUREMENT
/end FUNCTION
/begin FUNCTION airctl_desvalcalc_msg ""
 /begin OUT_MEASUREMENT AirCtl_mDesVal AirCtl_swtAPCor AirCtl_swtATCor AirCtl_swtTrm AirCtl_TrmValLim /end OUT_MEASUREMENT
/end FUNCTION
/begin FUNCTION airctl_desvalcalc_uic ""
 /begin OUT_MEASUREMENT AirCtl_facDesRgnCorr1_mp AirCtl_facDesRgnCorr2_mp AirCtl_mAPCor_mp AirCtl_mCorAfterStart_mp AirCtl_mDesBase_mp AirCtl_mDesCorr_mp AirCtl_mDesDyn_mp AirCtl_mDesRaw_mp AirCtl_mDesRgn0_mp AirCtl_mDesRgn1_mp AirCtl_mDesRgn2_mp AirCtl_mDesRgn3_mp AirCtl_mDesRgn4_mp AirCtl_mDesStat_mp AirCtl_mDesValByp_mp AirCtl_mDesVal_1_mp AirCtl_mDesVal_2_mp AirCtl_mDesVal_3_mp AirCtl_mDesVal_4_mp AirCtl_mDesVal_5_mp AirCtl_mDesVal_mp AirCtl_NQCTCor_mp AirCtl_RevThres_mp AirCtl_stATCorMsk_mp AirCtl_stCTCorMsk_mp AirCtl_stDesCurrRgn_mp AirCtl_stDesRgnMsk_mp AirCtl_stNQCTCorMsk_mp AirCtl_tRevThres_mp AirCtl_TrmVal_mp /end OUT_MEASUREMENT
/end FUNCTION
/begin FUNCTION airctl_flsel ""
 /begin DEF_CHARACTERISTIC AirCtl_qRpOilCorr_CUR AirCtl_swtRpOilCtl_C AirCtl_swtRpOilDes_C AirCtl_swtRpOilGov_C AirCtl_swtRpOilMon_C /end DEF_CHARACTERISTIC
 /begin IN_MEASUREMENT InjCtl_qRaw /end IN_MEASUREMENT
/end FUNCTION
/begin FUNCTION airctl_flsel_msg "" /begin OUT_MEASUREMENT AirCtl_qCtl AirCtl_qDes AirCtl_qGov AirCtl_qMon /end OUT_MEASUREMENT /end FUNCTION
/begin FUNCTION airctl_flsel_uic "" /begin OUT_MEASUREMENT AirCtl_qRpOilCorr_mp AirCtl_stFlSel_mp /end OUT_MEASUREMENT /end FUNCTION
/begin FUNCTION airctl_governor "Adaptiver Abgasrückführregler"
 /begin DEF_CHARACTERISTIC AirCtl_DT1_C AirCtl_DKd_C AirCtl_DKdPos_C AirCtl_DKdNeg_C AirCtl_dqDWinPos_C AirCtl_dqDWinNeg_C AirCtl_facATParAd_CUR AirCtl_facNQParAd_MAP AirCtl_IKi_C AirCtl_IKiPos_C AirCtl_IKiNeg_C AirCtl_mIWinPos_C AirCtl_mIWinNeg_C AirCtl_PKp_C AirCtl_PKpPos_C AirCtl_PKpNeg_C AirCtl_mPWinPos_C AirCtl_mPWinNeg_C AirCtl_rEGR2LimMax_C AirCtl_rEGR2LimMin_C AirCtl_rEGRLimMax_C AirCtl_rEGRLimMin_C AirCtl_RgnDT1_C AirCtl_RgnDKd_C AirCtl_RgnDKdPos_C AirCtl_RgnDKdNeg_C AirCtl_dqRgnDWinPos_C AirCtl_dqRgnDWinNeg_C AirCtl_RgnIKi_C AirCtl_RgnIKiPos_C AirCtl_RgnIKiNeg_C AirCtl_mRgnIWinPos_C AirCtl_mRgnIWinNeg_C AirCtl_RgnPKp_C AirCtl_RgnPKpPos_C AirCtl_RgnPKpNeg_C AirCtl_mRgnPWinPos_C AirCtl_mRgnPWinNeg_C AirCtl_rGovMax_C AirCtl_rGovMin_C AirCtl_rIDflGearShft_C AirCtl_rIDflOvrRun_C AirCtl_rIDflShOff_C AirCtl_stInitGovRgnMsk_C AirCtl_swtGovEGRSep_C AirCtl_swtGovVal_C AirCtl_swtGovType_C AirCtl_swtMAirPerCyl_C AirCtl_tiInitGovRgn_C /end DEF_CHARACTERISTIC
 /begin IN_MEASUREMENT Eng_nAvrg IATSCD_tAir InjCtl_qCurr /end IN_MEASUREMENT
/end FUNCTION
/begin FUNCTION airctl_governor_msg ""
 /begin OUT_MEASUREMENT AirCtl_mGovDev AirCtl_rGovEGR AirCtl_rGovEGR2 AirCtl_rGovEGRUnSplit AirCtl_rGovTVA AirCtl_swtGov /end OUT_MEASUREMENT
/end FUNCTION
/begin FUNCTION airctl_governor_uic ""
 /begin OUT_MEASUREMENT AirCtl_facATParAd_mp AirCtl_facNQParAd_mp AirCtl_facParAd_mp AirCtl_facParRgn_mp AirCtl_rBalGov1_mp AirCtl_rGovOut_mp AirCtl_rOutD_mp AirCtl_rOutI_mp AirCtl_rOutP_mp /end OUT_MEASUREMENT
/end FUNCTION
/begin COMPU_METHOD AirMass "Luftmasse" RAT_FUNC "%6.4" "[g]" COEFFS 0 100 0 0 0 1 /end COMPU_METHOD
/begin COMPU_METHOD AirMassPerCyl "Luftmasse pro Zylinder" RAT_FUNC "%6.3" "[mg/Hub Luft]" COEFFS 0 10 0 0 0 1 /end COMPU_METHOD
/begin COMPU_METHOD AirMassPerTime "Luftmasse pro Zeit" RAT_FUNC "%6.3" "[Kg/h Luft]" COEFFS 0 10 0 0 0 1 /end COMPU_METHOD
/begin COMPU_METHOD AirMassPerTime_20ms "Luftmasse pro Sekunde [kg/s]" RAT_FUNC "%6.2" "[(mg/Hub Luft)/s]" COEFFS 0 0.2 0 0 0 1 /end COMPU_METHOD
/begin COMPU_METHOD DtyCyc "Tastverhaeltnis" RAT_FUNC "%6.4" "[%]" COEFFS 0 100 0 0 0 1 /end COMPU_METHOD
/begin COMPU_METHOD EngN "Motordrehzahl" RAT_FUNC "%6.2" "[rpm]" COEFFS 0 1 0 0 0 1 /end COMPU_METHOD
/begin COMPU_METHOD EngTempFldSel "Verbale Umrechnung für Auswahl aus dem Motortemperatur-Feld Eng_tFld" TAB_VERB "%6.3" "" COMPU_TAB_REF EngTempFldSel /end COMPU_METHOD
/begin COMPU_VTAB EngTempFldSel "Verbale Umrechnung für Auswahl aus dem Motortemperatur-Feld Eng_tFld" TAB_VERB 5 0 "Coolant_Temperature" 1 "Oil_Temperature" 2 "Engine_Temperature" 3 "Fuel_Temperature" 4 "Coolant_Temperature_CAN" /end COMPU_VTAB
/begin COMPU_METHOD facRmpEGT32 "Faktor für EGT Rampe  (32bit Normiert)" RAT_FUNC "%10.9" "[-]" COEFFS 0 16384000 0 0 0 1 /end COMPU_METHOD
/begin COMPU_METHOD Fact "Faktor mit Auflösung 1 / 8192, hauptsächlich für einen Faktorenbereich 0...1 verwendet" RAT_FUNC "%6.5" "[-]" COEFFS 0 8192 0 0 0 1 /end COMPU_METHOD
/begin COMPU_METHOD Fact1 "Faktor mit Auflösung 0,01 (100 mal höherer Bereich als Fact)" RAT_FUNC "%6.4" "[-]" COEFFS 0 128 0 0 0 1 /end COMPU_METHOD
/begin COMPU_METHOD Fact_HFM6 "Umrechnung für einen Faktor mit 14 Bit Auflösung" RAT_FUNC "%7.6" "-" COEFFS 0 16384 0 0 0 1 /end COMPU_METHOD
/begin COMPU_METHOD Fl_Half_L "Kraftstoffverbrauchsintegral" RAT_FUNC "%6.3" "[l]" COEFFS 0 2 0 0 0 1 /end COMPU_METHOD
/begin COMPU_METHOD InjMass "Einspritzmenge" RAT_FUNC "%6.4" "[mg/hub]" COEFFS 0 100 0 0 0 1 /end COMPU_METHOD
/begin COMPU_METHOD InjMassCyc "Einspritzmenge pro Zyklus (mg/Zyklus)" RAT_FUNC "%6.4" "[mg/cyc]" COEFFS 0 100 0 0 0 1 /end COMPU_METHOD
/begin COMPU_METHOD InjMassPerSec_20ms "Einspritzmengenänderung pro Sekunde für 20ms-Tasks" RAT_FUNC "%6.3" "[mg/hub/s]" COEFFS 0 2 0 0 0 1 /end COMPU_METHOD
/begin COMPU_METHOD Kd "Differentialverstärkung Kd (gleiche Einheit/Umrechnungsformel an Ein- und Ausgang)" RAT_FUNC "%7.6" "[1/1]" COEFFS 0 65536 0 0 0 1 /end COMPU_METHOD
/begin COMPU_METHOD Kd_InjMass2Prc "Differentialverstärkung (Einspritzmasse zu Prozent)" RAT_FUNC "%7.6" "[%/(mg/Hub)]" COEFFS 0 65536 0 0 0 1 /end COMPU_METHOD
/begin COMPU_METHOD Ki_Ampc2Prc "Integralverstärkung (Luftmasse pro Zyl. AirMassPerCyl zu Prozent Prc)" RAT_FUNC "%7.6" "[%/(mg/Hub Luft)/s]" COEFFS 0 42949.67296 0 0 0 1 /end COMPU_METHOD
/begin COMPU_METHOD Kp_Ampc2Prc "Proportionalverstärkung (Luftmasse zu Prozent)" RAT_FUNC "%8.7" "[%/(mg/Hub Luft)]" COEFFS 0 655360 0 0 0 1 /end COMPU_METHOD
/begin COMPU_METHOD mlToL "Umrechnungsformel von ml auf L" RAT_FUNC "%6.4" "[ml/l]" COEFFS 0 100 0 0 0 1 /end COMPU_METHOD
/begin COMPU_METHOD OneToOne "eins zu eins (physikalischer Wert ist gleich dem internen Wert)" RAT_FUNC "%6.2" "[-]" COEFFS 0 1 0 0 0 1 /end COMPU_METHOD
/begin COMPU_METHOD Period "Periodendauer" RAT_FUNC "%6.3" "[ms]" COEFFS 0 10 0 0 0 1 /end COMPU_METHOD
/begin COMPU_METHOD Prc "Prozent, gleiche interne Auflösung wie Fact, aber Darstellung in Prozent (0...100%)" RAT_FUNC "%6.4" "[%]" COEFFS 0 100 0 0 0 1 /end COMPU_METHOD
/begin COMPU_METHOD PrcPerSec_20ms "Prozentänderung pro Sekunde für 20ms-Tasks" RAT_FUNC "%6.3" "[%/s]" COEFFS 0 2 0 0 0 1 /end COMPU_METHOD
/begin COMPU_METHOD Prc_D20ms "Prozent (0...100%/s) fuer 20ms - Task" RAT_FUNC "%6.3" "[%/s]" COEFFS 0 2 0 0 0 1 /end COMPU_METHOD
/begin COMPU_METHOD PresAC_hPa "Druck (Klimatisierung) angezeigt in [hPa]" RAT_FUNC "%6.2" "[hPa]" COEFFS 0 0.5 0 0 0 1 /end COMPU_METHOD
/begin COMPU_METHOD Pres_hPa "Druck (angezeigt in [hPa])" RAT_FUNC "%6.2" "[hPa]" COEFFS 0 1 0 0 0 1 /end COMPU_METHOD
/begin COMPU_METHOD Pwr "Leistung" RAT_FUNC "%6.2" "[W]" COEFFS 0 0.10610329539459 0 0 0 1 /end COMPU_METHOD
/begin COMPU_METHOD Rmp "einheitenloser Rampengradient (für Library Ramp, etc.)" RAT_FUNC "%6.4" "[1/s]" COEFFS 0 65.536 0 0 0 1 /end COMPU_METHOD
/begin COMPU_METHOD RmpAirMassPerCyl "Rampengradient für Luftmasse pro Zylinder" RAT_FUNC "%6.4" "[(mg/Hub Luft)/s]" COEFFS 0 655.36 0 0 0 1 /end COMPU_METHOD
/begin COMPU_METHOD RmpTemp "Rampengradient für Temperatur" RAT_FUNC "%6.4" "[deg C/s]" COEFFS 0 655.36 0 0 0 1 /end COMPU_METHOD
/begin COMPU_METHOD stroke_pml "hübe pro Volumen [1/ml]" RAT_FUNC "%6.3" "[1/ml]" COEFFS 0 10 0 0 0 1 /end COMPU_METHOD
/begin COMPU_METHOD TempCels_100ms "Temperatur Differenz in Grad C/sec (bezgl. 100ms task)" RAT_FUNC "%6.2" "deg C/s" COEFFS 0 1 0 0 0 1 /end COMPU_METHOD
/begin COMPU_METHOD TempDiff_Kelv "Offsettemperatur dargestellt in [K]" RAT_FUNC "%6.3" "[ deg C ]" COEFFS 0 10 0 0 0 1 /end COMPU_METHOD
/begin COMPU_METHOD Temp_Cels "Temperatur dargestellt in °C (gleiche interne Darstellung wie Temp_Kelv)" RAT_FUNC "%6.1" "[deg C]" COEFFS 0 10 2731.4 0 0 1 /end COMPU_METHOD
/begin COMPU_METHOD TimeDeb "Entprellzeit in Millisekunden für Libraryfunktion Debounce" RAT_FUNC "%6.1" "[ms]" COEFFS 0 0.1 0 0 0 1 /end COMPU_METHOD
/begin COMPU_METHOD TimeDelay_ms "Zeitkonstante T1 fuer die Bibliotheksfunktionen PT1, DT1, etc.,  in ms angegeben" RAT_FUNC "%9.0" "[ms]" COEFFS 0 0 1 0 2.3283064365387e-07 0 /end COMPU_METHOD
/begin COMPU_METHOD TimeDelay_s "Zeitkonstante T1 (in s) für PT1, DT1, etc." RAT_FUNC "%9.3" "[s]" COEFFS 0 0 1 0 0.00023283064365387 0 /end COMPU_METHOD
/begin COMPU_METHOD TimeEGTRmp "Umrechnung  Zeit in Rampensteigung,  Verwendet in EGT-Bibliothek" RAT_FUNC "%6.3" "[s]" COEFFS 0 0 1 0 0.0152587890625 0 /end COMPU_METHOD
/begin COMPU_METHOD Time_4us "Umrechnung mit einer Auflösung von 4 micro Sekunden" RAT_FUNC "%6.4" "ms" COEFFS 0 250 0 0 0 1 /end COMPU_METHOD
/begin COMPU_METHOD Time_ms "Zeit in ms für Fehlerentprellung (DSM) und SW-Timer" RAT_FUNC "%6.1" "[ms]" COEFFS 0 0.1 0 0 0 1 /end COMPU_METHOD
/begin COMPU_METHOD Time_ms_20ms "Zeitzähler im 20 ms Raster, dargestellt in ms" RAT_FUNC "%6.1" "ms" COEFFS 0 0.05 0 0 0 1 /end COMPU_METHOD
/begin COMPU_METHOD Time_Period_HFM6 "Spezielle Umrechnung für die Periodendauer des HFM6" RAT_FUNC "%9.8" "ms" COEFFS 0 4096000 0 0 0 1 /end COMPU_METHOD
/begin COMPU_METHOD Time_PwmHigh "Periodenzeit von der HWE (Tio_PwmGetAvrg)" RAT_FUNC "%6.3" "[us]" COEFFS 0 10 0 0 0 1 /end COMPU_METHOD
/begin COMPU_METHOD Time_PwmHigh_Hfm6 "Periodendauer für HFM6 Luftmassensignal" RAT_FUNC "%6.0" "[us]" COEFFS 0 10 -32768 0 0 1 /end COMPU_METHOD
/begin COMPU_METHOD Trq "Motormoment" RAT_FUNC "%6.3" "[Nm]" COEFFS 0 10 0 0 0 1 /end COMPU_METHOD
/begin COMPU_METHOD TrqPrp "Vortriebsmoment" RAT_FUNC "%6.2" "[Nm]" COEFFS 0 1 0 0 0 1 /end COMPU_METHOD
/begin COMPU_METHOD Vel "Fahrzeuggeschwindigkeit, gleiche interne Auflösung wie Vel_SI" RAT_FUNC "%6.4" "[km/h]" COEFFS 0 100 0 0 0 1 /end COMPU_METHOD
/begin COMPU_METHOD volAdd_ml "Additivvolumen [ml]" RAT_FUNC "%6.3" "[ml]" COEFFS 0 10 0 0 0 1 /end COMPU_METHOD
/begin COMPU_METHOD volAdd_ml_fine "feinere Auflösung des Additivvolumen [ml]" RAT_FUNC "%6.5" "[ml]" COEFFS 0 1000 0 0 0 1 /end COMPU_METHOD
/begin COMPU_METHOD Volt "Spannung in V (von ADC)" RAT_FUNC "%6.2" "[mV]" COEFFS 0 0.2046 0 0 0 1 /end COMPU_METHOD
/begin COMPU_METHOD Volt_Batt "Batteriespannung" RAT_FUNC "%6.1" "[mV]" COEFFS 0 0.0492252911173131 0 0 0 1 /end COMPU_METHOD
/begin RECORD_LAYOUT Kf_Xs16_Ys16_Ws16 NO_AXIS_PTS_X 1 SWORD NO_AXIS_PTS_Y 2 SWORD AXIS_PTS_X 3 SWORD INDEX_INCR DIRECT AXIS_PTS_Y 4 SWORD INDEX_INCR DIRECT FNC_VALUES 5 SWORD COLUMN_DIR DIRECT /end RECORD_LAYOUT
/begin RECORD_LAYOUT Kl_Xs16_Ws16 NO_AXIS_PTS_X 1 SWORD AXIS_PTS_X 2 SWORD INDEX_INCR DIRECT FNC_VALUES 3 SWORD COLUMN_DIR DIRECT /end RECORD_LAYOUT
/begin RECORD_LAYOUT Kw_Ws16 FNC_VALUES 1 SWORD COLUMN_DIR DIRECT /end RECORD_LAYOUT
/begin RECORD_LAYOUT Kw_Ws32 FNC_VALUES 1 SLONG COLUMN_DIR DIRECT /end RECORD_LAYOUT
/begin RECORD_LAYOUT Kw_Ws8 FNC_VALUES 1 SBYTE COLUMN_DIR DIRECT /end RECORD_LAYOUT
/begin RECORD_LAYOUT Kw_Wu16 FNC_VALUES 1 UWORD COLUMN_DIR DIRECT /end RECORD_LAYOUT
/begin RECORD_LAYOUT Kw_Wu32 FNC_VALUES 1 ULONG COLUMN_DIR DIRECT /end RECORD_LAYOUT
/begin RECORD_LAYOUT Kw_Wu8 FNC_VALUES 1 UBYTE COLUMN_DIR DIRECT /end RECORD_LAYOUT
/end MODULE
/end PROJECT
