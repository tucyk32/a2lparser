ASAP2_VERSION 1 3
/begin PROJECT C177 "EDC16CP"
/begin HEADER "" VERSION "VCP7A3" PROJECT_NO C177 /end HEADER
/begin MODULE DIM ""
/begin MOD_COMMON "" BYTE_ORDER MSB_FIRST ALIGNMENT_BYTE 1 ALIGNMENT_WORD 2 ALIGNMENT_LONG 4 ALIGNMENT_FLOAT32_IEEE 4 /end MOD_COMMON
/begin CHARACTERISTIC CoDT_tiOvrRunDebNeg_C "Entprellung des Zustands ""Fahrzeug schiebt""" VALUE 0x1C8CC0 Kw_Wu16 655350.0 TimeDeb 0.00 655350.0 FORMAT "%8.1" /end CHARACTERISTIC
/begin CHARACTERISTIC CoDT_tiOvrRunDebPos_C "Entprellung des Zustands ""Fahrzeug schiebt""" VALUE 0x1C8CC2 Kw_Wu16 655350.0 TimeDeb 0.00 655350.0 FORMAT "%8.1" /end CHARACTERISTIC
/begin CHARACTERISTIC CoDT_dtrqLimDwnCurr_C "negative Steigung für einen Rampenschalter im Curr-Pfad" VALUE 0x1C8CA4 Kw_Wu32 6553599.99847 RmpTrq 0.00 6553599.99847 FORMAT "%13.5" /end CHARACTERISTIC
/begin CHARACTERISTIC CoDT_dtrqLimDwnLead_C "negative Steigung für einen Rampenschalter im Lead-Pfad" VALUE 0x1C8CA8 Kw_Wu32 6553599.99847 RmpTrq 0.00 6553599.99847 FORMAT "%13.5" /end CHARACTERISTIC
/begin CHARACTERISTIC CoDT_dtrqLimUpCurr_C "positive Steigung für einen Rampenschalter im Curr-Pfad" VALUE 0x1C8CAC Kw_Wu32 6553599.99847 RmpTrq 0.00 6553599.99847 FORMAT "%13.5" /end CHARACTERISTIC
/begin CHARACTERISTIC CoDT_dtrqLimUpLead_C "positive Steigung für Rampenschalter im Lead-Pfad" VALUE 0x1C8CB0 Kw_Wu32 6553599.99847 RmpTrq 0.00 6553599.99847 FORMAT "%13.5" /end CHARACTERISTIC
/begin CHARACTERISTIC CoDT_swtCoTypeVal_C "0: conventional; 1: mastershift" VALUE 0x1C8CB4 Kw_Wu8 1.000 OneToOne 0.00 1.000 FORMAT "%5.3" EXTENDED_LIMITS 0.00 255.0 /end CHARACTERISTIC
/begin CHARACTERISTIC CoDT_swtCoTypeType_C "CoDT_swtCoType 0: bed. Spez. ; 1: form E2PROM; 2: Applikation" VALUE 0x1C8CB5 Kw_Wu8 1.000 OneToOne 1.000 2.000 FORMAT "%5.3" EXTENDED_LIMITS 0.00 255.0 /end CHARACTERISTIC
/begin CHARACTERISTIC CoDT_swtCrCtlNoComp_C "Applikationsschalter für Kompensationsverhalten bei aktivem FGR (0 = Komp. aktiv, 1= Komp. nicht aktiv)" VALUE 0x1C8CC4 Kw_Wu8 1.000 OneToOne 0.00 1.000 FORMAT "%5.3" EXTENDED_LIMITS 0.00 255.0 /end CHARACTERISTIC
/begin CHARACTERISTIC CoDT_tiCompDwn_C "Zeit für Aufbau Nebenaggregatkompensation bei Wegfall Schub" VALUE 0x1C8CC6 Kw_Wu16 655350.0 Time_ms 0.00 655350.0 FORMAT "%8.1" /end CHARACTERISTIC
/begin CHARACTERISTIC CoDT_tiCompUp_C "Zeit für Abbau Nebenaggregatkompensation im Schub" VALUE 0x1C8CC8 Kw_Wu16 655350.0 Time_ms 0.00 655350.0 FORMAT "%8.1" /end CHARACTERISTIC
/begin CHARACTERISTIC CoDT_tiFltPT1_C "Parameter für Filterung des Momentenbands" VALUE 0x1C8CCC Kw_Wu32 4294.9673 TimeDelay_s 0.0000010000000 4294.9673 FORMAT "%9.4" /end CHARACTERISTIC
/begin CHARACTERISTIC CoDT_tiGripDeb_C "Entprellzeit für die Kraftschlußerkennung im Triebstrang" VALUE 0x1C8CBC Kw_Wu16 655350.0 Time_ms 0.00 655350.0 FORMAT "%8.1" /end CHARACTERISTIC
/begin CHARACTERISTIC CoDT_tiTrqRedMaxCurr_C "Zeitschwelle für ""langen"" Getriebeeingriff im Curr-Pfad" VALUE 0x1C8CB6 Kw_Wu16 655350.0 Time_ms 0.00 655350.0 FORMAT "%8.1" /end CHARACTERISTIC
/begin CHARACTERISTIC CoDT_tiTrqRedMaxLead_C "Zeitschwell für ""langen"" Getriebeeingriff im Lead-Pfad" VALUE 0x1C8CB8 Kw_Wu16 655350.0 Time_ms 0.00 655350.0 FORMAT "%8.1" /end CHARACTERISTIC
/begin CHARACTERISTIC CoDT_trqMinInit_C "Initialwert für minimales Vortriebsmoment" VALUE 0x1C8CD0 Kw_Ws16 65534.00 TrqPrp -32767.00 32767.00 FORMAT "%8.2" EXTENDED_LIMITS -32768.00 32767.00 /end CHARACTERISTIC
/begin CHARACTERISTIC CoDT_vGrip_C "Geschwindigkeitsschwelle für Kraftschlußerkennung im Triebstrang" VALUE 0x1C8CBE Kw_Ws16 310.0000 Vel -10.00000 300.0000 FORMAT "%8.4" EXTENDED_LIMITS -327.6800 327.6700 /end CHARACTERISTIC
/begin CHARACTERISTIC CoEng_APdtrqSlpLimDwn_CUR "Luftdruck abhängige Kennlinie für fallende Rampensteigung" CURVE 0x1C8E10 Kl_Xs16_Ws16 1000.000 RmpTrqxdHigh 0.00 1000.000 FORMAT "%8.3" EXTENDED_LIMITS -12800.00 12799.61
 /begin AXIS_DESCR STD_AXIS APSCD_pVal Pres_hPa 25 0.00 3500.000 FORMAT "%8.3" EXTENDED_LIMITS -32768.00 32767.00 DEPOSIT ABSOLUTE /end AXIS_DESCR
/end CHARACTERISTIC
/begin CHARACTERISTIC CoEng_APdtrqSlpLimUp_CUR "Luftdruck abhängige Kennlinie für steigende Rampensteigung" CURVE 0x1C8E76 Kl_Xs16_Ws16 1000.000 RmpTrqxdHigh 0.00 1000.000 FORMAT "%8.3" EXTENDED_LIMITS -12800.00 12799.61
 /begin AXIS_DESCR STD_AXIS APSCD_pVal Pres_hPa 25 0.00 3500.000 FORMAT "%8.3" EXTENDED_LIMITS -32768.00 32767.00 DEPOSIT ABSOLUTE /end AXIS_DESCR
/end CHARACTERISTIC
/begin CHARACTERISTIC CoEng_ATCor_CUR "Kennlinie für Lufttemperaturkorrektur" CURVE 0x1C8EDC Kl_Xs16_Ws16 3.900024 Fact 0.00 3.900024 FORMAT "%8.6" EXTENDED_LIMITS -4.000000 3.999878
 /begin AXIS_DESCR STD_AXIS IATSCD_tAir Temp_Cels 10 -50.14000 199.8600 FORMAT "%8.4" EXTENDED_LIMITS -3549.940 3003.560 DEPOSIT ABSOLUTE /end AXIS_DESCR
/end CHARACTERISTIC
/begin CHARACTERISTIC CoEng_dtrqLimBitUp_C "Rampenparameter bei positiver Fehlerflanke Momentenbegrenzung Bi-Turbo-Fehler" VALUE 0x1C8D88 Kw_Wu32 6553599.16840 RmpTrq 0.830078125000 6553599.99847 FORMAT "%13.5" EXTENDED_LIMITS 0.00 6553599.99847 /end CHARACTERISTIC
/begin CHARACTERISTIC CoEng_dtrqLimBitDwn_C "Rampenparameter bei negativer Fehlerflanke Momentenbegrenzung Bi-Turbo-Fehler" VALUE 0x1C8D8C Kw_Wu32 6553599.16840 RmpTrq 0.830078125000 6553599.99847 FORMAT "%13.5" EXTENDED_LIMITS 0.00 6553599.99847 /end CHARACTERISTIC
/begin CHARACTERISTIC CoEng_dtrqLimUp_C "pos. Rampenanstieg bei Umschaltung auf Begrenzungsmoment bei Systemfehler" VALUE 0x1C8D90 Kw_Wu32 6553599.16840 RmpTrq 0.830078125000 6553599.99847 FORMAT "%13.5" EXTENDED_LIMITS 0.00 6553599.99847 /end CHARACTERISTIC
/begin CHARACTERISTIC CoEng_dtrqLimDwn_C "neg. Rampenanstieg bei Rückkehr von dem Begrenzungsmoment bei Systemfehler" VALUE 0x1C8D94 Kw_Wu32 6553599.16840 RmpTrq 0.830078125000 6553599.99847 FORMAT "%13.5" EXTENDED_LIMITS 0.00 6553599.99847 /end CHARACTERISTIC
/begin CHARACTERISTIC CoEng_ExtWaitMsk_C "Bitmaske für externe Ereignisse for Schreiben des EEPROM" VALUE 0x1C8CF4 Kw_Wu8 255.0 OneToOne 0.00 255.0 FORMAT "%5.1" /end CHARACTERISTIC
/begin CHARACTERISTIC CoEng_facAdjDfl_C "Defaultwert für Abgleich Momentenbegrenzung" VALUE 0x1C8D98 Kw_Ws16 2.000000 Fact 0.00 2.000000 FORMAT "%8.6" EXTENDED_LIMITS -4.000000 3.999878 /end CHARACTERISTIC
/begin CHARACTERISTIC CoEng_facAdjMax_C "Maximaler Abgleichwert für Abgleich Momentenbegrenzung" VALUE 0x1C8D9A Kw_Ws16 2.000000 Fact 0.00 2.000000 FORMAT "%8.6" EXTENDED_LIMITS -4.000000 3.999878 /end CHARACTERISTIC
/begin CHARACTERISTIC CoEng_facAdjMin_C "Minimaler Abgleichwert für Abgleich Momentenbegrenzung" VALUE 0x1C8D9C Kw_Ws16 2.000000 Fact 0.00 2.000000 FORMAT "%8.6" EXTENDED_LIMITS -4.000000 3.999878 /end CHARACTERISTIC
/begin CHARACTERISTIC CoEng_facCorValTot_C "Abgleichwert des Verbrauchs für Gesamteinspritzmenge[-]" VALUE 0x1C8CD4 Kw_Ws16 1.000000 Fact1 0.5000000 1.500000 FORMAT "%8.6" EXTENDED_LIMITS -256.0000 255.9922 /end CHARACTERISTIC
/begin CHARACTERISTIC CoEng_facCorVal_C "Abgleichwert für die Verbrauchsberechnung [-]" VALUE 0x1C8CD6 Kw_Ws16 1.000000 Fact1 0.5000000 1.500000 FORMAT "%8.6" EXTENDED_LIMITS -256.0000 255.9922 /end CHARACTERISTIC
/begin CHARACTERISTIC CoEng_nActrRelease_C "Mindestdrehzahl für Stellerfreigabe" VALUE 0x1C8CE0 Kw_Ws16 32727.00 EngN 40.00000 32767.00 FORMAT "%8.2" EXTENDED_LIMITS -32768.00 32767.00 /end CHARACTERISTIC
/begin CHARACTERISTIC CoEng_nSlpLimMax_C "obere Drehzahlschwelle f. Aktivierung Tuboschubbegrenzung" VALUE 0x1C8F06 Kw_Ws16 6000.000 EngN 0.00 6000.000 FORMAT "%8.3" EXTENDED_LIMITS -32768.00 32767.00 /end CHARACTERISTIC
/begin CHARACTERISTIC CoEng_nSlpLimMin_C "Drehzahlschwelle f. Aktivierung Tuboschubbegrenzung" VALUE 0x1C8F08 Kw_Ws16 6000.000 EngN 0.00 6000.000 FORMAT "%8.3" EXTENDED_LIMITS -32768.00 32767.00 /end CHARACTERISTIC
/begin CHARACTERISTIC CoEng_nThresTMFWSync_C "Drehzahlschwelle für das Zweimassenschwungrad bei unsynchroner Drehzahlerfassung" VALUE 0x1C8D68 Kw_Ws16 5960.000 EngN 40.00000 6000.000 FORMAT "%8.3" EXTENDED_LIMITS -32768.00 32767.00 /end CHARACTERISTIC
/begin CHARACTERISTIC CoEng_nThresTMFW_C "Drehzahlschwelle fuer das Zweimassenschwungrad" VALUE 0x1C8D6A Kw_Ws16 5960.000 EngN 40.00000 6000.000 FORMAT "%8.3" EXTENDED_LIMITS -32768.00 32767.00 /end CHARACTERISTIC
/begin CHARACTERISTIC CoEng_nTVAClsd_C "Drehzahlschwelle für das Schließen der Drosselklappe im Nachlauf" VALUE 0x1C8D54 Kw_Ws16 6000.000 EngN 0.00 6000.000 FORMAT "%8.3" EXTENDED_LIMITS -32768.00 32767.00 /end CHARACTERISTIC
/begin CHARACTERISTIC CoEng_FBCfacActv_C "Mindestaktivierungsfaktor der Mengenausgleichsregelung im Schubkoordinator" VALUE 0x1C8D48 Kw_Wu8 10.00 OneToOne 0.00 10.00 FORMAT "%5.2" EXTENDED_LIMITS 0.00 255.0 /end CHARACTERISTIC
/begin CHARACTERISTIC CoEng_ZFCfacActv_C "Mindestaktivierungsfaktor der Nullmengenkalibrierung im Schubkoordinator" VALUE 0x1C8D49 Kw_Wu8 10.00 OneToOne 0.00 10.00 FORMAT "%5.2" EXTENDED_LIMITS 0.00 255.0 /end CHARACTERISTIC
/begin CHARACTERISTIC CoEng_ALSfacActv_C "Mindestaktivierungsfaktor der Adaption Lambdasonde im Schubkoordinator" VALUE 0x1C8D4A Kw_Wu8 10.00 OneToOne 0.00 10.00 FORMAT "%5.2" EXTENDED_LIMITS 0.00 255.0 /end CHARACTERISTIC
/begin CHARACTERISTIC CoEng_TAAfacActv_C "Mindestaktivierungsfaktor der Inkrementwinkellernens im Schubkoordinator" VALUE 0x1C8D4B Kw_Wu8 10.00 OneToOne 0.00 10.00 FORMAT "%5.2" EXTENDED_LIMITS 0.00 255.0 /end CHARACTERISTIC
/begin CHARACTERISTIC CoEng_tiPT1_C "Zeitkonstante für PT1 Element" VALUE 0x1C8CF8 Kw_Wu32 4294.9673 TimeDelay_s 0.0000010000000 4294.9673 FORMAT "%9.4" /end CHARACTERISTIC
/begin CHARACTERISTIC CoEng_pTVAClsd_C "Ladedruckschwelle für das Schließen der Drosselklappe im Nachlauf" VALUE 0x1C8D56 Kw_Ws16 3500.000 Pres_hPa 0.00 3500.000 FORMAT "%8.3" EXTENDED_LIMITS -32768.00 32767.00 /end CHARACTERISTIC
/begin CHARACTERISTIC CoEng_qTVAClsd_C "Mengenschwelle für das Schließen der Drosselklappe im Nachlauf" VALUE 0x1C8D58 Kw_Ws16 327.6700 InjMass 0.00 327.6700 FORMAT "%8.4" EXTENDED_LIMITS -327.6800 327.6700 /end CHARACTERISTIC
/begin CHARACTERISTIC CoEng_rhoFuel_C "Kraftstoffdichte [kg/m^3]" VALUE 0x1C8CD8 Kw_Ws16 1500.000 RhoFuel 0.00 1500.000 FORMAT "%8.3" EXTENDED_LIMITS -3276.800 3276.700 /end CHARACTERISTIC
/begin CHARACTERISTIC CoEng_stCoopCapbl_C "Kooperationsattribute zu koordinierender Funktionen im Schubkoordinator (bitcodiert)" VALUE 0x1C8D4C Kw_Wu8 15.00 OneToOne 0.00 15.00 FORMAT "%5.2" EXTENDED_LIMITS 0.00 255.0 /end CHARACTERISTIC
/begin CHARACTERISTIC CoEng_stGearLim_C "höchster Gang für Einsatz der Turboschubbegrenzung" VALUE 0x1C8F0A Kw_Ws8 5.000 OneToOne 1.000 6.000 FORMAT "%5.3" EXTENDED_LIMITS -128.0 127.0 /end CHARACTERISTIC
/begin CHARACTERISTIC CoEng_stIRevShutOff_C "Maske für irreversible Abschaltursachen" VALUE 0x1C8D00 Kw_Wu32 4294967295.00 OneToOne 0.00 4294967295.00 FORMAT "%13.2" /end CHARACTERISTIC
/begin CHARACTERISTIC CoEng_stRevShutOff_C "Maske für reversible Abschaltursachen" VALUE 0x1C8D04 Kw_Wu32 4294967295.00 OneToOne 0.00 4294967295.00 FORMAT "%13.2" /end CHARACTERISTIC
/begin CHARACTERISTIC CoEng_stShOffAftRun_C "Abschaltanforderungen im Nachlauf" VALUE 0x1C8D5C Kw_Wu32 4294967295.00 OneToOne 0.00 4294967295.00 FORMAT "%13.2" /end CHARACTERISTIC
/begin CHARACTERISTIC CoEng_stShOffAirbFrnt_C "Abstellpfade für Airbag Frontalaufprall aktiv" VALUE 0x1C8D08 Kw_Wu32 4294967295.00 OneToOne 0.00 4294967295.00 FORMAT "%13.2" /end CHARACTERISTIC
/begin CHARACTERISTIC CoEng_stShOffAirbFuel_C "Abstellpfade für Airbag Crash-Intensität aktiv" VALUE 0x1C8D0C Kw_Wu32 4294967295.00 OneToOne 0.00 4294967295.00 FORMAT "%13.2" /end CHARACTERISTIC
/begin CHARACTERISTIC CoEng_stShOffAirbRear_C "Abstellpfade für Airbag Heckaufprall aktiv" VALUE 0x1C8D10 Kw_Wu32 4294967295.00 OneToOne 0.00 4294967295.00 FORMAT "%13.2" /end CHARACTERISTIC
/begin CHARACTERISTIC CoEng_stShOffAirbSide_C "Abstellpfade für Airbag Seitenaufprall aktiv" VALUE 0x1C8D14 Kw_Wu32 4294967295.00 OneToOne 0.00 4294967295.00 FORMAT "%13.2" /end CHARACTERISTIC
/begin CHARACTERISTIC CoEng_stShOffCompTst_C "Kundenspezifische reversible Abschaltanforderung" VALUE 0x1C8D18 Kw_Wu32 4294967295.00 OneToOne 0.00 4294967295.00 FORMAT "%13.2" /end CHARACTERISTIC
/begin CHARACTERISTIC CoEng_stShOffEcomatic_C "Abschaltanforderung von Ecomatic" VALUE 0x1C8D1C Kw_Wu32 4294967295.00 OneToOne 0.00 4294967295.00 FORMAT "%13.2" /end CHARACTERISTIC
/begin CHARACTERISTIC CoEng_stShOffIRevSys_C "Abstellpfade für irreversible Systemfehler" VALUE 0x1C8D20 Kw_Wu32 4294967295.00 OneToOne 0.00 4294967295.00 FORMAT "%13.2" /end CHARACTERISTIC
/begin CHARACTERISTIC CoEng_stShOffIRevVeh_C "Abstellpfade für irreversible Fahrzeugfehler" VALUE 0x1C8D24 Kw_Wu32 4294967295.00 OneToOne 0.00 4294967295.00 FORMAT "%13.2" /end CHARACTERISTIC
/begin CHARACTERISTIC CoEng_stShOffIrrCmb_C "Abstellpfade bei irregulärer Verbrennung" VALUE 0x1C8D28 Kw_Wu32 4294967295.00 OneToOne 0.00 4294967295.00 FORMAT "%13.2" /end CHARACTERISTIC
/begin CHARACTERISTIC CoEng_stShOffOvrSpd_C "Abstellpfade aufgrund Überdrehzahl" VALUE 0x1C8D2C Kw_Wu32 4294967295.00 OneToOne 0.00 4294967295.00 FORMAT "%13.2" /end CHARACTERISTIC
/begin CHARACTERISTIC CoEng_stShOffRevSys_C "Abstellpfade für reversible Systemfehler" VALUE 0x1C8D30 Kw_Wu32 4294967295.00 OneToOne 0.00 4294967295.00 FORMAT "%13.2" /end CHARACTERISTIC
/begin CHARACTERISTIC CoEng_stShOffRevVeh_C "Abstellpfade für reversible Fahrzeugfehler" VALUE 0x1C8D34 Kw_Wu32 4294967295.00 OneToOne 0.00 4294967295.00 FORMAT "%13.2" /end CHARACTERISTIC
/begin CHARACTERISTIC CoEng_stShOffRlOvrBar_C "Abstellpfade für Überrollbügel aktiv" VALUE 0x1C8D38 Kw_Wu32 4294967295.00 OneToOne 0.00 4294967295.00 FORMAT "%13.2" /end CHARACTERISTIC
/begin CHARACTERISTIC CoEng_stShOffSV_C "Abstellpfade aufgrund dauerbestromtem Magnetventil" VALUE 0x1C8D3C Kw_Wu32 4294967295.00 OneToOne 0.00 4294967295.00 FORMAT "%13.2" /end CHARACTERISTIC
/begin CHARACTERISTIC CoEng_stShOffTMFWRev_C "Reversible Abschaltanforderungen fuer das Zweimassenschwungrad" VALUE 0x1C8D40 Kw_Wu32 4294967295.00 OneToOne 0.00 4294967295.00 FORMAT "%13.2" /end CHARACTERISTIC
/begin CHARACTERISTIC CoEng_stShOffTSCCod_C "Abstellpfade für TSC Kodierung" VALUE 0x1C8D44 Kw_Wu32 4294967295.00 OneToOne 0.00 4294967295.00 FORMAT "%13.2" /end CHARACTERISTIC
/begin CHARACTERISTIC CoEng_stSoftShOffAR_C "Abschaltanforderung im Nachlauf für Komfortabstellung" VALUE 0x1C8D60 Kw_Wu32 4294967295.00 OneToOne 0.00 4294967295.00 FORMAT "%13.2" /end CHARACTERISTIC
/begin CHARACTERISTIC CoEng_swtFlConsDsplVal_C "Schalter zur Auswahl der Botschaft Gesamtverbrauch" VALUE 0x1C8CFC Kw_Wu8 1.000 OneToOne 0.00 1.000 FORMAT "%5.3" EXTENDED_LIMITS 0.00 255.0 /end CHARACTERISTIC
/begin CHARACTERISTIC CoEng_swtKickDwn_C "Schalter Ausschalten der Turboschubbegrenzung bei KickDown ermöglichen" VALUE 0x1C8F0B Kw_Wu8 1.000 OneToOne 0.00 1.000 FORMAT "%5.3" EXTENDED_LIMITS 0.00 255.0 /end CHARACTERISTIC
/begin CHARACTERISTIC CoEng_tiActrPrt_C "maximale Zeit für Stellerbestromung" VALUE 0x1C8CE2 Kw_Wu16 655350.0 Time_ms 0.00 655350.0 FORMAT "%8.1" /end CHARACTERISTIC
/begin CHARACTERISTIC CoEng_tiAftRun_ImmCtl_C "Nachlaufzeit für Wegfahrsperre" VALUE 0x1C8CE4 Kw_Wu16 655350.0 Time_ms 0.00 655350.0 FORMAT "%8.1" /end CHARACTERISTIC
/begin CHARACTERISTIC CoEng_tiDebTMFW_C "Entprellzeit fuer das Zweimassenschwungrad" VALUE 0x1C8D6C Kw_Wu16 20000.00 Time_ms 0.00 20000.00 FORMAT "%8.2" EXTENDED_LIMITS 0.00 655350.0 /end CHARACTERISTIC
/begin CHARACTERISTIC CoEng_tiEep_ImmCtl_C "Maximalzeit für Speichervorgang von WFS Daten" VALUE 0x1C8CE6 Kw_Wu16 655350.0 Time_ms 0.00 655350.0 FORMAT "%8.1" /end CHARACTERISTIC
/begin CHARACTERISTIC CoEng_tiMinAftRun_C "minimale Nachlaufzeit" VALUE 0x1C8CE8 Kw_Wu32 42949672950.0 Time_ms 0.00 42949672950.0 FORMAT "%13.1" /end CHARACTERISTIC
/begin CHARACTERISTIC CoEng_tiOvrRunCoordDebPos_C "Entprellzeit für den Übergang ""Kein Schub -> Schub"" im Schubkoordinator" VALUE 0x1C8D4E Kw_Wu16 1000.000 Time_ms 0.00 1000.000 FORMAT "%8.3" EXTENDED_LIMITS 0.00 655350.0 /end CHARACTERISTIC
/begin CHARACTERISTIC CoEng_tiPwrStgDiaRdy_C "Verzoegerungszeit, um im Nachlauf abgeschaltete Steller zu diagnostizieren" VALUE 0x1C8CEC Kw_Wu16 655350.0 Time_ms 0.00 655350.0 FORMAT "%8.1" /end CHARACTERISTIC
/begin CHARACTERISTIC CoEng_tiResetTO_C "max. Verzögerungszeit für den Klemme 15 Reset" VALUE 0x1C8CDA Kw_Ws16 1000.000 Time_ms 0.00 1000.000 FORMAT "%8.3" EXTENDED_LIMITS -327680.0 327670.0 /end CHARACTERISTIC
/begin CHARACTERISTIC CoEng_tiSoftShOff_C "Verzögerungszeit der Mengenabstellung bei Komforabschaltung" VALUE 0x1C8D64 Kw_Wu16 655350.0 Time_ms 0.00 655350.0 FORMAT "%8.1" /end CHARACTERISTIC
/begin CHARACTERISTIC CoEng_tiSOPTstRdy_C "Verzögerungszeit, um redundanten Abschaltpfadtest durchzuführen" VALUE 0x1C8CEE Kw_Wu16 655350.0 Time_ms 0.00 655350.0 FORMAT "%8.1" /end CHARACTERISTIC
/begin CHARACTERISTIC CoEng_tiT15heal_C "Wartezeit  bis zum Startabbruch, falls kein T15 Signal anliegt und T15 Fehler erkannt wurde" VALUE 0x1C8CDC Kw_Ws32 60.0000000000 Time_s 0.00 60.0000000000 FORMAT "%13.10" EXTENDED_LIMITS -21474836.4800 21474836.4700 /end CHARACTERISTIC
/begin CHARACTERISTIC CoEng_tiTstMax_C "Maximale Zeit zwischen zwei Testanforderungen" VALUE 0x1C8F12 Kw_Wu16 655350.0 Time_ms 0.00 655350.0 FORMAT "%8.1" /end CHARACTERISTIC
/begin CHARACTERISTIC CoEng_tiTVAClsd_C "Zeit für Schließen der Drosselklappe nach Motorstillstand" VALUE 0x1C8CF0 Kw_Wu16 655350.0 Time_ms 0.00 655350.0 FORMAT "%8.1" /end CHARACTERISTIC
/begin CHARACTERISTIC CoEng_tiTVAOpn_C "Zeit für Wiederöffnen der Drosselklappe bei Motorstillstand" VALUE 0x1C8CF2 Kw_Wu16 655350.0 Time_ms 0.00 655350.0 FORMAT "%8.1" /end CHARACTERISTIC
/begin CHARACTERISTIC CoEng_trqLimBit_CUR "Kennfeld zur Begrenzungsmomentermittlung bei Bi-Turbo-Fehler in Abhängigkeit von der Drehzahl" CURVE 0x1C8D9E Kl_Xs16_Ws16 1000.000 Trq 0.00 1000.000 FORMAT "%8.3" EXTENDED_LIMITS -3276.800 3276.700
 /begin AXIS_DESCR STD_AXIS Eng_nAvrg EngN 2 0.00 6000.000 FORMAT "%8.3" EXTENDED_LIMITS -32768.00 32767.00 DEPOSIT ABSOLUTE /end AXIS_DESCR
/end CHARACTERISTIC
/begin CHARACTERISTIC CoEng_trqLimErr_CUR "Kennlinie für das Begrenzungsmoment bei Systemfehlern" CURVE 0x1C8DA8 Kl_Xs16_Ws16 1000.000 Trq 0.00 1000.000 FORMAT "%8.3" EXTENDED_LIMITS -3276.800 3276.700
 /begin AXIS_DESCR STD_AXIS Eng_nAvrg EngN 25 0.00 6000.000 FORMAT "%8.3" EXTENDED_LIMITS -32768.00 32767.00 DEPOSIT ABSOLUTE /end AXIS_DESCR
/end CHARACTERISTIC
/begin CHARACTERISTIC CoEng_trqnoKickDwn_C "Mindestmoment der Turboschubbegrenzung" VALUE 0x1C8F0C Kw_Ws16 1500.000 Trq -500.0000 1000.000 FORMAT "%8.3" EXTENDED_LIMITS -3276.800 3276.700 /end CHARACTERISTIC
/begin CHARACTERISTIC CoEng_trqOffs_CUR "Kennlinie zur Berechnung des Offsets der Momentbegrenzung" CURVE 0x1C8D6E Kl_Xs16_Ws16 100.0000 Trq 0.00 100.0000 FORMAT "%8.4" EXTENDED_LIMITS -3276.800 3276.700
 /begin AXIS_DESCR STD_AXIS Eng_nAvrg EngN 5 0.00 6500.000 FORMAT "%8.3" EXTENDED_LIMITS -32768.00 32767.00 DEPOSIT ABSOLUTE /end AXIS_DESCR
/end CHARACTERISTIC
/begin CHARACTERISTIC CoEng_trqOvrRunThres_C "Momentenschwelle zur Schuberkennung" VALUE 0x1C8D84 Kw_Ws16 10.00000 Trq 0.00 10.00000 FORMAT "%8.5" EXTENDED_LIMITS -3276.800 3276.700 /end CHARACTERISTIC
/begin CHARACTERISTIC CoEng_trqSlpLimMax_C "obere Momentenschwelle f. Aktivierung Tuboschubbegrenzung" VALUE 0x1C8F0E Kw_Ws16 1500.000 Trq -500.0000 1000.000 FORMAT "%8.3" EXTENDED_LIMITS -3276.800 3276.700 /end CHARACTERISTIC
/begin CHARACTERISTIC CoEng_trqSlpLimMin_C "untere Momentenschwelle f. Aktivierung Tuboschubbegrenzung" VALUE 0x1C8F10 Kw_Ws16 1500.000 Trq -500.0000 1000.000 FORMAT "%8.3" EXTENDED_LIMITS -3276.800 3276.700 /end CHARACTERISTIC
/begin CHARACTERISTIC CoEng_trqSlpLim_Vector "Bypass Label for CoEng_trqSlpLim (nicht verändern !)" VALUE 0x1C0A42 Kw_Wu8 255.0 OneToOne 0.00 255.0 FORMAT "%5.1" /end CHARACTERISTIC
/begin CHARACTERISTIC CoEng_trqSlpLim_Channel "Bypass Label für CoEng_trqSlpLim (nicht verändern !)" VALUE 0x1C0A43 Kw_Wu8 255.0 OneToOne 0.00 255.0 FORMAT "%5.1" /end CHARACTERISTIC
/begin CHARACTERISTIC CoEng_trqSwtOff_C "Momentschwelle, unter der im Schub hart auf 0 geschaltet wird" VALUE 0x1C8D86 Kw_Ws16 1000.000 Trq 0.00 1000.000 FORMAT "%8.3" EXTENDED_LIMITS -3276.800 3276.700 /end CHARACTERISTIC
/begin CHARACTERISTIC CoEng_uLowBattPwrStg_C "Untere Grenze der Batteriespannung, an welcher spezielle Endstufendiagnosen abgeschaltet werden" VALUE 0x1C8D50 Kw_Ws16 16008.03 Volt_Batt 0.00 16008.03 FORMAT "%8.2" EXTENDED_LIMITS -665674.1 665653.8 /end CHARACTERISTIC
/begin CHARACTERISTIC ConvCD_DebConvErrDef_C "Entprellzeit bis CAN Botschaftsfehler defekt" VALUE 0x1C8F14 Kw_Wu16 655350.0 Time_ms 0.00 655350.0 FORMAT "%8.1" /end CHARACTERISTIC
/begin CHARACTERISTIC ConvCD_DebConvErrOk_C "Entprellzeit bis CAN-Botschaftsfehler geheilt" VALUE 0x1C8F16 Kw_Wu16 655350.0 Time_ms 0.00 655350.0 FORMAT "%8.1" /end CHARACTERISTIC
/begin CHARACTERISTIC ConvCD_DebPlaDef_C "Zählerwert zur Defektentprellung (PLA)" VALUE 0x1C8F18 Kw_Wu16 65535.00 OneToOne 0.00 65535.00 FORMAT "%8.2" /end CHARACTERISTIC
/begin CHARACTERISTIC ConvCD_DebPlaOk_C "Zählerwert zur Heilungsentprellung (PLA)" VALUE 0x1C8F1A Kw_Wu16 65535.00 OneToOne 0.00 65535.00 FORMAT "%8.2" /end CHARACTERISTIC
/begin CHARACTERISTIC ConvCD_tiDebPos_C "Entprellzeit für pos. Flanke des Kupplungssignals" VALUE 0x1C8F1C Kw_Wu16 2000.000 TimeDeb 0.00 2000.000 FORMAT "%8.3" EXTENDED_LIMITS 0.00 655350.0 /end CHARACTERISTIC
/begin CHARACTERISTIC ConvCD_tiDebNeg_C "Entprellzeit für neg. Flanke des Kupplungssignals." VALUE 0x1C8F1E Kw_Wu16 2000.000 TimeDeb 0.00 2000.000 FORMAT "%8.3" EXTENDED_LIMITS 0.00 655350.0 /end CHARACTERISTIC
/begin CHARACTERISTIC ConvCD_DebSigDef_C "Entprellzeit bis CAN-Botschaftsfehler defekt" VALUE 0x1C8F20 Kw_Wu16 655350.0 Time_ms 0.00 655350.0 FORMAT "%8.1" /end CHARACTERISTIC
/begin CHARACTERISTIC ConvCD_DebSigOk_C "Entprellzeit bis CAN-Botschaftsfehler geheilt" VALUE 0x1C8F22 Kw_Wu16 655350.0 Time_ms 0.00 655350.0 FORMAT "%8.1" /end CHARACTERISTIC
/begin CHARACTERISTIC ConvCD_tiIlsDigInDebNeg_C "Entprellzeit für neg. Flanke des Interlock" VALUE 0x1C8F2C Kw_Wu16 655350.0 TimeDeb 0.00 655350.0 FORMAT "%8.1" /end CHARACTERISTIC
/begin CHARACTERISTIC ConvCD_tiIlsDigInDebPos_C "Entprellzeit für pos. Flanke des Interlock" VALUE 0x1C8F2E Kw_Wu16 655350.0 TimeDeb 0.00 655350.0 FORMAT "%8.1" /end CHARACTERISTIC
/begin CHARACTERISTIC ConvCD_numStepDef_C "Zählschrittweite für Aufwärtszählen zur Defektentprellung" VALUE 0x1C8F24 Kw_Wu8 3.000 OneToOne 0.00 3.000 FORMAT "%5.3" EXTENDED_LIMITS 0.00 255.0 /end CHARACTERISTIC
/begin CHARACTERISTIC ConvCD_numStepOK_C "Zählschrittweite für Abwärtszählen zur Heilungsentprellung" VALUE 0x1C8F25 Kw_Wu8 3.000 OneToOne 0.00 3.000 FORMAT "%5.3" EXTENDED_LIMITS 0.00 255.0 /end CHARACTERISTIC
/begin CHARACTERISTIC ConvCD_stDflVal_C "Kupplungssignal Vorgabewert" VALUE 0x1C8F26 Kw_Wu8 1.000 OneToOne 0.00 1.000 FORMAT "%5.3" EXTENDED_LIMITS 0.00 255.0 /end CHARACTERISTIC
/begin CHARACTERISTIC ConvCD_stGripCtlAST_C "Vorgabewert für autom. Schaltgetriebe bei fehlendem Kraftschluß (""rutschende Kupplung"")" VALUE 0x1C8F27 Kw_Wu8 1.000 OneToOne 0.00 1.000 FORMAT "%5.3" EXTENDED_LIMITS 0.00 255.0 /end CHARACTERISTIC
/begin CHARACTERISTIC ConvCD_stIlsDigInvIn_C "Invertierungsparameter des Eingangssignals" VALUE 0x1C8F30 Kw_Wu8 1.000 OneToOne 0.00 1.000 FORMAT "%5.3" EXTENDED_LIMITS 0.00 255.0 /end CHARACTERISTIC
/begin CHARACTERISTIC ConvCD_swtIlsDigInPVal_C "Softwareschalter ob Interlock vorhanden ist (0=Nein: 1=Ja)" VALUE 0x1C8F31 Kw_Wu8 1.000 OneToOne 0.00 1.000 FORMAT "%5.3" EXTENDED_LIMITS 0.00 255.0 /end CHARACTERISTIC
/begin CHARACTERISTIC ConvCD_swtIlsDigInPType_C "Type des Softwareschalters" VALUE 0x1C8F32 Kw_Wu8 0.00 OneToOne 2.000 2.000 FORMAT "%5.3" EXTENDED_LIMITS 0.00 255.0 /end CHARACTERISTIC
/begin CHARACTERISTIC ConvCD_swtInv_C "Schalter zum invertieren  des Kupplungsignals (0=nichtinvertiert,1=invertiert), Einfluss auf Digitaleingang und CAN" VALUE 0x1C1629 Kw_Wu8 1.000 OneToOne 0.00 1.000 FORMAT "%5.3" EXTENDED_LIMITS 0.00 255.0 /end CHARACTERISTIC
/begin CHARACTERISTIC ConvCD_swtSigVal_C "Schalter für Signalquellenauswahl (0=HW-Eingang, 1=CAN)" VALUE 0x1C8F28 Kw_Wu8 1.000 OneToOne 0.00 1.000 FORMAT "%5.3" EXTENDED_LIMITS 0.00 255.0 /end CHARACTERISTIC
/begin CHARACTERISTIC ConvCD_tiGearShft_C "Zeit für Entprellung zum Gangwechsel Erkennung." VALUE 0x1C8F2A Kw_Wu16 655350.0 Time_ms 0.00 655350.0 FORMAT "%8.1" /end CHARACTERISTIC
/begin CHARACTERISTIC COTSCD_uSRCMin_C "Minimalwert für SRC WTK-Sensor" VALUE 0x1C8F34 Kw_Ws16 5200.391 Volt 0.00 5200.391 FORMAT "%8.3" EXTENDED_LIMITS -160156.4 160151.5 /end CHARACTERISTIC
/begin CHARACTERISTIC COTSCD_uSRCMax_C "Maximalwert für SRC WTK-Sensor" VALUE 0x1C8F36 Kw_Ws16 5200.391 Volt 0.00 5200.391 FORMAT "%8.3" EXTENDED_LIMITS -160156.4 160151.5 /end CHARACTERISTIC
/begin CHARACTERISTIC COTSCD_tLin_CUR "Linearisierungskennlinie für WTK-Sensor" CURVE 0x1C8F38 Kl_Xs16_Ws16 250.0000 Temp_Cels -50.04000 199.9600 FORMAT "%8.4" EXTENDED_LIMITS -3549.940 3003.560
 /begin AXIS_DESCR STD_AXIS COTSCD_uRaw Volt 25 0.00 5200.391 FORMAT "%8.3" EXTENDED_LIMITS -160156.4 160151.5 DEPOSIT ABSOLUTE /end AXIS_DESCR
/end CHARACTERISTIC
/begin CHARACTERISTIC COTSCD_DebSRCHighDef_C "WTK Fehlerentprellzeit fuer SRC-High" VALUE 0x1C8F9E Kw_Wu16 655350.0 Time_ms 0.00 655350.0 FORMAT "%8.1" /end CHARACTERISTIC
/begin CHARACTERISTIC COTSCD_DebSRCHighOk_C "WTK Heilungsentprellzeit fuer SRC-High" VALUE 0x1C8FA0 Kw_Wu16 655350.0 Time_ms 0.00 655350.0 FORMAT "%8.1" /end CHARACTERISTIC
/begin CHARACTERISTIC COTSCD_DebSRCLowDef_C "WTK Fehlerentprellzeit fuer SRC-Low" VALUE 0x1C8FA2 Kw_Wu16 655350.0 Time_ms 0.00 655350.0 FORMAT "%8.1" /end CHARACTERISTIC
/begin CHARACTERISTIC COTSCD_DebSRCLowOk_C "WTK Heilungsentprellzeit fuer SRC-Low" VALUE 0x1C8FA4 Kw_Wu16 655350.0 Time_ms 0.00 655350.0 FORMAT "%8.1" /end CHARACTERISTIC
/begin CHARACTERISTIC COTSCD_dtRmpSlpUp_C "Rampensteigung bei Heilung/Vorgabewert für WTK" VALUE 0x1C8FA8 Kw_Wu32 6553599.99847 RmpTemp 0.00 6553599.99847 FORMAT "%13.5" /end CHARACTERISTIC
/begin CHARACTERISTIC COTSCD_dtRmpSlpDwn_C "Rampensteigung bei Heilung/Vorgabewert für WTK" VALUE 0x1C8FAC Kw_Wu32 6553599.99847 RmpTemp 0.00 6553599.99847 FORMAT "%13.5" /end CHARACTERISTIC
/begin CHARACTERISTIC COTSCD_stSensIDWord_C "Geberkennwort WTK-Sensor" VALUE 0x1C8FB0 Kw_Wu16 65535.00 OneToOne 0.00 65535.00 FORMAT "%8.2" /end CHARACTERISTIC
/begin CHARACTERISTIC COTSCD_tDfl_C "Vorgabewert im Fehlerfall" VALUE 0x1C8FB2 Kw_Ws16 250.0000 Temp_Cels -50.04000 199.9600 FORMAT "%8.4" EXTENDED_LIMITS -3549.940 3003.560 /end CHARACTERISTIC
/begin CHARACTERISTIC CoVeh_DCTClutch_C "Label für DCT-Kupplung(wird später implementiert): 0 geschlossen; 1 geöffnet" VALUE 0x1C8FB4 Kw_Wu8 1.000 OneToOne 0.00 1.000 FORMAT "%5.3" EXTENDED_LIMITS 0.00 255.0 /end CHARACTERISTIC
/begin CHARACTERISTIC CoVeh_dnLvlDfl_C "Vorgabewert für offset stufe [ 1 & 2 ]" VALUE 0x1C8FB6 Kw_Ws16 6000.000 EngN 0.00 6000.000 FORMAT "%8.3" EXTENDED_LIMITS -32768.00 32767.00 /end CHARACTERISTIC
/begin CHARACTERISTIC CoVeh_dnLvlMax_C "Maximalwerte für offset stufe [1 & 2 ]" VALUE 0x1C8FB8 Kw_Ws16 6000.000 EngN 0.00 6000.000 FORMAT "%8.3" EXTENDED_LIMITS -32768.00 32767.00 /end CHARACTERISTIC
/begin CHARACTERISTIC CoVeh_dnLvlMin_C "Minimalewerte für offset stufe [1 & 2 ]" VALUE 0x1C8FBA Kw_Ws16 6000.000 EngN 0.00 6000.000 FORMAT "%8.3" EXTENDED_LIMITS -32768.00 32767.00 /end CHARACTERISTIC
/begin CHARACTERISTIC CoVeh_dtrqEPBUp_C "Rampensteigung aufwaerts (Begrenzung bei EPB signal)" VALUE 0x1C8FE4 Kw_Wu32 65535999.1608 RmpTrqPrp 0.823974609375 65535999.9847 FORMAT "%13.4" EXTENDED_LIMITS 0.00 65535999.9847 /end CHARACTERISTIC
/begin CHARACTERISTIC CoVeh_dtrqEPBDwn_C "Rampensteigung abwaerts (Begrenzung bei EPB signal)" VALUE 0x1C8FE8 Kw_Wu32 65535999.1608 RmpTrqPrp 0.823974609375 65535999.9847 FORMAT "%13.4" EXTENDED_LIMITS 0.00 65535999.9847 /end CHARACTERISTIC
/begin CHARACTERISTIC CoVeh_dtrqLimDwn_C "Rampe für Systemfehler Drehmoment" VALUE 0x1C8FEC Kw_Ws16 1638300. dTrqPrp_20ms 50.00000 1638350. FORMAT "%8.0" EXTENDED_LIMITS -1638400. 1638350. /end CHARACTERISTIC
/begin CHARACTERISTIC CoVeh_dtrqLimUp_C "Rampe für Heilung Systemfehler Drehmoment" VALUE 0x1C8FEE Kw_Ws16 1638300. dTrqPrp_20ms 50.00000 1638350. FORMAT "%8.0" EXTENDED_LIMITS -1638400. 1638350. /end CHARACTERISTIC
/begin CHARACTERISTIC CoVeh_nEcoLoLim_C "Motordrehzahlschwelle für Startfreigabe der Ecomatic" VALUE 0x1C90C4 Kw_Ws16 6000.000 EngN 0.00 6000.000 FORMAT "%8.3" EXTENDED_LIMITS -32768.00 32767.00 /end CHARACTERISTIC
/begin CHARACTERISTIC CoVeh_nEcoTVAShOffThres_C "Ecomatic Motordrehzahlschwelle für TVA Abschaltung" VALUE 0x1C90C6 Kw_Ws16 6000.000 EngN 0.00 6000.000 FORMAT "%8.3" EXTENDED_LIMITS -32768.00 32767.00 /end CHARACTERISTIC
/begin CHARACTERISTIC CoVeh_nEngOffset_C "Offset für Fahrereinbezug" VALUE 0x1C8FBC Kw_Ws16 6000.000 EngN 0.00 6000.000 FORMAT "%8.3" EXTENDED_LIMITS -32768.00 32767.00 /end CHARACTERISTIC
/begin CHARACTERISTIC CoVeh_nENGOther_C "Leerlaufsolldrehzahl bei sonstigen Anforderungen" VALUE 0x1C8FBE Kw_Ws16 6000.000 EngN 0.00 6000.000 FORMAT "%8.3" EXTENDED_LIMITS -32768.00 32767.00 /end CHARACTERISTIC
/begin CHARACTERISTIC CoVeh_nENGStep1_C "LL-Solldrehzahl bei Drehzahlanhebung Stufe1" VALUE 0x1C8FC0 Kw_Ws16 6000.000 EngN 0.00 6000.000 FORMAT "%8.3" EXTENDED_LIMITS -32768.00 32767.00 /end CHARACTERISTIC
/begin CHARACTERISTIC CoVeh_nENGStep2_C "LL-Solldrehzahl bei Drehzahlanhebung Stufe2" VALUE 0x1C8FC2 Kw_Ws16 6000.000 EngN 0.00 6000.000 FORMAT "%8.3" EXTENDED_LIMITS -32768.00 32767.00 /end CHARACTERISTIC
/begin CHARACTERISTIC CoVeh_nRmpSlpUp_C "Rampensteigung für LL-Solldrehzahlanhebung" VALUE 0x1C8FC4 Kw_Wu32 99.9908447266 RmpEngN 50.0030517578 149.993896484 FORMAT "%13.9" EXTENDED_LIMITS 0.00 65535999.9847 /end CHARACTERISTIC
/begin CHARACTERISTIC CoVeh_nRmpSlpDwn_C "Abwertsschrittweite  für LL-Solldrehzahlanhebung" VALUE 0x1C8FC8 Kw_Wu32 65535949.9817 RmpEngN 50.0030517578 65535999.9847 FORMAT "%13.4" EXTENDED_LIMITS 0.00 65535999.9847 READ_ONLY /end CHARACTERISTIC
/begin CHARACTERISTIC CoVeh_nRgn_CUR "Kennlinie zur Generierung LL-Solldrehzahl bei Regeneration." CURVE 0x1C8FCC Kl_Xs16_Ws16 1490.000 EngN 0.00 1490.000 FORMAT "%8.3" EXTENDED_LIMITS -32768.00 32767.00
 /begin AXIS_DESCR STD_AXIS Eng_tEng Temp_Cels 2 -50.14000 199.8600 FORMAT "%8.4" EXTENDED_LIMITS -3549.940 3003.560 DEPOSIT ABSOLUTE /end AXIS_DESCR
/end CHARACTERISTIC
/begin CHARACTERISTIC CoVeh_rAPP_C "Schwelle für PWG aktiv" VALUE 0x1C8FF0 Kw_Ws16 100.0000 Prc 0.00 100.0000 FORMAT "%8.4" EXTENDED_LIMITS -327.6800 327.6700 /end CHARACTERISTIC
/begin CHARACTERISTIC CoVeh_rVnThreshold_C "Schwellwert für v/n Erkennung" VALUE 0x1C8FD6 Kw_Ws16 0.3276700 VelToN 0.00 0.3276700 FORMAT "%9.7" EXTENDED_LIMITS -0.3276800 0.3276700 /end CHARACTERISTIC
/begin CHARACTERISTIC CoVeh_stCalcRgnMsk1_C "Maske zur Aushwahl LL-Solldrehzahl bei Regeneration." VALUE 0x1C8FD8 Kw_Wu32 2147483647.00 OneToOne 0.00 2147483647.00 FORMAT "%13.2" EXTENDED_LIMITS 0.00 4294967295.00 /end CHARACTERISTIC
/begin CHARACTERISTIC CoVeh_swtDfpLvl2Ena_C "Schalter um den Dfp-Eintrag zu ermöglichen wenn stufe2 inkremiert wird" VALUE 0x1C8FDC Kw_Wu8 1.000 OneToOne 0.00 1.000 FORMAT "%5.3" EXTENDED_LIMITS 0.00 255.0 /end CHARACTERISTIC
/begin CHARACTERISTIC CoVeh_swtDriver_C "Fahrereinbezug: 0: mit, 1: ohne" VALUE 0x1C8FDD Kw_Wu8 15.00 OneToOne 0.00 15.00 FORMAT "%5.2" EXTENDED_LIMITS 0.00 255.0 /end CHARACTERISTIC
/begin CHARACTERISTIC CoVeh_swtEcoErrEngOff_C "Schalter für Motorabschaltung bei Ecomaticfehler (1=Motor aus, 0=Motor nicht aus)" VALUE 0x1C90C8 Kw_Wu8 1.000 OneToOne 0.00 1.000 FORMAT "%5.3" EXTENDED_LIMITS 0.00 255.0 /end CHARACTERISTIC
/begin CHARACTERISTIC CoVeh_swtEco_C "Funktionsschalter (1=ein, 0=aus)" VALUE 0x1C90C9 Kw_Wu8 1.000 OneToOne 0.00 1.000 FORMAT "%5.3" EXTENDED_LIMITS 0.00 255.0 /end CHARACTERISTIC
/begin CHARACTERISTIC CoVeh_swtEnableRequest_C "Freigabe der Anforderungen für LL-Solldrehzahlerhöhung" VALUE 0x1C8FDE Kw_Wu8 31.00 OneToOne 0.00 31.00 FORMAT "%5.2" EXTENDED_LIMITS 0.00 255.0 /end CHARACTERISTIC
/begin CHARACTERISTIC CoVeh_swtRampFree_C "Freigabe LL-Solldrehzahlerhöhung über Rampe" VALUE 0x1C8FDF Kw_Wu8 255.0 OneToOne 0.00 255.0 FORMAT "%5.1" /end CHARACTERISTIC
/begin CHARACTERISTIC CoVeh_swtStrtBitDelete_C "Schalter für warten auf Zurücksetzung des Startbits (1=nicht warten, 0=warten)" VALUE 0x1C90CA Kw_Wu8 1.000 OneToOne 0.00 1.000 FORMAT "%5.3" EXTENDED_LIMITS 0.00 255.0 /end CHARACTERISTIC
/begin CHARACTERISTIC CoVeh_swtTxLvl2_C "Wahlschalter für Übertragung der Leerlaufanhebung Stufe 2 (Stufe 1 oder 2)" VALUE 0x1C8FE0 Kw_Wu8 1.000 OneToOne 0.00 1.000 FORMAT "%5.3" EXTENDED_LIMITS 0.00 255.0 /end CHARACTERISTIC
/begin CHARACTERISTIC CoVeh_tEcoClntThres_C "Kühlmitteltemperaturschwelle für Ecomatic Abschaltanforderung" VALUE 0x1C90CC Kw_Ws16 200.0000 Temp_Cels -50.14000 149.8600 FORMAT "%8.4" EXTENDED_LIMITS -3549.940 3003.560 /end CHARACTERISTIC
/begin CHARACTERISTIC CoVeh_tiAccPedDly_C "Verzögerung für PWG in Brettfunktion" VALUE 0x1C8FF2 Kw_Wu16 655140.0 Time_ms 0.00 655140.0 FORMAT "%8.1" EXTENDED_LIMITS 0.00 655350.0 /end CHARACTERISTIC
/begin CHARACTERISTIC CoVeh_tiMaxDef_C "Entprellzeit für Ecomaticfehleränderung von OK auf Defekt" VALUE 0x1C90CE Kw_Wu16 655140.0 Time_ms 0.00 655140.0 FORMAT "%8.1" EXTENDED_LIMITS 0.00 655350.0 /end CHARACTERISTIC
/begin CHARACTERISTIC CoVeh_tiMaxOk_C "Entprellzeit für Ecomaticfehleränderung von Defekt auf OK" VALUE 0x1C90D0 Kw_Wu16 655140.0 Time_ms 0.00 655140.0 FORMAT "%8.1" EXTENDED_LIMITS 0.00 655350.0 /end CHARACTERISTIC
/begin CHARACTERISTIC CoVeh_tiEcoTO_C "Wartezeit für Ecmatic Signal beim Start" VALUE 0x1C90D2 Kw_Wu16 655350.0 Time_ms 0.00 655350.0 FORMAT "%8.1" /end CHARACTERISTIC
/begin CHARACTERISTIC CoVeh_tiEngSpdThresMon_C "Zeitfenster in dem die Motordrehzahl für die Ecomatic überwacht wird" VALUE 0x1C90D4 Kw_Wu16 655350.0 Time_ms 0.00 655350.0 FORMAT "%8.1" /end CHARACTERISTIC
/begin CHARACTERISTIC CoVeh_trqLimSafe_CUR "Momentenbegrenzung aus Brettfunktion" CURVE 0x1C8FF4 Kl_Xs16_Ws16 65534.00 TrqPrp -32767.00 32767.00 FORMAT "%8.2" EXTENDED_LIMITS -32768.00 32767.00
 /begin AXIS_DESCR STD_AXIS AccPed_rChkdVal Prc 25 0.00 100.0000 FORMAT "%8.4" EXTENDED_LIMITS -327.6800 327.6700 DEPOSIT ABSOLUTE /end AXIS_DESCR
/end CHARACTERISTIC
/begin CHARACTERISTIC CoVeh_trqLim_CUR "Begrenzungswert bei Systemfehler Drehmoment" CURVE 0x1C905A Kl_Xs16_Ws16 65534.00 TrqPrp -32767.00 32767.00 FORMAT "%8.2" EXTENDED_LIMITS -32768.00 32767.00
 /begin AXIS_DESCR STD_AXIS Eng_nAvrg EngN 25 0.00 6000.000 FORMAT "%8.3" EXTENDED_LIMITS -32768.00 32767.00 DEPOSIT ABSOLUTE /end AXIS_DESCR
/end CHARACTERISTIC
/begin CHARACTERISTIC CoVeh_trqPrpDes_Vector "Bypass-Label für CoVeh_trqPrpDes (Nicht verstellen!)" VALUE 0x1C0A44 Kw_Wu8 255.0 OneToOne 0.00 255.0 FORMAT "%5.1" /end CHARACTERISTIC
/begin CHARACTERISTIC CoVeh_trqPrpDes_Channel "Bypass label, nicht editieren" VALUE 0x1C0A45 Kw_Wu8 255.0 OneToOne 0.00 255.0 FORMAT "%5.1" /end CHARACTERISTIC
/begin CHARACTERISTIC CoVeh_trqPrpLead_Vector "Bypass label, nicht editieren!" VALUE 0x1C0A46 Kw_Wu8 255.0 OneToOne 0.00 255.0 FORMAT "%5.1" /end CHARACTERISTIC
/begin CHARACTERISTIC CoVeh_trqPrpLead_Channel "Bypass label, nicht editieren!" VALUE 0x1C0A47 Kw_Wu8 255.0 OneToOne 0.00 255.0 FORMAT "%5.1" /end CHARACTERISTIC
/begin CHARACTERISTIC CoVeh_vMax_C "Geschwindigkeitsschwelle in Brettfunktion" VALUE 0x1C90C0 Kw_Ws16 20.00000 Vel 0.00 20.00000 FORMAT "%8.5" EXTENDED_LIMITS -327.6800 327.6700 /end CHARACTERISTIC
/begin CHARACTERISTIC CoVM_amMAX_C "Grenzwert zur Erkennung der physikalischen Unplausibilität des MSR (DCS) Eingriffs" VALUE 0x1C90D6 Kw_Wu16 33553.92 AngMom 0.00 33553.92 FORMAT "%8.2" /end CHARACTERISTIC
/begin CHARACTERISTIC CoVM_dtrqRmpSlpUpDCS_C "Rampensteigung für steigenden Sollwert vom MSR Abschaltwert" VALUE 0x1C90F0 Kw_Wu32 65535989.9902 RmpTrqPrp 9.99450683594 65535999.9847 FORMAT "%13.4" EXTENDED_LIMITS 0.00 65535999.9847 /end CHARACTERISTIC
/begin CHARACTERISTIC CoVM_dtrqRmpSlpDwnDCS_C "Rampensteigung für fallenden Sollwert vom Abschaltwert MSR" VALUE 0x1C90F4 Kw_Wu32 65535989.9902 RmpTrqPrp 9.99450683594 65535999.9847 FORMAT "%13.4" EXTENDED_LIMITS 0.00 65535999.9847 /end CHARACTERISTIC
/begin CHARACTERISTIC CoVM_dtrqRmpSlpUpTCS_C "Rampensteigung für steigenden Sollwert vom ASR Abschaltwert" VALUE 0x1C90F8 Kw_Wu32 65535989.9902 RmpTrqPrp 9.99450683594 65535999.9847 FORMAT "%13.4" EXTENDED_LIMITS 0.00 65535999.9847 /end CHARACTERISTIC
/begin CHARACTERISTIC CoVM_dtrqRmpSlpDwnTCS_C "Rampensteigung für fallenden Sollwert vom Abschaltwert ASR" VALUE 0x1C90FC Kw_Wu32 65535989.9902 RmpTrqPrp 9.99450683594 65535999.9847 FORMAT "%13.4" EXTENDED_LIMITS 0.00 65535999.9847 /end CHARACTERISTIC
/begin CHARACTERISTIC CoVM_dtrqLeadCorUp_C "Rampe zum Aufbau ASR-Vorhalt" VALUE 0x1C90E4 Kw_Wu32 65535989.9902 RmpTrqPrp 9.99450683594 65535999.9847 FORMAT "%13.4" EXTENDED_LIMITS 0.00 65535999.9847 READ_ONLY /end CHARACTERISTIC
/begin CHARACTERISTIC CoVM_dtrqLeadCorDwn_C "Rampe zum Abbau ASR-Vorhalt" VALUE 0x1C90E8 Kw_Wu32 65535989.9902 RmpTrqPrp 9.99450683594 65535999.9847 FORMAT "%13.4" EXTENDED_LIMITS 0.00 65535999.9847 /end CHARACTERISTIC
/begin CHARACTERISTIC CoVM_swtSlipCtlVal_C "Fahrdynamik-Konfiguration (0: ASR aus & MSR aus; 1: ASR an & MSR aus;  2: ASR aus & MSR an;  3: ASR an & MSR an)" VALUE 0x1C90D8 Kw_Wu8 3.000 OneToOne 0.00 3.000 FORMAT "%5.3" EXTENDED_LIMITS 0.00 255.0 /end CHARACTERISTIC
/begin CHARACTERISTIC CoVM_swtSlipCtlType_C "Softwareschalter Type für CoVM_swtSlipCtlVal_C" VALUE 0x1C90D9 Kw_Wu8 2.000 OneToOne 0.00 2.000 FORMAT "%5.3" EXTENDED_LIMITS 0.00 255.0 /end CHARACTERISTIC
/begin CHARACTERISTIC CoVM_tiDCShighDefect_C "Physikalische Plausibilität Motorschleppmoment-Regelung (Tasse Diesel) Defektwerdezeit" VALUE 0x1C90DA Kw_Wu16 655350.0 Time_ms 0.00 655350.0 FORMAT "%8.1" /end CHARACTERISTIC
/begin CHARACTERISTIC CoVM_tiDCShighOK_C "Physikalische Plausibilität Motorschleppmoment-Regelung (Tasse Diesel) Heilungszeit" VALUE 0x1C90DC Kw_Wu16 655350.0 Time_ms 0.00 655350.0 FORMAT "%8.1" /end CHARACTERISTIC
/begin CHARACTERISTIC CoVM_tiDCSplauDefect_C "Funktionale Plausibilität Motorschleppmoment-Regelung mit Geschwindigkeit über Grund Defektwerdezeit" VALUE 0x1C90DE Kw_Wu16 655350.0 Time_ms 0.00 655350.0 FORMAT "%8.1" /end CHARACTERISTIC
/begin CHARACTERISTIC CoVM_tiDCSplauOK_C "Funktionale Plausibilität Motorschleppmoment-Regelung mit Geschwindigkeit über Grund Heilungszeit" VALUE 0x1C90E0 Kw_Wu16 655350.0 Time_ms 0.00 655350.0 FORMAT "%8.1" /end CHARACTERISTIC
/begin CHARACTERISTIC CoVM_tiTrqRedMax_C "Zeitschwelle für ""langen"" ASR-Eingriff" VALUE 0x1C90EC Kw_Wu16 655.3500 Time_s 0.00 655.3500 FORMAT "%8.4" /end CHARACTERISTIC
/begin CHARACTERISTIC CoVM_trqToB_C "Toleranz für ""Eingriffswunsch kann nicht vollständg erfüllt werden""" VALUE 0x1C9100 Kw_Ws16 65535.00 TrqPrp -32768.00 32767.00 FORMAT "%8.2" /end CHARACTERISTIC
/begin CHARACTERISTIC CoVM_vGS_L_C "Minimale Geschwindigkeit über Grund für MSR Eingriff" VALUE 0x1C90E2 Kw_Ws16 655.3500 Vel -327.6800 327.6700 FORMAT "%8.4" /end CHARACTERISTIC
/begin CHARACTERISTIC CrCCD_tiFGADebNeg_C "Entprellzeit für negative Flanke des FGA-Eingangs" VALUE 0x1C9104 Kw_Wu16 655350.0 TimeDeb 0.00 655350.0 FORMAT "%8.1" /end CHARACTERISTIC
/begin CHARACTERISTIC CrCCD_tiFGADebPos_C "Entprellzeit für positive Flanke des FGA-Eingangs" VALUE 0x1C9106 Kw_Wu16 655350.0 TimeDeb 0.00 655350.0 FORMAT "%8.1" /end CHARACTERISTIC
/begin CHARACTERISTIC CrCCD_tiFGLDebNeg_C "Entprellzeit für negative Flanke des FGL-Eingangs" VALUE 0x1C9108 Kw_Wu16 655350.0 TimeDeb 0.00 655350.0 FORMAT "%8.1" /end CHARACTERISTIC
/begin CHARACTERISTIC CrCCD_tiFGLDebPos_C "Entprellzeit für positive Flanke des FGL-Eingangs" VALUE 0x1C910A Kw_Wu16 655350.0 TimeDeb 0.00 655350.0 FORMAT "%8.1" /end CHARACTERISTIC
/begin CHARACTERISTIC CrCCD_tiFGPDebNeg_C "Entprellzeit für negative Flanke des FGP-Eingangs" VALUE 0x1C910C Kw_Wu16 655350.0 TimeDeb 0.00 655350.0 FORMAT "%8.1" /end CHARACTERISTIC
/begin CHARACTERISTIC CrCCD_tiFGPDebPos_C "Entprellzeit für positive Flanke des FGP_Eingangs" VALUE 0x1C910E Kw_Wu16 655350.0 TimeDeb 0.00 655350.0 FORMAT "%8.1" /end CHARACTERISTIC
/begin CHARACTERISTIC CrCCD_tiFGWDebNeg_C "Entprellzeit für negative Flanke des FGW-Eingangs" VALUE 0x1C9110 Kw_Wu16 655350.0 TimeDeb 0.00 655350.0 FORMAT "%8.1" /end CHARACTERISTIC
/begin CHARACTERISTIC CrCCD_tiFGWDebPos_C "Entprellzeit für positive Flanke des FGW-Eingangs" VALUE 0x1C9112 Kw_Wu16 655350.0 TimeDeb 0.00 655350.0 FORMAT "%8.1" /end CHARACTERISTIC
/begin CHARACTERISTIC CrCCD_stFGASwtInvIn_C "Invertierung vom FGA-Eingang" VALUE 0x1C9114 Kw_Wu8 1.000 OneToOne 0.00 1.000 FORMAT "%5.3" EXTENDED_LIMITS 0.00 255.0 /end CHARACTERISTIC
/begin CHARACTERISTIC CrCCD_stFGLSwtInvIn_C "Invertierung vom FGL-Eingang" VALUE 0x1C9115 Kw_Wu8 1.000 OneToOne 0.00 1.000 FORMAT "%5.3" EXTENDED_LIMITS 0.00 255.0 /end CHARACTERISTIC
/begin CHARACTERISTIC CrCCD_stFGPSwtInvIn_C "Invertierung vom FGP-Eingang" VALUE 0x1C9116 Kw_Wu8 1.000 OneToOne 0.00 1.000 FORMAT "%5.3" EXTENDED_LIMITS 0.00 255.0 /end CHARACTERISTIC
/begin CHARACTERISTIC CrCCD_stFGWSwtInvIn_C "Invertierung vom FGW-Eingang" VALUE 0x1C9117 Kw_Wu8 1.000 OneToOne 0.00 1.000 FORMAT "%5.3" EXTENDED_LIMITS 0.00 255.0 /end CHARACTERISTIC
/begin CHARACTERISTIC CrCCD_stPanelVer_C "Art des verbauten Bedienteils" VALUE 0x1C9118 Kw_Wu8 7.000 OneToOne 0.00 7.000 FORMAT "%5.3" EXTENDED_LIMITS 0.00 255.0 /end CHARACTERISTIC
/begin CHARACTERISTIC CrCCD_swtCCTLEna_C "Schalter für Sperren der CrCtl-Funktionalität" VALUE 0x1C9119 Kw_Wu8 255.0 OneToOne 0.00 255.0 FORMAT "%5.1" /end CHARACTERISTIC
/begin CHARACTERISTIC CrCCD_swtInvCancel_C "Schalterinvertierung für 4pos über Lenkrad" VALUE 0x1C911A Kw_Wu8 1.000 OneToOne 0.00 1.000 FORMAT "%5.3" EXTENDED_LIMITS 0.00 255.0 /end CHARACTERISTIC
/begin CHARACTERISTIC CrCCD_swtSetKeyRes_C "Schalter für Setzen mit Wiederaufnahmetaste bei 6 Pos. Bedienteil Main Switch Off" VALUE 0x1C911B Kw_Wu8 1.000 OneToOne 0.00 1.000 FORMAT "%5.3" EXTENDED_LIMITS 0.00 255.0 /end CHARACTERISTIC
/begin CHARACTERISTIC CrCCD_swtSetKeyTip_C "Schalter für Setzen mit Verzögerungs- bzw. Beschleunigungstaste bei 6 Pos. Bedienteil mit Main Switch Off" VALUE 0x1C911C Kw_Wu8 1.000 OneToOne 0.00 1.000 FORMAT "%5.3" EXTENDED_LIMITS 0.00 255.0 /end CHARACTERISTIC
/begin CHARACTERISTIC CrCCD_tiPanDetDel_C "Entprellzeit für die Erkennung des Bedienteils" VALUE 0x1C911E Kw_Wu16 100.0000 Time_ms 0.00 100.0000 FORMAT "%8.4" EXTENDED_LIMITS 0.00 655350.0 /end CHARACTERISTIC
/begin CHARACTERISTIC CrCCD_tmrDecAcc_C "Zeit bis Erkennen auf Anforderung Verzögern oder Beschleunigen" VALUE 0x1C9120 Kw_Wu16 655350.0 Time_ms 0.00 655350.0 FORMAT "%8.1" /end CHARACTERISTIC
/begin CHARACTERISTIC CrCCD_tmrMaxAct_C "max. Aktivzeit für das HW- und CAN- Hauptschalter-Signal um keinen Panel Fehler zu erkennen" VALUE 0x1C9122 Kw_Wu16 100.0000 Time_s 0.00 100.0000 FORMAT "%8.4" EXTENDED_LIMITS 0.00 655.3500 /end CHARACTERISTIC
/begin CHARACTERISTIC CrCCD_tmrMaxKeyDel_C "Maximale Verzögerungszeit für Sechs Pos. Bedienteil Main Switch Off" VALUE 0x1C9124 Kw_Wu16 500.0000 Time_ms 0.00 500.0000 FORMAT "%8.4" EXTENDED_LIMITS 0.00 655350.0 /end CHARACTERISTIC
/begin CHARACTERISTIC CrCCD_tmrMinAct_C "minim. Zeit, während der das CAN- und HW- Hauptschalte-Signal gleichzeitig anliegen müssen, um den Hauptschalter einzuschalten" VALUE 0x1C9126 Kw_Wu16 500.0000 Time_ms 0.00 500.0000 FORMAT "%8.4" EXTENDED_LIMITS 0.00 655350.0 /end CHARACTERISTIC
/begin CHARACTERISTIC CrCCD_tmrMinHwNotAct_C "minimale Deaktivzeit des Hauptschalter- HW-Signals, um den Hauptschalter auszuschalten" VALUE 0x1C9128 Kw_Wu16 500.0000 Time_ms 0.00 500.0000 FORMAT "%8.4" EXTENDED_LIMITS 0.00 655350.0 /end CHARACTERISTIC
/begin CHARACTERISTIC CrCCD_tmrMinNotAct_C "minimale  Zeit während der HW und CAN- Hauptschalter-Signal nicht aktiv sein dürfen um Hauptschalter einzuschalten" VALUE 0x1C912A Kw_Wu16 500.0000 Time_ms 0.00 500.0000 FORMAT "%8.4" EXTENDED_LIMITS 0.00 655350.0 /end CHARACTERISTIC
/begin CHARACTERISTIC CrCCD_tmrSetRes_C "Zeit bis Erkennen Setzen oder Wiederaufnahme" VALUE 0x1C912C Kw_Wu16 100.0000 Time_ms 0.00 100.0000 FORMAT "%8.4" EXTENDED_LIMITS 0.00 655350.0 /end CHARACTERISTIC
/begin CHARACTERISTIC CrCtl_aAcc_CUR "Kennlinie Sollbeschleunigung für Accelerate" CURVE 0x1C92BC Kl_Xs16_Ws16 40.00000 Acc -20.00000 20.00000 FORMAT "%8.5" EXTENDED_LIMITS -32.76800 32.76700
 /begin AXIS_DESCR STD_AXIS VSSCD_v Vel 8 -327.6800 327.6700 FORMAT "%8.4" DEPOSIT ABSOLUTE /end AXIS_DESCR
/end CHARACTERISTIC
/begin CHARACTERISTIC CrCtl_AccPKp_C "Proportionalverstärkung Kp Kleinsignalbereich Rampe EIN+" VALUE 0x1C92E0 Kw_Wu32 6553599.99847 Kp_Vel2Nm 0.00 6553599.99847 FORMAT "%13.5" /end CHARACTERISTIC
/begin CHARACTERISTIC CrCtl_AccPKpPos_C "Proportionalverstärkung Kp pos. Großsignalbereich Rampe EIN+" VALUE 0x1C92E4 Kw_Wu32 6553599.99847 Kp_Vel2Nm 0.00 6553599.99847 FORMAT "%13.5" /end CHARACTERISTIC
/begin CHARACTERISTIC CrCtl_AccPKpNeg_C "Proportionalverstärkung Kp neg. Großsignalbereich Rampe EIN+" VALUE 0x1C92E8 Kw_Wu32 6553599.99847 Kp_Vel2Nm 0.00 6553599.99847 FORMAT "%13.5" /end CHARACTERISTIC
/begin CHARACTERISTIC CrCtl_AccPWinPos_C "P-Regler pos. Kleinsignalgrenze" VALUE 0x1C92EC Kw_Ws16 655.3500 Vel -327.6800 327.6700 FORMAT "%8.4" /end CHARACTERISTIC
/begin CHARACTERISTIC CrCtl_AccPWinNeg_C "P-Regler neg. Kleinsignalgrenze" VALUE 0x1C92EE Kw_Ws16 655.3500 Vel -327.6800 327.6700 FORMAT "%8.4" /end CHARACTERISTIC
/begin CHARACTERISTIC CrCtl_aDecDemDecP_MAP "Kennfeld zur Berechnung des Sollverzögerungswertes bei Dec+" MAP 0x1C9130 Kf_Xs16_Ys16_Ws16 65.53500 Acc -32.76800 32.76700 FORMAT "%8.5"
 /begin AXIS_DESCR STD_AXIS VSSCD_v Vel 8 -327.6800 327.6700 FORMAT "%8.4" DEPOSIT ABSOLUTE /end AXIS_DESCR
 /begin AXIS_DESCR STD_AXIS CrCtl_vDecDemP_mp Vel 8 -327.6800 327.6700 FORMAT "%8.4" DEPOSIT ABSOLUTE /end AXIS_DESCR
/end CHARACTERISTIC
/begin CHARACTERISTIC CrCtl_aDecDemHoldP_CUR "Kennlinie zur Berechnung des Sollverzögerungswertes bei Hold+" CURVE 0x1C91D4 Kl_Xs16_Ws16 0.8000000 Acc -0.8000000 0.00 FORMAT "%9.7" EXTENDED_LIMITS -32.76800 32.76700
 /begin AXIS_DESCR STD_AXIS CrCtl_vDecDemHoldP_mp Vel 8 -327.6800 327.6700 FORMAT "%8.4" DEPOSIT ABSOLUTE /end AXIS_DESCR
/end CHARACTERISTIC
/begin CHARACTERISTIC CrCtl_aDecDemOvRdP_CUR "Kennlinie zur Berechnung des Sollverzögerungswertes bei Override+" CURVE 0x1C91F6 Kl_Xs16_Ws16 0.8000000 Acc -0.8000000 0.00 FORMAT "%9.7" EXTENDED_LIMITS -32.76800 32.76700
 /begin AXIS_DESCR STD_AXIS CrCtl_vDecOvRdP_mp Vel 8 -327.6800 327.6700 FORMAT "%8.4" DEPOSIT ABSOLUTE /end AXIS_DESCR
/end CHARACTERISTIC
/begin CHARACTERISTIC CrCtl_aDecDemResAbvP_CUR "Kennlinie zur Berechnung des Sollverzögerungswertes bei ResAbv+" CURVE 0x1C9218 Kl_Xs16_Ws16 0.8000000 Acc -0.8000000 0.00 FORMAT "%9.7" EXTENDED_LIMITS -32.76800 32.76700
 /begin AXIS_DESCR STD_AXIS CrCtl_vDecResAbvP_mp Vel 8 -327.6800 327.6700 FORMAT "%8.4" DEPOSIT ABSOLUTE /end AXIS_DESCR
/end CHARACTERISTIC
/begin CHARACTERISTIC CrCtl_aDecShutOff_C "Schwelle fuer maximale Verzoegerung" VALUE 0x1C9278 Kw_Ws16 65.53500 Acc -32.76800 32.76700 FORMAT "%8.5" /end CHARACTERISTIC
/begin CHARACTERISTIC CrCtl_aDec_CUR "Kennlinie Sollbeschleunigung für  Verzögerung" CURVE 0x1C92F0 Kl_Xs16_Ws16 40.00000 Acc -20.00000 20.00000 FORMAT "%8.5" EXTENDED_LIMITS -32.76800 32.76700
 /begin AXIS_DESCR STD_AXIS VSSCD_v Vel 8 -327.6800 327.6700 FORMAT "%8.4" DEPOSIT ABSOLUTE /end AXIS_DESCR
/end CHARACTERISTIC
/begin CHARACTERISTIC CrCtl_aEnmBod_C "Beschleunigungsschwelle" VALUE 0x1C9312 Kw_Ws16 65.53500 Acc -32.76800 32.76700 FORMAT "%8.5" /end CHARACTERISTIC
/begin CHARACTERISTIC CrCtl_aResAbvAct_MAP "Kennfeld Sollbeschleunigung für Resume Above" MAP 0x1C9314 Kf_Xs16_Ys16_Ws16 65.53500 Acc -32.76800 32.76700 FORMAT "%8.5"
 /begin AXIS_DESCR STD_AXIS VSSCD_v Vel 8 -327.6800 327.6700 FORMAT "%8.4" DEPOSIT ABSOLUTE /end AXIS_DESCR
 /begin AXIS_DESCR STD_AXIS CrCtl_vYMapResAbv_mp Vel 8 -327.6800 327.6700 FORMAT "%8.4" DEPOSIT ABSOLUTE /end AXIS_DESCR
/end CHARACTERISTIC
/begin CHARACTERISTIC CrCtl_aResBelAct_MAP "Kennfeld Sollbeschleunigung für Resume Below" MAP 0x1C93B8 Kf_Xs16_Ys16_Ws16 65.53500 Acc -32.76800 32.76700 FORMAT "%8.5"
 /begin AXIS_DESCR STD_AXIS VSSCD_v Vel 8 -327.6800 327.6700 FORMAT "%8.4" DEPOSIT ABSOLUTE /end AXIS_DESCR
 /begin AXIS_DESCR STD_AXIS CrCtl_vYMapResBel_mp Vel 8 -327.6800 327.6700 FORMAT "%8.4" DEPOSIT ABSOLUTE /end AXIS_DESCR
/end CHARACTERISTIC
/begin CHARACTERISTIC CrCtl_DebCrCtlPanErrDef_C "Defekterkennungszeit für Bedienteilfehler" VALUE 0x1C927A Kw_Wu16 655350.0 Time_ms 0.00 655350.0 FORMAT "%8.1" /end CHARACTERISTIC
/begin CHARACTERISTIC CrCtl_DebCrCtlPanErrOK_C "Intakterkennungszeit für Bedienteilfehler" VALUE 0x1C927C Kw_Wu16 655350.0 Time_ms 0.00 655350.0 FORMAT "%8.1" /end CHARACTERISTIC
/begin CHARACTERISTIC CrCtl_DebCrCtlPanSwtErrDef_C "Defekterkennungszeit für CCTL Hauptschalter unplausibel" VALUE 0x1C927E Kw_Wu16 655350.0 Time_ms 0.00 655350.0 FORMAT "%8.1" /end CHARACTERISTIC
/begin CHARACTERISTIC CrCtl_DebCrCtlPanSwtErrOK_C "Intakterkennungszeit für CCTL Hauptschalter unplausibel" VALUE 0x1C9280 Kw_Wu16 655350.0 Time_ms 0.00 655350.0 FORMAT "%8.1" /end CHARACTERISTIC
/begin CHARACTERISTIC CrCtl_tiDebLmpDefDef_C "Anzahl unplausibler Signale bis zur Fehlererkennung dynamische Plausibilität für  Bremslichtfehler" VALUE 0x1C923A Kw_Wu16 655350.0 Time_ms 0.00 655350.0 FORMAT "%8.1" /end CHARACTERISTIC
/begin CHARACTERISTIC CrCtl_tiDebLmpDefOk_C "Anzahl unplausibler Signale bis zur Heilungserkennung dynamische Plausibilität für Bremslichtfehler" VALUE 0x1C923C Kw_Wu16 655350.0 Time_ms 0.00 655350.0 FORMAT "%8.1" /end CHARACTERISTIC
/begin CHARACTERISTIC CrCtl_tiDebTlrDefDef_C "Anzahl unplausibler Signale bis zur Fehlererkennung dynamische Plausibilität für  Bremslichtfehler Anhänger" VALUE 0x1C923E Kw_Wu16 655350.0 Time_ms 0.00 655350.0 FORMAT "%8.1" /end CHARACTERISTIC
/begin CHARACTERISTIC CrCtl_tiDebTlrDefOk_C "Anzahl unplausibler Signale bis zur Heilungserkennung dynamische Plausibilität für Bremslichtfehler Anhänger" VALUE 0x1C9240 Kw_Wu16 655350.0 Time_ms 0.00 655350.0 FORMAT "%8.1" /end CHARACTERISTIC
/begin CHARACTERISTIC CrCtl_DecPKp_C "P-Regler Kleinsignalverstaerkung" VALUE 0x1C945C Kw_Wu32 6553599.99847 Kp_Vel2Nm 0.00 6553599.99847 FORMAT "%13.5" /end CHARACTERISTIC
/begin CHARACTERISTIC CrCtl_DecPKpPos_C "P-Regler pos. Grossignalverstaerkung" VALUE 0x1C9460 Kw_Wu32 6553599.99847 Kp_Vel2Nm 0.00 6553599.99847 FORMAT "%13.5" /end CHARACTERISTIC
/begin CHARACTERISTIC CrCtl_DecPKpNeg_C "P-Regler neg. Grossignalverstaerkung" VALUE 0x1C9464 Kw_Wu32 6553599.99847 Kp_Vel2Nm 0.00 6553599.99847 FORMAT "%13.5" /end CHARACTERISTIC
/begin CHARACTERISTIC CrCtl_DecPWinPos_C "P-Regler pos. Kleinsignalgrenze" VALUE 0x1C9468 Kw_Ws16 655.3500 Vel -327.6800 327.6700 FORMAT "%8.4" /end CHARACTERISTIC
/begin CHARACTERISTIC CrCtl_DecPWinNeg_C "P-Regler neg. Kleinsignalgrenze" VALUE 0x1C946A Kw_Ws16 655.3500 Vel -327.6800 327.6700 FORMAT "%8.4" /end CHARACTERISTIC
/begin CHARACTERISTIC CrCtl_facUpDecP_C "Positive Steigung für Rampe bei DEC+" VALUE 0x1C9244 Kw_Wu32 65535.9999847 RmpAcc 0.00 65535.9999847 FORMAT "%13.7" /end CHARACTERISTIC
/begin CHARACTERISTIC CrCtl_facDwnDecP_C "negative Steigung für Rampe bei DEC+" VALUE 0x1C9248 Kw_Wu32 65535.9999847 RmpAcc 0.00 65535.9999847 FORMAT "%13.7" /end CHARACTERISTIC
/begin CHARACTERISTIC CrCtl_facEnmPem_C "Faktor zur Momentenerhoehung" VALUE 0x1C946C Kw_Wu16 127.0000 Vel2Nm_2 0.00 127.0000 FORMAT "%8.4" EXTENDED_LIMITS 0.00 762.0349 /end CHARACTERISTIC
/begin CHARACTERISTIC CrCtl_facEnmRsu_C "Steigung Momentenrampe fuer Warten auf Halten" VALUE 0x1C946E Kw_Ws16 44.99817 RmpTrq 5.000305 49.99847 FORMAT "%8.5" EXTENDED_LIMITS -50.00000 49.99847 /end CHARACTERISTIC
/begin CHARACTERISTIC CrCtl_facEnpBou_C "Beschleunigungsschwelle" VALUE 0x1C9470 Kw_Ws16 65.53500 Acc -32.76800 32.76700 FORMAT "%8.5" /end CHARACTERISTIC
/begin CHARACTERISTIC CrCtl_facEnpFmg_C "Reduktionsfaktor Moment > Schwelle" VALUE 0x1C9472 Kw_Wu16 655.3500 Prc 0.00 655.3500 FORMAT "%8.4" /end CHARACTERISTIC
/begin CHARACTERISTIC CrCtl_facEnpFmk_C "Reduktionsfaktor Moment <= Schwelle" VALUE 0x1C9474 Kw_Wu16 655.3500 Prc 0.00 655.3500 FORMAT "%8.4" /end CHARACTERISTIC
/begin CHARACTERISTIC CrCtl_facEnpPaw_C "Faktor fuer momentenproportionalen Anfangswert" VALUE 0x1C9476 Kw_Wu16 127.0000 Vel2Nm_2 0.00 127.0000 FORMAT "%8.4" EXTENDED_LIMITS 0.00 762.0349 /end CHARACTERISTIC
/begin CHARACTERISTIC CrCtl_facEnpRsu_C "Steigung Momentenrampe fuer Warten auf Halten" VALUE 0x1C9478 Kw_Ws16 75.00458 RmpTrqLow 4.997253 80.00183 FORMAT "%8.5" EXTENDED_LIMITS -250.0000 249.9924 /end CHARACTERISTIC
/begin CHARACTERISTIC CrCtl_facFabVdu_C "erlaubte relative Regelabweichung" VALUE 0x1C9282 Kw_Wu16 655.3500 Prc 0.00 655.3500 FORMAT "%8.4" /end CHARACTERISTIC
/begin CHARACTERISTIC CrCtl_facOffRas_C "Faktor fuer Momentenreduzierung bei steigungskonstanter Rampe" VALUE 0x1C947A Kw_Ws16 655.3500 Prc -327.6800 327.6700 FORMAT "%8.4" /end CHARACTERISTIC
/begin CHARACTERISTIC CrCtl_facOffRsb_C "Faktor fuer Momentenreduzierung bei zeitkonstanter Rampe" VALUE 0x1C947C Kw_Ws16 655.3500 Prc -327.6800 327.6700 FORMAT "%8.4" /end CHARACTERISTIC
/begin CHARACTERISTIC CrCtl_facUpOvRdP_C "Positive Steigung für Rampe bei OVERRIDE+" VALUE 0x1C924C Kw_Wu32 65535.9999847 RmpAcc 0.00 65535.9999847 FORMAT "%13.7" /end CHARACTERISTIC
/begin CHARACTERISTIC CrCtl_facDwnOvRdP_C "negative Steigung für Rampe bei OVERRIDE+" VALUE 0x1C9250 Kw_Wu32 65535.9999847 RmpAcc 0.00 65535.9999847 FORMAT "%13.7" /end CHARACTERISTIC
/begin CHARACTERISTIC CrCtl_facParCor_CUR "Korrekturkennlinie Triebstrang-Übersetzung für  Reglerparameter" CURVE 0x1C947E Kl_Xs16_Ws16 3.199951 Fact 0.00 3.199951 FORMAT "%8.6" EXTENDED_LIMITS -4.000000 3.999878
 /begin AXIS_DESCR STD_AXIS DrvTrn_rTransDT TransR 8 -327.6800 327.6700 FORMAT "%8.4" DEPOSIT ABSOLUTE /end AXIS_DESCR
/end CHARACTERISTIC
/begin CHARACTERISTIC CrCtl_facUpResAbvP_C "positive Steigung für Rampe bei RESABV+" VALUE 0x1C9254 Kw_Wu32 65535.9999847 RmpAcc 0.00 65535.9999847 FORMAT "%13.7" /end CHARACTERISTIC
/begin CHARACTERISTIC CrCtl_facDwnResAbvP_C "negative Steigung für Rampe bei RESABV+" VALUE 0x1C9258 Kw_Wu32 65535.9999847 RmpAcc 0.00 65535.9999847 FORMAT "%13.7" /end CHARACTERISTIC
/begin CHARACTERISTIC CrCtl_facSlpAccCor_CUR "Korrekturkennlinie Fahrwiderstandsindex für Accelerate" CURVE 0x1C94A0 Kl_Xs16_Ws16 3.199951 Fact 0.00 3.199951 FORMAT "%8.6" EXTENDED_LIMITS -4.000000 3.999878
 /begin AXIS_DESCR STD_AXIS CrCtl_rSlpRes PrcHigh 8 -32.76800 32.76700 FORMAT "%8.5" DEPOSIT ABSOLUTE /end AXIS_DESCR
/end CHARACTERISTIC
/begin CHARACTERISTIC CrCtl_facSlpDecCor_CUR "Korrekturkennlinie Fahrwiderstandsindex für Decelerate" CURVE 0x1C94C2 Kl_Xs16_Ws16 3.199951 Fact 0.00 3.199951 FORMAT "%8.6" EXTENDED_LIMITS -4.000000 3.999878
 /begin AXIS_DESCR STD_AXIS CrCtl_rSlpRes PrcHigh 8 -32.76800 32.76700 FORMAT "%8.5" DEPOSIT ABSOLUTE /end AXIS_DESCR
/end CHARACTERISTIC
/begin CHARACTERISTIC CrCtl_facSlpHoldCor_CUR "Korrekturkennlinie Fahrwiderstandsindex für Momenteninitialisierung Hold" CURVE 0x1C94E4 Kl_Xs16_Ws16 3.199951 Fact 0.00 3.199951 FORMAT "%8.6" EXTENDED_LIMITS -4.000000 3.999878
 /begin AXIS_DESCR STD_AXIS CrCtl_rSlpRes PrcHigh 8 -32.76800 32.76700 FORMAT "%8.5" DEPOSIT ABSOLUTE /end AXIS_DESCR
/end CHARACTERISTIC
/begin CHARACTERISTIC CrCtl_facSlpResAbvCor_CUR "Korrekturkennlinie Fahrwiderstandsindex für Resume Above" CURVE 0x1C9506 Kl_Xs16_Ws16 3.199951 Fact 0.00 3.199951 FORMAT "%8.6" EXTENDED_LIMITS -4.000000 3.999878
 /begin AXIS_DESCR STD_AXIS CrCtl_rSlpRes PrcHigh 8 -32.76800 32.76700 FORMAT "%8.5" DEPOSIT ABSOLUTE /end AXIS_DESCR
/end CHARACTERISTIC
/begin CHARACTERISTIC CrCtl_facSlpResBelCor_CUR "Korrekturkennlinie Fahrwiderstandsindex für Resume Below" CURVE 0x1C9528 Kl_Xs16_Ws16 3.199951 Fact 0.00 3.199951 FORMAT "%8.6" EXTENDED_LIMITS -4.000000 3.999878
 /begin AXIS_DESCR STD_AXIS CrCtl_rSlpRes PrcHigh 8 -32.76800 32.76700 FORMAT "%8.5" DEPOSIT ABSOLUTE /end AXIS_DESCR
/end CHARACTERISTIC
/begin CHARACTERISTIC CrCtl_facWaPav_C "Reduktionsfaktor Momentenanfangswert" VALUE 0x1C954A Kw_Ws16 655.3500 Prc -327.6800 327.6700 FORMAT "%8.4" /end CHARACTERISTIC
/begin CHARACTERISTIC CrCtl_HoldIKi_C "I-Regler Kleinsignalverstaerkung" VALUE 0x1C954C Kw_Wu32 99999999.9767 Ki_Vel2Nm 0.00 99999999.9767 FORMAT "%13.4" /end CHARACTERISTIC
/begin CHARACTERISTIC CrCtl_HoldIKiPos_C "I-Regler pos. Grossignalverstaerkung" VALUE 0x1C9550 Kw_Wu32 99999999.9767 Ki_Vel2Nm 0.00 99999999.9767 FORMAT "%13.4" /end CHARACTERISTIC
/begin CHARACTERISTIC CrCtl_HoldIKiNeg_C "I-Regler neg. Grossignalverstaerkung" VALUE 0x1C9554 Kw_Wu32 99999999.9767 Ki_Vel2Nm 0.00 99999999.9767 FORMAT "%13.4" /end CHARACTERISTIC
/begin CHARACTERISTIC CrCtl_HoldIWinPos_C "I-Regler pos. Kleinsignalgrenze" VALUE 0x1C9558 Kw_Ws16 655.3500 Vel -327.6800 327.6700 FORMAT "%8.4" /end CHARACTERISTIC
/begin CHARACTERISTIC CrCtl_HoldIWinNeg_C "I-Regler neg. Kleinsignalgrenze" VALUE 0x1C955A Kw_Ws16 655.3500 Vel -327.6800 327.6700 FORMAT "%8.4" /end CHARACTERISTIC
/begin CHARACTERISTIC CrCtl_HoldPKp_C "P-Regler Kleinsignalverstaerkung" VALUE 0x1C955C Kw_Wu32 6553599.99847 Kp_Vel2Nm 0.00 6553599.99847 FORMAT "%13.5" /end CHARACTERISTIC
/begin CHARACTERISTIC CrCtl_HoldPKpPos_C "P-Regler pos. Grossignalverstaerkung" VALUE 0x1C9560 Kw_Wu32 6553599.99847 Kp_Vel2Nm 0.00 6553599.99847 FORMAT "%13.5" /end CHARACTERISTIC
/begin CHARACTERISTIC CrCtl_HoldPKpNeg_C "P-Regler neg. Grossignalverstaerkung" VALUE 0x1C9564 Kw_Wu32 6553599.99847 Kp_Vel2Nm 0.00 6553599.99847 FORMAT "%13.5" /end CHARACTERISTIC
/begin CHARACTERISTIC CrCtl_HoldPWinPos_C "P-Regler pos. Kleinsignalgrenze" VALUE 0x1C9568 Kw_Ws16 655.3500 Vel -327.6800 327.6700 FORMAT "%8.4" /end CHARACTERISTIC
/begin CHARACTERISTIC CrCtl_HoldPWinNeg_C "P-Regler neg. Kleinsignalgrenze" VALUE 0x1C956A Kw_Ws16 655.3500 Vel -327.6800 327.6700 FORMAT "%8.4" /end CHARACTERISTIC
/begin CHARACTERISTIC CrCtl_nShutOffMax_C "max. erlaubte Drehzahl" VALUE 0x1C9284 Kw_Ws16 65535.00 EngN -32768.00 32767.00 FORMAT "%8.2" /end CHARACTERISTIC
/begin CHARACTERISTIC CrCtl_nShutOffMin_C "min. erlaubte Drehzahl" VALUE 0x1C9286 Kw_Ws16 65535.00 EngN -32768.00 32767.00 FORMAT "%8.2" /end CHARACTERISTIC
/begin CHARACTERISTIC CrCtl_ResHoldIKi_C "I-Regler Kleinsignalverstaerkung" VALUE 0x1C956C Kw_Wu32 99999999.9767 Ki_Vel2Nm 0.00 99999999.9767 FORMAT "%13.4" /end CHARACTERISTIC
/begin CHARACTERISTIC CrCtl_ResHoldIKiPos_C "I-Regler pos. Grossignalverstaerkung" VALUE 0x1C9570 Kw_Wu32 99999999.9767 Ki_Vel2Nm 0.00 99999999.9767 FORMAT "%13.4" /end CHARACTERISTIC
/begin CHARACTERISTIC CrCtl_ResHoldIKiNeg_C "I-Regler neg. Grossignalverstaerkung" VALUE 0x1C9574 Kw_Wu32 99999999.9767 Ki_Vel2Nm 0.00 99999999.9767 FORMAT "%13.4" /end CHARACTERISTIC
/begin CHARACTERISTIC CrCtl_ResHoldIWinPos_C "I-Regler pos. Kleinsignalgrenze" VALUE 0x1C9578 Kw_Ws16 655.3500 Vel -327.6800 327.6700 FORMAT "%8.4" /end CHARACTERISTIC
/begin CHARACTERISTIC CrCtl_ResHoldIWinNeg_C "I-Regler neg. Kleinsignalgrenze" VALUE 0x1C957A Kw_Ws16 655.3500 Vel -327.6800 327.6700 FORMAT "%8.4" /end CHARACTERISTIC
/begin CHARACTERISTIC CrCtl_ResHoldPKp_C "P-Regler Kleinsignalverstaerkung" VALUE 0x1C957C Kw_Wu32 6553599.99847 Kp_Vel2Nm 0.00 6553599.99847 FORMAT "%13.5" /end CHARACTERISTIC
/begin CHARACTERISTIC CrCtl_ResHoldPKpPos_C "P-Regler pos. Grossignalverstaerkung" VALUE 0x1C9580 Kw_Wu32 6553599.99847 Kp_Vel2Nm 0.00 6553599.99847 FORMAT "%13.5" /end CHARACTERISTIC
/begin CHARACTERISTIC CrCtl_ResHoldPKpNeg_C "P-Regler neg. Grossignalverstaerkung" VALUE 0x1C9584 Kw_Wu32 6553599.99847 Kp_Vel2Nm 0.00 6553599.99847 FORMAT "%13.5" /end CHARACTERISTIC
/begin CHARACTERISTIC CrCtl_ResHoldPWinPos_C "P-Regler pos. Kleinsignalgrenze" VALUE 0x1C9588 Kw_Ws16 655.3500 Vel -327.6800 327.6700 FORMAT "%8.4" /end CHARACTERISTIC
/begin CHARACTERISTIC CrCtl_ResHoldPWinNeg_C "P-Regler neg. Kleinsignalgrenze" VALUE 0x1C958A Kw_Ws16 655.3500 Vel -327.6800 327.6700 FORMAT "%8.4" /end CHARACTERISTIC
/begin CHARACTERISTIC CrCtl_ResPKp_C "P-Regler Kleinsignalverstaerkung" VALUE 0x1C958C Kw_Wu32 6553599.99847 Kp_Vel2Nm 0.00 6553599.99847 FORMAT "%13.5" /end CHARACTERISTIC
/begin CHARACTERISTIC CrCtl_ResPKpPos_C "P-Regler pos. Grossignalverstaerkung" VALUE 0x1C9590 Kw_Wu32 6553599.99847 Kp_Vel2Nm 0.00 6553599.99847 FORMAT "%13.5" /end CHARACTERISTIC
/begin CHARACTERISTIC CrCtl_ResPKpNeg_C "P-Regler neg. Grossignalverstaerkung" VALUE 0x1C9594 Kw_Wu32 6553599.99847 Kp_Vel2Nm 0.00 6553599.99847 FORMAT "%13.5" /end CHARACTERISTIC
/begin CHARACTERISTIC CrCtl_ResPWinPos_C "P-Regler pos. Kleinsignalgrenze" VALUE 0x1C9598 Kw_Ws16 655.3500 Vel -327.6800 327.6700 FORMAT "%8.4" /end CHARACTERISTIC
/begin CHARACTERISTIC CrCtl_ResPWinNeg_C "P-Regler neg. Kleinsignalgrenze" VALUE 0x1C959A Kw_Ws16 655.3500 Vel -327.6800 327.6700 FORMAT "%8.4" /end CHARACTERISTIC
/begin CHARACTERISTIC CrCtl_rFltMaxAlwP_C "Erlaubter gefilterter Wert des Fahrpedals" VALUE 0x1C925C Kw_Ws16 100.0000 Prc 0.00 100.0000 FORMAT "%8.4" EXTENDED_LIMITS -327.6800 327.6700 /end CHARACTERISTIC
/begin CHARACTERISTIC CrCtl_rSlpRes_MAP "Fahwiderstandsindex für Korrektur" MAP 0x1C959C Kf_Xs16_Ys16_Ws16 65.53500 PrcHigh -32.76800 32.76700 FORMAT "%8.5"
 /begin AXIS_DESCR STD_AXIS VSSCD_a Acc 8 -32.76800 32.76700 FORMAT "%8.5" DEPOSIT ABSOLUTE /end AXIS_DESCR
 /begin AXIS_DESCR STD_AXIS CoEng_dvolFlConsumFlt FlConsum_l_h 8 -327.6800 327.6700 FORMAT "%8.4" DEPOSIT ABSOLUTE /end AXIS_DESCR
/end CHARACTERISTIC
/begin CHARACTERISTIC CrCtl_rVnBeg_Vector "Konfigurationslabel für Bypass" VALUE 0x1C0A4A Kw_Wu8 255.0 OneToOne 0.00 255.0 FORMAT "%5.1" /end CHARACTERISTIC
/begin CHARACTERISTIC CrCtl_rVnBeg_Channel "Konfigurationslabel für Bypass" VALUE 0x1C0A4B Kw_Wu8 255.0 OneToOne 0.00 255.0 FORMAT "%5.1" /end CHARACTERISTIC
/begin CHARACTERISTIC CrCtl_rVnDvtAbs_C "erlaubte v/n-Abweichung (akt. v/n-Verhaeltnis)" VALUE 0x1C9288 Kw_Ws16 0.6553500 VelToN -0.3276800 0.3276700 FORMAT "%9.7" /end CHARACTERISTIC
/begin CHARACTERISTIC CrCtl_rVnDvtShutOff_C "Abweichung v/n-Verhältnis Abschalten FGR" VALUE 0x1C928A Kw_Ws16 0.6553500 VelToN -0.3276800 0.3276700 FORMAT "%9.7" /end CHARACTERISTIC
/begin CHARACTERISTIC CrCtl_stActive_Vector "Konfigurationslabel für Bypass" VALUE 0x1C0A4C Kw_Wu8 255.0 OneToOne 0.00 255.0 FORMAT "%5.1" /end CHARACTERISTIC
/begin CHARACTERISTIC CrCtl_stActive_Channel "Meßpunkt für Bypass" VALUE 0x1C0A4D Kw_Wu8 255.0 OneToOne 0.00 255.0 FORMAT "%5.1" /end CHARACTERISTIC
/begin CHARACTERISTIC CrCtl_stBlocking_Vector "Konfigurationslabel für Bypass" VALUE 0x1C0A48 Kw_Wu8 255.0 OneToOne 0.00 255.0 FORMAT "%5.1" /end CHARACTERISTIC
/begin CHARACTERISTIC CrCtl_stBlocking_Channel "Konfigurationslabel für Bypass" VALUE 0x1C0A49 Kw_Wu8 255.0 OneToOne 0.00 255.0 FORMAT "%5.1" /end CHARACTERISTIC
/begin CHARACTERISTIC CrCtl_stIRevCutOff_C "irreversible Abschaltungen ohne Rampe" VALUE 0x1C9640 Kw_Wu8 255.0 OneToOne 0.00 255.0 FORMAT "%5.1" /end CHARACTERISTIC
/begin CHARACTERISTIC CrCtl_stIRevRampOne_C "irreversible Abschaltungen mit zeitkonstanter Rampe" VALUE 0x1C9641 Kw_Wu8 255.0 OneToOne 0.00 255.0 FORMAT "%5.1" /end CHARACTERISTIC
/begin CHARACTERISTIC CrCtl_stIRevRampTwo_C "irreversible Abschaltungen mit steigungskonstanter Rampe" VALUE 0x1C9642 Kw_Wu8 255.0 OneToOne 0.00 255.0 FORMAT "%5.1" /end CHARACTERISTIC
/begin CHARACTERISTIC CrCtl_stKeyStateSig_Vector "Konfigurationslabel für Bypass" VALUE 0x1C0A4E Kw_Wu8 255.0 OneToOne 0.00 255.0 FORMAT "%5.1" /end CHARACTERISTIC
/begin CHARACTERISTIC CrCtl_stKeyStateSig_Channel "Konfigurationslabel für Bypass" VALUE 0x1C0A4F Kw_Wu8 255.0 OneToOne 0.00 255.0 FORMAT "%5.1" /end CHARACTERISTIC
/begin CHARACTERISTIC CrCtl_stOpFunc_Vector "Konfigurationslabel für Bypass" VALUE 0x1C0A50 Kw_Wu8 255.0 OneToOne 0.00 255.0 FORMAT "%5.1" /end CHARACTERISTIC
/begin CHARACTERISTIC CrCtl_stOpFunc_Channel "Konfigurationslabel für Bypass" VALUE 0x1C0A51 Kw_Wu8 255.0 OneToOne 0.00 255.0 FORMAT "%5.1" /end CHARACTERISTIC
/begin CHARACTERISTIC CrCtl_stPanelErr_C "Maske für Meldung des BT-Fehlerstatus" VALUE 0x1C928C Kw_Wu8 1.000 OneToOne 0.00 1.000 FORMAT "%5.3" EXTENDED_LIMITS 0.00 255.0 /end CHARACTERISTIC
/begin CHARACTERISTIC CrCtl_stPanErrHdlActv_C "Bitmaske für die Aktivierung der Fehlerbehandlung bei Plausibilitätsfehler Bedienteil (abgebildet in FrmMng_stPlsPanErr)" VALUE 0x1C928E Kw_Wu16 65535.00 OneToOne 0.00 65535.00 FORMAT "%8.2" /end CHARACTERISTIC
/begin CHARACTERISTIC CrCtl_stRevCutOff_C "reversible Abschaltungen ohne Rampe" VALUE 0x1C9644 Kw_Wu32 4294967295.00 OneToOne 0.00 4294967295.00 FORMAT "%13.2" /end CHARACTERISTIC
/begin CHARACTERISTIC CrCtl_stRevRampOne_C "reversible Abschaltungen mit zeitkonstanter Rampe" VALUE 0x1C9648 Kw_Wu32 4294967295.00 OneToOne 0.00 4294967295.00 FORMAT "%13.2" /end CHARACTERISTIC
/begin CHARACTERISTIC CrCtl_stRevRampTwo_C "reversible Abschaltungen mit steigungskonstanter Rampe" VALUE 0x1C964C Kw_Wu32 4294967295.00 OneToOne 0.00 4294967295.00 FORMAT "%13.2" /end CHARACTERISTIC
/begin CHARACTERISTIC CrCtl_stRevShutOff_C "Applikationsmaske für Aktivierung der reversiblen Abschaltbedingung" VALUE 0x1C9290 Kw_Wu32 4294967295.00 OneToOne 0.00 4294967295.00 FORMAT "%13.2" /end CHARACTERISTIC
/begin CHARACTERISTIC CrCtl_stStateMchSub_Vector "Konfigurationslabel für Bypass" VALUE 0x1C0A52 Kw_Wu8 255.0 OneToOne 0.00 255.0 FORMAT "%5.1" /end CHARACTERISTIC
/begin CHARACTERISTIC CrCtl_stStateMchSub_Channel "Konfigurationslabel für Bypass" VALUE 0x1C0A53 Kw_Wu8 255.0 OneToOne 0.00 255.0 FORMAT "%5.1" /end CHARACTERISTIC
/begin CHARACTERISTIC CrCtl_stStateMch_Vector "Konfigurationslabel für Bypass" VALUE 0x1C0A54 Kw_Wu8 255.0 OneToOne 0.00 255.0 FORMAT "%5.1" /end CHARACTERISTIC
/begin CHARACTERISTIC CrCtl_stStateMch_Channel "Konfigurationslabel für Bypass" VALUE 0x1C0A55 Kw_Wu8 255.0 OneToOne 0.00 255.0 FORMAT "%5.1" /end CHARACTERISTIC
/begin CHARACTERISTIC CrCtl_stSwitchSig_Vector "Konfigurationslabel für Bypass" VALUE 0x1C0A56 Kw_Wu8 255.0 OneToOne 0.00 255.0 FORMAT "%5.1" /end CHARACTERISTIC
/begin CHARACTERISTIC CrCtl_stSwitchSig_Channel "Konfigurationslabel für Bypass" VALUE 0x1C0A57 Kw_Wu8 255.0 OneToOne 0.00 255.0 FORMAT "%5.1" /end CHARACTERISTIC
/begin CHARACTERISTIC CrCtl_swtAAGVal_C "Wert des Switchs für  das Anhänger SG" VALUE 0x1C925E Kw_Wu8 1.000 OneToOne 0.00 1.000 FORMAT "%5.3" EXTENDED_LIMITS 0.00 255.0 /end CHARACTERISTIC
/begin CHARACTERISTIC CrCtl_swtAAGType_C "Switch Typ für das Anhänger-SG" VALUE 0x1C925F Kw_Wu8 1.000 OneToOne 1.000 2.000 FORMAT "%5.3" EXTENDED_LIMITS 0.00 255.0 /end CHARACTERISTIC
/begin CHARACTERISTIC CrCtl_swtResSlpSrc_C "Schalter um den Fahrwiderstandsindex über Getriebe 1 Botschaft zu erhalten" VALUE 0x1C9650 Kw_Wu8 255.0 OneToOne 0.00 255.0 FORMAT "%5.1" /end CHARACTERISTIC
/begin CHARACTERISTIC CrCtl_tiBABShutOff_C "Entprellzeit für Abschaltung ABS" VALUE 0x1C9294 Kw_Wu16 655350.0 Time_ms 0.00 655350.0 FORMAT "%8.1" /end CHARACTERISTIC
/begin CHARACTERISTIC CrCtl_tiBattShutOff_C "Timer für Abschaltung wg. Batterieunterspannung" VALUE 0x1C9296 Kw_Wu16 655350.0 Time_ms 0.00 655350.0 FORMAT "%8.1" /end CHARACTERISTIC
/begin CHARACTERISTIC CrCtl_tiDCSShutOff_C "Entprellzeit bis Abschaltanforderung DCS-Eingriff" VALUE 0x1C9298 Kw_Wu16 655350.0 Time_ms 0.00 655350.0 FORMAT "%8.1" /end CHARACTERISTIC
/begin CHARACTERISTIC CrCtl_tiDecDelayP_C "Zeit, den Verzögerungswert in DEC+ auf 0 zu rampen" VALUE 0x1C9260 Kw_Wu16 327670.0 Time_ms 0.00 327670.0 FORMAT "%8.1" EXTENDED_LIMITS 0.00 655350.0 /end CHARACTERISTIC
/begin CHARACTERISTIC CrCtl_tiDecShutOff_C "Maximalzeit fuer zu hohe Verzoegerung" VALUE 0x1C929A Kw_Wu16 655350.0 Time_ms 0.00 655350.0 FORMAT "%8.1" /end CHARACTERISTIC
/begin CHARACTERISTIC CrCtl_tiDevShutOff_C "Maximalzeit fuer unerlaubte Abweichung der Geschwindigkeit" VALUE 0x1C929C Kw_Wu32 42949672.9500 Time_s 0.00 42949672.9500 FORMAT "%13.4" /end CHARACTERISTIC
/begin CHARACTERISTIC CrCtl_tiEDSShutOff_C "Entprellzeit für Abschaltung Cruise Control EDS" VALUE 0x1C92A0 Kw_Wu16 655350.0 Time_ms 0.00 655350.0 FORMAT "%8.1" /end CHARACTERISTIC
/begin CHARACTERISTIC CrCtl_tiEPBAct_C "Entprellzeit für Abschaltung EPB" VALUE 0x1C92A2 Kw_Wu16 655350.0 Time_ms 0.00 655350.0 FORMAT "%8.1" /end CHARACTERISTIC
/begin CHARACTERISTIC CrCtl_tiFDRShutOff_C "Entprellzeit für Abschaltung Cruise Control FDR" VALUE 0x1C92A4 Kw_Wu16 655350.0 Time_ms 0.00 655350.0 FORMAT "%8.1" /end CHARACTERISTIC
/begin CHARACTERISTIC CrCtl_tiHoldDiffMax_C "Zeit für das Wechseln vom Zustand Hold in Resume bei zu großer Regelabweichung" VALUE 0x1C9652 Kw_Ws16 327.6700 Time_s 0.00 327.6700 FORMAT "%8.4" EXTENDED_LIMITS -327.6800 327.6700 /end CHARACTERISTIC
/begin CHARACTERISTIC CrCtl_tiMainSwitchOff_C "Entprellzeit für Abschaltanforderung unplausible Hauptschaltersignale" VALUE 0x1C92A6 Kw_Wu16 655350.0 Time_ms 0.00 655350.0 FORMAT "%8.1" /end CHARACTERISTIC
/begin CHARACTERISTIC CrCtl_tiMsgTOTemp_C "Entprellzeit für Abschaltung vorläufiges Message TimeOut" VALUE 0x1C92A8 Kw_Wu16 655350.0 Time_ms 0.00 655350.0 FORMAT "%8.1" /end CHARACTERISTIC
/begin CHARACTERISTIC CrCtl_tiRmpDwnP_C "Zeit während der, den Verzögerungswert beim gedrückten Fahrgaspedal auf 0 gerampt wird" VALUE 0x1C9262 Kw_Wu16 327670.0 Time_ms 0.00 327670.0 FORMAT "%8.1" EXTENDED_LIMITS 0.00 655350.0 /end CHARACTERISTIC
/begin CHARACTERISTIC CrCtl_DebtiShutOffMaxDef_C "Anzahl unplausibler Signale bis zur Fehlererkennung dynamische Plausibilität für BRK8 message" VALUE 0x1C9264 Kw_Wu16 655350.0 Time_ms 0.00 655350.0 FORMAT "%8.1" /end CHARACTERISTIC
/begin CHARACTERISTIC CrCtl_DebtiShutOffMaxOk_C "Anzahl unplausibler Signale bis zur Heilungserkennung dynamische Plausibilität für BRK8 message" VALUE 0x1C9266 Kw_Wu16 655350.0 Time_ms 0.00 655350.0 FORMAT "%8.1" /end CHARACTERISTIC
/begin CHARACTERISTIC CrCtl_DebtiShutOffMinDef_C "Anzahl unplausibler Signale bis zur Fehlererkennung dynamische Plausibilität für ESP-Systemstatus" VALUE 0x1C9268 Kw_Wu16 655350.0 Time_ms 0.00 655350.0 FORMAT "%8.1" /end CHARACTERISTIC
/begin CHARACTERISTIC CrCtl_DebtiShutOffMinOk_C "Anzahl unplausibler Signale bis zur Heilungserkennung dynamische Plausibilität für ESP-Systemstatus" VALUE 0x1C926A Kw_Wu16 655350.0 Time_ms 0.00 655350.0 FORMAT "%8.1" /end CHARACTERISTIC
/begin CHARACTERISTIC CrCtl_DebtiShutOffNplDef_C "Anzahl unplausibler Signale bis zur Fehlererkennung dynamische Plausibilität für Bremstemperatur-Fehler und Status Verzögerungsr" VALUE 0x1C926C Kw_Wu16 655350.0 Time_ms 0.00 655350.0 FORMAT "%8.1" /end CHARACTERISTIC
/begin CHARACTERISTIC CrCtl_DebtiShutOffNplOk_C "Anzahl unplausibler Signale bis zur Heilungserkennung dynamische Plausibilität für Bremstemperatur-Fehler und Status Verzögerung" VALUE 0x1C926E Kw_Wu16 655350.0 Time_ms 0.00 655350.0 FORMAT "%8.1" /end CHARACTERISTIC
/begin CHARACTERISTIC CrCtl_tiTCSShutOff_C "Entprellzeit bis Abschaltanforderung TCS" VALUE 0x1C92AA Kw_Wu16 655350.0 Time_ms 0.00 655350.0 FORMAT "%8.1" /end CHARACTERISTIC
/begin CHARACTERISTIC CrCtl_tmrDecDelayP_C "Zeitverzögerung beim Rampenstart bei Dec+" VALUE 0x1C9270 Kw_Wu16 655350.0 Time_ms 0.00 655350.0 FORMAT "%8.1" /end CHARACTERISTIC
/begin CHARACTERISTIC CrCtl_tmrOffRab_C "Abschaltdauer der zeitkonstanten Rampe" VALUE 0x1C9654 Kw_Wu16 327.6700 Time_s 0.00 327.6700 FORMAT "%8.4" EXTENDED_LIMITS 0.00 655.3500 /end CHARACTERISTIC
/begin CHARACTERISTIC CrCtl_tmrOffSra_C "Abschaltdauer für Rampe 2" VALUE 0x1C9656 Kw_Wu16 327.6700 Time_s 0.00 327.6700 FORMAT "%8.4" EXTENDED_LIMITS 0.00 655.3500 /end CHARACTERISTIC
/begin CHARACTERISTIC CrCtl_trqDes_Vector "Bypass label, nicht editieren!" VALUE 0x1C0A58 Kw_Wu8 255.0 OneToOne 0.00 255.0 FORMAT "%5.1" /end CHARACTERISTIC
/begin CHARACTERISTIC CrCtl_trqDes_Channel "Bypass label, nicht editieren!" VALUE 0x1C0A59 Kw_Wu8 255.0 OneToOne 0.00 255.0 FORMAT "%5.1" /end CHARACTERISTIC
/begin CHARACTERISTIC CrCtl_trqEnpMmp_C "Momentenschwelle fuer Reduktionsfaktorauswahl" VALUE 0x1C9658 Kw_Wu16 65535.00 TrqPrp 0.00 65535.00 FORMAT "%8.2" /end CHARACTERISTIC
/begin CHARACTERISTIC CrCtl_trqLead_Vector "Bypass label, nicht editieren!" VALUE 0x1C0A5A Kw_Wu8 255.0 OneToOne 0.00 255.0 FORMAT "%5.1" /end CHARACTERISTIC
/begin CHARACTERISTIC CrCtl_trqLead_Channel "Bypass label, nicht editieren!" VALUE 0x1C0A5B Kw_Wu8 255.0 OneToOne 0.00 255.0 FORMAT "%5.1" /end CHARACTERISTIC
/begin CHARACTERISTIC CrCtl_trqLimAct_Vector "Konfigurationslabel für Bypass" VALUE 0x1C0A5C Kw_Wu8 255.0 OneToOne 0.00 255.0 FORMAT "%5.1" /end CHARACTERISTIC
/begin CHARACTERISTIC CrCtl_trqLimAct_Channel "Konfigurationslabel für Bypass" VALUE 0x1C0A5D Kw_Wu8 255.0 OneToOne 0.00 255.0 FORMAT "%5.1" /end CHARACTERISTIC
/begin CHARACTERISTIC CrCtl_trqMax_C "Abschaltschwelle für maximales CrCtl-Wunschmoment" VALUE 0x1C92AC Kw_Ws16 32767.00 TrqPrp 0.00 32767.00 FORMAT "%8.2" EXTENDED_LIMITS -32768.00 32767.00 /end CHARACTERISTIC
/begin CHARACTERISTIC CrCtl_trqMinAlwP_C "Momentenschwelle im Bereich ""befeuerter Schub""" VALUE 0x1C9272 Kw_Ws16 32768.00 TrqPrp -32768.00 0.00 FORMAT "%8.2" EXTENDED_LIMITS -32768.00 32767.00 /end CHARACTERISTIC
/begin CHARACTERISTIC CrCtl_trqSetPreCtl_MAP "Kennfeld Initialisierungsmoment Hold" MAP 0x1C965A Kf_Xs16_Ys16_Ws16 65535.00 TrqPrp -32768.00 32767.00 FORMAT "%8.2"
 /begin AXIS_DESCR STD_AXIS VSSCD_v Vel 8 -327.6800 327.6700 FORMAT "%8.4" DEPOSIT ABSOLUTE /end AXIS_DESCR
 /begin AXIS_DESCR STD_AXIS DrvTrn_rTransDT TransR 8 -327.6800 327.6700 FORMAT "%8.4" DEPOSIT ABSOLUTE /end AXIS_DESCR
/end CHARACTERISTIC
/begin CHARACTERISTIC CrCtl_uShutOff_C "Batteriespannungsschwelle fuer Abschaltung" VALUE 0x1C92AE Kw_Ws16 100009.6 Volt_Batt 0.00 100009.6 FORMAT "%8.1" EXTENDED_LIMITS -665674.1 665653.8 /end CHARACTERISTIC
/begin CHARACTERISTIC CrCtl_vALLIAV_C "v-Schwelle fuer Beenden OVERRIDE-modus" VALUE 0x1C96FE Kw_Ws16 327.6700 Vel 0.00 327.6700 FORMAT "%8.4" EXTENDED_LIMITS -327.6800 327.6700 /end CHARACTERISTIC
/begin CHARACTERISTIC CrCtl_vAlwDvtThresP_C "Schwelle für zuläßige Abweichung der Fahrzeuggeschwindigkeit bei CrCtl_Plus" VALUE 0x1C9274 Kw_Ws16 10.00000 Vel 0.00 10.00000 FORMAT "%8.5" EXTENDED_LIMITS -327.6800 327.6700 /end CHARACTERISTIC
/begin CHARACTERISTIC CrCtl_vAlwMaxP_C "Maximal zulässige Geschwindigkeit unter der das ESP-ECU-Verhalten richtig ist" VALUE 0x1C9276 Kw_Ws16 300.0000 Vel 0.00 300.0000 FORMAT "%8.4" EXTENDED_LIMITS -327.6800 327.6700 /end CHARACTERISTIC
/begin CHARACTERISTIC CrCtl_vAlwMax_C "Obere Geschwindigkeitsgrenze Aktivierung FGR" VALUE 0x1C92B0 Kw_Ws16 327.6700 Vel 0.00 327.6700 FORMAT "%8.4" EXTENDED_LIMITS -327.6800 327.6700 /end CHARACTERISTIC
/begin CHARACTERISTIC CrCtl_vAlwMinAus_C "min. Geschwindigkeit für Abschaltung der CrCtl" VALUE 0x1C92B2 Kw_Ws16 327.6700 Vel 0.00 327.6700 FORMAT "%8.4" EXTENDED_LIMITS -327.6800 327.6700 /end CHARACTERISTIC
/begin CHARACTERISTIC CrCtl_vAlwOffSet_C "Ein applizierbarer Offset zur Berechnung der Sollgeschwindigkeit im Zustand RESABV" VALUE 0x1C9700 Kw_Ws16 655.3500 Vel -327.6800 327.6700 FORMAT "%8.4" /end CHARACTERISTIC
/begin CHARACTERISTIC CrCtl_vDevShutOff_C "zulaessige Abweichung der Geschwindigkeit" VALUE 0x1C92B4 Kw_Ws16 327.6700 Vel 0.00 327.6700 FORMAT "%8.4" EXTENDED_LIMITS -327.6800 327.6700 /end CHARACTERISTIC
/begin CHARACTERISTIC CrCtl_vEnmAvd_C "max. Regelabweichung fuer Uebergang Halten" VALUE 0x1C9702 Kw_Ws16 200.0000 Vel 0.00 200.0000 FORMAT "%8.4" EXTENDED_LIMITS -327.6800 327.6700 /end CHARACTERISTIC
/begin CHARACTERISTIC CrCtl_vEnpAvd_C "max. Regelabweichung fuer Uebergang Halten" VALUE 0x1C9704 Kw_Ws16 200.0000 Vel 0.00 200.0000 FORMAT "%8.4" EXTENDED_LIMITS -327.6800 327.6700 /end CHARACTERISTIC
/begin CHARACTERISTIC CrCtl_vFabVdg_C "erlaubte positive Regelabweichung" VALUE 0x1C92B6 Kw_Ws16 327.6700 Vel 0.00 327.6700 FORMAT "%8.4" EXTENDED_LIMITS -327.6800 327.6700 /end CHARACTERISTIC
/begin CHARACTERISTIC CrCtl_vFabVdk_C "erlaubte negative Regelabweichung" VALUE 0x1C92B8 Kw_Ws16 10.00000 Vel 0.00 10.00000 FORMAT "%8.5" EXTENDED_LIMITS -327.6800 327.6700 /end CHARACTERISTIC
/begin CHARACTERISTIC CrCtl_vHoldDiffMax_C "Zulässige Regelabweichung im Zustand Hold SubGovern" VALUE 0x1C9706 Kw_Ws16 327.6700 Vel 0.00 327.6700 FORMAT "%8.4" EXTENDED_LIMITS -327.6800 327.6700 /end CHARACTERISTIC
/begin CHARACTERISTIC CrCtl_vMindelta_C "Offset auf min. Geschwindigkeit für kleinste Zielgeschwindigkeit" VALUE 0x1C92BA Kw_Ws16 327.6700 Vel 0.00 327.6700 FORMAT "%8.4" EXTENDED_LIMITS -327.6800 327.6700 /end CHARACTERISTIC
/begin CHARACTERISTIC CrCtl_vSetPointTrgtdAWD_C "Differenzwert für GRA-Zielwert bei aktiver Höchstgeschwindigkeit durch AWD" VALUE 0x1C9708 Kw_Ws16 655.3500 Vel -327.6800 327.6700 FORMAT "%8.4" /end CHARACTERISTIC
/begin CHARACTERISTIC CrCtl_vSetPointTrgtdNIVEAU_C "Differenzwert für GRA-Zielwert bei aktiver Höchstgeschwindigkeit durch NIVEAU1" VALUE 0x1C970A Kw_Ws16 655.3500 Vel -327.6800 327.6700 FORMAT "%8.4" /end CHARACTERISTIC
/begin CHARACTERISTIC CrCtl_vSetPointTrgt_Vector "Konfigurationslabel für Bypass" VALUE 0x1C0A5E Kw_Wu8 255.0 OneToOne 0.00 255.0 FORMAT "%5.1" /end CHARACTERISTIC
/begin CHARACTERISTIC CrCtl_vSetPointTrgt_Channel "Konfigurationslabel für Bypass" VALUE 0x1C0A5F Kw_Wu8 255.0 OneToOne 0.00 255.0 FORMAT "%5.1" /end CHARACTERISTIC
/begin CHARACTERISTIC CrCtl_vTipLimit_C "Limit fuer Tip Up/Down" VALUE 0x1C970C Kw_Ws16 655.3500 Vel -327.6800 327.6700 FORMAT "%8.4" READ_ONLY /end CHARACTERISTIC
/begin CHARACTERISTIC CrCtl_vTipStep_C "FGR TIP-UP/DOWN Geschwindigkeitsschritt" VALUE 0x1C970E Kw_Ws16 327.6700 Vel 0.00 327.6700 FORMAT "%8.4" EXTENDED_LIMITS -327.6800 327.6700 /end CHARACTERISTIC
/begin CHARACTERISTIC CrSCD_ctGapIncs_C "Kurbelwellenkonfiguration: Anzahl der fehlenden Inkremente in der Lücke (virtuelle Inkremente)" VALUE 0x1C0C82 Kw_Wu8 0.00 OneToOne 2.000 2.000 FORMAT "%5.3" EXTENDED_LIMITS 0.00 255.0 /end CHARACTERISTIC
/begin CHARACTERISTIC CrSCD_ctGaps_C "Kurbelwellenkonfiguration: Anzahl der Lücken auf dem Inkrementgeberrad" VALUE 0x1C0C83 Kw_Wu8 3.000 OneToOne 1.000 4.000 FORMAT "%5.3" EXTENDED_LIMITS 0.00 255.0 /end CHARACTERISTIC
/begin CHARACTERISTIC CrSCD_ctIncs_C "Kurbelwellenkonfiguration: Anzahl der Inkremente einschließlich virtueller Lückenzähne" VALUE 0x1C0C84 Kw_Wu8 110.0 OneToOne 10.00 120.0 FORMAT "%5.1" EXTENDED_LIMITS 0.00 255.0 /end CHARACTERISTIC
/begin CHARACTERISTIC CrSCD_ctThresCtlMin_C "Kleinste Schwelle der dyn. Schwellennachführung des Kurbelwellensignals" VALUE 0x1C0C7C Kw_Wu8 7.000 OneToOne 0.00 7.000 FORMAT "%5.3" EXTENDED_LIMITS 0.00 255.0 /end CHARACTERISTIC
/begin CHARACTERISTIC CrSCD_ctTurns_C "Anzahl der Kurbelwellenumdrehungen pro Nockenwellenumdrehung (1 = 2 Takter, 2 = 4 Takter)" VALUE 0x1C0C6A Kw_Wu8 1.000 OneToOne 1.000 2.000 FORMAT "%5.3" EXTENDED_LIMITS 0.00 255.0 /end CHARACTERISTIC
/begin CHARACTERISTIC CrSCD_facGapPlausHigh_CUR "Verhältnis zur Bestimmung der oberen Grenze des Fensters zur Lückenplausibilisierung des Inkrementsignals" CURVE 0x1C9742 Kl_Xs16_Ws16 3.000000 Fact_Inc 3.000000 6.000000 FORMAT "%8.6" EXTENDED_LIMITS -128.0000 127.9961
 /begin AXIS_DESCR STD_AXIS CrSCD_tiIncr TimeDT 10 100.0000 32767.00 FORMAT "%8.2" EXTENDED_LIMITS 0.00 65535.00 DEPOSIT ABSOLUTE /end AXIS_DESCR
/end CHARACTERISTIC
/begin CHARACTERISTIC CrSCD_facGapPlausLow_CUR "Verhältnis zur Bestimmung der unteren Grenze des Fensters zur Lückenplausibilisierung des Inkrementsignals" CURVE 0x1C976C Kl_Xs16_Ws16 3.000000 Fact_Inc 0.00 3.000000 FORMAT "%8.6" EXTENDED_LIMITS -128.0000 127.9961
 /begin AXIS_DESCR STD_AXIS CrSCD_tiIncr TimeDT 10 100.0000 32767.00 FORMAT "%8.2" EXTENDED_LIMITS 0.00 65535.00 DEPOSIT ABSOLUTE /end AXIS_DESCR
/end CHARACTERISTIC
/begin CHARACTERISTIC CrSCD_facIncPlausHigh_CUR "Verhältnis zur Bestimmung der obere Grenze des Fensters zur Plausibilisierung des Inkrementsignals" CURVE 0x1C9796 Kl_Xs16_Ws16 1.000000 Fact_Inc 1.000000 2.000000 FORMAT "%8.6" EXTENDED_LIMITS -128.0000 127.9961
 /begin AXIS_DESCR STD_AXIS CrSCD_tiIncr TimeDT 10 100.0000 32767.00 FORMAT "%8.2" EXTENDED_LIMITS 0.00 65535.00 DEPOSIT ABSOLUTE /end AXIS_DESCR
/end CHARACTERISTIC
/begin CHARACTERISTIC CrSCD_facIncPlausLow_CUR "Verhältnis zur Bestimmung der unteren Grenze des Fensters zur Plausibilisierung des Inkrementsignals" CURVE 0x1C97C0 Kl_Xs16_Ws16 1.000000 Fact_Inc 0.00 1.000000 FORMAT "%8.6" EXTENDED_LIMITS -128.0000 127.9961
 /begin AXIS_DESCR STD_AXIS CrSCD_tiIncr TimeDT 10 100.0000 32767.00 FORMAT "%8.2" EXTENDED_LIMITS 0.00 65535.00 DEPOSIT ABSOLUTE /end AXIS_DESCR
/end CHARACTERISTIC
/begin CHARACTERISTIC CrSCD_nFast_C "Frequenz für das winkelsynchrone Interruptsystem, wenn kein Inkrementsignal vorhanden" VALUE 0x1C0C6C Kw_Ws16 8000.000 EngN 0.00 8000.000 FORMAT "%8.3" EXTENDED_LIMITS -32768.00 32767.00 /end CHARACTERISTIC
/begin CHARACTERISTIC CrSCD_nMax_C "Größte zulässige Frequenz des Inkrementsignals" VALUE 0x1C0C6E Kw_Ws16 2000.000 EngN 5000.000 7000.000 FORMAT "%8.3" EXTENDED_LIMITS -32768.00 32767.00 /end CHARACTERISTIC
/begin CHARACTERISTIC CrSCD_nMin_C "Kleinste zulässige Frequenz des Inkrementsignals" VALUE 0x1C0C70 Kw_Ws16 480.0000 EngN 20.00000 500.0000 FORMAT "%8.4" EXTENDED_LIMITS -32768.00 32767.00 /end CHARACTERISTIC
/begin CHARACTERISTIC CrSCD_nSlowHigh_C "Obere Drehzahlschwelle ab der das Slow-Bit für die Diahnose zurückgesetzt wird" VALUE 0x1C0C72 Kw_Ws16 3000.000 EngN 0.00 3000.000 FORMAT "%8.3" EXTENDED_LIMITS -32768.00 32767.00 /end CHARACTERISTIC
/begin CHARACTERISTIC CrSCD_nSlow_C "Schwelle ab der Unterdrehzahl gemeldet wird" VALUE 0x1C0C74 Kw_Ws16 1000.000 EngN 0.00 1000.000 FORMAT "%8.3" EXTENDED_LIMITS -32768.00 32767.00 /end CHARACTERISTIC
/begin CHARACTERISTIC CrSCD_nThresCtlHigh_C "Obere Schwelle zur Aktiviereung der dyn. Schwellennachführung" VALUE 0x1C0C7E Kw_Ws16 65535.00 EngN -32768.00 32767.00 FORMAT "%8.2" /end CHARACTERISTIC
/begin CHARACTERISTIC CrSCD_nThresCtlLow_C "Untere Schwelle zur Aktivierung der dyn. Schwellennachführung" VALUE 0x1C0C80 Kw_Ws16 65535.00 EngN -32768.00 32767.00 FORMAT "%8.2" /end CHARACTERISTIC
/begin CHARACTERISTIC CrSCD_numFBCSeg_C "Anzahl der FBC segmente" VALUE 0x1C0C85 Kw_Wu8 7.000 OneToOne 1.000 8.000 FORMAT "%5.3" EXTENDED_LIMITS 0.00 255.0 /end CHARACTERISTIC
/begin CHARACTERISTIC CrSCD_numShftMisf_C "Phasenverschiebung Segmentsystem für Aussetzererkennung (in MAR-Segmenten)" VALUE 0x1C0C76 Kw_Wu8 1.000 OneToOne 0.00 1.000 FORMAT "%5.3" EXTENDED_LIMITS 0.00 255.0 /end CHARACTERISTIC
/begin CHARACTERISTIC CrSCD_numTDCSeg_C "Anzahl der Segment pro OT" VALUE 0x1C0C86 Kw_Wu8 0.00 OneToOne 2.000 2.000 FORMAT "%5.3" EXTENDED_LIMITS 0.00 255.0 READ_ONLY /end CHARACTERISTIC
/begin CHARACTERISTIC CrSCD_phiGap2Zero_C "Winkel zwischen Lücke und physikalischer Nullposition" VALUE 0x1C0C88 Kw_Ws16 720.0000 AngleCrS 0.00 720.0000 FORMAT "%8.4" EXTENDED_LIMITS -768.0000 767.9766 /end CHARACTERISTIC
/begin CHARACTERISTIC CrSCD_phiIncCor_CUR "Phasenkorrekturkennlinie des Inkrementsystems der Kurbelwelle" CURVE 0x1C9710 Kl_Xs16_Ws16 50.01562 AngleCrS -25.00781 25.00781 FORMAT "%8.5" EXTENDED_LIMITS -768.0000 767.9766
 /begin AXIS_DESCR STD_AXIS CrSCD_nAvrg EngN 12 0.00 6000.000 FORMAT "%8.3" EXTENDED_LIMITS -32768.00 32767.00 DEPOSIT ABSOLUTE /end AXIS_DESCR
/end CHARACTERISTIC
/begin CHARACTERISTIC CrSCD_phiSegLength_C "Kurbelwellenkonfiguration: Segementlänge" VALUE 0x1C0C78 Kw_Ws16 90.00000 AngleCrS 30.00000 120.0000 FORMAT "%8.4" EXTENDED_LIMITS -768.0000 767.9766 /end CHARACTERISTIC
/begin CHARACTERISTIC CrSCD_phiSegPhase_C "Phasenlage der Drehzahlsegmente zum OT" VALUE 0x1C0C7A Kw_Ws16 720.0000 AngleCrS 0.00 720.0000 FORMAT "%8.4" EXTENDED_LIMITS -768.0000 767.9766 /end CHARACTERISTIC
/begin CHARACTERISTIC CrSCD_tiPlausCalcOff_C "Schwelle zum Abschalten der Berechnung der Plausibilitätsfenster" VALUE 0x1C0C8A Kw_Ws16 32767.00 TimeDT 0.00 32767.00 FORMAT "%8.2" EXTENDED_LIMITS -32768.00 32767.00 /end CHARACTERISTIC
/begin CHARACTERISTIC CrS_ctMaxInjStrt_C "Maximale Anzahl von Testeinspritzungen" VALUE 0x1C0C54 Kw_Wu16 100.0000 OneToOne 0.00 100.0000 FORMAT "%8.4" EXTENDED_LIMITS 0.00 65535.00 /end CHARACTERISTIC
/begin CHARACTERISTIC CrS_facSegTimeMax_C "Maximales Verhältnis der Segmentzeiten, das eine konstante Motordrehzahl signalisiert" VALUE 0x1C0C58 Kw_Ws32 100.000000000 Fact1 0.00 100.000000000 FORMAT "%13.9" EXTENDED_LIMITS -16777216.0000 16777215.9922 /end CHARACTERISTIC
/begin CHARACTERISTIC CrS_facSegTimeMin_C "Minimales Verhältnis der Segmentzeiten, das eine konstante Motordrehzahl signalisiert" VALUE 0x1C0C5C Kw_Ws32 100.000000000 Fact1 0.00 100.000000000 FORMAT "%13.9" EXTENDED_LIMITS -16777216.0000 16777215.9922 /end CHARACTERISTIC
/begin CHARACTERISTIC CrS_facSegTime_C "Verhältnis der Segmentzeiten" VALUE 0x1C0C60 Kw_Ws32 99.0000000000 Fact1 1.00000000000 100.000000000 FORMAT "%13.9" EXTENDED_LIMITS -16777216.0000 16777215.9922 /end CHARACTERISTIC
/begin CHARACTERISTIC CrS_phiSegLengthStrtSpd_C "Segmentlänge, die berechnet werden soll" VALUE 0x1C0C64 Kw_Ws16 180.0000 AngleCrS 0.00 180.0000 FORMAT "%8.4" EXTENDED_LIMITS -768.0000 767.9766 /end CHARACTERISTIC
/begin CHARACTERISTIC CrS_phiSegOfsStrtSpdOld_C "Segment Offset des alten Segmentes bezüglich TDC" VALUE 0x1C0C66 Kw_Ws16 1440.000 AngleCrS -720.0000 720.0000 FORMAT "%8.4" EXTENDED_LIMITS -768.0000 767.9766 /end CHARACTERISTIC
/begin CHARACTERISTIC CrS_phiSegOfsStrtSpd_C "Segment Offset des aktuellen Segmentes bezüglich TDC" VALUE 0x1C0C68 Kw_Ws16 1440.000 AngleCrS -720.0000 720.0000 FORMAT "%8.4" EXTENDED_LIMITS -768.0000 767.9766 /end CHARACTERISTIC
/begin CHARACTERISTIC CtApCD_dcycMax_C "Vorgabewert im Status ""AFTERRUN"" der Kühlerlüftersteuerung" VALUE 0x1C97EA Kw_Ws16 100.0000 DtyCyc 0.00 100.0000 FORMAT "%8.4" EXTENDED_LIMITS -327.6800 327.6700 /end CHARACTERISTIC
/begin CHARACTERISTIC CtApCD_dcycMin_C "Vorgabewert im Status ""NORMALRUN"" der Kühlerlüftersteuerung" VALUE 0x1C97EC Kw_Ws16 100.0000 DtyCyc 0.00 100.0000 FORMAT "%8.4" EXTENDED_LIMITS -327.6800 327.6700 /end CHARACTERISTIC
/begin CHARACTERISTIC CtApCD_dcycShutOff_C "Vorgabewert im Status ""POSTAFTERRUN"" der Kühlerlüftersteuerung" VALUE 0x1C97EE Kw_Ws16 100.0000 DtyCyc 0.00 100.0000 FORMAT "%8.4" EXTENDED_LIMITS -327.6800 327.6700 /end CHARACTERISTIC
/begin CHARACTERISTIC CtApCD_DebExcTempDef_C "Fehlerentprellzeit für Übertemperatur" VALUE 0x1C97F0 Kw_Wu16 655350.0 Time_ms 0.00 655350.0 FORMAT "%8.1" /end CHARACTERISTIC
/begin CHARACTERISTIC CtApCD_DebExcTempOk_C "Heilungsentprellzeit für Übertemperatur" VALUE 0x1C97F2 Kw_Wu16 655350.0 Time_ms 0.00 655350.0 FORMAT "%8.1" /end CHARACTERISTIC
/begin CHARACTERISTIC CtApCD_DebNoLoadDef_C "Fehlerentprellzeit für Lastabfall" VALUE 0x1C97F4 Kw_Wu16 655350.0 Time_ms 0.00 655350.0 FORMAT "%8.1" /end CHARACTERISTIC
/begin CHARACTERISTIC CtApCD_DebNoLoadOk_C "Heilungsentprellzeit für Lastabfall" VALUE 0x1C97F6 Kw_Wu16 655350.0 Time_ms 0.00 655350.0 FORMAT "%8.1" /end CHARACTERISTIC
/begin CHARACTERISTIC CtApCD_DebShortCircBatDef_C "Fehlerentprellzeitzeit für Kurzschluß nach Batteriespannung" VALUE 0x1C97F8 Kw_Wu16 655350.0 Time_ms 0.00 655350.0 FORMAT "%8.1" /end CHARACTERISTIC
/begin CHARACTERISTIC CtApCD_DebShortCircBatOk_C "Heilungsentprellzeit für Kurzschluß nach Batteriespannung" VALUE 0x1C97FA Kw_Wu16 655350.0 Time_ms 0.00 655350.0 FORMAT "%8.1" /end CHARACTERISTIC
/begin CHARACTERISTIC CtApCD_DebShortCircGndDef_C "Fehlerentprellzeit für Kurzschluß nach Masse" VALUE 0x1C97FC Kw_Wu16 655350.0 Time_ms 0.00 655350.0 FORMAT "%8.1" /end CHARACTERISTIC
/begin CHARACTERISTIC CtApCD_DebShortCircGndOk_C "Heilungsentprellzeit für Kurzschluß nach Masse" VALUE 0x1C97FE Kw_Wu16 655350.0 Time_ms 0.00 655350.0 FORMAT "%8.1" /end CHARACTERISTIC
/begin CHARACTERISTIC CtApCD_stInvOut_C "Invertierung des Ausgangssignals" VALUE 0x1C9800 Kw_Wu8 1.000 OneToOne 0.00 1.000 FORMAT "%5.3" EXTENDED_LIMITS 0.00 255.0 /end CHARACTERISTIC
/begin CHARACTERISTIC CtApCD_tiPer_C "Periodendauer des Ausgangssignal der Kühlmitteltnachlaufpumpe" VALUE 0x1C9802 Kw_Ws16 21.10000 Period 1.100000 22.20000 FORMAT "%8.5" EXTENDED_LIMITS -3276.800 3276.700 /end CHARACTERISTIC
/begin CHARACTERISTIC CtApCD_rHWE_mp_Vector "Konfigurationslabel für Bypass message" VALUE 0x1C0A60 Kw_Wu8 255.0 OneToOne 0.00 255.0 FORMAT "%5.1" /end CHARACTERISTIC
/begin CHARACTERISTIC CtApCD_rHWE_mp_Channel "Konfigurationslabel für Bypass message" VALUE 0x1C0A61 Kw_Wu8 255.0 OneToOne 0.00 255.0 FORMAT "%5.1" /end CHARACTERISTIC
/begin CHARACTERISTIC CtApCD_rTst_C "Tastverhältnis, dass im Fehlerfall zyklisch ausgegeben wird" VALUE 0x1C9804 Kw_Ws16 100.0000 DtyCyc 0.00 100.0000 FORMAT "%8.4" EXTENDED_LIMITS -327.6800 327.6700 /end CHARACTERISTIC
/begin CHARACTERISTIC CtApCD_tAirXHi_C "oberer Schwellwert der Umgebungstemperaturhysterese" VALUE 0x1C9806 Kw_Ws16 250.0000 Temp_Cels -50.14000 199.8600 FORMAT "%8.4" EXTENDED_LIMITS -3549.940 3003.560 /end CHARACTERISTIC
/begin CHARACTERISTIC CtApCD_tAirXLo_C "untere Schwellwert der Umgebungstemperaturhystere" VALUE 0x1C9808 Kw_Ws16 250.0000 Temp_Cels -50.14000 199.8600 FORMAT "%8.4" EXTENDED_LIMITS -3549.940 3003.560 /end CHARACTERISTIC
/begin CHARACTERISTIC CtApCD_tClntCanXHi_C "oberer Schwelle der Hysterese für die Wassertemperatur über CAN" VALUE 0x1C980A Kw_Ws16 200.0000 Temp_Cels -50.14000 149.8600 FORMAT "%8.4" EXTENDED_LIMITS -3549.940 3003.560 /end CHARACTERISTIC
/begin CHARACTERISTIC CtApCD_tClntCanXLo_C "untere Schwelle der Hysterese für die Wassertemperatur über CAN" VALUE 0x1C980C Kw_Ws16 200.0000 Temp_Cels -50.14000 149.8600 FORMAT "%8.4" EXTENDED_LIMITS -3549.940 3003.560 /end CHARACTERISTIC
/begin CHARACTERISTIC CtApCD_tiBtwTst_C "Zeitabstand, in dem im Fehlerfall die Endstufe getestet wird" VALUE 0x1C980E Kw_Wu16 29900.00 Time_ms 100.0000 30000.00 FORMAT "%8.2" EXTENDED_LIMITS 0.00 655350.0 /end CHARACTERISTIC
/begin CHARACTERISTIC CtApCD_tiCtApcheckDfpTmr_C "Ansteuerdauer bei Abschaltung der Endstufe im Fehlerfall" VALUE 0x1C9810 Kw_Wu16 655350.0 Time_ms 0.00 655350.0 FORMAT "%8.1" /end CHARACTERISTIC
/begin CHARACTERISTIC CtApCD_tiCtApOFFTmr_C "Abschaltzeit der Endstufe im Fehlerfall" VALUE 0x1C9812 Kw_Wu16 655350.0 Time_ms 0.00 655350.0 FORMAT "%8.1" /end CHARACTERISTIC
/begin CHARACTERISTIC CtApCD_tiDelOn_C "Verzögerungszeit nach Startabwurf für CtApCD" VALUE 0x1C9814 Kw_Wu16 655350.0 Time_ms 0.00 655350.0 FORMAT "%8.1" /end CHARACTERISTIC
/begin MEASUREMENT CmbChb_ctEngRevLogBuf1_mp "Meßpunkt für die Anzahl bewerteten Motorumdrehungen der Kurbelwelle des Puffer1" UWORD OneToOne 1 100 0.00 65535.00 FORMAT "%8.2" ECU_ADDRESS 0x802240 /end MEASUREMENT
/begin MEASUREMENT CmbChb_ctEngRevLogBuf2_mp "Meßpunkt für die Anzahl bewerteten Motorumdrehungen der Kurbelwelle des Puffer2" UWORD OneToOne 1 100 0.00 65535.00 FORMAT "%8.2" ECU_ADDRESS 0x802242 /end MEASUREMENT
/begin MEASUREMENT CmbChb_ctEngRevLogMem_mp "Kurbelwellen-Umdrehungszähler" UWORD OneToOne 1 100 0.00 65535.00 FORMAT "%8.2" ECU_ADDRESS 0x802244 /end MEASUREMENT
/begin MEASUREMENT CmbChb_ctEngRevPerBlk_mp "Meßpunkt für die Anzahl der Blockgroesse für die bewerteten Motorumdrehungen der Kurbelwelle" UWORD OneToOne 1 100 0.00 65535.00 FORMAT "%8.2" ECU_ADDRESS 0x802246 /end MEASUREMENT
/begin MEASUREMENT CmbChb_dnSegMinPerCyl_mp "minimaler Drehzahlanstiege pro Zylinder" SWORD EngN 1 100 -32768.00 32767.00 FORMAT "%8.2" ECU_ADDRESS 0x802248 /end MEASUREMENT
/begin MEASUREMENT CmbChb_nSegEven_mp "Summe der Drehzahl fuer jede gerade Segmentnummer (von zwei Umdrehungen)" SWORD EngN 1 100 -32768.00 32767.00 FORMAT "%8.2" ECU_ADDRESS 0x80224A /end MEASUREMENT
/begin MEASUREMENT CmbChb_nSegOdd_mp "Summe der Drehzahl fuer jede ungerade Segmentnummer (von zwei Umdrehungen)" SWORD EngN 1 100 -32768.00 32767.00 FORMAT "%8.2" ECU_ADDRESS 0x80224C /end MEASUREMENT
/begin MEASUREMENT CoDT_Grip "Kraftschluß innerhalb Antrieb" UBYTE OneToOne 1 100 0.00 255.0 FORMAT "%5.1" ECU_ADDRESS 0x7F933F /end MEASUREMENT
/begin MEASUREMENT CoDT_nMax "Drehzahlforderung Maximalwert Triebstrangkoordinator" SWORD EngN 1 100 -32768.00 32767.00 FORMAT "%8.2" ECU_ADDRESS 0x7F9692 /end MEASUREMENT
/begin MEASUREMENT CoDT_nMin "Drehzahlforderung Minimalwert Triebstrangkoordinator" SWORD EngN 1 100 -32768.00 32767.00 FORMAT "%8.2" ECU_ADDRESS 0x7F9694 /end MEASUREMENT
/begin MEASUREMENT CoDT_stGripDeb "Zustand der Kraftschlußentprellung" UBYTE OneToOne 1 100 0.00 255.0 FORMAT "%5.1" ECU_ADDRESS 0x7F9340 /end MEASUREMENT
/begin MEASUREMENT CoDT_stOrd "Randbedingungen für physikalischen Auftrag" UBYTE OneToOne 1 100 0.00 255.0 FORMAT "%5.1" ECU_ADDRESS 0x7F9341 /end MEASUREMENT
/begin MEASUREMENT CoDT_stPrpOvrRun_mp "Schubfall erkannt (0: kein Schub)" UWORD OneToOne 1 100 0.00 65535.00 FORMAT "%8.2" ECU_ADDRESS 0x80225C /end MEASUREMENT
/begin MEASUREMENT CoDT_swtCoType "0: conventional; 1: mastershift" UBYTE OneToOne 1 100 0.00 255.0 FORMAT "%5.1" ECU_ADDRESS 0x7F9342 /end MEASUREMENT
/begin MEASUREMENT CoDT_trq "aktuelles Getriebeausgangsmoment" SWORD TrqPrp 1 100 -32768.00 32767.00 FORMAT "%8.2" ECU_ADDRESS 0x7F9696 /end MEASUREMENT
/begin MEASUREMENT CoDT_trqAcsMax_mp "maximales Nebenaggregatmoment" SWORD Trq 1 100 -3276.800 3276.700 FORMAT "%8.3" ECU_ADDRESS 0x80225E /end MEASUREMENT
/begin MEASUREMENT CoDT_trqAcsMin "minimaler Momentenbedarf der Nebenaggregate" SWORD Trq 1 100 -3276.800 3276.700 FORMAT "%8.3" ECU_ADDRESS 0x7F9698 /end MEASUREMENT
/begin MEASUREMENT CoDT_trqAcsRaw_mp "Zielwert Momentenbedarf der Nebenaggregate" SWORD Trq 1 100 -3276.800 3276.700 FORMAT "%8.3" ECU_ADDRESS 0x802260 /end MEASUREMENT
/begin MEASUREMENT CoDT_trqAcs_mp "ungefilterter Momentenbedarf der Nebenaggregate" SWORD Trq 1 100 -3276.800 3276.700 FORMAT "%8.3" ECU_ADDRESS 0x802262 /end MEASUREMENT
/begin MEASUREMENT CoDT_trqActAcs_mp "aktuelle Momentenanforderung der Nebenaggregate" SWORD Trq 1 100 -3276.800 3276.700 FORMAT "%8.3" ECU_ADDRESS 0x80225A /end MEASUREMENT
/begin MEASUREMENT CoDT_trqCurr "Momentenanforderung Triebstrang Vorhaltewert" SWORD Trq 1 100 -3276.800 3276.700 FORMAT "%8.3" ECU_ADDRESS 0x7F969A /end MEASUREMENT
/begin MEASUREMENT CoDT_trqDes "Momentenanforderung Triebstrangkoordinator Wunschwert" SWORD Trq 1 100 -3276.800 3276.700 FORMAT "%8.3" ECU_ADDRESS 0x7F96A6 /end MEASUREMENT
/begin MEASUREMENT CoDT_trqDrv "Momentforderung Triebstangkoordinator ohne ext. Eingriffe" SWORD Trq 1 100 -3276.800 3276.700 FORMAT "%8.3" ECU_ADDRESS 0x7F96A8 /end MEASUREMENT
/begin MEASUREMENT CoDT_trqDTInCurr "Momentenanforderung Vorhalt Triebstrangkoordinator (Kupplungseingang) (curr-Pfad)" SWORD Trq 1 100 -3276.800 3276.700 FORMAT "%8.3" ECU_ADDRESS 0x7F969C /end MEASUREMENT
/begin MEASUREMENT CoDT_trqDTInDecCurr_mp "Momentenanforderung Triebstrang nach Reduzierenden Getriebeeingriffen Vorhaltewert (Curr Pfad)" SWORD Trq 1 100 -3276.800 3276.700 FORMAT "%8.3" ECU_ADDRESS 0x80224E /end MEASUREMENT
/begin MEASUREMENT CoDT_trqDTInDecLead_mp "Momentenanforderung Triebstrang nach reduzierenden Getriebeeingriffen" SWORD Trq 1 100 -3276.800 3276.700 FORMAT "%8.3" ECU_ADDRESS 0x802250 /end MEASUREMENT
/begin MEASUREMENT CoDT_trqDTInDes "Momentenanforderung Triebstrang (Kupplungseingang) Wunschwert" SWORD Trq 1 100 -3276.800 3276.700 FORMAT "%8.3" ECU_ADDRESS 0x7F969E /end MEASUREMENT
/begin MEASUREMENT CoDT_trqDTInDrv "Sollwert Triebstrangmoment (Kupplungseingang) ohne ext. Eingriffe" SWORD Trq 1 100 -3276.800 3276.700 FORMAT "%8.3" ECU_ADDRESS 0x7F96A0 /end MEASUREMENT
/begin MEASUREMENT CoDT_trqDTInLead "Momentenanforderung Triebstrang (Kupplungseingang) Vorhaltewert" SWORD Trq 1 100 -3276.800 3276.700 FORMAT "%8.3" ECU_ADDRESS 0x7F96A2 /end MEASUREMENT
/begin MEASUREMENT CoDT_trqDTInPCtl "Momentenanforderung Triebstrang (Kupplungseingang) ohne ext. Eingriffe" SWORD Trq 1 100 -3276.800 3276.700 FORMAT "%8.3" ECU_ADDRESS 0x7F96A4 /end MEASUREMENT
/begin MEASUREMENT CoDT_trqDTInwoiCurr_mp "Antrieb-Zug gab Drehmoment Ein, ohne über Getriebe-Interventionen für Curr Pfad" SWORD Trq 1 100 -3276.800 3276.700 FORMAT "%8.3" ECU_ADDRESS 0x802252 /end MEASUREMENT
/begin MEASUREMENT CoDT_trqDTInwoiLead_mp "Antrieb-Zug gab Drehmoment Ein, ohne über Getriebe-Interventionen für Lead Pfad" SWORD Trq 1 100 -3276.800 3276.700 FORMAT "%8.3" ECU_ADDRESS 0x802254 /end MEASUREMENT
/begin MEASUREMENT CoDT_trqGbx "aktuelles Eingangsmoment Getriebe" SWORD Trq 1 100 -3276.800 3276.700 FORMAT "%8.3" ECU_ADDRESS 0x7F96AA /end MEASUREMENT
/begin MEASUREMENT CoDT_trqGbxMax "maximales Getriebeeingangsmoment" SWORD Trq 1 100 -3276.800 3276.700 FORMAT "%8.3" ECU_ADDRESS 0x7F96AC /end MEASUREMENT
/begin MEASUREMENT CoDT_trqGbxMin "minimales Getriebeeingangsmoment" SWORD Trq 1 100 -3276.800 3276.700 FORMAT "%8.3" ECU_ADDRESS 0x7F96AE /end MEASUREMENT
/begin MEASUREMENT CoDT_trqGearbxDes "Getriebeeingangsmoment Fahrerwunsch" SWORD Trq 1 100 -3276.800 3276.700 FORMAT "%8.3" ECU_ADDRESS 0x7F96B0 /end MEASUREMENT
/begin MEASUREMENT CoDT_trqGearbxDrv "Fahrerwunsch Getriebeeingangsmoment ohne ext. Eingriffe" SWORD Trq 1 100 -3276.800 3276.700 FORMAT "%8.3" ECU_ADDRESS 0x7F96B2 /end MEASUREMENT
/begin MEASUREMENT CoDT_trqGearbxLead_mp "Getriebeeingangsmoment Vorhaltewert" SWORD Trq 1 100 -3276.800 3276.700 FORMAT "%8.3" ECU_ADDRESS 0x802256 /end MEASUREMENT
/begin MEASUREMENT CoDT_trqGearbxPCtl "Ungefilterter Fahrerwunsch Getriebeeingangsmoment ohne ext. Eingriffe" SWORD Trq 1 100 -3276.800 3276.700 FORMAT "%8.3" ECU_ADDRESS 0x7F96B4 /end MEASUREMENT
/begin MEASUREMENT CoDT_trqLead "Momentenanforderung Vorhaltewert" SWORD Trq 1 100 -3276.800 3276.700 FORMAT "%8.3" ECU_ADDRESS 0x7F96B6 /end MEASUREMENT
/begin MEASUREMENT CoDT_trqLeadDec_mp "Vorhalt Begrenzungsmoment Getriebe" SWORD Trq 1 100 -3276.800 3276.700 FORMAT "%8.3" ECU_ADDRESS 0x802258 /end MEASUREMENT
/begin MEASUREMENT CoDT_trqMax "maximal mögliches Antriebsmoment (Getriebeausgang)" SWORD TrqPrp 1 100 -32768.00 32767.00 FORMAT "%8.2" ECU_ADDRESS 0x7F96B8 /end MEASUREMENT
/begin MEASUREMENT CoDT_trqMin "minimal mögliches Antriebsmoment (Getriebeausgang)" SWORD TrqPrp 1 100 -32768.00 32767.00 FORMAT "%8.2" ECU_ADDRESS 0x7F96BA /end MEASUREMENT
/begin MEASUREMENT CoDT_trqMinInr "Minimal mögliches innerses Motorantriebsmoment" SWORD Trq 1 100 -3276.800 3276.700 FORMAT "%8.3" ECU_ADDRESS 0x7F96BC /end MEASUREMENT
/begin MEASUREMENT CoDT_trqPCtl "Ungefilterter Fahrerwunschmoment ohne ext. Eingriffe" SWORD Trq 1 100 -3276.800 3276.700 FORMAT "%8.3" ECU_ADDRESS 0x7F96BE /end MEASUREMENT
/begin MEASUREMENT CoDT_trqPlaus "Moment zur Plausibilisierung Master/Slave" SWORD Trq 1 100 -3276.800 3276.700 FORMAT "%8.3" ECU_ADDRESS 0x7F96C0 /end MEASUREMENT
/begin MEASUREMENT CoEng_CoordPrioALS_mp "Dynamische Priorität der Adaption Lambdasonde im Schubkoordinator" UWORD OneToOne 1 100 0.00 65535.00 FORMAT "%8.2" ECU_ADDRESS 0x802266 /end MEASUREMENT
/begin MEASUREMENT CoEng_CoordPrioFBC_mp "Dynamische Priorität der Mengenausgleichsregelung im Schubkoordinator" UWORD OneToOne 1 100 0.00 65535.00 FORMAT "%8.2" ECU_ADDRESS 0x802268 /end MEASUREMENT
/begin MEASUREMENT CoEng_CoordPrioTAA_mp "Dynamische Priorität des Inkrementwinkellernens im Schubkoordinator" UWORD OneToOne 1 100 0.00 65535.00 FORMAT "%8.2" ECU_ADDRESS 0x80226A /end MEASUREMENT
/begin MEASUREMENT CoEng_CoordPrioZFC_mp "Dynamische Priorität der Nullmengenkalibrierung im Schubkoordinator" UWORD OneToOne 1 100 0.00 65535.00 FORMAT "%8.2" ECU_ADDRESS 0x80226C /end MEASUREMENT
/begin MEASUREMENT CoEng_dvolFlConsAll "aktueller Verbrauch für Gesamteinspritzmenge in l/h" SWORD FlConsum_l_h 1 100 -327.6800 327.6700 FORMAT "%8.4" ECU_ADDRESS 0x7F96C2 /end MEASUREMENT
/begin MEASUREMENT CoEng_dvolFlConsAllTot "aktueller Gesamtkraftstoffverbrauch in l/h" SWORD FlConsum_l_h 1 100 -327.6800 327.6700 FORMAT "%8.4" ECU_ADDRESS 0x7F96C4 /end MEASUREMENT
/begin MEASUREMENT CoEng_dvolFlConsum "Kraftstoffverbrauch" SWORD FlConsum_l_h 1 100 -327.6800 327.6700 FORMAT "%8.4" ECU_ADDRESS 0x7F96C6 /end MEASUREMENT
/begin MEASUREMENT CoEng_dvolFlConsumFlt "mit DT1- und PT1-Regler gefilterter Kraftstoffverbrauch" SWORD FlConsum_l_h 1 100 -327.6800 327.6700 FORMAT "%8.4" ECU_ADDRESS 0x7F96C8 /end MEASUREMENT
/begin MEASUREMENT CoEng_dvolPerStroke_mp "Kraftstoffverbrauch in [mm^3/hub]" SWORD InjQnt 1 100 -3276.800 3276.700 FORMAT "%8.3" ECU_ADDRESS 0x80229C /end MEASUREMENT
/begin MEASUREMENT CoEng_facAdj "EEPROM Abgleichwert zur Korrektur des Begrenzungsmomentes" SWORD Fact 1 100 -4.000000 3.999878 FORMAT "%8.6" ECU_ADDRESS 0x7F96CA /end MEASUREMENT
/begin MEASUREMENT CoEng_facAdj_mp "EEPROM Abgleichswert zur Korrektur des Begrenzungsmomentes CoEng_trqLim" SWORD Fact 1 100 -4.000000 3.999878 FORMAT "%8.6" ECU_ADDRESS 0x802290 /end MEASUREMENT
/begin MEASUREMENT CoEng_nMax "Drehzahlintervall Maximum" SWORD EngN 1 100 -32768.00 32767.00 FORMAT "%8.2" ECU_ADDRESS 0x7F96CC /end MEASUREMENT
/begin MEASUREMENT CoEng_nMin "Drehzahlintervall Minimum" SWORD EngN 1 100 -32768.00 32767.00 FORMAT "%8.2" ECU_ADDRESS 0x7F96CE /end MEASUREMENT
/begin MEASUREMENT CoEng_qSetUnBalTrim_mp "getrimmte Einspritzmenge [mg/Hub]" SWORD InjMass 1 100 -327.6800 327.6700 FORMAT "%8.4" ECU_ADDRESS 0x80229E /end MEASUREMENT
/begin MEASUREMENT CoEng_qTotTrim_mp "korrigierte Einspritzmenge in  mg/Hub für Gesamteinspritzmenge" SWORD InjMass 1 100 -327.6800 327.6700 FORMAT "%8.4" ECU_ADDRESS 0x8022A0 /end MEASUREMENT
/begin MEASUREMENT CoEng_rTrq "Verhältnis aktuelles Moment zu Maximalmoment" SWORD Prc 1 100 -327.6800 327.6700 FORMAT "%8.4" ECU_ADDRESS 0x7F96D0 /end MEASUREMENT
/begin MEASUREMENT CoEng_stAftRun "nachlauf-interner Nachlauf-Zustand" UBYTE OneToOne 1 100 0.00 255.0 FORMAT "%5.1" ECU_ADDRESS 0x7F9344 /end MEASUREMENT
/begin MEASUREMENT CoEng_stAftRunPath "Abschaltpfade aufgrund Motorzustand Nachlauf" ULONG OneToOne 1 100 0.00 4294967295.00 FORMAT "%13.2" ECU_ADDRESS 0x7F9C3C /end MEASUREMENT
/begin MEASUREMENT CoEng_stCompTst "Status ob Kompressionstest aktiv/nicht aktiv" UBYTE OneToOne 1 100 0.00 255.0 FORMAT "%5.1" ECU_ADDRESS 0x7F9345 /end MEASUREMENT
/begin MEASUREMENT CoEng_stCoordALS_mp "Statusanzeige Schubkoordinator für Adaption Lambdasonde" UWORD OneToOne 1 100 0.00 65535.00 FORMAT "%8.2" ECU_ADDRESS 0x80226E /end MEASUREMENT
/begin MEASUREMENT CoEng_stCoordFBC_mp "Statusanzeige Schubkoordinator für Mengenausgleichsregelung" UWORD OneToOne 1 100 0.00 65535.00 FORMAT "%8.2" ECU_ADDRESS 0x802270 /end MEASUREMENT
/begin MEASUREMENT CoEng_stCoordTAA_mp "Statusanzeige Schubkoordinator für Inkrementwinkellernen" UWORD OneToOne 1 100 0.00 65535.00 FORMAT "%8.2" ECU_ADDRESS 0x802272 /end MEASUREMENT
/begin MEASUREMENT CoEng_stCoordZFC_mp "Statusanzeige Schubkoordinator für Nullmengenkalibrierung" UWORD OneToOne 1 100 0.00 65535.00 FORMAT "%8.2" ECU_ADDRESS 0x802274 /end MEASUREMENT
/begin MEASUREMENT CoEng_stCurrLimActive "Statusword zur Markierung der wirksamen niedrigsten Begrenzungsmomente" ULONG OneToOne 1 100 0.00 4294967295.00 FORMAT "%13.2" ECU_ADDRESS 0x7F9C40 /end MEASUREMENT
/begin MEASUREMENT CoEng_stEEPStore_mp "Speicherstatus für EEPROM während Nachlauf" UBYTE OneToOne 1 100 0.00 255.0 FORMAT "%5.1" ECU_ADDRESS 0x802264 /end MEASUREMENT
/begin MEASUREMENT CoEng_stEng "aktueller Motorzustand [-]" UBYTE OneToOne 1 100 0.00 255.0 FORMAT "%5.1" ECU_ADDRESS 0x7F9347 /end MEASUREMENT
/begin MEASUREMENT CoEng_stEngOld "Motorstatus vor aktuellem Status" UBYTE OneToOne 1 100 0.00 255.0 FORMAT "%5.1" ECU_ADDRESS 0x7F9348 /end MEASUREMENT
/begin MEASUREMENT CoEng_stENGSlpInd "Steuergerät im Nachlauf" UBYTE OneToOne 1 100 0.00 255.0 FORMAT "%5.1" ECU_ADDRESS 0x7F9346 /end MEASUREMENT
/begin MEASUREMENT CoEng_stExtWait "Zustand ""warten auf externe Ereignisse vor Schreiben des EEPROM""" UBYTE OneToOne 1 100 0.00 255.0 FORMAT "%5.1" ECU_ADDRESS 0x7F9349 /end MEASUREMENT
/begin MEASUREMENT CoEng_stIRevShutOff "irreversible Abschaltursachen (nach Maskierung)" ULONG OneToOne 1 100 0.00 4294967295.00 FORMAT "%13.2" ECU_ADDRESS 0x7F9C44 /end MEASUREMENT
/begin MEASUREMENT CoEng_stMonActrPrt "Zustand der Steuerung Stellerschutz" UBYTE OneToOne 1 100 0.00 255.0 FORMAT "%5.1" ECU_ADDRESS 0x7F934A /end MEASUREMENT
/begin MEASUREMENT CoEng_stMonShOff "aktueller Zustand der Abstellsteuerung im Nachlauf" UBYTE OneToOne 1 100 0.00 255.0 FORMAT "%5.1" ECU_ADDRESS 0x7F934B /end MEASUREMENT
/begin MEASUREMENT CoEng_stOvrRun "Zustand Schuberkennung (0: kein Schub, 1: Schub)" UBYTE OneToOne 1 100 0.00 255.0 FORMAT "%5.1" ECU_ADDRESS 0x7F934C /end MEASUREMENT
/begin MEASUREMENT CoEng_stOvrRunCoord "Status Schuberkennung des Schubkoordinators (0: kein Schub; 1: Schub)" UBYTE OneToOne 1 100 0.00 255.0 FORMAT "%5.1" ECU_ADDRESS 0x7F934D /end MEASUREMENT
/begin MEASUREMENT CoEng_stPwrStgEnaCond "Steuergerätestatus, der für die Abschaltung der Endstufe/Endstufenfehlerdiagnose relevant ist" UBYTE OneToOne 1 100 0.00 255.0 FORMAT "%5.1" ECU_ADDRESS 0x7F934E /end MEASUREMENT
/begin MEASUREMENT CoEng_stRevShutOff "reversible Abschaltursachen (nach Maskierung)" ULONG OneToOne 1 100 0.00 4294967295.00 FORMAT "%13.2" ECU_ADDRESS 0x7F9C48 /end MEASUREMENT
/begin MEASUREMENT CoEng_stShutOff "Typ der wirksamen Abschaltursache (0: Nachlauf; 1: reversibel; 2: irreversibel)" UBYTE OneToOne 1 100 0.00 255.0 FORMAT "%5.1" ECU_ADDRESS 0x7F934F /end MEASUREMENT
/begin MEASUREMENT CoEng_stShutOffPath "aktive Abstellpfade resultierend aus aktiven reversiblen, irreversiblen und Nachlauf-Abstellpfaden" ULONG OneToOne 1 100 0.00 4294967295.00 FORMAT "%13.2" ECU_ADDRESS 0x7F9C4C /end MEASUREMENT
/begin MEASUREMENT CoEng_stSlpLim_mp "Statusbits für Turboschubbegrenzung" UBYTE OneToOne 1 100 0.00 255.0 FORMAT "%5.1" ECU_ADDRESS 0x802296 /end MEASUREMENT
/begin MEASUREMENT CoEng_stTMFWShOff "Status Message ob Abschaltanforderung für das Zweimassenschwungrad notwendig ist" UBYTE OneToOne 1 100 0.00 255.0 FORMAT "%5.1" ECU_ADDRESS 0x7F9350 /end MEASUREMENT
/begin MEASUREMENT CoEng_stTrqLimErr "Status Begrenzungsmoment im Systemfehlerfall. Bit0: Begrenzung aktiv; Bit1: Rampe von/zu Begrenzungswert aktiv" UBYTE OneToOne 1 100 0.00 255.0 FORMAT "%5.1" ECU_ADDRESS 0x7F9352 /end MEASUREMENT
/begin MEASUREMENT CoEng_stTst "Zustand des Motortestkoordinators (= aktiver Testmodus)" UBYTE OneToOne 1 100 0.00 255.0 FORMAT "%5.1" ECU_ADDRESS 0x7F9353 /end MEASUREMENT
/begin MEASUREMENT CoEng_stTVAClsd "Status für Drosselklappe im Nachlauf zur Vermeidung von Abstellschlagen" UBYTE OneToOne 1 100 0.00 255.0 FORMAT "%5.1" ECU_ADDRESS 0x7F9351 /end MEASUREMENT
/begin MEASUREMENT CoEng_tiAfterrun "Zeit seit Erreichen des Motorzustands Nachlauf (COENG_STAFTERRUN)" ULONG Time_ms 1 100 0.00 42949672950.0 FORMAT "%13.1" ECU_ADDRESS 0x7F9C50 /end MEASUREMENT
/begin MEASUREMENT CoEng_tiNormal "Zeit seit Erreichen Zustand NORMAL" ULONG Time_ms 1 100 0.00 42949672950.0 FORMAT "%13.1" ECU_ADDRESS 0x7F9C54 /end MEASUREMENT
/begin MEASUREMENT CoEng_tiStandby "Zeit seit Erriechen Zustand STANDBY" ULONG Time_ms 1 100 0.00 42949672950.0 FORMAT "%13.1" ECU_ADDRESS 0x7F9C58 /end MEASUREMENT
/begin MEASUREMENT CoEng_tiStart "Zeit seit Erreichen Motorzustand START (0x02)" ULONG Time_ms 1 100 0.00 42949672950.0 FORMAT "%13.1" ECU_ADDRESS 0x7F9C5C /end MEASUREMENT
/begin MEASUREMENT CoEng_trq "aktuelles Motorausgangsmoment" SWORD Trq 1 100 -3276.800 3276.700 FORMAT "%8.3" ECU_ADDRESS 0x7F96D2 /end MEASUREMENT
/begin MEASUREMENT CoEng_trqASDdcGvnr_mp "Moment des Führungsformers in Berücksichtigung des Lastschlagreglers" SWORD Trq 1 100 -3276.800 3276.700 FORMAT "%8.3" ECU_ADDRESS 0x80227A /end MEASUREMENT
/begin MEASUREMENT CoEng_trqInrAct "inneres Motormoment ohne Ruckeldämpfer (coeng_trqinrltd + coeng_trqliltd)" SWORD Trq 1 100 -3276.800 3276.700 FORMAT "%8.3" ECU_ADDRESS 0x7F96D4 /end MEASUREMENT
/begin MEASUREMENT CoEng_trqInrActDrv "inneres Moment Wunschwert plus begrenztes LLR-Moment ohne ext. Eingriffe" SWORD Trq 1 100 -3276.800 3276.700 FORMAT "%8.3" ECU_ADDRESS 0x7F96D6 /end MEASUREMENT
/begin MEASUREMENT CoEng_trqInrCurr "inneres Moment aktueller Wert" SWORD Trq 1 100 -3276.800 3276.700 FORMAT "%8.3" ECU_ADDRESS 0x7F96D8 /end MEASUREMENT
/begin MEASUREMENT CoEng_trqInrCurrFast "inneres Wunschmoment (schneller Pfad) erzeugt aus CoDT_trqCurr" SWORD Trq 1 100 -3276.800 3276.700 FORMAT "%8.3" ECU_ADDRESS 0x7F96DA /end MEASUREMENT
/begin MEASUREMENT CoEng_trqInrCurrFastBase_mp "inneres schnelles Wunschmoment im Curr-Pfad" SWORD Trq 1 100 -3276.800 3276.700 FORMAT "%8.3" ECU_ADDRESS 0x802288 /end MEASUREMENT
/begin MEASUREMENT CoEng_trqInrCurrLim "aktuell kleinstes Begrenzungsmoment (inneres Motormoment)" SWORD Trq 1 100 -3276.800 3276.700 FORMAT "%8.3" ECU_ADDRESS 0x7F96DC /end MEASUREMENT
/begin MEASUREMENT CoEng_trqInrCurrPre_mp "aktuelles inneres Moment ahne Leerlaufreglerstellgrösse" SWORD Trq 1 100 -3276.800 3276.700 FORMAT "%8.3" ECU_ADDRESS 0x80227C /end MEASUREMENT
/begin MEASUREMENT CoEng_trqInrDes "Wunschmoment (inneres Motormoment)" SWORD Trq 1 100 -3276.800 3276.700 FORMAT "%8.3" ECU_ADDRESS 0x7F96DE /end MEASUREMENT
/begin MEASUREMENT CoEng_trqInrDesFast "Wunschmoment (inneres Motormoment) (schneller Pfad) erzeugt aus CoDT_trqLead" SWORD Trq 1 100 -3276.800 3276.700 FORMAT "%8.3" ECU_ADDRESS 0x7F96E0 /end MEASUREMENT
/begin MEASUREMENT CoEng_trqInrDesFastBase_mp "inneres schnelles Wunschmoment ohne Veränderung" SWORD Trq 1 100 -3276.800 3276.700 FORMAT "%8.3" ECU_ADDRESS 0x80228A /end MEASUREMENT
/begin MEASUREMENT CoEng_trqInrDesSlow "inneres Moment Wunschwert (normaler Pfad) erzeugt aus CoDT_trqDes" SWORD Trq 1 100 -3276.800 3276.700 FORMAT "%8.3" ECU_ADDRESS 0x7F96E2 /end MEASUREMENT
/begin MEASUREMENT CoEng_trqInrDesSlowBase_mp "inneres langsames Wunschmoment ohne Veränderung" SWORD Trq 1 100 -3276.800 3276.700 FORMAT "%8.3" ECU_ADDRESS 0x80227E /end MEASUREMENT
/begin MEASUREMENT CoEng_trqInrDrvSlow "Wunschmoment des Antriebsstrangs (inneres Moment) ohne ext. Eingriffe" SWORD Trq 1 100 -3276.800 3276.700 FORMAT "%8.3" ECU_ADDRESS 0x7F96E4 /end MEASUREMENT
/begin MEASUREMENT CoEng_trqInrDrvSlowBase_mp "Grundwert inneres Sollmoment ohne ext. Eingriffe" SWORD Trq 1 100 -3276.800 3276.700 FORMAT "%8.3" ECU_ADDRESS 0x80228C /end MEASUREMENT
/begin MEASUREMENT CoEng_trqInrGearbxInMax_mp "maximales Getriebeeingangsmoment als inneres Motormoment" SWORD Trq 1 100 -3276.800 3276.700 FORMAT "%8.3" ECU_ADDRESS 0x802276 /end MEASUREMENT
/begin MEASUREMENT CoEng_trqInrLim "Begrenzungsmoment (inneres Motormoment)" SWORD Trq 1 100 -3276.800 3276.700 FORMAT "%8.3" ECU_ADDRESS 0x7F96E6 /end MEASUREMENT
/begin MEASUREMENT CoEng_trqInrLimDes "Begrenzungsmoment als inneres Motormoment, korrigiert um Leerlaufreglerstellgröße" SWORD Trq 1 100 -3276.800 3276.700 FORMAT "%8.3" ECU_ADDRESS 0x7F96E8 /end MEASUREMENT
/begin MEASUREMENT CoEng_trqInrLimDyn "Dynamisches Begrenzungsmoment" SWORD Trq 1 100 -3276.800 3276.700 FORMAT "%8.3" ECU_ADDRESS 0x7F96EA /end MEASUREMENT
/begin MEASUREMENT CoEng_trqInrLimLead "Begrenzungsmoment mit lang anhaltenden Begrenzungen" SWORD Trq 1 100 -3276.800 3276.700 FORMAT "%8.3" ECU_ADDRESS 0x7F96EC /end MEASUREMENT
/begin MEASUREMENT CoEng_trqInrLimStat "Statisches Begrenzungsmoment" SWORD Trq 1 100 -3276.800 3276.700 FORMAT "%8.3" ECU_ADDRESS 0x7F96EE /end MEASUREMENT
/begin MEASUREMENT CoEng_trqInrLtd "inneres Moment Sollwert nach Begrenzung, vor Eingriff ARD-Störungsregler" SWORD Trq 1 100 -3276.800 3276.700 FORMAT "%8.3" ECU_ADDRESS 0x7F96F0 /end MEASUREMENT
/begin MEASUREMENT CoEng_trqInrLtdDrv "begrenztes Sollmoment (inneres Moment) vor Aktiver Ruckel-dämpfer ohne ext. Eingriffe" SWORD Trq 1 100 -3276.800 3276.700 FORMAT "%8.3" ECU_ADDRESS 0x7F96F2 /end MEASUREMENT
/begin MEASUREMENT CoEng_trqInrPCtl "Vorsteuermoment" SWORD Trq 1 100 -3276.800 3276.700 FORMAT "%8.3" ECU_ADDRESS 0x7F96F4 /end MEASUREMENT
/begin MEASUREMENT CoEng_trqInrPCtlULtd "Vorsteuermoment ohne Beschränkungen" SWORD Trq 1 100 -3276.800 3276.700 FORMAT "%8.3" ECU_ADDRESS 0x7F96F6 /end MEASUREMENT
/begin MEASUREMENT CoEng_trqInrPCtl_mp "Ungefiltertes Fahrerwunschmoment ohne ext. Eingriffe" SWORD Trq 1 100 -3276.800 3276.700 FORMAT "%8.3" ECU_ADDRESS 0x80228E /end MEASUREMENT
/begin MEASUREMENT CoEng_trqInrPrpLimErr_mp "Begrenzungsmoment für Vortrieb im Falle eines Systemfehlers als inneres Motormoment" SWORD Trq 1 100 -3276.800 3276.700 FORMAT "%8.3" ECU_ADDRESS 0x802278 /end MEASUREMENT
/begin MEASUREMENT CoEng_trqInrRaw "inneres Moment Rohwert" SWORD Trq 1 100 -3276.800 3276.700 FORMAT "%8.3" ECU_ADDRESS 0x7F96F8 /end MEASUREMENT
/begin MEASUREMENT CoEng_trqInrRawPre_mp "Rohwet inneres Moment ohne Leerlaufreglerstellgrösse" SWORD Trq 1 100 -3276.800 3276.700 FORMAT "%8.3" ECU_ADDRESS 0x802280 /end MEASUREMENT
/begin MEASUREMENT CoEng_trqInrSet "inneres Moment Sollwert (>Mengenberechnung)" SWORD Trq 1 100 -3276.800 3276.700 FORMAT "%8.3" ECU_ADDRESS 0x7F96FA /end MEASUREMENT
/begin MEASUREMENT CoEng_trqLiLtd "begrenztes Leerlaufreglermoment" SWORD Trq 1 100 -3276.800 3276.700 FORMAT "%8.3" ECU_ADDRESS 0x7F96FC /end MEASUREMENT
/begin MEASUREMENT CoEng_trqLimASDdc_mp "Sollmoment nach Eingriff des Ruckeldämfers nach zweiter Begrenzung" SWORD Trq 1 100 -3276.800 3276.700 FORMAT "%8.3" ECU_ADDRESS 0x802282 /end MEASUREMENT
/begin MEASUREMENT CoEng_trqLimBit "Begrenzungsmoment im Bi-Turbo-Fehlerfall" SWORD Trq 1 100 -3276.800 3276.700 FORMAT "%8.3" ECU_ADDRESS 0x7F96FE /end MEASUREMENT
/begin MEASUREMENT CoEng_trqLimBitSwt "Ausgang des Ramp-Switch-Blocks zur Momentbegrenzung im Bi-Turbo-Fehlerfall" SWORD Trq 1 100 -3276.800 3276.700 FORMAT "%8.3" ECU_ADDRESS 0x7F9700 /end MEASUREMENT
/begin MEASUREMENT CoEng_trqLimCorr "Begrenzungsmoment nach der Multiplikationskorrektur" SWORD Trq 1 100 -3276.800 3276.700 FORMAT "%8.3" ECU_ADDRESS 0x7F9702 /end MEASUREMENT
/begin MEASUREMENT CoEng_trqLimErr "Begrenzungsmoment im Falle eines Systemfehlers" SWORD Trq 1 100 -3276.800 3276.700 FORMAT "%8.3" ECU_ADDRESS 0x7F9704 /end MEASUREMENT
/begin MEASUREMENT CoEng_trqLimMax_mp "Begrenzungsmoment nach der Volllasterhöhung" SWORD Trq 1 100 -3276.800 3276.700 FORMAT "%8.3" ECU_ADDRESS 0x802294 /end MEASUREMENT
/begin MEASUREMENT CoEng_trqLimMin_mp "Begrenzungsmoment, falls kein momentenbegrenzender Systemfehler vorliegt (Minimum aus Rauchgrenze un Motormech.schutz)" SWORD Trq 1 100 -3276.800 3276.700 FORMAT "%8.3" ECU_ADDRESS 0x802292 /end MEASUREMENT
/begin MEASUREMENT CoEng_trqLimOffs_mp "aktueller Momentgrenzwert mit Offset f. ARD" SWORD Trq 1 100 -3276.800 3276.700 FORMAT "%8.3" ECU_ADDRESS 0x802284 /end MEASUREMENT
/begin MEASUREMENT CoEng_trqLimSwt "Ausgang des RampSwitch-Block zur Momentbegrenzung im Systemfehlerfall" SWORD Trq 1 100 -3276.800 3276.700 FORMAT "%8.3" ECU_ADDRESS 0x7F9706 /end MEASUREMENT
/begin MEASUREMENT CoEng_trqLoss "Motorverlustmomente" SWORD Trq 1 100 -3276.800 3276.700 FORMAT "%8.3" ECU_ADDRESS 0x7F9708 /end MEASUREMENT
/begin MEASUREMENT CoEng_trqMax "Momentintervall Maximum" SWORD Trq 1 100 -3276.800 3276.700 FORMAT "%8.3" ECU_ADDRESS 0x7F970A /end MEASUREMENT
/begin MEASUREMENT CoEng_trqMin "Schleppmoment" SWORD Trq 1 100 -3276.800 3276.700 FORMAT "%8.3" ECU_ADDRESS 0x7F970C /end MEASUREMENT
/begin MEASUREMENT CoEng_trqMinInMax_mp "Minimum Moment für Maximum Auswahl" SWORD Trq 1 100 -3276.800 3276.700 FORMAT "%8.3" ECU_ADDRESS 0x802286 /end MEASUREMENT
/begin MEASUREMENT CoEng_trqOffs "Offset auf Begrenzungsmoment, um Arbeitsbereich für ARDsr zu schaffen" SWORD Trq 1 100 -3276.800 3276.700 FORMAT "%8.3" ECU_ADDRESS 0x7F970E /end MEASUREMENT
/begin MEASUREMENT CoEng_trqOutRamp_mp "Ausgang der Rampe (Anstiegsbegrenzung" SWORD Trq 1 100 -3276.800 3276.700 FORMAT "%8.3" ECU_ADDRESS 0x802298 /end MEASUREMENT
/begin MEASUREMENT CoEng_trqSetASDUnLim "Sollmoment nach Eingriff Ruckeldämpfer(Störregler) vor 2.Begrenzung" SWORD Trq 1 100 -3276.800 3276.700 FORMAT "%8.3" ECU_ADDRESS 0x7F9710 /end MEASUREMENT
/begin MEASUREMENT CoEng_trqSlpLim "Begrenzungsmoment für Rauchbegrenzung nach Turboschubbegrenzung" SWORD Trq 1 100 -3276.800 3276.700 FORMAT "%8.3" ECU_ADDRESS 0x7F9712 /end MEASUREMENT
/begin MEASUREMENT CoEng_trqSlpLimByp_mp "Meßpunkt für Bypass Freischnitt" SWORD Trq 1 100 -3276.800 3276.700 FORMAT "%8.3" ECU_ADDRESS 0x80229A /end MEASUREMENT
/begin MEASUREMENT CoEng_volFlConsAll "Gesamtverbrauchberechnung aus Gesamteinspritzmenge" SLONG FlConsum_ul 1 100 -2147483648.00 2147483647.00 FORMAT "%13.2" ECU_ADDRESS 0x7F9C60 /end MEASUREMENT
/begin MEASUREMENT CoEng_volFlConsAllDT_mp "aktueller Verbrauch in [ul/20ms] für Gesamteinspritzmenge" SLONG FlConsum_ul 1 100 -2147483648.00 2147483647.00 FORMAT "%13.2" ECU_ADDRESS 0x8022A4 /end MEASUREMENT
/begin MEASUREMENT CoEng_volFlConsAllTotDT_mp "aktueller Verbrauch in [ul/20ms] für Gesamteinspritzmenge" SLONG FlConsum_ul 1 100 -2147483648.00 2147483647.00 FORMAT "%13.2" ECU_ADDRESS 0x8022A8 /end MEASUREMENT
/begin MEASUREMENT CoEng_volFlConsAllTot_mp "Gesamter Kraftstoffverbrauch in [ul] für Gesamteinspritzmenge" SLONG FlConsum_ul 1 100 -2147483648.00 2147483647.00 FORMAT "%13.2" ECU_ADDRESS 0x8022AC /end MEASUREMENT
/begin MEASUREMENT CoEng_volFlConsDspl "Anzeige des Gesamtverbrauchs" SLONG FlConsum_ul 1 100 -2147483648.00 2147483647.00 FORMAT "%13.2" ECU_ADDRESS 0x7F9C64 /end MEASUREMENT
/begin MEASUREMENT CoEng_volFlConsTotDT_mp "aktueller Verbrauch in [ul/20ms]" SLONG FlConsum_ul 1 100 -2147483648.00 2147483647.00 FORMAT "%13.2" ECU_ADDRESS 0x8022B0 /end MEASUREMENT
/begin MEASUREMENT CoEng_volFlConsTot_mp "Verbrauch pro Fahrzyklus in ul" SLONG FlConsum_ul 1 100 -2147483648.00 2147483647.00 FORMAT "%13.2" ECU_ADDRESS 0x8022B4 /end MEASUREMENT
/begin MEASUREMENT ComVar_stDebClaEn "Status der verriegelten Debounce Klassen." UWORD OneToOne 1 100 0.00 65535.00 FORMAT "%8.2" ECU_ADDRESS 0x7F9752 /end MEASUREMENT
/begin MEASUREMENT ComVar_stK2Com "Status der K-Line Kommunikation" UBYTE OneToOne 1 100 0.00 255.0 FORMAT "%5.1" ECU_ADDRESS 0x7F935F /end MEASUREMENT
/begin MEASUREMENT ComVar_swtRemote "Status des Remote Schalters" UBYTE OneToOne 1 100 0.00 255.0 FORMAT "%5.1" ECU_ADDRESS 0x7F9360 /end MEASUREMENT
/begin MEASUREMENT ConvCD_ctClutchDfct_mp "Defektzähler von Plausibitätfehler des Kupplungssignals" UWORD OneToOne 1 100 0.00 65535.00 FORMAT "%8.2" ECU_ADDRESS 0x8022B8 /end MEASUREMENT
/begin MEASUREMENT ConvCD_stClth "Kupplungszustand" UBYTE OneToOne 1 100 0.00 255.0 FORMAT "%5.1" ECU_ADDRESS 0x7F9361 /end MEASUREMENT
/begin MEASUREMENT ConvCD_stClutchRecord "Message zur Kupplungsstatus Wechsel ( 0 --> 1)" UBYTE OneToOne 1 100 0.00 255.0 FORMAT "%5.1" ECU_ADDRESS 0x7F9362 /end MEASUREMENT
/begin MEASUREMENT ConvCD_stIlsDebVal "Entprellter Interlock Status" UBYTE OneToOne 1 100 0.00 255.0 FORMAT "%5.1" ECU_ADDRESS 0x7F9363 /end MEASUREMENT
/begin MEASUREMENT ConvCD_stIlsRawVal "Interlock Rohwert" UBYTE OneToOne 1 100 0.00 255.0 FORMAT "%5.1" ECU_ADDRESS 0x7F9364 /end MEASUREMENT
/begin MEASUREMENT ConvCD_stIntDebVal "Entprellt Kupplung Status zur internen Verwendung" UBYTE OneToOne 1 100 0.00 255.0 FORMAT "%5.1" ECU_ADDRESS 0x7F9365 /end MEASUREMENT
/begin MEASUREMENT ConvCD_stLastDebVal "Letzter Kupplungssignalstatus." UBYTE OneToOne 1 100 0.00 255.0 FORMAT "%5.1" ECU_ADDRESS 0x7F9366 /end MEASUREMENT
/begin MEASUREMENT ConvCD_stLastGear "Gang von den letzten Zyklus [k-1]" SBYTE OneToOne 1 100 -128.0 127.0 FORMAT "%5.1" ECU_ADDRESS 0x7F9367 /end MEASUREMENT
/begin MEASUREMENT ConvCD_stOldGear "Letzte gültigen Gang" SBYTE OneToOne 1 100 -128.0 127.0 FORMAT "%5.1" ECU_ADDRESS 0x7F9368 /end MEASUREMENT
/begin MEASUREMENT ConvCD_stRawVal "Kupplungssignal Rohwert" UBYTE OneToOne 1 100 0.00 255.0 FORMAT "%5.1" ECU_ADDRESS 0x7F9369 /end MEASUREMENT
/begin MEASUREMENT ConvCD_swtIlsDigInPVal "Interlock vorhanden" UBYTE OneToOne 1 100 0.00 255.0 FORMAT "%5.1" ECU_ADDRESS 0x7F936A /end MEASUREMENT
/begin MEASUREMENT ConvCD_swtSig "Schalter für Kupplungssignalquelle (DIO/CAN)." UBYTE OneToOne 1 100 0.00 255.0 FORMAT "%5.1" ECU_ADDRESS 0x7F936B /end MEASUREMENT
/begin MEASUREMENT Conv_rTrans "Übertragungsverhältins Momentenwandler (Kupplung)" SWORD TransR 1 100 -327.6800 327.6700 FORMAT "%8.4" ECU_ADDRESS 0x7F9754 /end MEASUREMENT
/begin MEASUREMENT COTSCD_tClnt "Kühlmitteltemperatur am Kühleraustritt" SWORD Temp_Cels 1 100 -3549.940 3003.560 FORMAT "%8.3" ECU_ADDRESS 0x7F9660 /end MEASUREMENT
/begin MEASUREMENT COTSCD_tClntLin "linearisierter Wert aus HWK vorm Aufruf der Übergangsfunktion" SWORD Temp_Cels 1 100 -3549.940 3003.560 FORMAT "%8.3" ECU_ADDRESS 0x7F9662 /end MEASUREMENT
/begin MEASUREMENT COTSCD_uRaw "Rohwert des Senorsignals" SWORD Volt 1 100 -160156.4 160151.5 FORMAT "%8.1" ECU_ADDRESS 0x7F9664 /end MEASUREMENT
/begin MEASUREMENT CoVeh_dnLvl1_mp "Offsetwerte für stufe 1" SWORD EngN 1 100 -32768.00 32767.00 FORMAT "%8.2" ECU_ADDRESS 0x8022BA /end MEASUREMENT
/begin MEASUREMENT CoVeh_dnLvl2_mp "Offsetwerte für stufe 2" SWORD EngN 1 100 -32768.00 32767.00 FORMAT "%8.2" ECU_ADDRESS 0x8022BC /end MEASUREMENT
/begin MEASUREMENT CoVeh_nAcsMax "maximale Drehzahl Nebenaggregate" SWORD EngN 1 100 -32768.00 32767.00 FORMAT "%8.2" ECU_ADDRESS 0x7F972C /end MEASUREMENT
/begin MEASUREMENT CoVeh_nAcsMin "minimale Drehzahl Nebenaggregate" SWORD EngN 1 100 -32768.00 32767.00 FORMAT "%8.2" ECU_ADDRESS 0x7F972E /end MEASUREMENT
/begin MEASUREMENT CoVeh_nAcsMinRequest "erhöhte Leerlaufsolldrehzahl für Nebenaggregaten" SWORD EngN 1 100 -32768.00 32767.00 FORMAT "%8.2" ECU_ADDRESS 0x7F9730 /end MEASUREMENT
/begin MEASUREMENT CoVeh_nENGMax_mp "Sollwert für LL-Drehzahlanhebung mit Fahrereinbezug" SWORD EngN 1 100 -32768.00 32767.00 FORMAT "%8.2" ECU_ADDRESS 0x8022BE /end MEASUREMENT
/begin MEASUREMENT CoVeh_nMax "Auftrag maximale Motordrehzahl" SWORD EngN 1 100 -32768.00 32767.00 FORMAT "%8.2" ECU_ADDRESS 0x7F9732 /end MEASUREMENT
/begin MEASUREMENT CoVeh_nMin "Auftrag minimale Motordrehzahl" SWORD EngN 1 100 -32768.00 32767.00 FORMAT "%8.2" ECU_ADDRESS 0x7F9734 /end MEASUREMENT
/begin MEASUREMENT CoVeh_nRampDes_mp "Sollwert für LL-Drehzahlanhebung über Rampe" SWORD EngN 1 100 -32768.00 32767.00 FORMAT "%8.2" ECU_ADDRESS 0x8022C0 /end MEASUREMENT
/begin MEASUREMENT CoVeh_nRgnIdle "LL- Solldrehzahl bei Regenerationsbetrieb." SWORD EngN 1 100 -32768.00 32767.00 FORMAT "%8.2" ECU_ADDRESS 0x7F9736 /end MEASUREMENT
/begin MEASUREMENT CoVeh_nRmpAcsMin "erhöhte Leerlaufsolldrehzahl über Rampe für Nebenaggregate" SWORD EngN 1 100 -32768.00 32767.00 FORMAT "%8.2" ECU_ADDRESS 0x7F9738 /end MEASUREMENT
/begin MEASUREMENT CoVeh_pwrAcsDes "Nebenaggregatleistung Auftrag" SWORD Pwr 1 100 -308831.1 308821.7 FORMAT "%8.1" ECU_ADDRESS 0x7F973A /end MEASUREMENT
/begin MEASUREMENT CoVeh_pwrAcsLead "Vorhalt Nebenaggregatleistung Auftrag" SWORD Pwr 1 100 -308831.1 308821.7 FORMAT "%8.1" ECU_ADDRESS 0x7F973C /end MEASUREMENT
/begin MEASUREMENT CoVeh_stActSafe_mp "Momentenbegrenzung aus Brettfunktion aktiv" UBYTE OneToOne 1 100 0.00 255.0 FORMAT "%5.1" ECU_ADDRESS 0x8022C8 /end MEASUREMENT
/begin MEASUREMENT CoVeh_stDem_mp "Status Anforderung Leerlaufdrehzahlanhebung" UBYTE OneToOne 1 100 0.00 255.0 FORMAT "%5.1" ECU_ADDRESS 0x8022C2 /end MEASUREMENT
/begin MEASUREMENT CoVeh_stEcoCoEngNrmToStrt "Ecomaticstatus für Motorstauswechsel von NORMAL nach START" UBYTE OneToOne 1 100 0.00 255.0 FORMAT "%5.1" ECU_ADDRESS 0x7F9359 /end MEASUREMENT
/begin MEASUREMENT CoVeh_stEcomaticOut "Status von Ecomatic für EKP Ein/Ausschaltung" UBYTE OneToOne 1 100 0.00 255.0 FORMAT "%5.1" ECU_ADDRESS 0x7F935C /end MEASUREMENT
/begin MEASUREMENT CoVeh_stEcomatic_mp "Status der Ecomatic Statemachine" UBYTE OneToOne 1 100 0.00 255.0 FORMAT "%5.1" ECU_ADDRESS 0x8022D2 /end MEASUREMENT
/begin MEASUREMENT CoVeh_stEcoStart "Ecomatic bit für Startfreigabe" UBYTE OneToOne 1 100 0.00 255.0 FORMAT "%5.1" ECU_ADDRESS 0x7F935A /end MEASUREMENT
/begin MEASUREMENT CoVeh_stEcoTVAShOff "Ecomatic Anforderung für TVA Abschaltung" UBYTE OneToOne 1 100 0.00 255.0 FORMAT "%5.1" ECU_ADDRESS 0x7F935B /end MEASUREMENT
/begin MEASUREMENT CoVeh_stInputs_mp "Eingabebedingungen für Statemachine Brettfunktion" UBYTE OneToOne 1 100 0.00 255.0 FORMAT "%5.1" ECU_ADDRESS 0x8022C9 /end MEASUREMENT
/begin MEASUREMENT CoVeh_stLIInc "Status der Leerlaufanhebung (Stufe1/2)" UBYTE OneToOne 1 100 0.00 255.0 FORMAT "%5.1" ECU_ADDRESS 0x7F935D /end MEASUREMENT
/begin MEASUREMENT CoVeh_stOrd "Randbedingungen für physikalischen Auftrag" UBYTE OneToOne 1 100 0.00 255.0 FORMAT "%5.1" ECU_ADDRESS 0x7F935E /end MEASUREMENT
/begin MEASUREMENT CoVeh_stRampFreeAuto_mp "Status Freigabe Rampe Automatik" UBYTE OneToOne 1 100 0.00 255.0 FORMAT "%5.1" ECU_ADDRESS 0x8022C3 /end MEASUREMENT
/begin MEASUREMENT CoVeh_stRampFreeManuell_mp "Status Freigabe Rampe Handschaltung" UBYTE OneToOne 1 100 0.00 255.0 FORMAT "%5.1" ECU_ADDRESS 0x8022C4 /end MEASUREMENT
/begin MEASUREMENT CoVeh_stRampFree_mp "Status Freigabe Rampe" UBYTE OneToOne 1 100 0.00 255.0 FORMAT "%5.1" ECU_ADDRESS 0x8022C5 /end MEASUREMENT
/begin MEASUREMENT CoVeh_stSelfhold_mp "Meßpunkt für Momentenbegrenzung größer als Schwelle" UBYTE OneToOne 1 100 0.00 255.0 FORMAT "%5.1" ECU_ADDRESS 0x8022CA /end MEASUREMENT
/begin MEASUREMENT CoVeh_stState_mp "Status der Brettfunktion" UBYTE OneToOne 1 100 0.00 255.0 FORMAT "%5.1" ECU_ADDRESS 0x8022CB /end MEASUREMENT
/begin MEASUREMENT CoVeh_stThres_mp "Meßpunkt für PWG Wert größer als Schwelle" UBYTE OneToOne 1 100 0.00 255.0 FORMAT "%5.1" ECU_ADDRESS 0x8022CC /end MEASUREMENT
/begin MEASUREMENT CoVeh_swtStep1_mp "Status Anforderung Stufe1" UBYTE OneToOne 1 100 0.00 255.0 FORMAT "%5.1" ECU_ADDRESS 0x8022C6 /end MEASUREMENT
/begin MEASUREMENT CoVeh_swtStep2_mp "Status Anforderung Stufe2" UBYTE OneToOne 1 100 0.00 255.0 FORMAT "%5.1" ECU_ADDRESS 0x8022C7 /end MEASUREMENT
/begin MEASUREMENT CoVeh_trqAcs "Momentenanforderung der Nebenaggregate" SWORD Trq 1 100 -3276.800 3276.700 FORMAT "%8.3" ECU_ADDRESS 0x7F973E /end MEASUREMENT
/begin MEASUREMENT CoVeh_trqAcsDes "Momentenanforderung Nebenaggregate Wunschwert" SWORD Trq 1 100 -3276.800 3276.700 FORMAT "%8.3" ECU_ADDRESS 0x7F9740 /end MEASUREMENT
/begin MEASUREMENT CoVeh_trqAcsLead "Momentenanforderung Nebenaggregate Vorhaltewert" SWORD Trq 1 100 -3276.800 3276.700 FORMAT "%8.3" ECU_ADDRESS 0x7F9742 /end MEASUREMENT
/begin MEASUREMENT CoVeh_trqAcsPerm "Momentenbedarf permanente Nebenaggregate" SWORD Trq 1 100 -3276.800 3276.700 FORMAT "%8.3" ECU_ADDRESS 0x7F9744 /end MEASUREMENT
/begin MEASUREMENT CoVeh_trqAcsTemp "Momentenbedarf zuschaltbare Nebenaggregate" SWORD Trq 1 100 -3276.800 3276.700 FORMAT "%8.3" ECU_ADDRESS 0x7F9746 /end MEASUREMENT
/begin MEASUREMENT CoVeh_trqLimSafe_mp "Momentenbegrenzung aus Brettfunktion" SWORD TrqPrp 1 100 -32768.00 32767.00 FORMAT "%8.2" ECU_ADDRESS 0x8022CE /end MEASUREMENT
/begin MEASUREMENT CoVeh_trqPrpDes "Vortriebsmoment Wunschwert" SWORD TrqPrp 1 100 -32768.00 32767.00 FORMAT "%8.2" ECU_ADDRESS 0x7F9748 /end MEASUREMENT
/begin MEASUREMENT CoVeh_trqPrpDrv "Wunsch Vortriebsmoment ohne ext. Eingriffe" SWORD TrqPrp 1 100 -32768.00 32767.00 FORMAT "%8.2" ECU_ADDRESS 0x7F974A /end MEASUREMENT
/begin MEASUREMENT CoVeh_trqPrpLead "Vortriebsmoment Vorhaltewert" SWORD TrqPrp 1 100 -32768.00 32767.00 FORMAT "%8.2" ECU_ADDRESS 0x7F974C /end MEASUREMENT
/begin MEASUREMENT CoVeh_trqPrpLimErr "Begrenzungsmoment für Vortrieb im Falle eines Systemfehlers" SWORD TrqPrp 1 100 -32768.00 32767.00 FORMAT "%8.2" ECU_ADDRESS 0x7F974E /end MEASUREMENT
/begin MEASUREMENT CoVeh_trqPrpLimErrAct_mp "Meßpunkt für eigentliches Antriebsbegrenzungsmoment im Falle eines Systemfehlers" SWORD TrqPrp 1 100 -32768.00 32767.00 FORMAT "%8.2" ECU_ADDRESS 0x8022D0 /end MEASUREMENT
/begin MEASUREMENT CoVeh_trqPrpPCtl "Vorhalt Vortriebsmoment ohne ext. Eingriffe" SWORD TrqPrp 1 100 -32768.00 32767.00 FORMAT "%8.2" ECU_ADDRESS 0x7F9750 /end MEASUREMENT
/begin MEASUREMENT CoVM_amAKT_mp "Integral des Drehmomenteingriffes MSR (Drehimpuls)" UWORD AngMom 1 100 0.00 33553.92 FORMAT "%8.2" ECU_ADDRESS 0x8022D4 /end MEASUREMENT
/begin MEASUREMENT CoVM_stActDem "Status aktiv wirkender Fahrdynamikeingriffe" UBYTE OneToOne 1 100 0.00 255.0 FORMAT "%5.1" ECU_ADDRESS 0x7F9354 /end MEASUREMENT
/begin MEASUREMENT CoVM_stDCS "Momenteneingriff durch DCS" SWORD OneToOne 1 100 -32768.00 32767.00 FORMAT "%8.2" ECU_ADDRESS 0x7F9714 /end MEASUREMENT
/begin MEASUREMENT CoVM_stDemCheck "Steuerbits der Abschaltsteuerung der Fahrdynamikeingriffe" UBYTE OneToOne 1 100 0.00 255.0 FORMAT "%5.1" ECU_ADDRESS 0x7F9355 /end MEASUREMENT
/begin MEASUREMENT CoVM_stOrd "Randbedingungen für physikalischen Auftrag" UBYTE OneToOne 1 100 0.00 255.0 FORMAT "%5.1" ECU_ADDRESS 0x7F9357 /end MEASUREMENT
/begin MEASUREMENT CoVM_stTCS "Momenteneingriff durch TCS" SWORD OneToOne 1 100 -32768.00 32767.00 FORMAT "%8.2" ECU_ADDRESS 0x7F9718 /end MEASUREMENT
/begin MEASUREMENT CoVM_swtSlipCtl "Fahrdynamik-Konfiguration (0: ASR aus, MSR aus; 1: ASR an, MSR aus;  2: ASR aus, MSR an;  3: ASR an, MSR an)" UBYTE OneToOne 1 100 0.00 255.0 FORMAT "%5.1" ECU_ADDRESS 0x7F9358 /end MEASUREMENT
/begin MEASUREMENT CoVM_trqDec "Momenteneingriff von ASR" SWORD TrqPrp 1 100 -32768.00 32767.00 FORMAT "%8.2" ECU_ADDRESS 0x7F971C /end MEASUREMENT
/begin MEASUREMENT CoVM_trqDecDfl_mp "Abschaltmoment ASR" SWORD TrqPrp 1 100 -32768.00 32767.00 FORMAT "%8.2" ECU_ADDRESS 0x8022DA /end MEASUREMENT
/begin MEASUREMENT CoVM_trqDesIncMax_mp "Messpunkt des Maximumwertes zwischen PrpBrk_trqDes & CoVM_trqInc" SWORD TrqPrp 1 100 -32768.00 32767.00 FORMAT "%8.2" ECU_ADDRESS 0x8022D6 /end MEASUREMENT
/begin MEASUREMENT CoVM_trqGearbxMax "Momentbegrenzung reduzierender Getriebeeingriff" SWORD Trq 1 100 -3276.800 3276.700 FORMAT "%8.3" ECU_ADDRESS 0x7F971E /end MEASUREMENT
/begin MEASUREMENT CoVM_trqGearbxMin "Momentbegrenzung erhöhender Getriebeeingriff" SWORD Trq 1 100 -3276.800 3276.700 FORMAT "%8.3" ECU_ADDRESS 0x7F9720 /end MEASUREMENT
/begin MEASUREMENT CoVM_trqInc "Momenteneingriff von MSR" SWORD TrqPrp 1 100 -32768.00 32767.00 FORMAT "%8.2" ECU_ADDRESS 0x7F9722 /end MEASUREMENT
/begin MEASUREMENT CoVM_trqIncDfl_mp "Abschaltmoment MSR" SWORD TrqPrp 1 100 -32768.00 32767.00 FORMAT "%8.2" ECU_ADDRESS 0x8022DC /end MEASUREMENT
/begin MEASUREMENT CoVM_trqLeadIncMax_mp "Messpunkt des Maximumwertes zwischen PrpBrk_trqLead & CoVM_trqInc" SWORD TrqPrp 1 100 -32768.00 32767.00 FORMAT "%8.2" ECU_ADDRESS 0x8022D8 /end MEASUREMENT
/begin MEASUREMENT CoVM_trqPrpDes "Wunsch Vortriebsmoment" SWORD TrqPrp 1 100 -32768.00 32767.00 FORMAT "%8.2" ECU_ADDRESS 0x7F9724 /end MEASUREMENT
/begin MEASUREMENT CoVM_trqPrpDrv "Wunsch Vortriebsmoment ohne ext. Eingriffe" SWORD TrqPrp 1 100 -32768.00 32767.00 FORMAT "%8.2" ECU_ADDRESS 0x7F9726 /end MEASUREMENT
/begin MEASUREMENT CoVM_trqPrpLead "Vorhalt Vortriebsmoment" SWORD TrqPrp 1 100 -32768.00 32767.00 FORMAT "%8.2" ECU_ADDRESS 0x7F9728 /end MEASUREMENT
/begin MEASUREMENT CoVM_trqPrpPCtl "Vorhalt Vortriebsmoment ohne ext. Eingriffe" SWORD TrqPrp 1 100 -32768.00 32767.00 FORMAT "%8.2" ECU_ADDRESS 0x7F972A /end MEASUREMENT
/begin MEASUREMENT CrCCD_stCrErr "Fehlerresultat des Bedienteils" UBYTE OneToOne 1 100 0.00 255.0 FORMAT "%5.1" ECU_ADDRESS 0x7F936C /end MEASUREMENT
/begin MEASUREMENT CrCCD_stCrPan "Resultat der Bedienteilauswertung" UWORD OneToOne 1 100 0.00 65535.00 FORMAT "%8.2" ECU_ADDRESS 0x7F9756 /end MEASUREMENT
/begin MEASUREMENT CrCCD_stFourPosPressed_mp "Meßpunkt ob eine Taste des Vierpositionsbedienteils gedrückt ist" UBYTE OneToOne 1 100 0.00 255.0 FORMAT "%5.1" ECU_ADDRESS 0x8022DE /end MEASUREMENT
/begin MEASUREMENT CrCCD_stKey "Rückgabewert ""Taste gedrückt""" UBYTE OneToOne 1 100 0.00 255.0 FORMAT "%5.1" ECU_ADDRESS 0x7F936E /end MEASUREMENT
/begin MEASUREMENT CrCCD_stKeySig "Tasten der Fahrgeschwindigkeitsregelung" UBYTE OneToOne 1 100 0.00 255.0 FORMAT "%5.1" ECU_ADDRESS 0x7F936F /end MEASUREMENT
/begin MEASUREMENT CrCCD_stMainSwitchOff "Status des Ausschalters" UBYTE OneToOne 1 100 0.00 255.0 FORMAT "%5.1" ECU_ADDRESS 0x7F9370 /end MEASUREMENT
/begin MEASUREMENT CrCCD_stPanelErr "Status der Vebaukodierung" UBYTE OneToOne 1 100 0.00 255.0 FORMAT "%5.1" ECU_ADDRESS 0x7F9371 /end MEASUREMENT
/begin MEASUREMENT CrCCD_stPanelVer "Art der Verbauvariante des Fahrgeschwindigkeitsreglers" UBYTE OneToOne 1 100 0.00 255.0 FORMAT "%5.1" ECU_ADDRESS 0x7F9372 /end MEASUREMENT
/begin MEASUREMENT CrCCD_stPlsPanErr "Status des Pl.Fehlers" UWORD OneToOne 1 100 0.00 65535.00 FORMAT "%8.2" ECU_ADDRESS 0x7F9758 /end MEASUREMENT
/begin MEASUREMENT CrCCD_stReadyOff_mp "Status der Bedingungen für Abschaltung" UBYTE OneToOne 1 100 0.00 255.0 FORMAT "%5.1" ECU_ADDRESS 0x8022DF /end MEASUREMENT
/begin MEASUREMENT CrCCD_stReadyOn_mp "Status der Bedingungen für Einschalten" UBYTE OneToOne 1 100 0.00 255.0 FORMAT "%5.1" ECU_ADDRESS 0x8022E0 /end MEASUREMENT
/begin MEASUREMENT CrCtl_aAct "aktuelle Sollbeschleunigung" SWORD Acc 1 100 -32.76800 32.76700 FORMAT "%8.5" ECU_ADDRESS 0x7F975A /end MEASUREMENT
/begin MEASUREMENT CrCtl_aDecDemDecP_mp "Initialisierungswert für Sollverzögerung bei Dec+" SWORD Acc 1 100 -32.76800 32.76700 FORMAT "%8.5" ECU_ADDRESS 0x8022E4 /end MEASUREMENT
/begin MEASUREMENT CrCtl_aDecDemOvRdP_mp "Initialisierungswert für Sollverzögerung bei Override+" SWORD Acc 1 100 -32.76800 32.76700 FORMAT "%8.5" ECU_ADDRESS 0x8022E6 /end MEASUREMENT
/begin MEASUREMENT CrCtl_aDecDemResAbvP_mp "Initialisierungswert für Sollverzögerung bei ResAbv+" SWORD Acc 1 100 -32.76800 32.76700 FORMAT "%8.5" ECU_ADDRESS 0x8022E8 /end MEASUREMENT
/begin MEASUREMENT CrCtl_aDecDemVal "Sollverzögerungswert" SWORD Acc 1 100 -32.76800 32.76700 FORMAT "%8.5" ECU_ADDRESS 0x7F975C /end MEASUREMENT
/begin MEASUREMENT CrCtl_facParCor_mp "Korrekturfaktor Reglerparameter in Abhängigkeit der Triebstrang - Überstetzung" UWORD Fact 1 100 0.00 7.999878 FORMAT "%8.6" ECU_ADDRESS 0x8022EA /end MEASUREMENT
/begin MEASUREMENT CrCtl_RmpPtrTempSlpNeg_mp "Negativ Rampen Steigung" ULONG RmpTrqPrp 1 100 0.00 65535999.9847 FORMAT "%13.4" ECU_ADDRESS 0x8022EC /end MEASUREMENT
/begin MEASUREMENT CrCtl_RmpPtrTempSlpPos_mp "Positiv Rampen Steigung" ULONG RmpTrqPrp 1 100 0.00 65535999.9847 FORMAT "%13.4" ECU_ADDRESS 0x8022F0 /end MEASUREMENT
/begin MEASUREMENT CrCtl_RmpPtrTempVelSlpNeg_mp "Negative Rampen Steigung" ULONG RmpVel 1 100 0.00 655359.999847 FORMAT "%13.6" ECU_ADDRESS 0x8022F4 /end MEASUREMENT
/begin MEASUREMENT CrCtl_RmpPtrTempVelSlpPos_mp "Positive Rampen Steigung" ULONG RmpVel 1 100 0.00 655359.999847 FORMAT "%13.6" ECU_ADDRESS 0x8022F8 /end MEASUREMENT
/begin MEASUREMENT CrCtl_RmpPtrTmpSlpNeg_mp "Negative Rampen Steigung" ULONG RmpAcc 1 100 0.00 65535.9999847 FORMAT "%13.7" ECU_ADDRESS 0x8022FC /end MEASUREMENT
/begin MEASUREMENT CrCtl_RmpPtrTmpSlpPos_mp "Positive Rampen Steigung" ULONG RmpAcc 1 100 0.00 65535.9999847 FORMAT "%13.7" ECU_ADDRESS 0x802300 /end MEASUREMENT
/begin MEASUREMENT CrCtl_rSlpRes "Fahrwiderstandsindex für Korrektur" SWORD PrcHigh 1 100 -32.76800 32.76700 FORMAT "%8.5" ECU_ADDRESS 0x7F975E /end MEASUREMENT
/begin MEASUREMENT CrCtl_rVnBeg "Verhältnis Geschwindigkeit zu Drehzahl bei Aktivierung FGR" SWORD VelToN 1 100 -0.3276800 0.3276700 FORMAT "%9.7" ECU_ADDRESS 0x7F9760 /end MEASUREMENT
/begin MEASUREMENT CrCtl_rVnBegByp_mp "Meßpunkt für Bypass" SWORD VelToN 1 100 -0.3276800 0.3276700 FORMAT "%9.7" ECU_ADDRESS 0x802304 /end MEASUREMENT
/begin MEASUREMENT CrCtl_stActive "Flag aktiver FGR" UBYTE OneToOne 1 100 0.00 255.0 FORMAT "%5.1" ECU_ADDRESS 0x7F9373 /end MEASUREMENT
/begin MEASUREMENT CrCtl_stActiveByp_mp "Meßpunkt für Bypass" UBYTE OneToOne 1 100 0.00 255.0 FORMAT "%5.1" ECU_ADDRESS 0x802306 /end MEASUREMENT
/begin MEASUREMENT CrCtl_stBlocking "Aktivierung Fahrgeschwindigkeitsregelung gesperrt" UBYTE OneToOne 1 100 0.00 255.0 FORMAT "%5.1" ECU_ADDRESS 0x7F9374 /end MEASUREMENT
/begin MEASUREMENT CrCtl_stBlockingByp_mp "Meßpunkt für Bypass" UBYTE OneToOne 1 100 0.00 255.0 FORMAT "%5.1" ECU_ADDRESS 0x8022E1 /end MEASUREMENT
/begin MEASUREMENT CrCtl_stDecDemRls "Bit Freigabe Verzögerungsanforderung" UBYTE OneToOne 1 100 0.00 255.0 FORMAT "%5.1" ECU_ADDRESS 0x7F9375 /end MEASUREMENT
/begin MEASUREMENT CrCtl_stESPRls "ESP Funktionszustand in ACC1 message" UBYTE OneToOne 1 100 0.00 255.0 FORMAT "%5.1" ECU_ADDRESS 0x7F9376 /end MEASUREMENT
/begin MEASUREMENT CrCtl_stKeyStateSig "Tasten und Zustand der Fahrgeschwindigkeitsregelung" UBYTE OneToOne 1 100 0.00 255.0 FORMAT "%5.1" ECU_ADDRESS 0x7F9377 /end MEASUREMENT
/begin MEASUREMENT CrCtl_stKeyStateSigByp_mp "Meßpunkt für Bypass" UBYTE OneToOne 1 100 0.00 255.0 FORMAT "%5.1" ECU_ADDRESS 0x802307 /end MEASUREMENT
/begin MEASUREMENT CrCtl_stOpFunc "Arbeitsstatus der Fahrgeschwindigkeitsregelung" UBYTE OneToOne 1 100 0.00 255.0 FORMAT "%5.1" ECU_ADDRESS 0x7F9378 /end MEASUREMENT
/begin MEASUREMENT CrCtl_stOpFuncByp_mp "Meßpunkt für Bypass" UBYTE OneToOne 1 100 0.00 255.0 FORMAT "%5.1" ECU_ADDRESS 0x802308 /end MEASUREMENT
/begin MEASUREMENT CrCtl_stOvRdDet_mp "Zustandsvariable für CrCtl bei Override" UBYTE OneToOne 1 100 0.00 255.0 FORMAT "%5.1" ECU_ADDRESS 0x802309 /end MEASUREMENT
/begin MEASUREMENT CrCtl_stOvRdP_mp "Status, um in den Unterzustand Override+ zu kommen" UBYTE OneToOne 1 100 0.00 255.0 FORMAT "%5.1" ECU_ADDRESS 0x80230A /end MEASUREMENT
/begin MEASUREMENT CrCtl_stReady_mp "Die Zustandsvariablen für alle Grundbedingungen sind TRUE, der Verzögerungswert wird angefordert" UBYTE OneToOne 1 100 0.00 255.0 FORMAT "%5.1" ECU_ADDRESS 0x80230B /end MEASUREMENT
/begin MEASUREMENT CrCtl_stShutOff "Abschaltbedingungen für Anzeige im Messwerteblock" UBYTE OneToOne 1 100 0.00 255.0 FORMAT "%5.1" ECU_ADDRESS 0x7F9379 /end MEASUREMENT
/begin MEASUREMENT CrCtl_stShutOffirev "Bitleiste der irreversiblen Abschaltbedingungen" UBYTE OneToOne 1 100 0.00 255.0 FORMAT "%5.1" ECU_ADDRESS 0x7F937A /end MEASUREMENT
/begin MEASUREMENT CrCtl_stShutOffrev "Bitleiste der reversiblen Abschaltbedingungen" ULONG OneToOne 1 100 0.00 4294967295.00 FORMAT "%13.2" ECU_ADDRESS 0x7F9C68 /end MEASUREMENT
/begin MEASUREMENT CrCtl_stStateMch "aktueller Arbeitsstatus des Zustandsautomaten" ULONG OneToOne 1 100 0.00 4294967295.00 FORMAT "%13.2" ECU_ADDRESS 0x7F9C6C /end MEASUREMENT
/begin MEASUREMENT CrCtl_stStateMchByp_mp "Meßpunkt für Bypass" ULONG OneToOne 1 100 0.00 4294967295.00 FORMAT "%13.2" ECU_ADDRESS 0x80230C /end MEASUREMENT
/begin MEASUREMENT CrCtl_stStateMchSub "aktueller Unterzustand" UWORD OneToOne 1 100 0.00 65535.00 FORMAT "%8.2" ECU_ADDRESS 0x7F9762 /end MEASUREMENT
/begin MEASUREMENT CrCtl_stStateMchSubByp_mp "Meßpunkt für Bypass" UWORD OneToOne 1 100 0.00 65535.00 FORMAT "%8.2" ECU_ADDRESS 0x802310 /end MEASUREMENT
/begin MEASUREMENT CrCtl_stStateP "Status der Cruise Control Plus" UBYTE OneToOne 1 100 0.00 255.0 FORMAT "%5.1" ECU_ADDRESS 0x7F937B /end MEASUREMENT
/begin MEASUREMENT CrCtl_stSwitchSig "Status der Schalterstellungen 2 für Diagnose" UBYTE OneToOne 1 100 0.00 255.0 FORMAT "%5.1" ECU_ADDRESS 0x7F937C /end MEASUREMENT
/begin MEASUREMENT CrCtl_stSwitchSigByp_mp "Meßpunkt für Bypass" UBYTE OneToOne 1 100 0.00 255.0 FORMAT "%5.1" ECU_ADDRESS 0x802312 /end MEASUREMENT
/begin MEASUREMENT CrCtl_swtAAG "Anhängersteuergerät (AAG) verbaut oder nicht" UBYTE OneToOne 1 100 0.00 255.0 FORMAT "%5.1" ECU_ADDRESS 0x7F937D /end MEASUREMENT
/begin MEASUREMENT CrCtl_trqACCGov_mp "Cruise Control Modus ACC Momentenausgang P-Regler" SWORD TrqPrp 1 100 -32768.00 32767.00 FORMAT "%8.2" ECU_ADDRESS 0x802314 /end MEASUREMENT
/begin MEASUREMENT CrCtl_trqDECGov_mp "Cruise Control Modus DEC Momentenausgang P-Regler" SWORD TrqPrp 1 100 -32768.00 32767.00 FORMAT "%8.2" ECU_ADDRESS 0x802316 /end MEASUREMENT
/begin MEASUREMENT CrCtl_trqDes "Momentenanforderung FGR" SWORD TrqPrp 1 100 -32768.00 32767.00 FORMAT "%8.2" ECU_ADDRESS 0x7F9764 /end MEASUREMENT
/begin MEASUREMENT CrCtl_trqDesByp_mp "Meßpunkt für Bypass" SWORD TrqPrp 1 100 -32768.00 32767.00 FORMAT "%8.2" ECU_ADDRESS 0x802318 /end MEASUREMENT
/begin MEASUREMENT CrCtl_trqIFrz_mp "Eingefrorener Wert I-Anteil des Reglers" SLONG TrqPrp 1 100 -2147483648.00 2147483647.00 FORMAT "%13.2" ECU_ADDRESS 0x80231C /end MEASUREMENT
/begin MEASUREMENT CrCtl_trqI_mp "I-Anteil FGR" SLONG TrqPrp 1 100 -2147483648.00 2147483647.00 FORMAT "%13.2" ECU_ADDRESS 0x802320 /end MEASUREMENT
/begin MEASUREMENT CrCtl_trqLead "Vorhaltmoment des FGR" SWORD TrqPrp 1 100 -32768.00 32767.00 FORMAT "%8.2" ECU_ADDRESS 0x7F9766 /end MEASUREMENT
/begin MEASUREMENT CrCtl_trqLeadByp_mp "Meßpunkt für Bypass" SWORD TrqPrp 1 100 -32768.00 32767.00 FORMAT "%8.2" ECU_ADDRESS 0x802324 /end MEASUREMENT
/begin MEASUREMENT CrCtl_trqLimAct "aktuelle Momentenbegrenzung für die Fahrgeschwindigkeitsregelung" SWORD TrqPrp 1 100 -32768.00 32767.00 FORMAT "%8.2" ECU_ADDRESS 0x7F9768 /end MEASUREMENT
/begin MEASUREMENT CrCtl_trqLimActByp_mp "Meßpunkt für Bypass" SWORD TrqPrp 1 100 -32768.00 32767.00 FORMAT "%8.2" ECU_ADDRESS 0x802326 /end MEASUREMENT
/begin MEASUREMENT CrCtl_trqP_mp "P-Anteil der Fahrgeschwindigkeits PI-Regelung" SWORD TrqPrp 1 100 -32768.00 32767.00 FORMAT "%8.2" ECU_ADDRESS 0x802328 /end MEASUREMENT
/begin MEASUREMENT CrCtl_trqRESABVGov_mp "Cruise Control Modus RESABV Momentenausgang P-Regler" SWORD TrqPrp 1 100 -32768.00 32767.00 FORMAT "%8.2" ECU_ADDRESS 0x80232A /end MEASUREMENT
/begin MEASUREMENT CrCtl_trqRESBELGov_mp "Cruise Control Modus RESBEL Momentenausgang P-Regler" SWORD TrqPrp 1 100 -32768.00 32767.00 FORMAT "%8.2" ECU_ADDRESS 0x80232C /end MEASUREMENT
/begin MEASUREMENT CrCtl_trqRESBELLim_mp "Cruise Control Modus RESBEL Momentenausgang Begrenzung" SWORD TrqPrp 1 100 -32768.00 32767.00 FORMAT "%8.2" ECU_ADDRESS 0x80232E /end MEASUREMENT
/begin MEASUREMENT CrCtl_trqSetPreCtl_mp "Messpunkt - Initialisierungsmoment bei Setzen" SWORD TrqPrp 1 100 -32768.00 32767.00 FORMAT "%8.2" ECU_ADDRESS 0x802330 /end MEASUREMENT
/begin MEASUREMENT CrCtl_vAlwMin "min. mögliche Setzgeschwindigkeit" SWORD Vel 1 100 0.00 200.0000 FORMAT "%8.4" ECU_ADDRESS 0x7F976A /end MEASUREMENT
/begin MEASUREMENT CrCtl_vCompare "Geschwindigkeit zum Vergleich mit der aktuellen Geschwindigkeit bei Ende von Beschleunigen/Verzögern" SWORD Vel 1 100 -100.0000 500.0000 FORMAT "%8.4" ECU_ADDRESS 0x7F976C /end MEASUREMENT
/begin MEASUREMENT CrCtl_vDecDemHoldP_mp "Unterschied zwischen aktueller Geschwindigkeit und Zielgeschwindigkeit bei Hold+" SWORD Vel 1 100 -327.6800 327.6700 FORMAT "%8.4" ECU_ADDRESS 0x802332 /end MEASUREMENT
/begin MEASUREMENT CrCtl_vDecDemP_mp "Unterschied zwischen aktueller Geschwindigkeit und Zielgeschwindigkeit bei Dec+" SWORD Vel 1 100 -327.6800 327.6700 FORMAT "%8.4" ECU_ADDRESS 0x802334 /end MEASUREMENT
/begin MEASUREMENT CrCtl_vDecOvRdP_mp "Unterschied zwischen aktueller Geschwindigkeit und Zielgeschwindigkeit bei Override+" SWORD Vel 1 100 -327.6800 327.6700 FORMAT "%8.4" ECU_ADDRESS 0x802336 /end MEASUREMENT
/begin MEASUREMENT CrCtl_vDecResAbvP_mp "Unterschied zwischen aktueller Geschwindigkeit und Zielgeschwindigkeit bei ResAbv+" SWORD Vel 1 100 -327.6800 327.6700 FORMAT "%8.4" ECU_ADDRESS 0x802338 /end MEASUREMENT
/begin MEASUREMENT CrCtl_vRESBELRamp_mp "Cruise Control Modus RESBEL Geschwindigkeitsrampe" SWORD Vel 1 100 -327.6800 327.6700 FORMAT "%8.4" ECU_ADDRESS 0x80233A /end MEASUREMENT
/begin MEASUREMENT CrCtl_vSetPointTrgt "Zielgeschwindigkeit für die Fahrgeschwindigkeitsregelung" SWORD Vel 1 100 -100.0000 500.0000 FORMAT "%8.4" ECU_ADDRESS 0x7F976E /end MEASUREMENT
/begin MEASUREMENT CrCtl_vSetPointTrgtByp_mp "Meßpunkt für Bypass" SWORD Vel 1 100 -327.6800 327.6700 FORMAT "%8.4" ECU_ADDRESS 0x80233C /end MEASUREMENT
/begin MEASUREMENT CrCtl_vYMapResAbv_mp "Mess punkt - Kennfeldeingang Resume Above" SWORD Vel 1 100 -327.6800 327.6700 FORMAT "%8.4" ECU_ADDRESS 0x80233E /end MEASUREMENT
/begin MEASUREMENT CrCtl_vYMapResBel_mp "Mess punkt Kennfeldeingang Resume Below" SWORD Vel 1 100 -327.6800 327.6700 FORMAT "%8.4" ECU_ADDRESS 0x802340 /end MEASUREMENT
/begin MEASUREMENT CrSCD_dSegMisf "Verschiebung Segmentsystem für Aussetzererkennung" SBYTE OneToOne 1 100 -128.0 127.0 FORMAT "%5.1" ECU_ADDRESS 0x7F937E /end MEASUREMENT
/begin MEASUREMENT CrSCD_incNextIntDelta_mp "Anzahl der Inkrements bis zum nächsten statischen  Interrupt" SWORD OneToOne 1 100 -32768.00 32767.00 FORMAT "%8.2" ECU_ADDRESS 0x80235C /end MEASUREMENT
/begin MEASUREMENT CrSCD_incNextInt_mp "Anzahl der Inkrements bis zum nächsten statischen  Interrupt" SBYTE OneToOne 1 100 -128.0 127.0 FORMAT "%5.1" ECU_ADDRESS 0x80235E /end MEASUREMENT
/begin MEASUREMENT CrSCD_nAvrg "gemittelte Kurbelwellendrehzahl des letzten und vorletzten segmentes" SWORD EngN 1 100 -32768.00 32767.00 FORMAT "%8.2" ECU_ADDRESS 0x7F9770 /end MEASUREMENT
/begin MEASUREMENT CrSCD_nAvrgHiRes "Gemittelte hochauflösende Drehzahl" SLONG EngN_HiRes 1 100 -67108864.0000 67108863.9688 FORMAT "%13.4" ECU_ADDRESS 0x7F9C74 /end MEASUREMENT
/begin MEASUREMENT CrSCD_nCurr "aktuelle Motordrehzahl aus der letzten Segmentperiode" SWORD EngN 1 100 -32768.00 32767.00 FORMAT "%8.2" ECU_ADDRESS 0x7F9772 /end MEASUREMENT
/begin MEASUREMENT CrSCD_nCurrHiRes "Aktuelle hochauflösende Drehzahl" SLONG EngN_HiRes 1 100 -67108864.0000 67108863.9688 FORMAT "%13.4" ECU_ADDRESS 0x7F9C78 /end MEASUREMENT
/begin MEASUREMENT CrSCD_nDyn "aktuelle Motordrehzahl mit Filter für Segment der Dekompressionsphase" SWORD EngN 1 100 -32768.00 32767.00 FORMAT "%8.2" ECU_ADDRESS 0x7F9774 /end MEASUREMENT
/begin MEASUREMENT CrSCD_nHold "aktuelle Motordrehzahl des vorletzten Segmentes" SWORD EngN 1 100 -32768.00 32767.00 FORMAT "%8.2" ECU_ADDRESS 0x7F9776 /end MEASUREMENT
/begin MEASUREMENT CrSCD_nIncr "Motordrehzahl aus Inkrementperiode" SWORD EngN 1 100 -32768.00 32767.00 FORMAT "%8.2" ECU_ADDRESS 0x7F9778 /end MEASUREMENT
/begin MEASUREMENT CrSCD_nMisf "Drehzahlsignal für ODB-Zündaussetzererkennung" SWORD EngN 1 100 -32768.00 32767.00 FORMAT "%8.2" ECU_ADDRESS 0x7F977A /end MEASUREMENT
/begin MEASUREMENT CrSCD_numSeg "aktuelle Segmentnummer  (Segment 0 ist bei OT 1)" UBYTE OneToOne 1 100 0.00 255.0 FORMAT "%5.1" ECU_ADDRESS 0x7F937F /end MEASUREMENT
/begin MEASUREMENT CrSCD_phiCurr_mp "Aktueller Winkel basierent auf dem Inkrementsystem" SWORD AngleCrS 1 100 -768.0000 767.9766 FORMAT "%8.4" ECU_ADDRESS 0x802360 /end MEASUREMENT
/begin MEASUREMENT CrSCD_phiIncCor "aktuelle Phasenkorrektur des Inkrementsystems der Kurbelwelle" SWORD AngleCrS 1 100 -768.0000 767.9766 FORMAT "%8.4" ECU_ADDRESS 0x7F977C /end MEASUREMENT
/begin MEASUREMENT CrSCD_phiIncr "Winkel eines Inkrements in Grad Kurbelwelle" SWORD AngleCrS 1 100 -768.0000 767.9766 FORMAT "%8.4" ECU_ADDRESS 0x7F977E /end MEASUREMENT
/begin MEASUREMENT CrSCD_phiSegGrid_mp "Berechnete Drehzahlsegmentlänge" SWORD AngleCrS 1 100 -768.0000 767.9766 FORMAT "%8.4" ECU_ADDRESS 0x802362 /end MEASUREMENT
/begin MEASUREMENT CrSCD_stIncErr_mp "Fehlerstatus des Inkrementgebersignals (Signalstöhrungen, Frequenzstatus, Inkrementpufferstatus)" UBYTE OneToOne 1 100 0.00 255.0 FORMAT "%5.1" ECU_ADDRESS 0x802364 /end MEASUREMENT
/begin MEASUREMENT CrSCD_stIncSig_mp "Status des Inkrementgeber Signalauswertung (Plausibilisierung der Zahnflankenzeiten und -anzahl)" UBYTE OneToOne 1 100 0.00 255.0 FORMAT "%5.1" ECU_ADDRESS 0x802365 /end MEASUREMENT
/begin MEASUREMENT CrSCD_stIncSyncInc_mp "Synchronisationsstatus des Inkrementgebersignals nach Aufruf von CrSCD_UpdPos (Intern, Debugging)" UBYTE OneToOne 1 100 0.00 255.0 FORMAT "%5.1" ECU_ADDRESS 0x802366 /end MEASUREMENT
/begin MEASUREMENT CrSCD_stIncSyncPhase_mp "Synchronisationsstatus des Inkrementgebersignals nach Aufruf von CaSCD_GetPos (Intern, Debugging)" UBYTE OneToOne 1 100 0.00 255.0 FORMAT "%5.1" ECU_ADDRESS 0x802367 /end MEASUREMENT
/begin MEASUREMENT CrSCD_tiIncr "aktuelle Inkrementperiode (1 Inkrement = Winkelbereich aus 360°KW/CrSCD_ctIncs_C, Abtastung = 2ms)" UWORD TimeDT 1 100 0.00 65535.00 FORMAT "%8.2" ECU_ADDRESS 0x7F9780 /end MEASUREMENT
/begin MEASUREMENT CrSCD_tiSeg "aktuelle Segmentperiode (1 Segment = Winkelbereich der über CrSCD_phiSeg_C appliziert ist, Abtastung = n-sync.)" ULONG Per_Dur 1 100 0.00 4294967295.00 FORMAT "%13.2" ECU_ADDRESS 0x7F9C7C /end MEASUREMENT
/begin MEASUREMENT CrS_ctInjStrt_mp "Anzahl der durchgeführten Testeinspritzungen" UWORD OneToOne 1 100 0.00 65535.00 FORMAT "%8.2" ECU_ADDRESS 0x802344 /end MEASUREMENT
/begin MEASUREMENT CrS_facSegTime_mp "Verhältnis der Segmentzeiten" SLONG Fact1 1 100 -16777216.0000 16777215.9922 FORMAT "%13.4" ECU_ADDRESS 0x802348 /end MEASUREMENT
/begin MEASUREMENT CrS_numTDCStrtLst_mp "Zeigt den Zylinder an, in den als letztes eingespritzt wurde" UWORD OneToOne 1 100 0.00 65535.00 FORMAT "%8.2" ECU_ADDRESS 0x80234C /end MEASUREMENT
/begin MEASUREMENT CrS_numTDCStrt_mp "Zeigt die Zylinder an, in die bereits eingespritzt wurde" UWORD OneToOne 1 100 0.00 65535.00 FORMAT "%8.2" ECU_ADDRESS 0x80234E /end MEASUREMENT
/begin MEASUREMENT CrS_stStrt_mp "Messpunkt für Zustandsautomat" UBYTE OneToOne 1 100 0.00 255.0 FORMAT "%5.1" ECU_ADDRESS 0x802350 /end MEASUREMENT
/begin MEASUREMENT CrS_tiSegOld_mp "Segmentzeit vor einer Testeinspritzung" SLONG Per_Dur 1 100 -2147483648.00 2147483647.00 FORMAT "%13.2" ECU_ADDRESS 0x802354 /end MEASUREMENT
/begin MEASUREMENT CrS_tiSeg_mp "Segmentzeit nach einer Testeinspritzung" SLONG Per_Dur 1 100 -2147483648.00 2147483647.00 FORMAT "%13.2" ECU_ADDRESS 0x802358 /end MEASUREMENT
/begin MEASUREMENT CtApCD_rHWE_mp "Ausgabetastverhältnis zur HWK" SWORD DtyCyc 1 100 -327.6800 327.6700 FORMAT "%8.4" ECU_ADDRESS 0x802368 /end MEASUREMENT
/begin MEASUREMENT CtApCD_rHWE_mpByp_mp "Bypass message für CtApCD_rHWE_mp" SWORD DtyCyc 1 100 -327.6800 327.6700 FORMAT "%8.4" ECU_ADDRESS 0x80236A /end MEASUREMENT
/begin MEASUREMENT CtApCD_stVarDef_mp "Status fuer Ausgabe ueber PWM- oder Digitalendstufe" UBYTE OneToOne 1 100 0.00 255.0 FORMAT "%5.1" ECU_ADDRESS 0x80236C /end MEASUREMENT
/begin FUNCTION cmbchb_misfire_uic ""
 /begin OUT_MEASUREMENT CmbChb_ctEngRevLogBuf1_mp CmbChb_ctEngRevLogBuf2_mp CmbChb_ctEngRevLogMem_mp CmbChb_ctEngRevPerBlk_mp CmbChb_dnSegMinPerCyl_mp CmbChb_nSegEven_mp CmbChb_nSegOdd_mp /end OUT_MEASUREMENT
/end FUNCTION
/begin FUNCTION codt_drvtrncord "Antriebs-Koordination"
 /begin DEF_CHARACTERISTIC CoDT_dtrqLimDwnCurr_C CoDT_dtrqLimDwnLead_C CoDT_dtrqLimUpCurr_C CoDT_dtrqLimUpLead_C CoDT_swtCoTypeVal_C CoDT_swtCoTypeType_C CoDT_tiTrqRedMaxCurr_C CoDT_tiTrqRedMaxLead_C /end DEF_CHARACTERISTIC
/end FUNCTION
/begin FUNCTION codt_drvtrncordlead_uic ""
 /begin OUT_MEASUREMENT CoDT_trqDTInDecCurr_mp CoDT_trqDTInDecLead_mp CoDT_trqDTInwoiCurr_mp CoDT_trqDTInwoiLead_mp CoDT_trqGearbxLead_mp CoDT_trqLeadDec_mp /end OUT_MEASUREMENT
/end FUNCTION
/begin FUNCTION codt_drvtrncord_msg ""
 /begin OUT_MEASUREMENT CoDT_nMax CoDT_nMin CoDT_stOrd CoDT_swtCoType CoDT_trqCurr CoDT_trqDes CoDT_trqDrv CoDT_trqDTInCurr CoDT_trqDTInDes CoDT_trqDTInDrv CoDT_trqDTInLead CoDT_trqDTInPCtl CoDT_trqGearbxDes CoDT_trqGearbxDrv CoDT_trqGearbxPCtl CoDT_trqLead CoDT_trqPCtl /end OUT_MEASUREMENT
/end FUNCTION
/begin FUNCTION codt_drvtrncord_uic "" /end FUNCTION
/begin FUNCTION codt_grip "Kraftschluß innerhalb Antrieb" /begin DEF_CHARACTERISTIC CoDT_tiGripDeb_C CoDT_vGrip_C /end DEF_CHARACTERISTIC /end FUNCTION
/begin FUNCTION codt_grip_msg "" /begin OUT_MEASUREMENT CoDT_Grip CoDT_stGripDeb /end OUT_MEASUREMENT /end FUNCTION
/begin FUNCTION codt_grip_uic "" /end FUNCTION
/begin FUNCTION codt_mstrqplaus "" /end FUNCTION
/begin FUNCTION codt_mstrqplaus_msg "" /begin OUT_MEASUREMENT CoDT_trqPlaus /end OUT_MEASUREMENT /end FUNCTION
/begin FUNCTION codt_mstrqplaus_uic "" /end FUNCTION
/begin FUNCTION codt_prptrqcurrcalc "Antriebsmoment-Berechnung" /end FUNCTION
/begin FUNCTION codt_prptrqcurrcalc_msg "" /begin OUT_MEASUREMENT CoDT_trq CoDT_trqGbx /end OUT_MEASUREMENT /end FUNCTION
/begin FUNCTION codt_prptrqcurrcalc_uic "" /begin OUT_MEASUREMENT CoDT_trqActAcs_mp /end OUT_MEASUREMENT /end FUNCTION
/begin FUNCTION codt_prptrqrngcalc "Bereitstellung Momentenintervall"
 /begin DEF_CHARACTERISTIC CoDT_tiOvrRunDebNeg_C CoDT_tiOvrRunDebPos_C CoDT_swtCrCtlNoComp_C CoDT_tiCompDwn_C CoDT_tiCompUp_C CoDT_tiFltPT1_C CoDT_trqMinInit_C /end DEF_CHARACTERISTIC
/end FUNCTION
/begin FUNCTION codt_prptrqrngcalc_msg ""
 /begin OUT_MEASUREMENT CoDT_trqAcsMin CoDT_trqGbxMax CoDT_trqGbxMin CoDT_trqMax CoDT_trqMin CoDT_trqMinInr /end OUT_MEASUREMENT
/end FUNCTION
/begin FUNCTION codt_prptrqrngcalc_uic ""
 /begin OUT_MEASUREMENT CoDT_stPrpOvrRun_mp CoDT_trqAcsMax_mp CoDT_trqAcsRaw_mp CoDT_trqAcs_mp /end OUT_MEASUREMENT
/end FUNCTION
/begin FUNCTION coeng "Motorkoordinator"
 /begin DEF_CHARACTERISTIC CoEng_facCorValTot_C CoEng_facCorVal_C CoEng_rhoFuel_C CoEng_tiResetTO_C CoEng_tiT15heal_C /end DEF_CHARACTERISTIC
/end FUNCTION
/begin FUNCTION coeng_actrprt "Steuerung Stellerschutz" /begin DEF_CHARACTERISTIC CoEng_nActrRelease_C CoEng_tiActrPrt_C /end DEF_CHARACTERISTIC /end FUNCTION
/begin FUNCTION coeng_aftrun ""
 /begin DEF_CHARACTERISTIC CoEng_tiAftRun_ImmCtl_C CoEng_tiEep_ImmCtl_C CoEng_tiMinAftRun_C CoEng_tiPwrStgDiaRdy_C CoEng_tiSOPTstRdy_C CoEng_tiTVAClsd_C CoEng_tiTVAOpn_C /end DEF_CHARACTERISTIC
/end FUNCTION
/begin FUNCTION coeng_aftrunextwait "Warten auf externe Ereignisse während Nachlauf" /begin DEF_CHARACTERISTIC CoEng_ExtWaitMsk_C /end DEF_CHARACTERISTIC /end FUNCTION
/begin FUNCTION coeng_aftrunextwait_uic "" /end FUNCTION
/begin FUNCTION coeng_aftrun_uic "" /begin OUT_MEASUREMENT CoEng_stEEPStore_mp /end OUT_MEASUREMENT /end FUNCTION
/begin FUNCTION coeng_flconsum_var "" /begin DEF_CHARACTERISTIC CoEng_tiPT1_C CoEng_swtFlConsDsplVal_C /end DEF_CHARACTERISTIC /end FUNCTION
/begin FUNCTION coeng_flconsum_var_msg "" /begin OUT_MEASUREMENT CoEng_dvolFlConsumFlt /end OUT_MEASUREMENT /end FUNCTION
/begin FUNCTION coeng_mon "Abschaltkoordinator"
 /begin DEF_CHARACTERISTIC CoEng_stIRevShutOff_C CoEng_stRevShutOff_C CoEng_stShOffAirbFrnt_C CoEng_stShOffAirbFuel_C CoEng_stShOffAirbRear_C CoEng_stShOffAirbSide_C CoEng_stShOffCompTst_C CoEng_stShOffEcomatic_C CoEng_stShOffIRevSys_C CoEng_stShOffIRevVeh_C CoEng_stShOffIrrCmb_C CoEng_stShOffOvrSpd_C CoEng_stShOffRevSys_C CoEng_stShOffRevVeh_C CoEng_stShOffRlOvrBar_C CoEng_stShOffSV_C CoEng_stShOffTMFWRev_C CoEng_stShOffTSCCod_C /end DEF_CHARACTERISTIC
/end FUNCTION
/begin FUNCTION coeng_msg ""
 /begin OUT_MEASUREMENT CoEng_dvolFlConsAll CoEng_dvolFlConsAllTot CoEng_dvolFlConsum CoEng_facAdj CoEng_stAftRun CoEng_stAftRunPath CoEng_stEng CoEng_stEngOld CoEng_stENGSlpInd CoEng_stExtWait CoEng_stIRevShutOff CoEng_stMonActrPrt CoEng_stMonShOff CoEng_stPwrStgEnaCond CoEng_stRevShutOff CoEng_stShutOff CoEng_stShutOffPath CoEng_stTMFWShOff CoEng_stTrqLimErr CoEng_stTVAClsd CoEng_tiAfterrun CoEng_tiNormal CoEng_tiStandby CoEng_tiStart CoEng_trqInrCurrFast CoEng_trqInrLim CoEng_trqInrLimDyn CoEng_trqInrLimLead CoEng_trqInrLimStat CoEng_trqLimBit CoEng_trqLimBitSwt CoEng_trqLimCorr CoEng_trqLimErr CoEng_trqLimSwt CoEng_trqSlpLim CoEng_volFlConsAll CoEng_volFlConsDspl /end OUT_MEASUREMENT
/end FUNCTION
/begin FUNCTION coeng_ovrruncoord "Schubkoordinator"
 /begin DEF_CHARACTERISTIC CoEng_FBCfacActv_C CoEng_ZFCfacActv_C CoEng_ALSfacActv_C CoEng_TAAfacActv_C CoEng_stCoopCapbl_C CoEng_tiOvrRunCoordDebPos_C /end DEF_CHARACTERISTIC
/end FUNCTION
/begin FUNCTION coeng_ovrruncoord_msg "" /begin OUT_MEASUREMENT CoEng_stOvrRunCoord /end OUT_MEASUREMENT /end FUNCTION
/begin FUNCTION coeng_ovrruncoord_uic ""
 /begin OUT_MEASUREMENT CoEng_CoordPrioALS_mp CoEng_CoordPrioFBC_mp CoEng_CoordPrioTAA_mp CoEng_CoordPrioZFC_mp CoEng_stCoordALS_mp CoEng_stCoordFBC_mp CoEng_stCoordTAA_mp CoEng_stCoordZFC_mp /end OUT_MEASUREMENT
/end FUNCTION
/begin FUNCTION coeng_pwrstgstatecalc "Endstufenkoordinator" /begin DEF_CHARACTERISTIC CoEng_uLowBattPwrStg_C /end DEF_CHARACTERISTIC /end FUNCTION
/begin FUNCTION coeng_pwrstgstatecalc_uic "" /end FUNCTION
/begin FUNCTION coeng_shoff "Abstellsteuerung im Nachlauf"
 /begin DEF_CHARACTERISTIC CoEng_nTVAClsd_C CoEng_pTVAClsd_C CoEng_qTVAClsd_C CoEng_stShOffAftRun_C CoEng_stSoftShOffAR_C CoEng_tiSoftShOff_C /end DEF_CHARACTERISTIC
/end FUNCTION
/begin FUNCTION coeng_shoff_msg "" /end FUNCTION
/begin FUNCTION coeng_shoff_uic "" /end FUNCTION
/begin FUNCTION coeng_sttrqlimcalc "" /end FUNCTION
/begin FUNCTION coeng_sttrqlimcalc_msg "" /begin OUT_MEASUREMENT CoEng_rTrq CoEng_stCurrLimActive CoEng_trqInrCurrLim /end OUT_MEASUREMENT /end FUNCTION
/begin FUNCTION coeng_sttrqlimcalc_uic "" /begin OUT_MEASUREMENT CoEng_trqInrGearbxInMax_mp CoEng_trqInrPrpLimErr_mp /end OUT_MEASUREMENT /end FUNCTION
/begin FUNCTION coeng_tmfwshoff "Abschaltanforderung für das Zweimassenschwungrades"
 /begin DEF_CHARACTERISTIC CoEng_nThresTMFWSync_C CoEng_nThresTMFW_C CoEng_tiDebTMFW_C /end DEF_CHARACTERISTIC
/end FUNCTION
/begin FUNCTION coeng_trqcalc "Motormomentenberechnung" /begin DEF_CHARACTERISTIC CoEng_trqOffs_CUR CoEng_trqOvrRunThres_C /end DEF_CHARACTERISTIC /begin IN_MEASUREMENT Eng_nAvrg /end IN_MEASUREMENT /end FUNCTION
/begin FUNCTION coeng_trqcalclead "" /end FUNCTION
/begin FUNCTION coeng_trqcalclead_uic ""
 /begin OUT_MEASUREMENT CoEng_trqInrCurrFastBase_mp CoEng_trqInrDesFastBase_mp CoEng_trqInrDrvSlowBase_mp CoEng_trqInrPCtl_mp /end OUT_MEASUREMENT
/end FUNCTION
/begin FUNCTION coeng_trqcalc_msg ""
 /begin OUT_MEASUREMENT CoEng_nMax CoEng_nMin CoEng_stOvrRun CoEng_trq CoEng_trqInrAct CoEng_trqInrActDrv CoEng_trqInrCurr CoEng_trqInrDes CoEng_trqInrDesFast CoEng_trqInrDesSlow CoEng_trqInrDrvSlow CoEng_trqInrLimDes CoEng_trqInrLtd CoEng_trqInrLtdDrv CoEng_trqInrPCtl CoEng_trqInrPCtlULtd CoEng_trqInrRaw CoEng_trqInrSet CoEng_trqLiLtd CoEng_trqLoss CoEng_trqMax CoEng_trqMin CoEng_trqOffs CoEng_trqSetASDUnLim /end OUT_MEASUREMENT
/end FUNCTION
/begin FUNCTION coeng_trqcalc_uic ""
 /begin OUT_MEASUREMENT CoEng_trqASDdcGvnr_mp CoEng_trqInrCurrPre_mp CoEng_trqInrDesSlowBase_mp CoEng_trqInrRawPre_mp CoEng_trqLimASDdc_mp CoEng_trqLimOffs_mp CoEng_trqMinInMax_mp /end OUT_MEASUREMENT
/end FUNCTION
/begin FUNCTION coeng_trqcalc_var "" /begin DEF_CHARACTERISTIC CoEng_trqSwtOff_C /end DEF_CHARACTERISTIC /end FUNCTION
/begin FUNCTION coeng_trqcalc_var_uic "" /end FUNCTION
/begin FUNCTION coeng_trqlim "Momentenbegrenzung als Motormoment"
 /begin DEF_CHARACTERISTIC CoEng_dtrqLimBitUp_C CoEng_dtrqLimBitDwn_C CoEng_dtrqLimUp_C CoEng_dtrqLimDwn_C CoEng_facAdjDfl_C CoEng_facAdjMax_C CoEng_facAdjMin_C CoEng_trqLimBit_CUR CoEng_trqLimErr_CUR /end DEF_CHARACTERISTIC
 /begin IN_MEASUREMENT Eng_nAvrg /end IN_MEASUREMENT
/end FUNCTION
/begin FUNCTION coeng_trqlim_uic "" /begin OUT_MEASUREMENT CoEng_facAdj_mp CoEng_trqLimMin_mp /end OUT_MEASUREMENT /end FUNCTION
/begin FUNCTION coeng_trqlim_var "" /end FUNCTION
/begin FUNCTION coeng_trqlim_var_uic "" /begin OUT_MEASUREMENT CoEng_trqLimMax_mp /end OUT_MEASUREMENT /end FUNCTION
/begin FUNCTION coeng_trqslplim "Begrenzungsmoment für Rauchbegrenzung nach Turboschubbegrenzung"
 /begin DEF_CHARACTERISTIC CoEng_APdtrqSlpLimDwn_CUR CoEng_APdtrqSlpLimUp_CUR CoEng_ATCor_CUR CoEng_nSlpLimMax_C CoEng_nSlpLimMin_C CoEng_stGearLim_C CoEng_swtKickDwn_C CoEng_trqnoKickDwn_C CoEng_trqSlpLimMax_C CoEng_trqSlpLimMin_C /end DEF_CHARACTERISTIC
 /begin IN_MEASUREMENT APSCD_pVal IATSCD_tAir /end IN_MEASUREMENT
/end FUNCTION
/begin FUNCTION coeng_trqslplim_uic "" /begin DEF_CHARACTERISTIC CoEng_trqSlpLim_Vector CoEng_trqSlpLim_Channel /end DEF_CHARACTERISTIC
 /begin OUT_MEASUREMENT CoEng_stSlpLim_mp CoEng_trqOutRamp_mp CoEng_trqSlpLimByp_mp /end OUT_MEASUREMENT
/end FUNCTION
/begin FUNCTION coeng_tstco "Motortestkoordinator" /begin DEF_CHARACTERISTIC CoEng_tiTstMax_C /end DEF_CHARACTERISTIC /end FUNCTION
/begin FUNCTION coeng_tstco_msg "" /begin OUT_MEASUREMENT CoEng_stCompTst CoEng_stTst /end OUT_MEASUREMENT /end FUNCTION
/begin FUNCTION coeng_uic ""
 /begin OUT_MEASUREMENT CoEng_dvolPerStroke_mp CoEng_qSetUnBalTrim_mp CoEng_qTotTrim_mp CoEng_volFlConsAllDT_mp CoEng_volFlConsAllTotDT_mp CoEng_volFlConsAllTot_mp CoEng_volFlConsTotDT_mp CoEng_volFlConsTot_mp /end OUT_MEASUREMENT
/end FUNCTION
/begin FUNCTION coeng_var "" /end FUNCTION
/begin FUNCTION coeng_var_ers "" /end FUNCTION
/begin FUNCTION coeng_var_ers_msg "" /end FUNCTION
/begin FUNCTION coeng_var_ers_uic "" /end FUNCTION
/begin FUNCTION comvar_msg "" /begin OUT_MEASUREMENT ComVar_stDebClaEn ComVar_stK2Com ComVar_swtRemote /end OUT_MEASUREMENT /end FUNCTION
/begin FUNCTION conf_proj "" /end FUNCTION
/begin FUNCTION convcd_co "Komponententreiber zur Mapping Funktion auf Struktur"
 /begin DEF_CHARACTERISTIC ConvCD_DebConvErrDef_C ConvCD_DebConvErrOk_C ConvCD_DebPlaDef_C ConvCD_DebPlaOk_C ConvCD_tiDebPos_C ConvCD_tiDebNeg_C ConvCD_DebSigDef_C ConvCD_DebSigOk_C ConvCD_numStepDef_C ConvCD_numStepOK_C ConvCD_stDflVal_C ConvCD_stGripCtlAST_C ConvCD_swtSigVal_C ConvCD_tiGearShft_C /end DEF_CHARACTERISTIC
/end FUNCTION
/begin FUNCTION convcd_co_chkd "" /begin DEF_CHARACTERISTIC ConvCD_swtInv_C /end DEF_CHARACTERISTIC /end FUNCTION
/begin FUNCTION convcd_co_uic "" /begin OUT_MEASUREMENT ConvCD_ctClutchDfct_mp /end OUT_MEASUREMENT /end FUNCTION
/begin FUNCTION convcd_ils "Interlock Komponententreiber"
 /begin DEF_CHARACTERISTIC ConvCD_tiIlsDigInDebNeg_C ConvCD_tiIlsDigInDebPos_C ConvCD_stIlsDigInvIn_C ConvCD_swtIlsDigInPVal_C ConvCD_swtIlsDigInPType_C /end DEF_CHARACTERISTIC
/end FUNCTION
/begin FUNCTION convcd_ils_uic "" /end FUNCTION
/begin FUNCTION convcd_msg ""
 /begin OUT_MEASUREMENT ConvCD_stClth ConvCD_stClutchRecord ConvCD_stIlsDebVal ConvCD_stIlsRawVal ConvCD_stIntDebVal ConvCD_stLastDebVal ConvCD_stLastGear ConvCD_stOldGear ConvCD_stRawVal ConvCD_swtIlsDigInPVal ConvCD_swtSig /end OUT_MEASUREMENT
/end FUNCTION
/begin FUNCTION conv_grip "" /end FUNCTION
/begin FUNCTION conv_grip_msg "" /begin OUT_MEASUREMENT Conv_rTrans /end OUT_MEASUREMENT /end FUNCTION
/begin FUNCTION cotscd "Komponententreiber der Wassertemperatur am Kühleraustritt"
 /begin DEF_CHARACTERISTIC COTSCD_uSRCMin_C COTSCD_uSRCMax_C COTSCD_tLin_CUR COTSCD_DebSRCHighDef_C COTSCD_DebSRCHighOk_C COTSCD_DebSRCLowDef_C COTSCD_DebSRCLowOk_C COTSCD_dtRmpSlpUp_C COTSCD_dtRmpSlpDwn_C COTSCD_stSensIDWord_C COTSCD_tDfl_C /end DEF_CHARACTERISTIC
 /begin IN_MEASUREMENT COTSCD_uRaw /end IN_MEASUREMENT
/end FUNCTION
/begin FUNCTION cotscd_msg "" /begin OUT_MEASUREMENT COTSCD_tClnt COTSCD_tClntLin COTSCD_uRaw /end OUT_MEASUREMENT /end FUNCTION
/begin FUNCTION coveh_acsmng "Koordination Nebenaggregate"
 /begin DEF_CHARACTERISTIC CoVeh_DCTClutch_C CoVeh_dnLvlDfl_C CoVeh_dnLvlMax_C CoVeh_dnLvlMin_C CoVeh_nEngOffset_C CoVeh_nENGOther_C CoVeh_nENGStep1_C CoVeh_nENGStep2_C CoVeh_nRmpSlpUp_C CoVeh_nRmpSlpDwn_C CoVeh_nRgn_CUR CoVeh_rVnThreshold_C CoVeh_stCalcRgnMsk1_C CoVeh_swtDfpLvl2Ena_C CoVeh_swtDriver_C CoVeh_swtEnableRequest_C CoVeh_swtRampFree_C CoVeh_swtTxLvl2_C /end DEF_CHARACTERISTIC
 /begin IN_MEASUREMENT Eng_tEng /end IN_MEASUREMENT
/end FUNCTION
/begin FUNCTION coveh_acsmng_msg ""
 /begin OUT_MEASUREMENT CoVeh_nAcsMax CoVeh_nAcsMin CoVeh_nAcsMinRequest CoVeh_nRgnIdle CoVeh_nRmpAcsMin CoVeh_pwrAcsDes CoVeh_pwrAcsLead CoVeh_stLIInc CoVeh_trqAcs CoVeh_trqAcsDes CoVeh_trqAcsLead CoVeh_trqAcsPerm CoVeh_trqAcsTemp /end OUT_MEASUREMENT
/end FUNCTION
/begin FUNCTION coveh_acsmng_uic ""
 /begin OUT_MEASUREMENT CoVeh_dnLvl1_mp CoVeh_dnLvl2_mp CoVeh_nENGMax_mp CoVeh_nRampDes_mp CoVeh_stDem_mp CoVeh_stRampFreeAuto_mp CoVeh_stRampFreeManuell_mp CoVeh_stRampFree_mp CoVeh_swtStep1_mp CoVeh_swtStep2_mp /end OUT_MEASUREMENT
/end FUNCTION
/begin FUNCTION coveh_drvtrnord "Auftrag für Antrieb"
 /begin DEF_CHARACTERISTIC CoVeh_dtrqEPBUp_C CoVeh_dtrqEPBDwn_C CoVeh_dtrqLimDwn_C CoVeh_dtrqLimUp_C CoVeh_rAPP_C CoVeh_tiAccPedDly_C CoVeh_trqLimSafe_CUR CoVeh_trqLim_CUR CoVeh_vMax_C /end DEF_CHARACTERISTIC
 /begin IN_MEASUREMENT AccPed_rChkdVal Eng_nAvrg /end IN_MEASUREMENT
/end FUNCTION
/begin FUNCTION coveh_drvtrnordlead_uic "" /begin DEF_CHARACTERISTIC CoVeh_trqPrpLead_Vector CoVeh_trqPrpLead_Channel /end DEF_CHARACTERISTIC
 /begin OUT_MEASUREMENT CoVeh_stActSafe_mp CoVeh_stInputs_mp CoVeh_stSelfhold_mp CoVeh_stState_mp CoVeh_stThres_mp CoVeh_trqLimSafe_mp CoVeh_trqPrpLimErrAct_mp /end OUT_MEASUREMENT
/end FUNCTION
/begin FUNCTION coveh_drvtrnord_msg ""
 /begin OUT_MEASUREMENT CoVeh_nMax CoVeh_nMin CoVeh_stOrd CoVeh_trqPrpDes CoVeh_trqPrpDrv CoVeh_trqPrpLead CoVeh_trqPrpLimErr CoVeh_trqPrpPCtl /end OUT_MEASUREMENT
/end FUNCTION
/begin FUNCTION coveh_drvtrnord_uic "" /begin DEF_CHARACTERISTIC CoVeh_trqPrpDes_Vector CoVeh_trqPrpDes_Channel /end DEF_CHARACTERISTIC /end FUNCTION
/begin FUNCTION coveh_idlestop ""
 /begin DEF_CHARACTERISTIC CoVeh_nEcoLoLim_C CoVeh_nEcoTVAShOffThres_C CoVeh_swtEcoErrEngOff_C CoVeh_swtEco_C CoVeh_swtStrtBitDelete_C CoVeh_tEcoClntThres_C CoVeh_tiMaxDef_C CoVeh_tiMaxOk_C CoVeh_tiEcoTO_C CoVeh_tiEngSpdThresMon_C /end DEF_CHARACTERISTIC
/end FUNCTION
/begin FUNCTION coveh_idlestop_msg ""
 /begin OUT_MEASUREMENT CoVeh_stEcoCoEngNrmToStrt CoVeh_stEcomaticOut CoVeh_stEcoStart CoVeh_stEcoTVAShOff /end OUT_MEASUREMENT
/end FUNCTION
/begin FUNCTION coveh_idlestop_uic "" /begin OUT_MEASUREMENT CoVeh_stEcomatic_mp /end OUT_MEASUREMENT /end FUNCTION
/begin FUNCTION covm_demcheck "Vortriebsstabilisierungsprüfung"
 /begin DEF_CHARACTERISTIC CoVM_amMAX_C CoVM_swtSlipCtlVal_C CoVM_swtSlipCtlType_C CoVM_tiDCShighDefect_C CoVM_tiDCShighOK_C CoVM_tiDCSplauDefect_C CoVM_tiDCSplauOK_C CoVM_vGS_L_C /end DEF_CHARACTERISTIC
/end FUNCTION
/begin FUNCTION covm_demcheck_msg "" /begin OUT_MEASUREMENT CoVM_stDemCheck CoVM_swtSlipCtl /end OUT_MEASUREMENT /end FUNCTION
/begin FUNCTION covm_demcheck_uic "" /begin OUT_MEASUREMENT CoVM_amAKT_mp /end OUT_MEASUREMENT /end FUNCTION
/begin FUNCTION covm_demcord "Anforderungskoordination"
 /begin DEF_CHARACTERISTIC CoVM_dtrqLeadCorUp_C CoVM_dtrqLeadCorDwn_C CoVM_tiTrqRedMax_C /end DEF_CHARACTERISTIC
/end FUNCTION
/begin FUNCTION covm_demcordlead_uic "" /begin OUT_MEASUREMENT CoVM_trqLeadIncMax_mp /end OUT_MEASUREMENT /end FUNCTION
/begin FUNCTION covm_demcord_msg ""
 /begin OUT_MEASUREMENT CoVM_stActDem CoVM_stOrd CoVM_trqGearbxMax CoVM_trqGearbxMin CoVM_trqPrpDes CoVM_trqPrpDrv CoVM_trqPrpLead CoVM_trqPrpPCtl /end OUT_MEASUREMENT
/end FUNCTION
/begin FUNCTION covm_demcord_uic "" /begin OUT_MEASUREMENT CoVM_trqDesIncMax_mp /end OUT_MEASUREMENT /end FUNCTION
/begin FUNCTION covm_stabdem "Vortriebsstabilisierung"
 /begin DEF_CHARACTERISTIC CoVM_dtrqRmpSlpUpDCS_C CoVM_dtrqRmpSlpDwnDCS_C CoVM_dtrqRmpSlpUpTCS_C CoVM_dtrqRmpSlpDwnTCS_C CoVM_trqToB_C /end DEF_CHARACTERISTIC
/end FUNCTION
/begin FUNCTION covm_stabdem_msg "" /begin OUT_MEASUREMENT CoVM_stDCS CoVM_stTCS CoVM_trqDec CoVM_trqInc /end OUT_MEASUREMENT /end FUNCTION
/begin FUNCTION covm_stabdem_uic "" /begin OUT_MEASUREMENT CoVM_trqDecDfl_mp CoVM_trqIncDfl_mp /end OUT_MEASUREMENT /end FUNCTION
/begin FUNCTION crccd "Komponententreiber des Bedienteils der  Fahrgeschwindigkeitsregelung"
 /begin DEF_CHARACTERISTIC CrCCD_tiFGADebNeg_C CrCCD_tiFGADebPos_C CrCCD_tiFGLDebNeg_C CrCCD_tiFGLDebPos_C CrCCD_tiFGPDebNeg_C CrCCD_tiFGPDebPos_C CrCCD_tiFGWDebNeg_C CrCCD_tiFGWDebPos_C CrCCD_stFGASwtInvIn_C CrCCD_stFGLSwtInvIn_C CrCCD_stFGPSwtInvIn_C CrCCD_stFGWSwtInvIn_C CrCCD_stPanelVer_C CrCCD_swtCCTLEna_C CrCCD_swtInvCancel_C CrCCD_swtSetKeyRes_C CrCCD_swtSetKeyTip_C CrCCD_tiPanDetDel_C CrCCD_tmrDecAcc_C CrCCD_tmrMaxAct_C CrCCD_tmrMaxKeyDel_C CrCCD_tmrMinAct_C CrCCD_tmrMinHwNotAct_C CrCCD_tmrMinNotAct_C CrCCD_tmrSetRes_C /end DEF_CHARACTERISTIC
/end FUNCTION
/begin FUNCTION crccd_msg ""
 /begin OUT_MEASUREMENT CrCCD_stCrErr CrCCD_stCrPan CrCCD_stKey CrCCD_stKeySig CrCCD_stMainSwitchOff CrCCD_stPanelErr CrCCD_stPanelVer CrCCD_stPlsPanErr /end OUT_MEASUREMENT
/end FUNCTION
/begin FUNCTION crccd_uic "" /begin DEF_CHARACTERISTIC CrCtl_stBlocking_Vector CrCtl_stBlocking_Channel /end DEF_CHARACTERISTIC
 /begin OUT_MEASUREMENT CrCCD_stFourPosPressed_mp CrCCD_stReadyOff_mp CrCCD_stReadyOn_mp CrCtl_stBlockingByp_mp /end OUT_MEASUREMENT
/end FUNCTION
/begin FUNCTION crctl_msg ""
 /begin OUT_MEASUREMENT CrCtl_aAct CrCtl_aDecDemVal CrCtl_rSlpRes CrCtl_rVnBeg CrCtl_stActive CrCtl_stBlocking CrCtl_stDecDemRls CrCtl_stESPRls CrCtl_stKeyStateSig CrCtl_stOpFunc CrCtl_stShutOff CrCtl_stShutOffirev CrCtl_stShutOffrev CrCtl_stStateMch CrCtl_stStateMchSub CrCtl_stStateP CrCtl_stSwitchSig CrCtl_swtAAG CrCtl_trqDes CrCtl_trqLead CrCtl_trqLimAct CrCtl_vAlwMin CrCtl_vCompare CrCtl_vSetPointTrgt /end OUT_MEASUREMENT
/end FUNCTION
/begin FUNCTION crctl_plus "Function to provide extra braking torque by sending the information to ESP-ECU"
 /begin DEF_CHARACTERISTIC CrCtl_aDecDemDecP_MAP CrCtl_aDecDemHoldP_CUR CrCtl_aDecDemOvRdP_CUR CrCtl_aDecDemResAbvP_CUR CrCtl_tiDebLmpDefDef_C CrCtl_tiDebLmpDefOk_C CrCtl_tiDebTlrDefDef_C CrCtl_tiDebTlrDefOk_C CrCtl_facUpDecP_C CrCtl_facDwnDecP_C CrCtl_facUpOvRdP_C CrCtl_facDwnOvRdP_C CrCtl_facUpResAbvP_C CrCtl_facDwnResAbvP_C CrCtl_rFltMaxAlwP_C CrCtl_swtAAGVal_C CrCtl_swtAAGType_C CrCtl_tiDecDelayP_C CrCtl_tiRmpDwnP_C CrCtl_DebtiShutOffMaxDef_C CrCtl_DebtiShutOffMaxOk_C CrCtl_DebtiShutOffMinDef_C CrCtl_DebtiShutOffMinOk_C CrCtl_DebtiShutOffNplDef_C CrCtl_DebtiShutOffNplOk_C CrCtl_tmrDecDelayP_C CrCtl_trqMinAlwP_C CrCtl_vAlwDvtThresP_C CrCtl_vAlwMaxP_C /end DEF_CHARACTERISTIC
 /begin IN_MEASUREMENT CrCtl_vDecDemHoldP_mp CrCtl_vDecDemP_mp CrCtl_vDecOvRdP_mp CrCtl_vDecResAbvP_mp VSSCD_v /end IN_MEASUREMENT
/end FUNCTION
/begin FUNCTION crctl_shutoff "FGR-Abschaltung"
 /begin DEF_CHARACTERISTIC CrCtl_aDecShutOff_C CrCtl_DebCrCtlPanErrDef_C CrCtl_DebCrCtlPanErrOK_C CrCtl_DebCrCtlPanSwtErrDef_C CrCtl_DebCrCtlPanSwtErrOK_C CrCtl_facFabVdu_C CrCtl_nShutOffMax_C CrCtl_nShutOffMin_C CrCtl_rVnDvtAbs_C CrCtl_rVnDvtShutOff_C CrCtl_stPanelErr_C CrCtl_stPanErrHdlActv_C CrCtl_stRevShutOff_C CrCtl_tiBABShutOff_C CrCtl_tiBattShutOff_C CrCtl_tiDCSShutOff_C CrCtl_tiDecShutOff_C CrCtl_tiDevShutOff_C CrCtl_tiEDSShutOff_C CrCtl_tiEPBAct_C CrCtl_tiFDRShutOff_C CrCtl_tiMainSwitchOff_C CrCtl_tiMsgTOTemp_C CrCtl_tiTCSShutOff_C CrCtl_trqMax_C CrCtl_uShutOff_C CrCtl_vAlwMax_C CrCtl_vAlwMinAus_C CrCtl_vDevShutOff_C CrCtl_vFabVdg_C CrCtl_vFabVdk_C CrCtl_vMindelta_C /end DEF_CHARACTERISTIC
/end FUNCTION
/begin FUNCTION crctl_state "Zustandsautomat Fahrgeschwindigkeitsregelung"
 /begin DEF_CHARACTERISTIC CrCtl_aAcc_CUR CrCtl_AccPKp_C CrCtl_AccPKpPos_C CrCtl_AccPKpNeg_C CrCtl_AccPWinPos_C CrCtl_AccPWinNeg_C CrCtl_aDec_CUR CrCtl_aEnmBod_C CrCtl_aResAbvAct_MAP CrCtl_aResBelAct_MAP CrCtl_DecPKp_C CrCtl_DecPKpPos_C CrCtl_DecPKpNeg_C CrCtl_DecPWinPos_C CrCtl_DecPWinNeg_C CrCtl_facEnmPem_C CrCtl_facEnmRsu_C CrCtl_facEnpBou_C CrCtl_facEnpFmg_C CrCtl_facEnpFmk_C CrCtl_facEnpPaw_C CrCtl_facEnpRsu_C CrCtl_facOffRas_C CrCtl_facOffRsb_C CrCtl_facParCor_CUR CrCtl_facSlpAccCor_CUR CrCtl_facSlpDecCor_CUR CrCtl_facSlpHoldCor_CUR CrCtl_facSlpResAbvCor_CUR CrCtl_facSlpResBelCor_CUR CrCtl_facWaPav_C CrCtl_HoldIKi_C CrCtl_HoldIKiPos_C CrCtl_HoldIKiNeg_C CrCtl_HoldIWinPos_C CrCtl_HoldIWinNeg_C CrCtl_HoldPKp_C CrCtl_HoldPKpPos_C CrCtl_HoldPKpNeg_C CrCtl_HoldPWinPos_C CrCtl_HoldPWinNeg_C CrCtl_ResHoldIKi_C CrCtl_ResHoldIKiPos_C CrCtl_ResHoldIKiNeg_C CrCtl_ResHoldIWinPos_C CrCtl_ResHoldIWinNeg_C CrCtl_ResHoldPKp_C CrCtl_ResHoldPKpPos_C CrCtl_ResHoldPKpNeg_C CrCtl_ResHoldPWinPos_C CrCtl_ResHoldPWinNeg_C CrCtl_ResPKp_C CrCtl_ResPKpPos_C CrCtl_ResPKpNeg_C CrCtl_ResPWinPos_C CrCtl_ResPWinNeg_C CrCtl_rSlpRes_MAP CrCtl_stIRevCutOff_C CrCtl_stIRevRampOne_C CrCtl_stIRevRampTwo_C CrCtl_stRevCutOff_C CrCtl_stRevRampOne_C CrCtl_stRevRampTwo_C CrCtl_swtResSlpSrc_C CrCtl_tiHoldDiffMax_C CrCtl_tmrOffRab_C CrCtl_tmrOffSra_C CrCtl_trqEnpMmp_C CrCtl_trqSetPreCtl_MAP CrCtl_vALLIAV_C CrCtl_vAlwOffSet_C CrCtl_vEnmAvd_C CrCtl_vEnpAvd_C CrCtl_vHoldDiffMax_C CrCtl_vSetPointTrgtdAWD_C CrCtl_vSetPointTrgtdNIVEAU_C CrCtl_vTipLimit_C CrCtl_vTipStep_C /end DEF_CHARACTERISTIC
 /begin IN_MEASUREMENT CoEng_dvolFlConsumFlt CrCtl_rSlpRes CrCtl_vYMapResAbv_mp CrCtl_vYMapResBel_mp DrvTrn_rTransDT VSSCD_a VSSCD_v /end IN_MEASUREMENT
/end FUNCTION
/begin FUNCTION crctl_uic ""
 /begin DEF_CHARACTERISTIC CrCtl_rVnBeg_Vector CrCtl_rVnBeg_Channel CrCtl_stActive_Vector CrCtl_stActive_Channel CrCtl_stKeyStateSig_Vector CrCtl_stKeyStateSig_Channel CrCtl_stOpFunc_Vector CrCtl_stOpFunc_Channel CrCtl_stStateMchSub_Vector CrCtl_stStateMchSub_Channel CrCtl_stStateMch_Vector CrCtl_stStateMch_Channel CrCtl_stSwitchSig_Vector CrCtl_stSwitchSig_Channel CrCtl_trqDes_Vector CrCtl_trqDes_Channel CrCtl_trqLead_Vector CrCtl_trqLead_Channel CrCtl_trqLimAct_Vector CrCtl_trqLimAct_Channel CrCtl_vSetPointTrgt_Vector CrCtl_vSetPointTrgt_Channel /end DEF_CHARACTERISTIC
 /begin OUT_MEASUREMENT CrCtl_aDecDemDecP_mp CrCtl_aDecDemOvRdP_mp CrCtl_aDecDemResAbvP_mp CrCtl_facParCor_mp CrCtl_RmpPtrTempSlpNeg_mp CrCtl_RmpPtrTempSlpPos_mp CrCtl_RmpPtrTempVelSlpNeg_mp CrCtl_RmpPtrTempVelSlpPos_mp CrCtl_RmpPtrTmpSlpNeg_mp CrCtl_RmpPtrTmpSlpPos_mp CrCtl_rVnBegByp_mp CrCtl_stActiveByp_mp CrCtl_stKeyStateSigByp_mp CrCtl_stOpFuncByp_mp CrCtl_stOvRdDet_mp CrCtl_stOvRdP_mp CrCtl_stReady_mp CrCtl_stStateMchByp_mp CrCtl_stStateMchSubByp_mp CrCtl_stSwitchSigByp_mp CrCtl_trqACCGov_mp CrCtl_trqDECGov_mp CrCtl_trqDesByp_mp CrCtl_trqIFrz_mp CrCtl_trqI_mp CrCtl_trqLeadByp_mp CrCtl_trqLimActByp_mp CrCtl_trqP_mp CrCtl_trqRESABVGov_mp CrCtl_trqRESBELGov_mp CrCtl_trqRESBELLim_mp CrCtl_trqSetPreCtl_mp CrCtl_vDecDemHoldP_mp CrCtl_vDecDemP_mp CrCtl_vDecOvRdP_mp CrCtl_vDecResAbvP_mp CrCtl_vRESBELRamp_mp CrCtl_vSetPointTrgtByp_mp CrCtl_vYMapResAbv_mp CrCtl_vYMapResBel_mp /end OUT_MEASUREMENT
/end FUNCTION
/begin FUNCTION crscd "Komponententreiber Kurbelwelle"
 /begin DEF_CHARACTERISTIC CrSCD_ctTurns_C CrSCD_nFast_C CrSCD_nMax_C CrSCD_nMin_C CrSCD_nSlowHigh_C CrSCD_nSlow_C CrSCD_numShftMisf_C CrSCD_phiIncCor_CUR CrSCD_phiSegLength_C CrSCD_phiSegPhase_C /end DEF_CHARACTERISTIC
 /begin IN_MEASUREMENT CrSCD_nAvrg /end IN_MEASUREMENT
/end FUNCTION
/begin FUNCTION crscd_msg ""
 /begin OUT_MEASUREMENT CrSCD_dSegMisf CrSCD_nAvrg CrSCD_nAvrgHiRes CrSCD_nCurr CrSCD_nCurrHiRes CrSCD_nDyn CrSCD_nHold CrSCD_nMisf CrSCD_numSeg CrSCD_phiIncCor CrSCD_phiIncr CrSCD_tiSeg /end OUT_MEASUREMENT
/end FUNCTION
/begin FUNCTION crscd_thresctl ""
 /begin DEF_CHARACTERISTIC CrSCD_ctThresCtlMin_C CrSCD_nThresCtlHigh_C CrSCD_nThresCtlLow_C /end DEF_CHARACTERISTIC
/end FUNCTION
/begin FUNCTION crscd_uic ""
 /begin OUT_MEASUREMENT CrSCD_incNextIntDelta_mp CrSCD_incNextInt_mp CrSCD_phiCurr_mp CrSCD_phiSegGrid_mp CrSCD_stIncErr_mp CrSCD_stIncSig_mp CrSCD_stIncSyncInc_mp CrSCD_stIncSyncPhase_mp /end OUT_MEASUREMENT
/end FUNCTION
/begin FUNCTION crscd_var ""
 /begin DEF_CHARACTERISTIC CrSCD_ctGapIncs_C CrSCD_ctGaps_C CrSCD_ctIncs_C CrSCD_facGapPlausHigh_CUR CrSCD_facGapPlausLow_CUR CrSCD_facIncPlausHigh_CUR CrSCD_facIncPlausLow_CUR CrSCD_numFBCSeg_C CrSCD_numTDCSeg_C CrSCD_phiGap2Zero_C CrSCD_tiPlausCalcOff_C /end DEF_CHARACTERISTIC
 /begin IN_MEASUREMENT CrSCD_tiIncr /end IN_MEASUREMENT
/end FUNCTION
/begin FUNCTION crscd_var_msg "" /begin OUT_MEASUREMENT CrSCD_nIncr CrSCD_tiIncr /end OUT_MEASUREMENT /end FUNCTION
/begin FUNCTION crs_chkstrtspd "Redundanter Start nur mit Kurbelwelle"
 /begin DEF_CHARACTERISTIC CrS_ctMaxInjStrt_C CrS_facSegTimeMax_C CrS_facSegTimeMin_C CrS_facSegTime_C CrS_phiSegLengthStrtSpd_C CrS_phiSegOfsStrtSpdOld_C CrS_phiSegOfsStrtSpd_C /end DEF_CHARACTERISTIC
/end FUNCTION
/begin FUNCTION crs_chkstrtspd_uic ""
 /begin OUT_MEASUREMENT CrS_ctInjStrt_mp CrS_facSegTime_mp CrS_numTDCStrtLst_mp CrS_numTDCStrt_mp CrS_stStrt_mp CrS_tiSegOld_mp CrS_tiSeg_mp /end OUT_MEASUREMENT
/end FUNCTION
/begin FUNCTION ctapcd ""
 /begin DEF_CHARACTERISTIC CtApCD_dcycMax_C CtApCD_dcycMin_C CtApCD_dcycShutOff_C CtApCD_DebExcTempDef_C CtApCD_DebExcTempOk_C CtApCD_DebNoLoadDef_C CtApCD_DebNoLoadOk_C CtApCD_DebShortCircBatDef_C CtApCD_DebShortCircBatOk_C CtApCD_DebShortCircGndDef_C CtApCD_DebShortCircGndOk_C CtApCD_stInvOut_C CtApCD_tiPer_C CtApCD_rTst_C CtApCD_tAirXHi_C CtApCD_tAirXLo_C CtApCD_tClntCanXHi_C CtApCD_tClntCanXLo_C CtApCD_tiBtwTst_C CtApCD_tiCtApcheckDfpTmr_C CtApCD_tiCtApOFFTmr_C CtApCD_tiDelOn_C /end DEF_CHARACTERISTIC
/end FUNCTION
/begin FUNCTION ctapcd_uic "" /begin DEF_CHARACTERISTIC CtApCD_rHWE_mp_Vector CtApCD_rHWE_mp_Channel /end DEF_CHARACTERISTIC /begin OUT_MEASUREMENT CtApCD_rHWE_mp CtApCD_rHWE_mpByp_mp CtApCD_stVarDef_mp /end OUT_MEASUREMENT /end FUNCTION
/begin COMPU_METHOD Acc "Fahrzeugbeschleunigung" RAT_FUNC "%6.5" "[m/s^2]" COEFFS 0 1000 0 0 0 1 /end COMPU_METHOD
/begin COMPU_METHOD AngleCrS "Winkel Kurbelwelle" RAT_FUNC "%6.4" "[deg CrS]" COEFFS 0 42.6666666666667 0 0 0 1 /end COMPU_METHOD
/begin COMPU_METHOD AngMom "Drehimpuls" RAT_FUNC "%6.3" "[Nms]" COEFFS 0 1.953125 0 0 0 1 /end COMPU_METHOD
/begin COMPU_METHOD Dia "Durchmesser des Rades" RAT_FUNC "%7.6" "[m]" COEFFS 0 10000 0 0 0 1 /end COMPU_METHOD
/begin COMPU_METHOD dTrqPrp_20ms "Anstieg Vortriebsmoment im 20 ms Raster" RAT_FUNC "%6.1" "[Nm/s]" COEFFS 0 0.02 0 0 0 1 /end COMPU_METHOD
/begin COMPU_METHOD DtyCyc "Tastverhaeltnis" RAT_FUNC "%6.4" "[%]" COEFFS 0 100 0 0 0 1 /end COMPU_METHOD
/begin COMPU_METHOD dVel_20ms "Anstieg Fahrgeschwindigkeit im 20 ms Raster" RAT_FUNC "%6.3" "[(km/h)/s]" COEFFS 0 2 0 0 0 1 /end COMPU_METHOD
/begin COMPU_METHOD EngN "Motordrehzahl" RAT_FUNC "%6.2" "[rpm]" COEFFS 0 1 0 0 0 1 /end COMPU_METHOD
/begin COMPU_METHOD EngN_HiRes "Motordrehzahl, höhere Auflösung als EngM" RAT_FUNC "%6.4" "[rpm]" COEFFS 0 32 0 0 0 1 /end COMPU_METHOD
/begin COMPU_METHOD Fact "Faktor mit Auflösung 1 / 8192, hauptsächlich für einen Faktorenbereich 0...1 verwendet" RAT_FUNC "%6.5" "[-]" COEFFS 0 8192 0 0 0 1 /end COMPU_METHOD
/begin COMPU_METHOD Fact1 "Faktor mit Auflösung 0,01 (100 mal höherer Bereich als Fact)" RAT_FUNC "%6.4" "[-]" COEFFS 0 128 0 0 0 1 /end COMPU_METHOD
/begin COMPU_METHOD Fact_Inc "Faktor für Inkrement/Gap Plausibilitäts-Fenster" RAT_FUNC "%6.4" "[-]" COEFFS 0 256 0 0 0 1 /end COMPU_METHOD
/begin COMPU_METHOD FlConsum_l_h "Kraftstoffverbrauch" RAT_FUNC "%6.4" "[l/h]" COEFFS 0 100 0 0 0 1 /end COMPU_METHOD
/begin COMPU_METHOD FlConsum_ul "Verbrauchsintegral (in Mikroliter)" RAT_FUNC "%6.2" "[ul]" COEFFS 0 1 0 0 0 1 /end COMPU_METHOD
/begin COMPU_METHOD InjMass "Einspritzmenge" RAT_FUNC "%6.4" "[mg/hub]" COEFFS 0 100 0 0 0 1 /end COMPU_METHOD
/begin COMPU_METHOD InjQnt "Einspritzvolumen/Hub" RAT_FUNC "%6.3" "[mm^3/hub]" COEFFS 0 10 0 0 0 1 /end COMPU_METHOD
/begin COMPU_METHOD Ki_Vel2Nm "Integralverstärkung (Fahrgeschwindigkeit zu Vortriebsmoment)" RAT_FUNC "%6.4" "[Nm/(Km/h)/s]" COEFFS 0 42.94967296 0 0 0 1 /end COMPU_METHOD
/begin COMPU_METHOD Kp_Vel2Nm "Proportionalverstärkung (Fahrgeschwindigkeit zu Vortriebsmoment)" RAT_FUNC "%6.4" "[Nm/Km/h]" COEFFS 0 655.36 0 0 0 1 /end COMPU_METHOD
/begin COMPU_METHOD OneToOne "eins zu eins (physikalischer Wert ist gleich dem internen Wert)" RAT_FUNC "%6.2" "[-]" COEFFS 0 1 0 0 0 1 /end COMPU_METHOD
/begin COMPU_METHOD Period "Periodendauer" RAT_FUNC "%6.3" "[ms]" COEFFS 0 10 0 0 0 1 /end COMPU_METHOD
/begin COMPU_METHOD Per_Dur "Periodendauer Segmentzeit" RAT_FUNC "%6.2" "[usec]" COEFFS 0 1 0 0 0 1 /end COMPU_METHOD
/begin COMPU_METHOD Prc "Prozent, gleiche interne Auflösung wie Fact, aber Darstellung in Prozent (0...100%)" RAT_FUNC "%6.4" "[%]" COEFFS 0 100 0 0 0 1 /end COMPU_METHOD
/begin COMPU_METHOD PrcHigh "Höch prozentanteil auflösung" RAT_FUNC "%6.5" "[%]" COEFFS 0 1000 0 0 0 1 /end COMPU_METHOD
/begin COMPU_METHOD Pres_hPa "Druck (angezeigt in [hPa])" RAT_FUNC "%6.2" "[hPa]" COEFFS 0 1 0 0 0 1 /end COMPU_METHOD
/begin COMPU_METHOD Pwr "Leistung" RAT_FUNC "%6.2" "[W]" COEFFS 0 0.10610329539459 0 0 0 1 /end COMPU_METHOD
/begin COMPU_METHOD RhoFuel "Kraftstoffdichte" RAT_FUNC "%6.3" "[kg/m^3]" COEFFS 0 10 0 0 0 1 /end COMPU_METHOD
/begin COMPU_METHOD RmpAcc "Beschleunigungsrampe - Gradient" RAT_FUNC "%7.6" "[m/s^2/s]" COEFFS 0 65536 0 0 0 1 /end COMPU_METHOD
/begin COMPU_METHOD RmpEngN "Rampengradient für Motordrehzahl" RAT_FUNC "%6.4" "[rpm/s]" COEFFS 0 65.536 0 0 0 1 /end COMPU_METHOD
/begin COMPU_METHOD RmpTemp "Rampengradient für Temperatur" RAT_FUNC "%6.4" "[deg C/s]" COEFFS 0 655.36 0 0 0 1 /end COMPU_METHOD
/begin COMPU_METHOD RmpTrq "Rampengradient für Motormoment" RAT_FUNC "%6.4" "[Nm/s]" COEFFS 0 655.36 0 0 0 1 /end COMPU_METHOD
/begin COMPU_METHOD RmpTrqLow "Momentenrampensteigung für höhere Werte" RAT_FUNC "%6.4" "[Nm/s]" COEFFS 0 131.072 0 0 0 1 /end COMPU_METHOD
/begin COMPU_METHOD RmpTrqPrp "Rampenanstieg für Vortriebsmoment [Nm/s]" RAT_FUNC "%6.4" "[Nm/s]" COEFFS 0 65.536 0 0 0 1 /end COMPU_METHOD
/begin COMPU_METHOD RmpTrqxdHigh "Drehmomentgradient für hohe Rampensteigung (max. 16767 Nm/s)" RAT_FUNC "%6.3" "[Nm/s]" COEFFS 0 2.56 0 0 0 1 /end COMPU_METHOD
/begin COMPU_METHOD RmpVel "Rampengradient für Fahrzeuggeschwindigkeit" RAT_FUNC "%6.5" "[Km/h/s]" COEFFS 0 6553.6 0 0 0 1 /end COMPU_METHOD
/begin COMPU_METHOD Temp_Cels "Temperatur dargestellt in °C (gleiche interne Darstellung wie Temp_Kelv)" RAT_FUNC "%6.1" "[deg C]" COEFFS 0 10 2731.4 0 0 1 /end COMPU_METHOD
/begin COMPU_METHOD TimeDeb "Entprellzeit in Millisekunden für Libraryfunktion Debounce" RAT_FUNC "%6.1" "[ms]" COEFFS 0 0.1 0 0 0 1 /end COMPU_METHOD
/begin COMPU_METHOD TimeDelay_s "Zeitkonstante T1 (in s) für PT1, DT1, etc." RAT_FUNC "%9.3" "[s]" COEFFS 0 0 1 0 0.00023283064365387 0 /end COMPU_METHOD
/begin COMPU_METHOD TimeDT "Abtastzeit (in us) für Library Regler, Filter, etc." RAT_FUNC "%6.2" "[us]" COEFFS 0 1 0 0 0 1 /end COMPU_METHOD
/begin COMPU_METHOD Time_ms "Zeit in ms für Fehlerentprellung (DSM) und SW-Timer" RAT_FUNC "%6.1" "[ms]" COEFFS 0 0.1 0 0 0 1 /end COMPU_METHOD
/begin COMPU_METHOD Time_s "Zeit in s für Fehlerentprellung (DSM) und SW-Timer" RAT_FUNC "%6.4" "[s]" COEFFS 0 100 0 0 0 1 /end COMPU_METHOD
/begin COMPU_METHOD TransR "Übersetzungsverhältnis (Getriebe etc.)" RAT_FUNC "%6.4" "[-]" COEFFS 0 100 0 0 0 1 /end COMPU_METHOD
/begin COMPU_METHOD Trq "Motormoment" RAT_FUNC "%6.3" "[Nm]" COEFFS 0 10 0 0 0 1 /end COMPU_METHOD
/begin COMPU_METHOD TrqPrp "Vortriebsmoment" RAT_FUNC "%6.2" "[Nm]" COEFFS 0 1 0 0 0 1 /end COMPU_METHOD
/begin COMPU_METHOD Vel "Fahrzeuggeschwindigkeit, gleiche interne Auflösung wie Vel_SI" RAT_FUNC "%6.4" "[km/h]" COEFFS 0 100 0 0 0 1 /end COMPU_METHOD
/begin COMPU_METHOD Vel2Nm_2 "Konvertierungsfaktor Fahrgeschwindigkeit in Vortriebsmoment" RAT_FUNC "%6.4" "[Nm/Km/h]" COEFFS 0 86 0 0 0 1 /end COMPU_METHOD
/begin COMPU_METHOD VelToN "Verhältnis Fahrzeuggeschwindigkeit zu Motordrehzahl v/n" RAT_FUNC "%8.7" "[(km/h)/rpm]" COEFFS 0 100000 0 0 0 1 /end COMPU_METHOD
/begin COMPU_METHOD Volt "Spannung in V (von ADC)" RAT_FUNC "%6.2" "[mV]" COEFFS 0 0.2046 0 0 0 1 /end COMPU_METHOD
/begin COMPU_METHOD Volt_Batt "Batteriespannung" RAT_FUNC "%6.1" "[mV]" COEFFS 0 0.0492252911173131 0 0 0 1 /end COMPU_METHOD
/begin RECORD_LAYOUT Kf_Xs16_Ys16_Ws16 NO_AXIS_PTS_X 1 SWORD NO_AXIS_PTS_Y 2 SWORD AXIS_PTS_X 3 SWORD INDEX_INCR DIRECT AXIS_PTS_Y 4 SWORD INDEX_INCR DIRECT FNC_VALUES 5 SWORD COLUMN_DIR DIRECT /end RECORD_LAYOUT
/begin RECORD_LAYOUT Kl_Xs16_Ws16 NO_AXIS_PTS_X 1 SWORD AXIS_PTS_X 2 SWORD INDEX_INCR DIRECT FNC_VALUES 3 SWORD COLUMN_DIR DIRECT /end RECORD_LAYOUT
/begin RECORD_LAYOUT Kw_Ws16 FNC_VALUES 1 SWORD COLUMN_DIR DIRECT /end RECORD_LAYOUT
/begin RECORD_LAYOUT Kw_Ws32 FNC_VALUES 1 SLONG COLUMN_DIR DIRECT /end RECORD_LAYOUT
/begin RECORD_LAYOUT Kw_Ws8 FNC_VALUES 1 SBYTE COLUMN_DIR DIRECT /end RECORD_LAYOUT
/begin RECORD_LAYOUT Kw_Wu16 FNC_VALUES 1 UWORD COLUMN_DIR DIRECT /end RECORD_LAYOUT
/begin RECORD_LAYOUT Kw_Wu32 FNC_VALUES 1 ULONG COLUMN_DIR DIRECT /end RECORD_LAYOUT
/begin RECORD_LAYOUT Kw_Wu8 FNC_VALUES 1 UBYTE COLUMN_DIR DIRECT /end RECORD_LAYOUT
/end MODULE
/end PROJECT
