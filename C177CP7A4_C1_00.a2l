ASAP2_VERSION 1 3
/begin PROJECT C177 "EDC16CP"
/begin HEADER "" VERSION "VCP7A3" PROJECT_NO C177 /end HEADER
/begin MODULE DIM ""
/begin MOD_COMMON "" BYTE_ORDER MSB_FIRST ALIGNMENT_BYTE 1 ALIGNMENT_WORD 2 ALIGNMENT_LONG 4 ALIGNMENT_FLOAT32_IEEE 4 /end MOD_COMMON
/begin CHARACTERISTIC FTSCD_uSRCMin_C "SRC Minimum (Kraftstoffstemperatur)" VALUE 0x1D28C4 Kw_Ws16 5200.391 Volt 0.00 5200.391 FORMAT "%8.3" EXTENDED_LIMITS -160156.4 160151.5 /end CHARACTERISTIC
/begin CHARACTERISTIC FTSCD_uSRCMax_C "SRC Maximum (Kraftstoffstemperatur)" VALUE 0x1D28C6 Kw_Ws16 5200.391 Volt 0.00 5200.391 FORMAT "%8.3" EXTENDED_LIMITS -160156.4 160151.5 /end CHARACTERISTIC
/begin CHARACTERISTIC FTSCD_tLin_CUR "Linearisierungskennlinie der Kraftstoffstemperatur" CURVE 0x1D28C8 Kl_Xs16_Ws16 250.0000 Temp_Cels -50.04000 199.9600 FORMAT "%8.4" EXTENDED_LIMITS -3549.940 3003.560
 /begin AXIS_DESCR STD_AXIS FTSCD_uRaw Volt 25 0.00 5200.391 FORMAT "%8.3" EXTENDED_LIMITS -160156.4 160151.5 DEPOSIT ABSOLUTE /end AXIS_DESCR
/end CHARACTERISTIC
/begin CHARACTERISTIC FTSCD_DebNplDef_C "Defektentprellzeit für  Npl" VALUE 0x1D292E Kw_Wu16 655350.0 Time_ms 0.00 655350.0 FORMAT "%8.1" /end CHARACTERISTIC
/begin CHARACTERISTIC FTSCD_DebNplOk_C "Heilentprellzeit Npl" VALUE 0x1D2930 Kw_Wu16 655350.0 Time_ms 0.00 655350.0 FORMAT "%8.1" /end CHARACTERISTIC
/begin CHARACTERISTIC FTSCD_DebSigDef_C "Defektentprellzeit Signalfehler Kraftstofftemperaturfuehler ueber CAN" VALUE 0x1D2932 Kw_Wu16 655350.0 Time_ms 0.00 655350.0 FORMAT "%8.1" /end CHARACTERISTIC
/begin CHARACTERISTIC FTSCD_DebSigOk_C "Heilungsentprellzeit Signalfehler Kraftstofftemperaturfuehler ueber CAN" VALUE 0x1D2934 Kw_Wu16 655350.0 Time_ms 0.00 655350.0 FORMAT "%8.1" /end CHARACTERISTIC
/begin CHARACTERISTIC FTSCD_DebSRCHighDef_C "FTS Fehlerentprellungszeit fuer SRC-High" VALUE 0x1D2936 Kw_Wu16 655350.0 Time_ms 0.00 655350.0 FORMAT "%8.1" /end CHARACTERISTIC
/begin CHARACTERISTIC FTSCD_DebSRCHighOk_C "FTS Heilungsentprellzeit fuer SRC-High" VALUE 0x1D2938 Kw_Wu16 655350.0 Time_ms 0.00 655350.0 FORMAT "%8.1" /end CHARACTERISTIC
/begin CHARACTERISTIC FTSCD_DebSRCLowDef_C "FTS Fehlerentprellungszeit fuer SRC-Low" VALUE 0x1D293A Kw_Wu16 655350.0 Time_ms 0.00 655350.0 FORMAT "%8.1" /end CHARACTERISTIC
/begin CHARACTERISTIC FTSCD_DebSRCLowOk_C "FTS Heilungsentprellzeit fuer SRC-Low" VALUE 0x1D293C Kw_Wu16 655350.0 Time_ms 0.00 655350.0 FORMAT "%8.1" /end CHARACTERISTIC
/begin CHARACTERISTIC FTSCD_dtRmpSlpUp_C "Aufwärts-Schritt für Rampe" VALUE 0x1D2940 Kw_Wu32 6553599.99847 RmpTemp 0.00 6553599.99847 FORMAT "%13.5" /end CHARACTERISTIC
/begin CHARACTERISTIC FTSCD_dtRmpSlpDwn_C "Abwärts-Schritt für Rampe" VALUE 0x1D2944 Kw_Wu32 6553599.99847 RmpTemp 0.00 6553599.99847 FORMAT "%13.5" /end CHARACTERISTIC
/begin CHARACTERISTIC FTSCD_stPRDY_C "Kraftstofftemperatur Status für Early Readiness" VALUE 0x1D2948 Kw_Ws16 256.0000 OneToOne 0.00 256.0000 FORMAT "%8.4" EXTENDED_LIMITS -32768.00 32767.00 /end CHARACTERISTIC
/begin CHARACTERISTIC FTSCD_tDiff_C "Absolute Kraftstofftemperaturdifferenzschwelle" VALUE 0x1D294A Kw_Ws16 149.9000 TempDiff_Kelv 0.00 149.9000 FORMAT "%8.4" EXTENDED_LIMITS -3276.800 3276.700 /end CHARACTERISTIC
/begin CHARACTERISTIC FTSCD_tImn_C "minimale Kraftstofftemperaturdifferenz" VALUE 0x1D294C Kw_Ws16 149.9000 TempDiff_Kelv 0.00 149.9000 FORMAT "%8.4" EXTENDED_LIMITS -3276.800 3276.700 /end CHARACTERISTIC
/begin CHARACTERISTIC FTSCD_tInt_C "Kraftstofftemperaturdifferenz Integral Schwelle" VALUE 0x1D294E Kw_Ws16 149.9000 TempDiff_Kelv 0.00 149.9000 FORMAT "%8.4" EXTENDED_LIMITS -3276.800 3276.700 /end CHARACTERISTIC
/begin CHARACTERISTIC FTSCD_tiTmn_C "minimale Kraftstofftemperatur DTI Testdauer" VALUE 0x1D2950 Kw_Wu32 100.000000000 TimeEngOn 0.00 100.000000000 FORMAT "%13.9" EXTENDED_LIMITS 0.00 4294967295.00 /end CHARACTERISTIC
/begin CHARACTERISTIC FTSCD_tiT_C "Kraftstofftemperatur DTI Testdauer" VALUE 0x1D2954 Kw_Wu32 500.000000000 TimeEngOn 0.00 500.000000000 FORMAT "%13.9" EXTENDED_LIMITS 0.00 4294967295.00 /end CHARACTERISTIC
/begin CHARACTERISTIC FTSCD_stSensIDWord_C "Geberkennwort Kraftstoffstemperatur" VALUE 0x1D2958 Kw_Wu16 65535.00 OneToOne 0.00 65535.00 FORMAT "%8.2" /end CHARACTERISTIC
/begin CHARACTERISTIC FTSCD_tDfl_C "Vorgabewert Kraftstoffstemperatur" VALUE 0x1D295A Kw_Ws16 250.0000 Temp_Cels -50.04000 199.9600 FORMAT "%8.4" EXTENDED_LIMITS -3549.940 3003.560 /end CHARACTERISTIC
/begin CHARACTERISTIC Gearbx_amASTMax_C "Maximales Integralmoment für den AST Eingriff" VALUE 0x1D29A8 Kw_Wu16 33553.92 AngMom 0.00 33553.92 FORMAT "%8.2" /end CHARACTERISTIC
/begin CHARACTERISTIC Gearbx_ASTCtlPKp_C "Reglerverstärkung Kp für AST-Getriebeeingriff-Kleinsignale" VALUE 0x1D29AC Kw_Wu32 6553.59999847 Kp_rpm2Nm 0.00 6553.59999847 FORMAT "%13.8" /end CHARACTERISTIC
/begin CHARACTERISTIC Gearbx_ASTCtlPKpPos_C "Reglerverstärkung für positive AST-Getriebeeingriff Grosssignale" VALUE 0x1D29B0 Kw_Wu32 6553.59999847 Kp_rpm2Nm 0.00 6553.59999847 FORMAT "%13.8" /end CHARACTERISTIC
/begin CHARACTERISTIC Gearbx_ASTCtlPKpNeg_C "Reglerverstärkung für negative AST-Getriebeeingriff- Grosssignale" VALUE 0x1D29B4 Kw_Wu32 6553.59999847 Kp_rpm2Nm 0.00 6553.59999847 FORMAT "%13.8" /end CHARACTERISTIC
/begin CHARACTERISTIC Gearbx_ASTCtlPWinPos_C "Kleinsignalfenster positiv" VALUE 0x1D29B8 Kw_Ws16 65535.00 EngN -32768.00 32767.00 FORMAT "%8.2" /end CHARACTERISTIC
/begin CHARACTERISTIC Gearbx_ASTCtlPWinNeg_C "Kleinsignalfenster negativ" VALUE 0x1D29BA Kw_Ws16 65535.00 EngN -32768.00 32767.00 FORMAT "%8.2" /end CHARACTERISTIC
/begin CHARACTERISTIC Gearbx_tiDebGearbxMTErrDef_C "Debounce Dauer" VALUE 0x1D2978 Kw_Wu16 655350.0 Time_ms 0.00 655350.0 FORMAT "%8.1" /end CHARACTERISTIC
/begin CHARACTERISTIC Gearbx_tiDebGearbxMTErrOk_C "Fehlerheilungserkennungszeit" VALUE 0x1D297A Kw_Wu16 655350.0 Time_ms 0.00 655350.0 FORMAT "%8.1" /end CHARACTERISTIC
/begin CHARACTERISTIC Gearbx_dtrqRmpSlpUpAST_C "Momentensteigung bei höherem Sollwert" VALUE 0x1D29BC Kw_Wu32 6553594.99817 RmpTrq 5.00030517578 6553599.99847 FORMAT "%13.5" EXTENDED_LIMITS 0.00 6553599.99847 /end CHARACTERISTIC
/begin CHARACTERISTIC Gearbx_dtrqRmpSlpDwnAST_C "Negative Momentensteigung bei niedrigerem Sollwert" VALUE 0x1D29C0 Kw_Wu32 6553594.99817 RmpTrq 5.00030517578 6553599.99847 FORMAT "%13.5" EXTENDED_LIMITS 0.00 6553599.99847 /end CHARACTERISTIC
/begin CHARACTERISTIC Gearbx_dtrqRmpSlpUpTSC_C "Rampensteigung für steigenden Sollwert vom Ersatzwert TSC" VALUE 0x1D29C4 Kw_Wu32 6553594.99817 RmpTrq 5.00030517578 6553599.99847 FORMAT "%13.5" EXTENDED_LIMITS 0.00 6553599.99847 /end CHARACTERISTIC
/begin CHARACTERISTIC Gearbx_dtrqRmpSlpDwnTSC_C "Rampensteigung für fallenden Sollwert vom Ersatzwert TSC" VALUE 0x1D29C8 Kw_Wu32 6553594.99817 RmpTrq 5.00030517578 6553599.99847 FORMAT "%13.5" EXTENDED_LIMITS 0.00 6553599.99847 /end CHARACTERISTIC
/begin CHARACTERISTIC Gearbx_itrqMot_C "Trägheitmoment" VALUE 0x1D29CC Kw_Ws16 5000.000 Moment_Inertia 0.00 5000.000 FORMAT "%8.3" EXTENDED_LIMITS -327.6800 327.6700 /end CHARACTERISTIC
/begin CHARACTERISTIC Gearbx_nASTMax_C "Maximale Drehzahl für Frame Manager Wunschdrehzahl" VALUE 0x1D29CE Kw_Ws16 6000.000 EngN 0.00 6000.000 FORMAT "%8.3" EXTENDED_LIMITS -32768.00 32767.00 /end CHARACTERISTIC
/begin CHARACTERISTIC Gearbx_nASTMin_C "Minimale Drehzahl für Frame Manager Wunschdrehzahl" VALUE 0x1D29D0 Kw_Ws16 6000.000 EngN 0.00 6000.000 FORMAT "%8.3" EXTENDED_LIMITS -32768.00 32767.00 /end CHARACTERISTIC
/begin CHARACTERISTIC Gearbx_rAWDLo_C "Untersetzungsverhältnis des Verteilergetriebes" VALUE 0x1D297C Kw_Ws16 327.6700 TransR 0.00 327.6700 FORMAT "%8.4" EXTENDED_LIMITS -327.6800 327.6700 /end CHARACTERISTIC
/begin CHARACTERISTIC Gearbx_rTrans1_C "Getriebeübersetzung 1. Gang" VALUE 0x1D297E Kw_Ws16 327.6700 TransR 0.00 327.6700 FORMAT "%8.4" EXTENDED_LIMITS -327.6800 327.6700 /end CHARACTERISTIC
/begin CHARACTERISTIC Gearbx_rTrans2_C "Getriebeübersetzung 2. Gang" VALUE 0x1D2980 Kw_Ws16 327.6700 TransR 0.00 327.6700 FORMAT "%8.4" EXTENDED_LIMITS -327.6800 327.6700 /end CHARACTERISTIC
/begin CHARACTERISTIC Gearbx_rTrans3_C "Getriebeübersetzung 3. Gang" VALUE 0x1D2982 Kw_Ws16 327.6700 TransR 0.00 327.6700 FORMAT "%8.4" EXTENDED_LIMITS -327.6800 327.6700 /end CHARACTERISTIC
/begin CHARACTERISTIC Gearbx_rTrans4_C "Getriebeübersetzung 4. Gang" VALUE 0x1D2984 Kw_Ws16 327.6700 TransR 0.00 327.6700 FORMAT "%8.4" EXTENDED_LIMITS -327.6800 327.6700 /end CHARACTERISTIC
/begin CHARACTERISTIC Gearbx_rTrans5_C "Getriebeübersetzung 5. Gang" VALUE 0x1D2986 Kw_Ws16 327.6700 TransR 0.00 327.6700 FORMAT "%8.4" EXTENDED_LIMITS -327.6800 327.6700 /end CHARACTERISTIC
/begin CHARACTERISTIC Gearbx_rTrans6_C "Getriebeübersetzung 6. Gang" VALUE 0x1D2988 Kw_Ws16 327.6700 TransR 0.00 327.6700 FORMAT "%8.4" EXTENDED_LIMITS -327.6800 327.6700 /end CHARACTERISTIC
/begin CHARACTERISTIC Gearbx_rTransR_C "Getriebeübersetzung Rückwärtsgang" VALUE 0x1D298A Kw_Ws16 327.6700 TransR 0.00 327.6700 FORMAT "%8.4" EXTENDED_LIMITS -327.6800 327.6700 /end CHARACTERISTIC
/begin CHARACTERISTIC Gearbx_rVn1H_C "obere Grenze des v/n-Toleranzbandes 1. Gang" VALUE 0x1D298C Kw_Ws16 0.3276700 VelToN 0.00 0.3276700 FORMAT "%9.7" EXTENDED_LIMITS -0.3276800 0.3276700 /end CHARACTERISTIC
/begin CHARACTERISTIC Gearbx_rVn1L_C "untere Grenze des v/n-Toleranzbandes 1. Gang" VALUE 0x1D298E Kw_Ws16 0.3276700 VelToN 0.00 0.3276700 FORMAT "%9.7" EXTENDED_LIMITS -0.3276800 0.3276700 /end CHARACTERISTIC
/begin CHARACTERISTIC Gearbx_rVn2H_C "obere Grenze des v/n-Toleranzbandes 2. Gang" VALUE 0x1D2990 Kw_Ws16 0.3276700 VelToN 0.00 0.3276700 FORMAT "%9.7" EXTENDED_LIMITS -0.3276800 0.3276700 /end CHARACTERISTIC
/begin CHARACTERISTIC Gearbx_rVn2L_C "untere Grenze des v/n-Toleranzbandes 2. Gang" VALUE 0x1D2992 Kw_Ws16 0.3276700 VelToN 0.00 0.3276700 FORMAT "%9.7" EXTENDED_LIMITS -0.3276800 0.3276700 /end CHARACTERISTIC
/begin CHARACTERISTIC Gearbx_rVn3H_C "obere Grenze des v/n-Toleranzbandes 3. Gang" VALUE 0x1D2994 Kw_Ws16 0.3276700 VelToN 0.00 0.3276700 FORMAT "%9.7" EXTENDED_LIMITS -0.3276800 0.3276700 /end CHARACTERISTIC
/begin CHARACTERISTIC Gearbx_rVn3L_C "untere Grenze des v/n-Toleranzbandes 3. Gang" VALUE 0x1D2996 Kw_Ws16 0.3276700 VelToN 0.00 0.3276700 FORMAT "%9.7" EXTENDED_LIMITS -0.3276800 0.3276700 /end CHARACTERISTIC
/begin CHARACTERISTIC Gearbx_rVn4H_C "obere Grenze des v/n-Toleranzbandes 4. Gang" VALUE 0x1D2998 Kw_Ws16 0.3276700 VelToN 0.00 0.3276700 FORMAT "%9.7" EXTENDED_LIMITS -0.3276800 0.3276700 /end CHARACTERISTIC
/begin CHARACTERISTIC Gearbx_rVn4L_C "untere Grenze des v/n-Toleranzbandes 4. Gang" VALUE 0x1D299A Kw_Ws16 0.3276700 VelToN 0.00 0.3276700 FORMAT "%9.7" EXTENDED_LIMITS -0.3276800 0.3276700 /end CHARACTERISTIC
/begin CHARACTERISTIC Gearbx_rVn5H_C "obere Grenze des v/n-Toleranzbandes 5. Gang" VALUE 0x1D299C Kw_Ws16 0.3276700 VelToN 0.00 0.3276700 FORMAT "%9.7" EXTENDED_LIMITS -0.3276800 0.3276700 /end CHARACTERISTIC
/begin CHARACTERISTIC Gearbx_rVn5L_C "untere Grenze des v/n-Toleranzbandes 5. Gang" VALUE 0x1D299E Kw_Ws16 0.3276700 VelToN 0.00 0.3276700 FORMAT "%9.7" EXTENDED_LIMITS -0.3276800 0.3276700 /end CHARACTERISTIC
/begin CHARACTERISTIC Gearbx_rVn6H_C "obere Grenze des v/n-Toleranzbandes 6. Gang" VALUE 0x1D29A0 Kw_Ws16 0.3276700 VelToN 0.00 0.3276700 FORMAT "%9.7" EXTENDED_LIMITS -0.3276800 0.3276700 /end CHARACTERISTIC
/begin CHARACTERISTIC Gearbx_rVn6L_C "untere Grenze des v/n-Toleranzbandes 6. Gang" VALUE 0x1D29A2 Kw_Ws16 0.3276700 VelToN 0.00 0.3276700 FORMAT "%9.7" EXTENDED_LIMITS -0.3276800 0.3276700 /end CHARACTERISTIC
/begin CHARACTERISTIC Gearbx_rVnRH_C "obere Grenze des v/n-Toleranzbandes Rückwärtsgang" VALUE 0x1D29A4 Kw_Ws16 0.3276700 VelToN 0.00 0.3276700 FORMAT "%9.7" EXTENDED_LIMITS -0.3276800 0.3276700 /end CHARACTERISTIC
/begin CHARACTERISTIC Gearbx_rVnRL_C "untere Grenze des v/n-Toleranzbandes Rückwärtsgang" VALUE 0x1D29A6 Kw_Ws16 0.3276700 VelToN 0.00 0.3276700 FORMAT "%9.7" EXTENDED_LIMITS -0.3276800 0.3276700 /end CHARACTERISTIC
/begin CHARACTERISTIC Gearbx_stTSCLim_C "Schalter zum aktivieren der Zeitlichen Begrenzung" VALUE 0x1D29D2 Kw_Ws16 65535.00 OneToOne -32768.00 32767.00 FORMAT "%8.2" /end CHARACTERISTIC
/begin CHARACTERISTIC Gearbx_swtASTFrc_C "Schalter zur Verwendung der reibungsverlustbezogenen Korrektur" VALUE 0x1D29D4 Kw_Wu8 2.000 OneToOne 0.00 2.000 FORMAT "%5.3" EXTENDED_LIMITS 0.00 255.0 /end CHARACTERISTIC
/begin CHARACTERISTIC Gearbx_swtASTPreCtl_C "Schalter für Verwendung der Vorsteuerung" VALUE 0x1D29D6 Kw_Ws16 65535.00 OneToOne -32768.00 32767.00 FORMAT "%8.2" /end CHARACTERISTIC
/begin CHARACTERISTIC Gearbx_swtAST_C "Schalter für AST Getriebeauswahl" VALUE 0x1D29D8 Kw_Wu8 1.000 OneToOne 0.00 1.000 FORMAT "%5.3" EXTENDED_LIMITS 0.00 255.0 /end CHARACTERISTIC
/begin CHARACTERISTIC Gearbx_swtDemtypeVal_C "Softwareschalter Wert:  Auswahl ""Automatisches Schaltgetriebe - TSC""  [0=off / 1=on]" VALUE 0x1D29D9 Kw_Wu8 1.000 OneToOne 0.00 1.000 FORMAT "%5.3" EXTENDED_LIMITS 0.00 255.0 /end CHARACTERISTIC
/begin CHARACTERISTIC Gearbx_swtDemtypeType_C "Softwareschalter Typ:  (EEPROM, Datensatz, appl.)" VALUE 0x1D29DA Kw_Wu8 2.000 OneToOne 0.00 2.000 FORMAT "%5.3" EXTENDED_LIMITS 0.00 255.0 READ_ONLY /end CHARACTERISTIC
/begin CHARACTERISTIC Gearbx_swtRotMass_C "Schalter zur Verwendung der drehzahlbezogenen Korrektur" VALUE 0x1D29DB Kw_Wu8 1.000 OneToOne 0.00 1.000 FORMAT "%5.3" EXTENDED_LIMITS 0.00 255.0 /end CHARACTERISTIC
/begin CHARACTERISTIC Gearbx_swtTypeStr_C "Applizierbare Getriebe Kennzeichen für die Ausgabe am Diagnosegerät" ASCII 0x1D295C Ktx 255.0 defaultAscii 0.00 255.0 NUMBER 24 /end CHARACTERISTIC
/begin CHARACTERISTIC Gearbx_swtTypeVal_C "Getriebetyp (0:manual; 1:automatisch; 2: automatisch shift; 3: continous variable; 4:automatisch manual/nur Z-Car)" VALUE 0x1D2975 Kw_Wu8 3.000 OneToOne 0.00 3.000 FORMAT "%5.3" EXTENDED_LIMITS 0.00 255.0 /end CHARACTERISTIC
/begin CHARACTERISTIC Gearbx_swtTypeType_C "Getriebetyp-Ablageart" VALUE 0x1D2976 Kw_Wu8 1.000 OneToOne 1.000 2.000 FORMAT "%5.3" EXTENDED_LIMITS 0.00 255.0 /end CHARACTERISTIC
/begin CHARACTERISTIC Gearbx_tiCANerrHold_C "Haltezeit für maximales Moment bei CAN Fehler" VALUE 0x1D2A60 Kw_Wu16 655350.0 Time_ms 0.00 655350.0 FORMAT "%8.1" /end CHARACTERISTIC
/begin CHARACTERISTIC Gearbx_tiCANerrRmp_C "Rampenzeit für Umschaltung auf Ersatz- oder Ursprungswert" VALUE 0x1D2A62 Kw_Wu16 655350.0 Time_ms 0.00 655350.0 FORMAT "%8.1" /end CHARACTERISTIC
/begin CHARACTERISTIC Gearbx_tiASThighDefect_C "Entprellzeit für Momentenintegralfehler" VALUE 0x1D29DC Kw_Wu16 655350.0 Time_ms 0.00 655350.0 FORMAT "%8.1" /end CHARACTERISTIC
/begin CHARACTERISTIC Gearbx_tiASThighOK_C "Heilungszeit für Momentenintegralfehler" VALUE 0x1D29DE Kw_Wu16 655350.0 Time_ms 0.00 655350.0 FORMAT "%8.1" /end CHARACTERISTIC
/begin CHARACTERISTIC Gearbx_tiASTlowDefect_C "Entprellzeit für Fehlererkennung Kupplungsplausibiliät beim AST" VALUE 0x1D29E0 Kw_Wu16 655350.0 Time_ms 0.00 655350.0 FORMAT "%8.1" /end CHARACTERISTIC
/begin CHARACTERISTIC Gearbx_tiASTlowOK_C "Heilungszeit für Fehlererkennung Kupplungsplausibiliät beim AST" VALUE 0x1D29E2 Kw_Wu16 655350.0 Time_ms 0.00 655350.0 FORMAT "%8.1" /end CHARACTERISTIC
/begin CHARACTERISTIC Gearbx_tiTSChighDefect_C "Fehlerpfad der Zeitbegrenzung vom TSC Defektwerdezeit" VALUE 0x1D29E4 Kw_Wu16 655350.0 Time_ms 0.00 655350.0 FORMAT "%8.1" /end CHARACTERISTIC
/begin CHARACTERISTIC Gearbx_tiTSChighOK_C "Fehlerpfad der Zeitbegrenzung vom TSC Heilungszeit" VALUE 0x1D29E6 Kw_Wu16 655350.0 Time_ms 0.00 655350.0 FORMAT "%8.1" /end CHARACTERISTIC
/begin CHARACTERISTIC Gearbx_tiStepTSC_C "Schrittweite zum Veringern des Zeitinigrals  in 20ms" VALUE 0x1D29E8 Kw_Ws16 65535.00 OneToOne -32768.00 32767.00 FORMAT "%8.2" /end CHARACTERISTIC
/begin CHARACTERISTIC Gearbx_tiTSC_C "Maximales Zeitintegral für TSC Eingriff" VALUE 0x1D29EA Kw_Ws16 65535.00 OneToOne -32768.00 32767.00 FORMAT "%8.2" /end CHARACTERISTIC
/begin CHARACTERISTIC Gearbx_trqASTM2_C "Momentengrenzwert für den AST Eingriff bei aktiviertem Vorregler" VALUE 0x1D29EC Kw_Ws16 1500.000 Trq -500.0000 1000.000 FORMAT "%8.3" EXTENDED_LIMITS -3276.800 3276.700 /end CHARACTERISTIC
/begin CHARACTERISTIC Gearbx_trqASTMax_C "Momentengrenzwert für den increasing torque Eingriff" VALUE 0x1D29EE Kw_Ws16 1500.000 Trq -500.0000 1000.000 FORMAT "%8.3" EXTENDED_LIMITS -3276.800 3276.700 /end CHARACTERISTIC
/begin CHARACTERISTIC Gearbx_trqASTToG_C "Toleranzgrenze für begrenztes Gtriebeeingriffsmoment" VALUE 0x1D29F0 Kw_Ws16 1500.000 Trq -500.0000 1000.000 FORMAT "%8.3" EXTENDED_LIMITS -3276.800 3276.700 /end CHARACTERISTIC
/begin CHARACTERISTIC Gearbx_trqCANerrMax_C "maximales Moment bei CAN Fehler" VALUE 0x1D2A64 Kw_Ws16 1000.000 Trq 0.00 1000.000 FORMAT "%8.3" EXTENDED_LIMITS -3276.800 3276.700 /end CHARACTERISTIC
/begin CHARACTERISTIC Gearbx_trqCANerrMax_MAP "Ersatzwert bei endgültigem CAN Fehler in Abhängigkeit von Eng_nAvrg und VSSCD_v" MAP 0x1D2A66 Kf_Xs16_Ys16_Ws16 1500.000 Trq -500.0000 1000.000 FORMAT "%8.3" EXTENDED_LIMITS -3276.800 3276.700
 /begin AXIS_DESCR STD_AXIS Eng_nAvrg EngN 10 0.00 6000.000 FORMAT "%8.3" EXTENDED_LIMITS -32768.00 32767.00 DEPOSIT ABSOLUTE /end AXIS_DESCR
 /begin AXIS_DESCR STD_AXIS VSSCD_v Vel 10 0.00 300.0000 FORMAT "%8.4" EXTENDED_LIMITS -327.6800 327.6700 DEPOSIT ABSOLUTE /end AXIS_DESCR
/end CHARACTERISTIC
/begin CHARACTERISTIC Gearbx_trqFrcMin_C "Minimaler Reibungsverlust" VALUE 0x1D29F2 Kw_Ws16 1500.000 Trq -500.0000 1000.000 FORMAT "%8.3" EXTENDED_LIMITS -3276.800 3276.700 /end CHARACTERISTIC
/begin CHARACTERISTIC Gearbx_trqInMax_Vector "Bypass Label, nicht ändern!" VALUE 0x1C0ABC Kw_Wu8 255.0 OneToOne 0.00 255.0 FORMAT "%5.1" /end CHARACTERISTIC
/begin CHARACTERISTIC Gearbx_trqInMax_Channel "Bypass Label, nicht ändern!" VALUE 0x1C0ABD Kw_Wu8 255.0 OneToOne 0.00 255.0 FORMAT "%5.1" /end CHARACTERISTIC
/begin CHARACTERISTIC Gearbx_trqInMax_C "Maximales Getriebeeingangsmoment" VALUE 0x1D2B5A Kw_Ws16 1000.000 Trq 0.00 1000.000 FORMAT "%8.3" EXTENDED_LIMITS -3276.800 3276.700 /end CHARACTERISTIC
/begin CHARACTERISTIC Gearbx_trqMaxGear1_CUR "Begrenzungsmoment für ersten Gang" CURVE 0x1D2B5C Kl_Xs16_Ws16 1000.000 Trq 0.00 1000.000 FORMAT "%8.3" EXTENDED_LIMITS -3276.800 3276.700
 /begin AXIS_DESCR STD_AXIS Eng_nAvrg EngN 15 0.00 6000.000 FORMAT "%8.3" EXTENDED_LIMITS -32768.00 32767.00 DEPOSIT ABSOLUTE /end AXIS_DESCR
/end CHARACTERISTIC
/begin CHARACTERISTIC Gearbx_trqMaxGear2_CUR "Begrenzungsmoment für zweiten Gang" CURVE 0x1D2B9A Kl_Xs16_Ws16 1000.000 Trq 0.00 1000.000 FORMAT "%8.3" EXTENDED_LIMITS -3276.800 3276.700
 /begin AXIS_DESCR STD_AXIS Eng_nAvrg EngN 15 0.00 6000.000 FORMAT "%8.3" EXTENDED_LIMITS -32768.00 32767.00 DEPOSIT ABSOLUTE /end AXIS_DESCR
/end CHARACTERISTIC
/begin CHARACTERISTIC Gearbx_trqMaxGear3_CUR "Begrenzungsmoment für dritten Gang" CURVE 0x1D2BD8 Kl_Xs16_Ws16 1000.000 Trq 0.00 1000.000 FORMAT "%8.3" EXTENDED_LIMITS -3276.800 3276.700
 /begin AXIS_DESCR STD_AXIS Eng_nAvrg EngN 15 0.00 6000.000 FORMAT "%8.3" EXTENDED_LIMITS -32768.00 32767.00 DEPOSIT ABSOLUTE /end AXIS_DESCR
/end CHARACTERISTIC
/begin CHARACTERISTIC Gearbx_trqMaxGear4_CUR "Begrenzungsmoment für vierten Gang" CURVE 0x1D2C16 Kl_Xs16_Ws16 1000.000 Trq 0.00 1000.000 FORMAT "%8.3" EXTENDED_LIMITS -3276.800 3276.700
 /begin AXIS_DESCR STD_AXIS Eng_nAvrg EngN 15 0.00 6000.000 FORMAT "%8.3" EXTENDED_LIMITS -32768.00 32767.00 DEPOSIT ABSOLUTE /end AXIS_DESCR
/end CHARACTERISTIC
/begin CHARACTERISTIC Gearbx_trqMaxGear5_CUR "Begrenzungsmoment für fünften Gang" CURVE 0x1D2C54 Kl_Xs16_Ws16 1000.000 Trq 0.00 1000.000 FORMAT "%8.3" EXTENDED_LIMITS -3276.800 3276.700
 /begin AXIS_DESCR STD_AXIS Eng_nAvrg EngN 15 0.00 6000.000 FORMAT "%8.3" EXTENDED_LIMITS -32768.00 32767.00 DEPOSIT ABSOLUTE /end AXIS_DESCR
/end CHARACTERISTIC
/begin CHARACTERISTIC Gearbx_trqMaxGear6_CUR "Begrenzungsmoment für sechsten Gang" CURVE 0x1D2C92 Kl_Xs16_Ws16 1000.000 Trq 0.00 1000.000 FORMAT "%8.3" EXTENDED_LIMITS -3276.800 3276.700
 /begin AXIS_DESCR STD_AXIS Eng_nAvrg EngN 15 0.00 6000.000 FORMAT "%8.3" EXTENDED_LIMITS -32768.00 32767.00 DEPOSIT ABSOLUTE /end AXIS_DESCR
/end CHARACTERISTIC
/begin CHARACTERISTIC Gearbx_trqMaxGearR_CUR "Begrenzungsmoment für Rückwärtsgang" CURVE 0x1D2CD0 Kl_Xs16_Ws16 1000.000 Trq 0.00 1000.000 FORMAT "%8.3" EXTENDED_LIMITS -3276.800 3276.700
 /begin AXIS_DESCR STD_AXIS Eng_nAvrg EngN 15 0.00 6000.000 FORMAT "%8.3" EXTENDED_LIMITS -32768.00 32767.00 DEPOSIT ABSOLUTE /end AXIS_DESCR
/end CHARACTERISTIC
/begin CHARACTERISTIC Gearbx_trqMoveOFF_CUR "Anfahrkennlinie EGS Eingriff" CURVE 0x1D29F4 Kl_Xs16_Ws16 300.0000 Trq 0.00 300.0000 FORMAT "%8.4" EXTENDED_LIMITS -3276.800 3276.700
 /begin AXIS_DESCR STD_AXIS Eng_nAvrg EngN 25 0.00 6000.000 FORMAT "%8.3" EXTENDED_LIMITS -32768.00 32767.00 DEPOSIT ABSOLUTE /end AXIS_DESCR
/end CHARACTERISTIC
/begin CHARACTERISTIC Gearbx_trqToB_C "Toleranz für ""Getriebeeingriff konnte nicht vollständig durchgeführt werden""" VALUE 0x1D2A5A Kw_Ws16 6553.500 Trq -3276.800 3276.700 FORMAT "%8.3" /end CHARACTERISTIC
/begin CHARACTERISTIC Gearbx_vASTMin_C "Minimale Fahrzeuggeschwindigkeit für einen AST- Eingriff" VALUE 0x1D2A5C Kw_Ws16 300.0000 Vel 0.00 300.0000 FORMAT "%8.4" EXTENDED_LIMITS -327.6800 327.6700 /end CHARACTERISTIC
/begin CHARACTERISTIC Gearbx_vThres_C "Kleinste Geschwindigkeit für Getriebeeingriff über Rampe" VALUE 0x1D2A5E Kw_Ws16 655.3500 Vel -327.6800 327.6700 FORMAT "%8.4" /end CHARACTERISTIC
/begin CHARACTERISTIC GlwCD_ActrDebExcTempDef_C "Fehlerentprellzeit für EXC_TEMP für Aktorausgang" VALUE 0x1D2D0E Kw_Wu16 655350.0 Time_ms 0.00 655350.0 FORMAT "%8.1" /end CHARACTERISTIC
/begin CHARACTERISTIC GlwCD_ActrDebExcTempOk_C "Heilungszeit für EXC_TEMP für Aktorausgang" VALUE 0x1D2D10 Kw_Wu16 655350.0 Time_ms 0.00 655350.0 FORMAT "%8.1" /end CHARACTERISTIC
/begin CHARACTERISTIC GlwCD_ActrDebNoLoadDef_C "Fehlerentprellzeit für NO_LOAD für Aktorausgang" VALUE 0x1D2D12 Kw_Wu16 655350.0 Time_ms 0.00 655350.0 FORMAT "%8.1" /end CHARACTERISTIC
/begin CHARACTERISTIC GlwCD_ActrDebNoLoadOk_C "Heilungszeit für NO_LOAD für Aktorausgang" VALUE 0x1D2D14 Kw_Wu16 655350.0 Time_ms 0.00 655350.0 FORMAT "%8.1" /end CHARACTERISTIC
/begin CHARACTERISTIC GlwCD_ActrDebShortCircBatDef_C "Fehlerentprellzeit für SHORT_CIRC_BAT für Aktorausgang" VALUE 0x1D2D16 Kw_Wu16 655350.0 Time_ms 0.00 655350.0 FORMAT "%8.1" /end CHARACTERISTIC
/begin CHARACTERISTIC GlwCD_ActrDebShortCircBatOk_C "Heilungszeit für SHORT_CIRC_BAT für Aktorausgang" VALUE 0x1D2D18 Kw_Wu16 655350.0 Time_ms 0.00 655350.0 FORMAT "%8.1" /end CHARACTERISTIC
/begin CHARACTERISTIC GlwCD_ActrDebShortCircGndDef_C "Fehlerentprellzeit für SHORT_CIRC_GND für Aktorausgang" VALUE 0x1D2D1A Kw_Wu16 655350.0 Time_ms 0.00 655350.0 FORMAT "%8.1" /end CHARACTERISTIC
/begin CHARACTERISTIC GlwCD_ActrDebShortCircGndOk_C "Heilungszeit für SHORT_CIRC_GND für Aktorausgang" VALUE 0x1D2D1C Kw_Wu16 655350.0 Time_ms 0.00 655350.0 FORMAT "%8.1" /end CHARACTERISTIC
/begin CHARACTERISTIC GlwCD_CntEepWrtAtm_C "Anzahl von EEPROM Schreibversuchen" VALUE 0x1D2D1E Kw_Wu8 3.000 OneToOne 0.00 3.000 FORMAT "%5.3" EXTENDED_LIMITS 0.00 255.0 /end CHARACTERISTIC
/begin CHARACTERISTIC GlwCD_Cod2of3DebPlaDef_C "Entprellzaehler Defekterkennung" VALUE 0x1D2D20 Kw_Wu16 65535.00 OneToOne 0.00 65535.00 FORMAT "%8.2" /end CHARACTERISTIC
/begin CHARACTERISTIC GlwCD_Cod2of3DebPlaOk_C "Entprellzähler für Heilungserkennung" VALUE 0x1D2D22 Kw_Wu16 65535.00 OneToOne 0.00 65535.00 FORMAT "%8.2" /end CHARACTERISTIC
/begin CHARACTERISTIC GlwCD_Cod3diffDebPlaDef_C "Entprellzähler für Defekterkennung" VALUE 0x1D2D24 Kw_Wu16 65535.00 OneToOne 0.00 65535.00 FORMAT "%8.2" /end CHARACTERISTIC
/begin CHARACTERISTIC GlwCD_Cod3diffDebPlaOk_C "Entprellzaehler Heilungserkennung" VALUE 0x1D2D26 Kw_Wu16 65535.00 OneToOne 0.00 65535.00 FORMAT "%8.2" /end CHARACTERISTIC
/begin CHARACTERISTIC GlwCD_ctsyncmin_C "Anzahl von GSK3-Diagnoseprotokoll-Synchronisierbits" VALUE 0x1D2D28 Kw_Wu8 17.00 OneToOne 0.00 17.00 FORMAT "%5.2" EXTENDED_LIMITS 0.00 255.0 /end CHARACTERISTIC
/begin CHARACTERISTIC GlwCD_ctTimeOutInit_C "Anzahl der Bits für Timeout nach Initialisierung der Diagnose" VALUE 0x1D2D29 Kw_Wu8 128.0 OneToOne 0.00 128.0 FORMAT "%5.1" EXTENDED_LIMITS 0.00 255.0 /end CHARACTERISTIC
/begin CHARACTERISTIC GlwCD_ctTimeOutReload_C "Anzahl der Bits für Timeout nach Reload der Diagnose" VALUE 0x1D2D2A Kw_Wu8 128.0 OneToOne 0.00 128.0 FORMAT "%5.1" EXTENDED_LIMITS 0.00 255.0 /end CHARACTERISTIC
/begin CHARACTERISTIC GlwCD_DebExcTempDef_C "Fehlerentprellzeit für Übertemperaturfehler" VALUE 0x1D2D2C Kw_Wu16 655350.0 Time_ms 0.00 655350.0 FORMAT "%8.1" /end CHARACTERISTIC
/begin CHARACTERISTIC GlwCD_DebExcTempOk_C "Heilungsdauer für Fehler Übertemperatur" VALUE 0x1D2D2E Kw_Wu16 655350.0 Time_ms 0.00 655350.0 FORMAT "%8.1" /end CHARACTERISTIC
/begin CHARACTERISTIC GlwCD_DebNoLoadDef_C "Fehlerentprellzeit für Leerlauf" VALUE 0x1D2D30 Kw_Wu16 655350.0 Time_ms 0.00 655350.0 FORMAT "%8.1" /end CHARACTERISTIC
/begin CHARACTERISTIC GlwCD_DebNoLoadOk_C "Heilungsentprellzeit für Leerlauffehler" VALUE 0x1D2D32 Kw_Wu16 655350.0 Time_ms 0.00 655350.0 FORMAT "%8.1" /end CHARACTERISTIC
/begin CHARACTERISTIC GlwCD_DebShortCircBatDef_C "Entprellzähler empfangener Fehlerbytes für den Fehler Kurzschluss der Datenleitung zur Batterie" VALUE 0x1D2D34 Kw_Wu16 655350.0 Time_ms 0.00 655350.0 FORMAT "%8.1" READ_ONLY /end CHARACTERISTIC
/begin CHARACTERISTIC GlwCD_DebShortCircBatOk_C "Heilungszähler empfangener Fehlerbytes für den Fehler Kurzschluss der Datenleitung zur Batterie" VALUE 0x1D2D36 Kw_Wu16 655350.0 Time_ms 0.00 655350.0 FORMAT "%8.1" READ_ONLY /end CHARACTERISTIC
/begin CHARACTERISTIC GlwCD_DebShortCircGndDef_C "Entprellzähler empfangener Fehlerbytes für den Fehler Kurzschluss der Datenleitung zur Masse" VALUE 0x1D2D38 Kw_Wu16 655350.0 Time_ms 0.00 655350.0 FORMAT "%8.1" /end CHARACTERISTIC
/begin CHARACTERISTIC GlwCD_DebShortCircGndOk_C "Heilungszähler empfangener Fehlerbytes für den Fehler Kurzschluss der Datenleitung zur Masse" VALUE 0x1D2D3A Kw_Wu16 655350.0 Time_ms 0.00 655350.0 FORMAT "%8.1" /end CHARACTERISTIC
/begin CHARACTERISTIC GlwCD_tiDigInDebNeg_C "Entprellteit für fallende Flanke der Glührückmeldung" VALUE 0x1D2D3C Kw_Wu16 655350.0 TimeDeb 0.00 655350.0 FORMAT "%8.1" /end CHARACTERISTIC
/begin CHARACTERISTIC GlwCD_tiDigInDebPos_C "Entprellzeit für steigende Flanke der Glührückmeldung" VALUE 0x1D2D3E Kw_Wu16 655350.0 TimeDeb 0.00 655350.0 FORMAT "%8.1" /end CHARACTERISTIC
/begin CHARACTERISTIC GlwCD_GSK3DiagDebPlaDef_C "Schwelle für Fehlererkennung (GSK3-Diagnoseprotokoll)" VALUE 0x1D2D40 Kw_Wu16 65535.00 OneToOne 0.00 65535.00 FORMAT "%8.2" /end CHARACTERISTIC
/begin CHARACTERISTIC GlwCD_GSK3DiagDebPlaOk_C "Schwelle für Fehlerheilung (GSK3 Diagnoseprotokoll" VALUE 0x1D2D42 Kw_Wu16 65535.00 OneToOne 0.00 65535.00 FORMAT "%8.2" /end CHARACTERISTIC
/begin CHARACTERISTIC GlwCD_GSK3Error1DebPlaDef_C "Schwelle für Fehlererkennung (GSK3-Diagnoseprotokoll: Bit 6 - Überstrom)" VALUE 0x1D2D44 Kw_Wu16 65535.00 OneToOne 0.00 65535.00 FORMAT "%8.2" /end CHARACTERISTIC
/begin CHARACTERISTIC GlwCD_GSK3Error1DebPlaOk_C "Schwelle für Fehlerheilung (GSK3-Diagnoseprotokoll: Bit 6 - Überstrom)" VALUE 0x1D2D46 Kw_Wu16 65535.00 OneToOne 0.00 65535.00 FORMAT "%8.2" /end CHARACTERISTIC
/begin CHARACTERISTIC GlwCD_GSK3Error2DebPlaDef_C "Schwelle für Fehlererkennung (GSK3-Diagnoseprotokoll: Bit 7 - Summenfehler)" VALUE 0x1D2D48 Kw_Wu16 65535.00 OneToOne 0.00 65535.00 FORMAT "%8.2" /end CHARACTERISTIC
/begin CHARACTERISTIC GlwCD_GSK3Error2DebPlaOk_C "Schwelle für Fehlerheilung (GSK3-Diagnoseprotokoll: Bit 7 - Summenfehler)" VALUE 0x1D2D4A Kw_Wu16 65535.00 OneToOne 0.00 65535.00 FORMAT "%8.2" /end CHARACTERISTIC
/begin CHARACTERISTIC GlwCD_GSK3Plug0DebPlaDef_C "Schwelle für Fehlererkennung (GSK3-Diagnoseprotokoll: Fehlerbehandlung Glühkerze 0)" VALUE 0x1D2D4C Kw_Wu16 65535.00 OneToOne 0.00 65535.00 FORMAT "%8.2" /end CHARACTERISTIC
/begin CHARACTERISTIC GlwCD_GSK3Plug0DebPlaOk_C "Schwelle für Fehlerheilung (GSK3-Diagnoseprotokoll: Fehlerbehandlung Glühkerze 0)" VALUE 0x1D2D4E Kw_Wu16 65535.00 OneToOne 0.00 65535.00 FORMAT "%8.2" /end CHARACTERISTIC
/begin CHARACTERISTIC GlwCD_GSK3Plug1DebPlaDef_C "Schwelle für Fehlererkennung (GSK3-Diagnoseprotokoll: Fehlerbehandlung Glühkerze 1)" VALUE 0x1D2D50 Kw_Wu16 65535.00 OneToOne 0.00 65535.00 FORMAT "%8.2" /end CHARACTERISTIC
/begin CHARACTERISTIC GlwCD_GSK3Plug1DebPlaOk_C "Schwelle für Fehlerheilung (GSK3-Diagnoseprotokoll: Fehlerbehandlung Glühkerze 1)" VALUE 0x1D2D52 Kw_Wu16 65535.00 OneToOne 0.00 65535.00 FORMAT "%8.2" /end CHARACTERISTIC
/begin CHARACTERISTIC GlwCD_GSK3Plug2DebPlaDef_C "Schwelle für Fehlererkennung (GSK3-Diagnoseprotokoll: Fehlerbehandlung Glühkerze 2)" VALUE 0x1D2D54 Kw_Wu16 65535.00 OneToOne 0.00 65535.00 FORMAT "%8.2" /end CHARACTERISTIC
/begin CHARACTERISTIC GlwCD_GSK3Plug2DebPlaOk_C "Schwelle für Fehlerheilung (GSK3-Diagnoseprotokoll: Fehlerbehandlung Glühkerze 2)" VALUE 0x1D2D56 Kw_Wu16 65535.00 OneToOne 0.00 65535.00 FORMAT "%8.2" /end CHARACTERISTIC
/begin CHARACTERISTIC GlwCD_GSK3Plug3DebPlaDef_C "Schwelle für Fehlererkennung (GSK3-Diagnoseprotokoll: Fehlerbehandlung Glühkerze 3)" VALUE 0x1D2D58 Kw_Wu16 65535.00 OneToOne 0.00 65535.00 FORMAT "%8.2" /end CHARACTERISTIC
/begin CHARACTERISTIC GlwCD_GSK3Plug3DebPlaOk_C "Schwelle für Fehlerheilung (GSK3-Diagnoseprotokoll: Fehlerbehandlung Glühkerze 3)" VALUE 0x1D2D5A Kw_Wu16 65535.00 OneToOne 0.00 65535.00 FORMAT "%8.2" /end CHARACTERISTIC
/begin CHARACTERISTIC GlwCD_GSK3Plug4DebPlaDef_C "Schwelle für Fehlererkennung (GSK3-Diagnoseprotokoll: Fehlerbehandlung Glühkerze 4)" VALUE 0x1D2D5C Kw_Wu16 65535.00 OneToOne 0.00 65535.00 FORMAT "%8.2" /end CHARACTERISTIC
/begin CHARACTERISTIC GlwCD_GSK3Plug4DebPlaOk_C "Schwelle für Fehlerheilung (GSK3-Diagnoseprotokoll: Fehlerbehandlung Glühkerze 4)" VALUE 0x1D2D5E Kw_Wu16 65535.00 OneToOne 0.00 65535.00 FORMAT "%8.2" /end CHARACTERISTIC
/begin CHARACTERISTIC GlwCD_GSK3Plug5DebPlaDef_C "Schwelle für Fehlererkennung (GSK3-Diagnoseprotokoll: Fehlerbehandlung Glühkerze 5)" VALUE 0x1D2D60 Kw_Wu16 65535.00 OneToOne 0.00 65535.00 FORMAT "%8.2" /end CHARACTERISTIC
/begin CHARACTERISTIC GlwCD_GSK3Plug5DebPlaOk_C "Schwelle für Fehlerheilung (GSK3-Diagnoseprotokoll: Fehlerbehandlung Glühkerze 5)" VALUE 0x1D2D62 Kw_Wu16 65535.00 OneToOne 0.00 65535.00 FORMAT "%8.2" /end CHARACTERISTIC
/begin CHARACTERISTIC GlwCD_LampCanDebNplDef_C "Entprellzeit für NPL Fehler für Vorglühlampe via CAN" VALUE 0x1D2D64 Kw_Wu16 655350.0 Time_ms 0.00 655350.0 FORMAT "%8.1" /end CHARACTERISTIC
/begin CHARACTERISTIC GlwCD_LampCanDebNplOk_C "Fehlerheilzeit für NPL Fehler für Vorglühlampe via CAN" VALUE 0x1D2D66 Kw_Wu16 655350.0 Time_ms 0.00 655350.0 FORMAT "%8.1" /end CHARACTERISTIC
/begin CHARACTERISTIC GlwCD_LampDebExcTempDef_C "Fehlerentprellzeit für EXC_TEMP für Lampenausgang" VALUE 0x1D2D68 Kw_Wu16 655350.0 Time_ms 0.00 655350.0 FORMAT "%8.1" /end CHARACTERISTIC
/begin CHARACTERISTIC GlwCD_LampDebExcTempOk_C "Heilungszeit für EXC_TEMP für Lampenausgang" VALUE 0x1D2D6A Kw_Wu16 655350.0 Time_ms 0.00 655350.0 FORMAT "%8.1" /end CHARACTERISTIC
/begin CHARACTERISTIC GlwCD_LampDebNoLoadDef_C "Fehlerentprellzeit für NO_LOAD für Lampenausgang" VALUE 0x1D2D6C Kw_Wu16 655350.0 Time_ms 0.00 655350.0 FORMAT "%8.1" /end CHARACTERISTIC
/begin CHARACTERISTIC GlwCD_LampDebNoLoadOk_C "Heilungszeit für NO_LOAD für Lampenausgang" VALUE 0x1D2D6E Kw_Wu16 655350.0 Time_ms 0.00 655350.0 FORMAT "%8.1" /end CHARACTERISTIC
/begin CHARACTERISTIC GlwCD_LampDebShortCircBatDef_C "Fehlerentprellzeit für SHORT_CIRC_BAT Lampenausgang" VALUE 0x1D2D70 Kw_Wu16 655350.0 Time_ms 0.00 655350.0 FORMAT "%8.1" /end CHARACTERISTIC
/begin CHARACTERISTIC GlwCD_LampDebShortCircBatOk_C "Heilungszeit für SHORT_CIRC_BAT Lampenausgang" VALUE 0x1D2D72 Kw_Wu16 655350.0 Time_ms 0.00 655350.0 FORMAT "%8.1" /end CHARACTERISTIC
/begin CHARACTERISTIC GlwCD_LampDebShortCircGndDef_C "Fehlerentprellzeit für SHORT_CIRC_GND Lampenausgang" VALUE 0x1D2D74 Kw_Wu16 655350.0 Time_ms 0.00 655350.0 FORMAT "%8.1" /end CHARACTERISTIC
/begin CHARACTERISTIC GlwCD_LampDebShortCircGndOk_C "Heilungszeit für SHORT_CIRC_GND Lampenausgang" VALUE 0x1D2D76 Kw_Wu16 655350.0 Time_ms 0.00 655350.0 FORMAT "%8.1" /end CHARACTERISTIC
/begin CHARACTERISTIC GlwCD_numStepDef_C "Schrittweite für Fehlererkennung (GSK3-Diagnose)" VALUE 0x1D2D78 Kw_Wu8 3.000 OneToOne 0.00 3.000 FORMAT "%5.3" EXTENDED_LIMITS 0.00 255.0 /end CHARACTERISTIC
/begin CHARACTERISTIC GlwCD_numStepOK_C "Schrittweite für Fehlererkennung (GSK3-Diagnose)" VALUE 0x1D2D79 Kw_Wu8 3.000 OneToOne 0.00 3.000 FORMAT "%5.3" EXTENDED_LIMITS 0.00 255.0 /end CHARACTERISTIC
/begin CHARACTERISTIC GlwCD_stInvOut_C "Invertierung des GSK3-Tastverhältnisses" VALUE 0x1D2D7A Kw_Wu8 1.000 OneToOne 0.00 1.000 FORMAT "%5.3" EXTENDED_LIMITS 0.00 255.0 /end CHARACTERISTIC
/begin CHARACTERISTIC GlwCD_tiPer_C "Periodendauer des PWM-Ausgangssignals (GSK3)" VALUE 0x1D2D7C Kw_Ws16 0.00 Period 31.00000 31.00000 FORMAT "%8.5" EXTENDED_LIMITS -3276.800 3276.700 /end CHARACTERISTIC
/begin CHARACTERISTIC GlwCD_rGSKCode_C "Tastverhaeltnis vor abgeschlossener Ueberpruefung der Codierung" VALUE 0x1D2D7E Kw_Wu16 100.0000 DtyCyc 0.00 100.0000 FORMAT "%8.4" EXTENDED_LIMITS 0.00 655.3500 /end CHARACTERISTIC
/begin CHARACTERISTIC GlwCD_rGSKHighPreGlow_C "Tastverhältnis - Vorglühen mit Energieeintrag" VALUE 0x1D2D80 Kw_Wu16 100.0000 DtyCyc 0.00 100.0000 FORMAT "%8.4" EXTENDED_LIMITS 0.00 655.3500 /end CHARACTERISTIC
/begin CHARACTERISTIC GlwCD_rGSKmax_C "max. Tastverhältnis für GSK3-Diagnose" VALUE 0x1D2D82 Kw_Wu16 100.0000 DtyCyc 0.00 100.0000 FORMAT "%8.4" EXTENDED_LIMITS 0.00 655.3500 /end CHARACTERISTIC
/begin CHARACTERISTIC GlwCD_rGSKmin_C "min. Begrenzung des GSK3-Tastverhältnisses und untere Schwelle für GSK3-Diagnose" VALUE 0x1D2D84 Kw_Wu16 100.0000 DtyCyc 0.00 100.0000 FORMAT "%8.4" EXTENDED_LIMITS 0.00 655.3500 /end CHARACTERISTIC
/begin CHARACTERISTIC GlwCD_rGSKtst_C "Tastverhaeltnis waehrend des Stellgliedtests" VALUE 0x1D2D86 Kw_Wu16 100.0000 DtyCyc 0.00 100.0000 FORMAT "%8.4" EXTENDED_LIMITS 0.00 655.3500 /end CHARACTERISTIC
/begin CHARACTERISTIC GlwCD_rTst_C "Tastverhältnis, das im Fehler fall cyclisch ausgegeben wird" VALUE 0x1D2D88 Kw_Ws16 100.0000 DtyCyc 0.00 100.0000 FORMAT "%8.4" EXTENDED_LIMITS -327.6800 327.6700 /end CHARACTERISTIC
/begin CHARACTERISTIC GlwCD_stActrInvOut_C "Glührelaisausgang invertiert" VALUE 0x1D2D8A Kw_Wu8 1.000 OneToOne 0.00 1.000 FORMAT "%5.3" EXTENDED_LIMITS 0.00 255.0 /end CHARACTERISTIC
/begin CHARACTERISTIC GlwCD_stDigInvIn_C "Rückmeldesignal invertiert" VALUE 0x1D2D8B Kw_Wu8 1.000 OneToOne 0.00 1.000 FORMAT "%5.3" EXTENDED_LIMITS 0.00 255.0 /end CHARACTERISTIC
/begin CHARACTERISTIC GlwCD_stGlwUnType_C "Codierungsvorgabe fuer das GZS" VALUE 0x1D2D8C Kw_Wu8 7.000 OneToOne 0.00 7.000 FORMAT "%5.3" EXTENDED_LIMITS 0.00 255.0 /end CHARACTERISTIC
/begin CHARACTERISTIC GlwCD_stLampInvOut_C "Ausgang Glühsteuerung invertiert" VALUE 0x1D2D8D Kw_Wu8 1.000 OneToOne 0.00 1.000 FORMAT "%5.3" EXTENDED_LIMITS 0.00 255.0 /end CHARACTERISTIC
/begin CHARACTERISTIC GlwCD_stPwrStgActrActv_C "Spezifikation des Abschaltverhaltens der Actuator Endstufe" VALUE 0x1D2D8E Kw_Wu8 255.0 OneToOne 0.00 255.0 FORMAT "%5.1" /end CHARACTERISTIC
/begin CHARACTERISTIC GlwCD_stPwrStgActrDia_C "Spezifikation des Diagnoseabschaltverhaltens der Actuator Endstufe" VALUE 0x1D2D8F Kw_Wu8 255.0 OneToOne 0.00 255.0 FORMAT "%5.1" /end CHARACTERISTIC
/begin CHARACTERISTIC GlwCD_stPwrStgLampActv_C "Spezifikation des Diagnoseabschaltverhaltens der Lamp-Endstufe" VALUE 0x1D2D90 Kw_Wu8 255.0 OneToOne 0.00 255.0 FORMAT "%5.1" /end CHARACTERISTIC
/begin CHARACTERISTIC GlwCD_stPwrStgLampDia_C "Spezifikation des Diagnoseabschaltverhaltens der Lamp-Endstufe" VALUE 0x1D2D91 Kw_Wu8 255.0 OneToOne 0.00 255.0 FORMAT "%5.1" /end CHARACTERISTIC
/begin CHARACTERISTIC GlwCD_swtDigInPresent_C "Schalter zur Deaktivierung des digitalen Eingangs von GlwCD" VALUE 0x1D2D92 Kw_Wu8 1.000 OneToOne 0.00 1.000 FORMAT "%5.3" EXTENDED_LIMITS 0.00 255.0 /end CHARACTERISTIC
/begin CHARACTERISTIC GlwCD_swtLampCan_C "Schalter für Vorglühlampe über CAN oder Endstufe" VALUE 0x1D2D93 Kw_Wu8 1.000 OneToOne 0.00 1.000 FORMAT "%5.3" EXTENDED_LIMITS 0.00 255.0 /end CHARACTERISTIC
/begin CHARACTERISTIC GlwCD_swtVarSfd_C "Schalter, ob Summenfehlerdiagnose verwendet werden soll" VALUE 0x1D2D94 Kw_Wu16 1.000000 OneToOne 0.00 1.000000 FORMAT "%8.6" EXTENDED_LIMITS 0.00 65535.00 /end CHARACTERISTIC
/begin CHARACTERISTIC GlwCD_tiBtwTst_C "Zeitabstand, in dem im Fehlerfall die GSK3-Endstufe getestet wird" VALUE 0x1D2D96 Kw_Wu16 29980.00 Time_ms 20.00000 30000.00 FORMAT "%8.2" EXTENDED_LIMITS 0.00 655350.0 /end CHARACTERISTIC
/begin CHARACTERISTIC GlwCD_tiMaxDef_C "Entprellzeit Max-Fehler für Dfp_GLWCD_SFD" VALUE 0x1D2D98 Kw_Wu16 65540.00 Time_ms 0.00 65540.00 FORMAT "%8.2" EXTENDED_LIMITS 0.00 655350.0 /end CHARACTERISTIC
/begin CHARACTERISTIC GlwCD_tiMaxOk_C "Heilungszeit Max-Fehler für Dfp_GLWCD_SFD" VALUE 0x1D2D9A Kw_Wu16 65540.00 Time_ms 0.00 65540.00 FORMAT "%8.2" EXTENDED_LIMITS 0.00 655350.0 /end CHARACTERISTIC
/begin CHARACTERISTIC GlwCD_tiMinDef_C "Entprellzeit für Min-Fehler für Dfp_GlwCD_SFD" VALUE 0x1D2D9C Kw_Wu16 65540.00 Time_ms 0.00 65540.00 FORMAT "%8.2" EXTENDED_LIMITS 0.00 655350.0 /end CHARACTERISTIC
/begin CHARACTERISTIC GlwCD_tiMinOk_C "Heilungszeit für Min-Fehler für Dfp_GlwCD_SFD" VALUE 0x1D2D9E Kw_Wu16 65540.00 Time_ms 0.00 65540.00 FORMAT "%8.2" EXTENDED_LIMITS 0.00 655350.0 /end CHARACTERISTIC
/begin CHARACTERISTIC GlwCD_tiDelay_C "Zeit von fallender Flanke des GSK3- Ausgangs, bis zum Gültigwerden der Diagnoseleitung" VALUE 0x1D2DA0 Kw_Wu16 9999.000 TimeDT 1.000000 10000.00 FORMAT "%8.2" EXTENDED_LIMITS 0.00 65535.00 /end CHARACTERISTIC
/begin CHARACTERISTIC GlwCD_tiGlwCDOFFTmr_C "Abschaltzeit der Endstufe im Fehlerfall" VALUE 0x1D2DA2 Kw_Wu16 655350.0 Time_ms 0.00 655350.0 FORMAT "%8.1" /end CHARACTERISTIC
/begin CHARACTERISTIC GlwCD_tiGlwcheckDfpTmr_C "Ansteuerdauer bei Abschaltung der Endstufe im Fehlerfall" VALUE 0x1D2DA4 Kw_Wu16 655350.0 Time_ms 0.00 655350.0 FORMAT "%8.1" /end CHARACTERISTIC
/begin CHARACTERISTIC GlwCD_uDfl_C "Referenzspannung zur Batteriespannungskorrektur, wenn nicht gepusht wird" VALUE 0x1D2DA6 Kw_Ws16 20010.04 Volt_Batt 0.00 20010.04 FORMAT "%8.2" EXTENDED_LIMITS -665674.1 665653.8 /end CHARACTERISTIC
/begin CHARACTERISTIC GlwCD_uPush_C "Referenzspannung zur Batteriespannungskorrektur im Falle des Pushens" VALUE 0x1D2DA8 Kw_Ws16 20010.04 Volt_Batt 0.00 20010.04 FORMAT "%8.2" EXTENDED_LIMITS -665674.1 665653.8 /end CHARACTERISTIC
/begin CHARACTERISTIC GlwCtl_facGlwPwrRed_MAP "Kennfeld zur Bestimmung des Faktors der Glühleistungsreduzierung" MAP 0x1D3044 Kf_Xs16_Ys16_Ws16 3.000000 Fact1 0.00 3.000000 FORMAT "%8.6" EXTENDED_LIMITS -256.0000 255.9922
 /begin AXIS_DESCR STD_AXIS Eng_nAvrg EngN 6 0.00 6000.000 FORMAT "%8.3" EXTENDED_LIMITS -32768.00 32767.00 DEPOSIT ABSOLUTE /end AXIS_DESCR
 /begin AXIS_DESCR STD_AXIS InjCtl_qAct InjMass 6 0.00 327.6700 FORMAT "%8.4" EXTENDED_LIMITS -327.6800 327.6700 DEPOSIT ABSOLUTE /end AXIS_DESCR
/end CHARACTERISTIC
/begin CHARACTERISTIC GlwCtl_nPost_C "oberer Schwellwert Drehzahl für Ende Nachglühen" VALUE 0x1D2DAA Kw_Ws16 5960.000 EngN 40.00000 6000.000 FORMAT "%8.3" EXTENDED_LIMITS -32768.00 32767.00 /end CHARACTERISTIC
/begin CHARACTERISTIC GlwCtl_nPre_C "oberer Schwellwert Drehzahl für Ende Vorglühen" VALUE 0x1D2DAC Kw_Wu16 5960.000 EngN 40.00000 6000.000 FORMAT "%8.3" EXTENDED_LIMITS 0.00 65535.00 /end CHARACTERISTIC
/begin CHARACTERISTIC GlwCtl_nReady_C "Drehzahlschwelle für Rücksprung von READYNESS GLOW in START GLOW" VALUE 0x1D2DAE Kw_Ws16 5960.000 EngN 40.00000 6000.000 FORMAT "%8.3" EXTENDED_LIMITS -32768.00 32767.00 /end CHARACTERISTIC
/begin CHARACTERISTIC GlwCtl_nThresGSK3_C "Drehzahlschwelle für GSK3" VALUE 0x1D2DB0 Kw_Wu16 5960.000 EngN 40.00000 6000.000 FORMAT "%8.3" EXTENDED_LIMITS 0.00 65535.00 /end CHARACTERISTIC
/begin CHARACTERISTIC GlwCtl_qPost_CUR "Schwellwert Einspritzmenge für Nachglühen" CURVE 0x1D2DB2 Kl_Xs16_Ws16 327.6700 InjMass 0.00 327.6700 FORMAT "%8.4" EXTENDED_LIMITS -327.6800 327.6700
 /begin AXIS_DESCR STD_AXIS GlwCtl_tEng Temp_Cels 25 -50.14000 149.8600 FORMAT "%8.4" EXTENDED_LIMITS -3549.940 3003.560 DEPOSIT ABSOLUTE /end AXIS_DESCR
/end CHARACTERISTIC
/begin CHARACTERISTIC GlwCtl_qThresFlQty_C "Mengenschwelle für das Beenden des Zustands Zwischenglühen" VALUE 0x1D2E18 Kw_Ws16 327.6700 InjMass 0.00 327.6700 FORMAT "%8.4" EXTENDED_LIMITS -327.6800 327.6700 /end CHARACTERISTIC
/begin CHARACTERISTIC GlwCtl_qThresFl_C "Treibstoffmengenschwelle für Zwischenglühen" VALUE 0x1D2E1A Kw_Ws16 327.6700 InjMass 0.00 327.6700 FORMAT "%8.4" EXTENDED_LIMITS -327.6800 327.6700 /end CHARACTERISTIC
/begin CHARACTERISTIC GlwCtl_rOut1_C "GSK3 Tastverhältnis im Vorglühfall, Bereich 1" VALUE 0x1D30A8 Kw_Ws16 100.0000 DtyCyc 0.00 100.0000 FORMAT "%8.4" EXTENDED_LIMITS -327.6800 327.6700 /end CHARACTERISTIC
/begin CHARACTERISTIC GlwCtl_rOut2_C "GSK3 Tastverhältnis im Vorglühfall, Bereich 2" VALUE 0x1D30AA Kw_Ws16 100.0000 DtyCyc 0.00 100.0000 FORMAT "%8.4" EXTENDED_LIMITS -327.6800 327.6700 /end CHARACTERISTIC
/begin CHARACTERISTIC GlwCtl_rOut3_C "GSK3 Tastverhältnis im Vorglühfall, Bereich 3" VALUE 0x1D30AC Kw_Ws16 100.0000 DtyCyc 0.00 100.0000 FORMAT "%8.4" EXTENDED_LIMITS -327.6800 327.6700 /end CHARACTERISTIC
/begin CHARACTERISTIC GlwCtl_rOut_MAP "GSK3-Tastverhältniskennfeld für die Stati Bereitschaftsglühen, Nachglühen und Zwischenglühen" MAP 0x1D30AE Kf_Xs16_Ys16_Ws16 300.0000 DtyCyc -100.0000 200.0000 FORMAT "%8.4" EXTENDED_LIMITS -327.6800 327.6700
 /begin AXIS_DESCR STD_AXIS Eng_nAvrg EngN 10 0.00 6000.000 FORMAT "%8.3" EXTENDED_LIMITS -32768.00 32767.00 DEPOSIT ABSOLUTE /end AXIS_DESCR
 /begin AXIS_DESCR STD_AXIS InjCtl_qCurr InjMass 10 0.00 327.6700 FORMAT "%8.4" EXTENDED_LIMITS -327.6800 327.6700 DEPOSIT ABSOLUTE /end AXIS_DESCR
/end CHARACTERISTIC
/begin CHARACTERISTIC GlwCtl_rStrt_C "GSK3 Tastverhältnis im Startglühfall" VALUE 0x1D31A2 Kw_Ws16 100.0000 DtyCyc 0.00 100.0000 FORMAT "%8.4" EXTENDED_LIMITS -327.6800 327.6700 /end CHARACTERISTIC
/begin CHARACTERISTIC GlwCtl_uXLow_C "untere Schwelle der Batteriespannungshysterese für alle Glühzustände" VALUE 0x1D31A4 Kw_Ws16 20782.00 Volt_Batt 0.00 20782.00 FORMAT "%8.2" EXTENDED_LIMITS -665674.1 665653.8 /end CHARACTERISTIC
/begin CHARACTERISTIC GlwCtl_uXHigh_C "obere Schwelle der Batteriespannungshysterese für alle Glühzustände" VALUE 0x1D31A6 Kw_Ws16 20782.00 Volt_Batt 0.00 20782.00 FORMAT "%8.2" EXTENDED_LIMITS -665674.1 665653.8 /end CHARACTERISTIC
/begin CHARACTERISTIC GlwCtl_YLow_C "Ausgang Hysterese Low" VALUE 0x1D31A8 Kw_Ws16 65535.00 OneToOne -32768.00 32767.00 FORMAT "%8.2" /end CHARACTERISTIC
/begin CHARACTERISTIC GlwCtl_YHigh_C "Ausgang Hysterese High" VALUE 0x1D31AA Kw_Ws16 65535.00 OneToOne -32768.00 32767.00 FORMAT "%8.2" /end CHARACTERISTIC
/begin CHARACTERISTIC GlwCtl_swtEnergPreEnaVal_C "Softwareschalter für Vorglühen mit Energieeintrag" VALUE 0x1D2E1C Kw_Wu8 1.000 OneToOne 0.00 1.000 FORMAT "%5.3" EXTENDED_LIMITS 0.00 255.0 /end CHARACTERISTIC
/begin CHARACTERISTIC GlwCtl_swtGSKModeVal_C "Schalterwert zur Wahl von GSK-Modus" VALUE 0x1D2E1D Kw_Wu8 7.000 OneToOne 0.00 7.000 FORMAT "%5.3" EXTENDED_LIMITS 0.00 255.0 /end CHARACTERISTIC
/begin CHARACTERISTIC GlwCtl_swtGSKModeType_C "Typ des Schalters zur Wahl von GSK-Modus" VALUE 0x1D2E1E Kw_Wu8 2.000 OneToOne 0.00 2.000 FORMAT "%5.3" EXTENDED_LIMITS 0.00 255.0 /end CHARACTERISTIC
/begin CHARACTERISTIC GlwCtl_swtPreGlowVal_C "Schalterwert für Glühkontrolllampenansteuerung" VALUE 0x1D31AC Kw_Wu8 1.000 OneToOne 0.00 1.000 FORMAT "%5.3" EXTENDED_LIMITS 0.00 255.0 /end CHARACTERISTIC
/begin CHARACTERISTIC GlwCtl_swtPreGlowType_C "Schaltertyp für Glühkontrolllampenansteuerung" VALUE 0x1D31AD Kw_Wu8 2.000 OneToOne 0.00 2.000 FORMAT "%5.3" EXTENDED_LIMITS 0.00 255.0 /end CHARACTERISTIC
/begin CHARACTERISTIC GlwCtl_swtPshDisable_C "Softwareschalter für Pushen" VALUE 0x1D2E1F Kw_Wu8 1.000 OneToOne 0.00 1.000 FORMAT "%5.3" EXTENDED_LIMITS 0.00 255.0 /end CHARACTERISTIC
/begin CHARACTERISTIC GlwCtl_swtRatStrt_C "Schalter-Wert fuer die Auswahl des Ausgangs-Tastverhaeltnis im Zustand Startgluehen" VALUE 0x1D31AE Kw_Wu8 1.000 OneToOne 0.00 1.000 FORMAT "%5.3" EXTENDED_LIMITS 0.00 255.0 /end CHARACTERISTIC
/begin CHARACTERISTIC GlwCtl_swtSpareStrtEn_C "kein Nachglühen im Notstartfall (0: keine Verzögerung/1: Verzögerung aktiv)" VALUE 0x1D2E20 Kw_Wu16 1.000000 OneToOne 0.00 1.000000 FORMAT "%8.6" EXTENDED_LIMITS 0.00 65535.00 /end CHARACTERISTIC
/begin CHARACTERISTIC GlwCtl_swtTempDef_C "Schalter der Temperaturwert des Arrays auswählt" VALUE 0x1D2E22 Kw_Wu8 4.00000000000 EngTempFldSel 0.00 4.00000000000 FORMAT "%13.11" /end CHARACTERISTIC
/begin CHARACTERISTIC GlwCtl_swtVarBatt_C "Variantenschalter zur Auswahl von Batteriespannungskennfeld oder Luftkennfeld zur Berechnung der Vorglühzeit" VALUE 0x1D2E24 Kw_Wu16 1.000000 OneToOne 0.00 1.000000 FORMAT "%8.6" EXTENDED_LIMITS 0.00 65535.00 /end CHARACTERISTIC
/begin CHARACTERISTIC GlwCtl_tAdjMax_C "Maximaler Abgleichwert f. Abgleich Kühlmitteltemperaturbegrenzung" VALUE 0x1D2E26 Kw_Ws16 100.0000 TempDiff_Kelv -50.00000 50.00000 FORMAT "%8.5" EXTENDED_LIMITS -3276.800 3276.700 /end CHARACTERISTIC
/begin CHARACTERISTIC GlwCtl_tAdjMin_C "Minimaler Abgleichwert f. Abgleich Kühlmitteltemperaturbegrenzung" VALUE 0x1D2E28 Kw_Ws16 100.0000 TempDiff_Kelv -50.00000 50.00000 FORMAT "%8.5" EXTENDED_LIMITS -3276.800 3276.700 /end CHARACTERISTIC
/begin CHARACTERISTIC GlwCtl_tAdjVal_C "Referenzwert f. Abgleich Kühlmitteltemperaturbegrenzung" VALUE 0x1D2E2A Kw_Ws16 100.0000 TempDiff_Kelv -50.00000 50.00000 FORMAT "%8.5" EXTENDED_LIMITS -3276.800 3276.700 /end CHARACTERISTIC
/begin CHARACTERISTIC GlwCtl_tDflEng_C "Temperaturersatzwert" VALUE 0x1D2E2C Kw_Ws16 250.0000 Temp_Cels -50.14000 199.8600 FORMAT "%8.4" EXTENDED_LIMITS -3549.940 3003.560 /end CHARACTERISTIC
/begin CHARACTERISTIC GlwCtl_tiChk_C "Sperrzeit für Zwischenglühfall" VALUE 0x1D2E2E Kw_Wu16 655350.0 Time_ms 0.00 655350.0 FORMAT "%8.1" /end CHARACTERISTIC
/begin CHARACTERISTIC GlwCtl_tiClgHigh_C "max. Begrenzung der Ablaufzeit des Glühkerzen Abkühl-Timers" VALUE 0x1D2E30 Kw_Wu16 655140.0 Time_ms 0.00 655140.0 FORMAT "%8.1" EXTENDED_LIMITS 0.00 655350.0 /end CHARACTERISTIC
/begin CHARACTERISTIC GlwCtl_tiClgLow_C "min. Begrenzung der Ablaufzeit des Glühkerzen Abkühl-Timers" VALUE 0x1D2E32 Kw_Wu16 655140.0 Time_ms 0.00 655140.0 FORMAT "%8.1" EXTENDED_LIMITS 0.00 655350.0 /end CHARACTERISTIC
/begin CHARACTERISTIC GlwCtl_tiDebPre_C "Entprellzeit für Ende Vorglühen falls Schwellwert Drehzahl erreicht ist" VALUE 0x1D2E34 Kw_Wu16 655350.0 Time_ms 0.00 655350.0 FORMAT "%8.1" /end CHARACTERISTIC
/begin CHARACTERISTIC GlwCtl_tiDebPwrRed_C "Zeit, in der sich der Ausgang der Hysterese nicht ändern darf, um auf den Ausgang geschrieben zu werden" VALUE 0x1D31B0 Kw_Wu16 200000.0 Time_ms 0.00 200000.0 FORMAT "%8.1" EXTENDED_LIMITS 0.00 655350.0 /end CHARACTERISTIC
/begin CHARACTERISTIC GlwCtl_tiDebT50_C "Entprellzeit für Zustandswechsel nach START GLOW" VALUE 0x1D2E36 Kw_Wu16 655350.0 Time_ms 0.00 655350.0 FORMAT "%8.1" /end CHARACTERISTIC
/begin CHARACTERISTIC GlwCtl_tiDel_C "Wartezeit für Nach- oder Zwischenglühen" VALUE 0x1D2E38 Kw_Wu16 655350.0 Time_ms 0.00 655350.0 FORMAT "%8.1" /end CHARACTERISTIC
/begin CHARACTERISTIC GlwCtl_tiGlowMax_C "maximale Glühzeit für Zwischenglühen" VALUE 0x1D2E3A Kw_Wu16 655350.0 Time_ms 0.00 655350.0 FORMAT "%8.1" /end CHARACTERISTIC
/begin CHARACTERISTIC GlwCtl_tiOut1_CUR "Kennlinie zur Berechnung der Vorglühzeit im Bereich 1" CURVE 0x1D2E3C Kl_Xs16_Ws16 335500.0 GlwCtl_Time_ms 0.00 335500.0 FORMAT "%8.1" EXTENDED_LIMITS -3276800. 3276700.
 /begin AXIS_DESCR STD_AXIS GlwCtl_tEng Temp_Cels 25 -50.14000 199.8600 FORMAT "%8.4" EXTENDED_LIMITS -3549.940 3003.560 DEPOSIT ABSOLUTE /end AXIS_DESCR
/end CHARACTERISTIC
/begin CHARACTERISTIC GlwCtl_tiOut2_C "GSK3 Vorglühzeit in Bereich 2" VALUE 0x1D31B4 Kw_Wu32 429496729500. GlwCtl_Time_ms 0.00 429496729500. FORMAT "%13.0" /end CHARACTERISTIC
/begin CHARACTERISTIC GlwCtl_tiPost_CUR "Nachglühzeit" CURVE 0x1D2EA2 Kl_Xs16_Ws16 335500.0 GlwCtl_Time_ms 0.00 335500.0 FORMAT "%8.1" EXTENDED_LIMITS -3276800. 3276700.
 /begin AXIS_DESCR STD_AXIS GlwCtl_tEng Temp_Cels 25 -50.14000 199.8600 FORMAT "%8.4" EXTENDED_LIMITS -3549.940 3003.560 DEPOSIT ABSOLUTE /end AXIS_DESCR
/end CHARACTERISTIC
/begin CHARACTERISTIC GlwCtl_tiPre1_MAP "Vorglühzeit (1)  als Funktion von Batteriespannung und Wassertemperatur" MAP 0x1D2F08 Kf_Xs16_Ys16_Ws16 335500.0 GlwCtl_Time_ms 0.00 335500.0 FORMAT "%8.1" EXTENDED_LIMITS -3276800. 3276700.
 /begin AXIS_DESCR STD_AXIS BattCD_u Volt_Batt 4 0.00 20842.94 FORMAT "%8.2" EXTENDED_LIMITS -665674.1 665653.8 DEPOSIT ABSOLUTE /end AXIS_DESCR
 /begin AXIS_DESCR STD_AXIS GlwCtl_tEngAdj Temp_Cels 7 -50.14000 199.8600 FORMAT "%8.4" EXTENDED_LIMITS -3549.940 3003.560 DEPOSIT ABSOLUTE /end AXIS_DESCR
/end CHARACTERISTIC
/begin CHARACTERISTIC GlwCtl_tiPre2_MAP "Vorglühzeit (2) als Funktion des Luftdruckes und der Wassertemperatur" MAP 0x1D2F5A Kf_Xs16_Ys16_Ws16 335500.0 GlwCtl_Time_ms 0.00 335500.0 FORMAT "%8.1" EXTENDED_LIMITS -3276800. 3276700.
 /begin AXIS_DESCR STD_AXIS APSCD_pVal Pres_hPa 4 0.00 3500.000 FORMAT "%8.3" EXTENDED_LIMITS -32768.00 32767.00 DEPOSIT ABSOLUTE /end AXIS_DESCR
 /begin AXIS_DESCR STD_AXIS GlwCtl_tEngAdj Temp_Cels 7 -50.14000 199.8600 FORMAT "%8.4" EXTENDED_LIMITS -3549.940 3003.560 DEPOSIT ABSOLUTE /end AXIS_DESCR
/end CHARACTERISTIC
/begin CHARACTERISTIC GlwCtl_tiPreGlowPsh_CUR "Kennlinie für die Dauer der Ansteuerung der Glühkontrolllampe während des Pushens" CURVE 0x1D31B8 Kl_Xs16_Ws16 335500.0 GlwCtl_Time_ms 0.00 335500.0 FORMAT "%8.1" EXTENDED_LIMITS -3276800. 3276700.
 /begin AXIS_DESCR STD_AXIS GlwCtl_tEng Temp_Cels 8 -50.14000 199.8600 FORMAT "%8.4" EXTENDED_LIMITS -3549.940 3003.560 DEPOSIT ABSOLUTE /end AXIS_DESCR
/end CHARACTERISTIC
/begin CHARACTERISTIC GlwCtl_tiPreGlow_CUR "Kennlinie für die Dauer der Ansteuerung der Glühkontrolllampe" CURVE 0x1D31DA Kl_Xs16_Ws16 335500.0 GlwCtl_Time_ms 0.00 335500.0 FORMAT "%8.1" EXTENDED_LIMITS -3276800. 3276700.
 /begin AXIS_DESCR STD_AXIS GlwCtl_tEng Temp_Cels 8 -50.14000 199.8600 FORMAT "%8.4" EXTENDED_LIMITS -3549.940 3003.560 DEPOSIT ABSOLUTE /end AXIS_DESCR
/end CHARACTERISTIC
/begin CHARACTERISTIC GlwCtl_tiReady_C "Dauer Status Startbereitschaftsglühen" VALUE 0x1D2FAC Kw_Wu16 655350.0 Time_ms 0.00 655350.0 FORMAT "%8.1" /end CHARACTERISTIC
/begin CHARACTERISTIC GlwCtl_tiSpareStrtDel_C "Nachglüh Verzögerungszeit im Notstartfall" VALUE 0x1D2FAE Kw_Wu16 65540.00 Time_ms 0.00 65540.00 FORMAT "%8.2" EXTENDED_LIMITS 0.00 655350.0 /end CHARACTERISTIC
/begin CHARACTERISTIC GlwCtl_tiStrt_C "Dauer Status Startglühen" VALUE 0x1D2FB0 Kw_Wu16 655350.0 Time_ms 0.00 655350.0 FORMAT "%8.1" /end CHARACTERISTIC
/begin CHARACTERISTIC GlwCtl_tiThresFl1_CUR "Kennlinie für Wartezeit für Übergang ""Kein Glühen"" zu ""Warten auf Zwischenglühen""" CURVE 0x1D2FB2 Kl_Xs16_Ws16 327570.0 Time_ms 0.00 327570.0 FORMAT "%8.1" EXTENDED_LIMITS -327680.0 327670.0
 /begin AXIS_DESCR STD_AXIS IATSCD_tAir Temp_Cels 25 -50.14000 199.8600 FORMAT "%8.4" EXTENDED_LIMITS -3549.940 3003.560 DEPOSIT ABSOLUTE /end AXIS_DESCR
/end CHARACTERISTIC
/begin CHARACTERISTIC GlwCtl_tiThresFl2_C "Wartezeit für Übergang ""Zwischenglühen"" nach ""Kein Glühen""" VALUE 0x1D3018 Kw_Wu16 655350.0 Time_ms 0.00 655350.0 FORMAT "%8.1" /end CHARACTERISTIC
/begin CHARACTERISTIC GlwCtl_tiThresFl3_C "Wartezeit für Übergang ""Warten auf Zwischenglühen"" zu ""Kein Glühen""" VALUE 0x1D301A Kw_Wu16 655350.0 Time_ms 0.00 655350.0 FORMAT "%8.1" /end CHARACTERISTIC
/begin CHARACTERISTIC GlwCtl_tStrt_C "Oberer Schwellwert der Wassertemperatur für Startglühen" VALUE 0x1D301C Kw_Ws16 250.0000 Temp_Cels -50.14000 199.8600 FORMAT "%8.4" EXTENDED_LIMITS -3549.940 3003.560 /end CHARACTERISTIC
/begin CHARACTERISTIC GlwCtl_tThresSwttiClg_C "Temperaturschwelle für Auswahl der Glühkerzen Abkühlzeit" VALUE 0x1D301E Kw_Ws16 250.0000 Temp_Cels -50.14000 199.8600 FORMAT "%8.4" EXTENDED_LIMITS -3549.940 3003.560 /end CHARACTERISTIC
/begin CHARACTERISTIC GlwCtl_uThresHighGSK3_C "obere Batterispannungshysteregrenze für GSK3" VALUE 0x1D31FC Kw_Ws16 20782.00 Volt_Batt 0.00 20782.00 FORMAT "%8.2" EXTENDED_LIMITS -665674.1 665653.8 /end CHARACTERISTIC
/begin CHARACTERISTIC GlwCtl_uThresLowGSK3_C "untere Batterispannungshysteregrenze für GSK3" VALUE 0x1D31FE Kw_Ws16 20782.00 Volt_Batt 0.00 20782.00 FORMAT "%8.2" EXTENDED_LIMITS -665674.1 665653.8 /end CHARACTERISTIC
/begin CHARACTERISTIC GlwCtl_wEnergPreMax_C "max. Energie für Hochvorglühen Integrator" VALUE 0x1D3020 Kw_Ws16 500.0000 SqrVltg_s 0.00 500.0000 FORMAT "%8.4" EXTENDED_LIMITS -3276.800 3276.700 /end CHARACTERISTIC
/begin CHARACTERISTIC GlwCtl_wEnergPre_CUR "Kennlinie für Energieberechnung für das Hochvorglühen" CURVE 0x1D3022 Kl_Xs16_Ws16 500.0000 SqrVltg_s 0.00 500.0000 FORMAT "%8.4" EXTENDED_LIMITS -3276.800 3276.700
 /begin AXIS_DESCR STD_AXIS GlwCtl_tEng Temp_Cels 8 -50.14000 149.8600 FORMAT "%8.4" EXTENDED_LIMITS -3549.940 3003.560 DEPOSIT ABSOLUTE /end AXIS_DESCR
/end CHARACTERISTIC
/begin CHARACTERISTIC HDSCD_uSRCMin_C "Minimalwert für SRC HZA-Sensor" VALUE 0x1D3200 Kw_Ws16 5200.391 Volt 0.00 5200.391 FORMAT "%8.3" EXTENDED_LIMITS -160156.4 160151.5 /end CHARACTERISTIC
/begin CHARACTERISTIC HDSCD_uSRCMax_C "Maximalwert für SRC HZA-Sensor" VALUE 0x1D3202 Kw_Ws16 5200.391 Volt 0.00 5200.391 FORMAT "%8.3" EXTENDED_LIMITS -160156.4 160151.5 /end CHARACTERISTIC
/begin CHARACTERISTIC HDSCD_prcLin_CUR "Linearisierungskennlinie für Heizungsanforderung" CURVE 0x1D3204 Kl_Xs16_Ws16 100.0000 Prc 0.00 100.0000 FORMAT "%8.4" EXTENDED_LIMITS -327.6800 327.6700
 /begin AXIS_DESCR STD_AXIS HDSCD_uRaw Volt 4 0.00 5200.391 FORMAT "%8.3" EXTENDED_LIMITS -160156.4 160151.5 DEPOSIT ABSOLUTE /end AXIS_DESCR
/end CHARACTERISTIC
/begin CHARACTERISTIC HDSCD_DebSRCHighDef_C "HZA Fehlerentprellzeit fuer SRC-High" VALUE 0x1D3216 Kw_Wu16 655350.0 Time_ms 0.00 655350.0 FORMAT "%8.1" /end CHARACTERISTIC
/begin CHARACTERISTIC HDSCD_DebSRCHighOk_C "HZA Heilungsentprellzeit fuer SRC-High" VALUE 0x1D3218 Kw_Wu16 655350.0 Time_ms 0.00 655350.0 FORMAT "%8.1" /end CHARACTERISTIC
/begin CHARACTERISTIC HDSCD_DebSRCLowDef_C "HZA Fehlerentprellzeit fuer SRC-Low" VALUE 0x1D321A Kw_Wu16 655350.0 Time_ms 0.00 655350.0 FORMAT "%8.1" /end CHARACTERISTIC
/begin CHARACTERISTIC HDSCD_DebSRCLowOk_C "HZA Heilungsentprellzeit fuer SRC-Low" VALUE 0x1D321C Kw_Wu16 655350.0 Time_ms 0.00 655350.0 FORMAT "%8.1" /end CHARACTERISTIC
/begin CHARACTERISTIC HDSCD_dprcRmpSlpUp_C "positive Rampensteigung zum Erreichen des Vorgabewertes" VALUE 0x1D3220 Kw_Wu32 100.000000000 RmpPrc 0.00 100.000000000 FORMAT "%13.9" EXTENDED_LIMITS 0.00 655359.999847 /end CHARACTERISTIC
/begin CHARACTERISTIC HDSCD_dprcRmpSlpDwn_C "negative Rampensteigung zum Erreichen des Vorgabewertes" VALUE 0x1D3224 Kw_Wu32 100.000000000 RmpPrc 0.00 100.000000000 FORMAT "%13.9" EXTENDED_LIMITS 0.00 655359.999847 /end CHARACTERISTIC
/begin CHARACTERISTIC HDSCD_stSensIDWord_C "Geberkennwort HZA-Sensor" VALUE 0x1D3228 Kw_Wu16 65535.00 OneToOne 0.00 65535.00 FORMAT "%8.2" /end CHARACTERISTIC
/begin CHARACTERISTIC HDSCD_prcAirDfl_C "Ersatzwert für Heizungsanforderung" VALUE 0x1D322A Kw_Ws16 100.0000 Prc 0.00 100.0000 FORMAT "%8.4" EXTENDED_LIMITS -327.6800 327.6700 /end CHARACTERISTIC
/begin CHARACTERISTIC HPUn_dvolMeUnMax_C "maximales Fördervolumen durch die Zumesseinheit" VALUE 0x1D322C Kw_Ws16 50000.00 Qp_mm3_sec 0.00 50000.00 FORMAT "%8.2" EXTENDED_LIMITS -327680.0 327670.0 /end CHARACTERISTIC
/begin CHARACTERISTIC HPUn_etaPmpFlTemp_CUR "Kraftstofftemperaturabhängiger Wirkungsgrad der Hochdruckpumpe" CURVE 0x1D322E Kl_Xs16_Ws16 0.9921875 Eta 0.007812500 1.000000 FORMAT "%8.6" EXTENDED_LIMITS -256.0000 255.9922
 /begin AXIS_DESCR STD_AXIS FlSys_t Temp_Cels 12 -50.14000 149.8600 FORMAT "%8.4" EXTENDED_LIMITS -3549.940 3003.560 DEPOSIT ABSOLUTE /end AXIS_DESCR
/end CHARACTERISTIC
/begin CHARACTERISTIC HPUn_etaPmpMaxAged_CUR "Maximaler Wirkungsgrad einer gealterten Hochdruckpumpe" CURVE 0x1D3260 Kl_Xs16_Ws16 0.9921875 Eta 0.007812500 1.000000 FORMAT "%8.6" EXTENDED_LIMITS -256.0000 255.9922
 /begin AXIS_DESCR STD_AXIS Eng_nAvrg EngN 12 0.00 6000.000 FORMAT "%8.3" EXTENDED_LIMITS -32768.00 32767.00 DEPOSIT ABSOLUTE /end AXIS_DESCR
/end CHARACTERISTIC
/begin CHARACTERISTIC HPUn_etaPmpMech_C "mechanischer Wirkungsgrad der Hochdruckpumpe" VALUE 0x1D3292 Kw_Ws16 0.9921875 Eta 0.007812500 1.000000 FORMAT "%8.6" EXTENDED_LIMITS -256.0000 255.9922 /end CHARACTERISTIC
/begin CHARACTERISTIC HPUn_nMin_C "Drehzahlschwelle zur Abschaltung der Lastmomentberechnung der Hochdruckpumpe" VALUE 0x1D3294 Kw_Ws16 6000.000 EngN 0.00 6000.000 FORMAT "%8.3" EXTENDED_LIMITS -32768.00 32767.00 /end CHARACTERISTIC
/begin CHARACTERISTIC HPUn_numInjMin_C "Minimal von der Hochdruckpumpe erlaubte  Anzahl an Einspritzungen" VALUE 0x1D3510 Kw_Wu8 6.000 OneToOne 0.00 6.000 FORMAT "%5.3" EXTENDED_LIMITS 0.00 255.0 /end CHARACTERISTIC
/begin CHARACTERISTIC HPUn_pRailDvtOk_C "Maximale Raildruck Regelabweichung für die Mengenbilanzprüfung" VALUE 0x1D3512 Kw_Wu16 1800000. Pres_Rail 0.00 1800000. FORMAT "%8.0" EXTENDED_LIMITS 0.00 6553500. /end CHARACTERISTIC
/begin CHARACTERISTIC HPUn_tiPresDvtFlt_C "PT1 Zeitkonstante zur Filterung der Raildruck Regelabweichung" VALUE 0x1D3514 Kw_Wu32 4294.9673 TimeDelay_s 0.0000010000000 4294.9673 FORMAT "%9.4" /end CHARACTERISTIC
/begin CHARACTERISTIC HPUn_qBalLim_CUR "Begrenzungsmenge auf Grund der Mengenbilanz der Hochdruckpumpe" CURVE 0x1D3296 Kl_Xs16_Ws16 327.6700 InjMassCyc 0.00 327.6700 FORMAT "%8.4" EXTENDED_LIMITS -327.6800 327.6700
 /begin AXIS_DESCR STD_AXIS Eng_nAvrg EngN 12 0.00 6000.000 FORMAT "%8.3" EXTENDED_LIMITS -32768.00 32767.00 DEPOSIT ABSOLUTE /end AXIS_DESCR
/end CHARACTERISTIC
/begin CHARACTERISTIC HPUn_qFlTempLim_MAP "Kennfeld für Begrenzungsmenge abhängig der Kraftstofftemperatur" MAP 0x1D32C8 Kf_Xs16_Ys16_Ws16 327.6700 InjMassCyc 0.00 327.6700 FORMAT "%8.4" EXTENDED_LIMITS -327.6800 327.6700
 /begin AXIS_DESCR STD_AXIS Eng_nAvrg EngN 16 0.00 6000.000 FORMAT "%8.3" EXTENDED_LIMITS -32768.00 32767.00 DEPOSIT ABSOLUTE /end AXIS_DESCR
 /begin AXIS_DESCR STD_AXIS FTSCD_tFuel Temp_Cels 16 -50.14000 149.8600 FORMAT "%8.4" EXTENDED_LIMITS -3549.940 3003.560 DEPOSIT ABSOLUTE /end AXIS_DESCR
/end CHARACTERISTIC
/begin CHARACTERISTIC HPUn_rTransCrS_C "Übersetzung Hochdruckpumpe zu Kurbelwelle" VALUE 0x1D350C Kw_Ws16 10.00000 TransR 0.00 10.00000 FORMAT "%8.5" EXTENDED_LIMITS -327.6800 327.6700 /end CHARACTERISTIC
/begin CHARACTERISTIC HPUn_tiQntBalDel_C "Verzögerungszeit zur Berechnung der Mengenbilanz der Hochdruckpumpe" VALUE 0x1D3518 Kw_Wu16 655140.0 Time_ms 0.00 655140.0 FORMAT "%8.1" EXTENDED_LIMITS 0.00 655350.0 /end CHARACTERISTIC
/begin CHARACTERISTIC HPUn_volPmp_C "geometrisches Fördervolumen der Hochdruckpumpe pro Pumpenumdrehung" VALUE 0x1D350E Kw_Ws16 1500.000 PmpQnt 0.00 1500.000 FORMAT "%8.3" EXTENDED_LIMITS -3276.800 3276.700 /end CHARACTERISTIC
/begin CHARACTERISTIC HWEMon_DebComStepDown_C "Abwärts Schrittweite für Entprellung SPI Kommunikation" VALUE 0x1D351C Kw_Wu8 3.000 OneToOne 0.00 3.000 FORMAT "%5.3" EXTENDED_LIMITS 0.00 255.0 /end CHARACTERISTIC
/begin CHARACTERISTIC HWEMon_DebComStepUp_C "Aufwärts Schrittweite für Entprellung SPI Kommunikation" VALUE 0x1D351D Kw_Wu8 3.000 OneToOne 0.00 3.000 FORMAT "%5.3" EXTENDED_LIMITS 0.00 255.0 /end CHARACTERISTIC
/begin CHARACTERISTIC HWEMon_DebComDef_C "Entprellung für defekt Erkennung der SPI Kommunikation" VALUE 0x1D351E Kw_Wu16 65535.00 OneToOne 0.00 65535.00 FORMAT "%8.2" /end CHARACTERISTIC
/begin CHARACTERISTIC HWEMon_DebComOk_C "Entprellung für intakt Erkennung der SPI Kommunikation" VALUE 0x1D3520 Kw_Wu16 65535.00 OneToOne 0.00 65535.00 FORMAT "%8.2" /end CHARACTERISTIC
/begin CHARACTERISTIC HWEMon_nThres_C "Drehzahlschwelle für Latchbetrieb der Überspannungsüberwachung (nur für CJ945)" VALUE 0x1D3522 Kw_Ws16 300.0000 EngN 300.0000 600.0000 FORMAT "%8.4" EXTENDED_LIMITS -32768.00 32767.00 /end CHARACTERISTIC
/begin CHARACTERISTIC HWEMon_numTrigRecovery_C "Nummer der durch Änderung dieses Labels auszulösenden Recovery" VALUE 0x1D3524 Kw_Wu16 65535.00 OneToOne 0.00 65535.00 FORMAT "%8.2" /end CHARACTERISTIC
/begin CHARACTERISTIC IATSCD_uSRCMin_C "Minimalwert für SRC LTF-Sensor" VALUE 0x1D3528 Kw_Ws16 5200.391 Volt 0.00 5200.391 FORMAT "%8.3" EXTENDED_LIMITS -160156.4 160151.5 /end CHARACTERISTIC
/begin CHARACTERISTIC IATSCD_uSRCMax_C "Maximalwert für SRC LTF-Sensor" VALUE 0x1D352A Kw_Ws16 5200.391 Volt 0.00 5200.391 FORMAT "%8.3" EXTENDED_LIMITS -160156.4 160151.5 /end CHARACTERISTIC
/begin CHARACTERISTIC IATSCD_tLin_CUR "Linearisierungskennlinie für LTF-Sensor" CURVE 0x1D352C Kl_Xs16_Ws16 250.0000 Temp_Cels -50.04000 199.9600 FORMAT "%8.4" EXTENDED_LIMITS -3549.940 3003.560
 /begin AXIS_DESCR STD_AXIS IATSCD_uRaw Volt 25 0.00 5200.391 FORMAT "%8.3" EXTENDED_LIMITS -160156.4 160151.5 DEPOSIT ABSOLUTE /end AXIS_DESCR
/end CHARACTERISTIC
/begin CHARACTERISTIC IATSCD_DebSigDef_C "Ladelufttemperatur - Entprellzeit bis Signal defekt" VALUE 0x1D3592 Kw_Wu16 655350.0 Time_ms 0.00 655350.0 FORMAT "%8.1" /end CHARACTERISTIC
/begin CHARACTERISTIC IATSCD_DebSigOk_C "Ladelufttemperatur - Entprellzeit bis Signal geheilt" VALUE 0x1D3594 Kw_Wu16 655350.0 Time_ms 0.00 655350.0 FORMAT "%8.1" /end CHARACTERISTIC
/begin CHARACTERISTIC IATSCD_DebSRCHighDef_C "LTF Fehlerentprellzeit fuer SRC-High" VALUE 0x1D3596 Kw_Wu16 655350.0 Time_ms 0.00 655350.0 FORMAT "%8.1" /end CHARACTERISTIC
/begin CHARACTERISTIC IATSCD_DebSRCHighOk_C "LTF Heilungsentprellzeit fuer SRC-High" VALUE 0x1D3598 Kw_Wu16 655350.0 Time_ms 0.00 655350.0 FORMAT "%8.1" /end CHARACTERISTIC
/begin CHARACTERISTIC IATSCD_DebSRCLowDef_C "LTF Fehlerentprellzeit fuer SRC-Low" VALUE 0x1D359A Kw_Wu16 655350.0 Time_ms 0.00 655350.0 FORMAT "%8.1" /end CHARACTERISTIC
/begin CHARACTERISTIC IATSCD_DebSRCLowOk_C "LTF Heilungsentprellzeit fuer SRC-Low" VALUE 0x1D359C Kw_Wu16 655350.0 Time_ms 0.00 655350.0 FORMAT "%8.1" /end CHARACTERISTIC
/begin CHARACTERISTIC IATSCD_dtRmpSlpUp_C "Rampensteigung bei Heilung/Vorgabewert für LTF" VALUE 0x1D35A0 Kw_Wu32 6553599.99847 RmpTemp 0.00 6553599.99847 FORMAT "%13.5" /end CHARACTERISTIC
/begin CHARACTERISTIC IATSCD_dtRmpSlpDwn_C "Rampensteigung bei Heilung/Vorgabewert für LTF" VALUE 0x1D35A4 Kw_Wu32 6553599.99847 RmpTemp 0.00 6553599.99847 FORMAT "%13.5" /end CHARACTERISTIC
/begin CHARACTERISTIC IATSCD_swtSigVal_C "Lufttemperatur - Funktionsschalter Signalquelle ADC oder CAN" VALUE 0x1D35A8 Kw_Wu8 1.000 OneToOne 0.00 1.000 FORMAT "%5.3" EXTENDED_LIMITS 0.00 255.0 /end CHARACTERISTIC
/begin CHARACTERISTIC IATSCD_stSensIDWord_C "Geberkennwort LTF-Sensor" VALUE 0x1D35AA Kw_Wu16 65535.00 OneToOne 0.00 65535.00 FORMAT "%8.2" /end CHARACTERISTIC
/begin CHARACTERISTIC IATSCD_tDfl_C "Vorgabewert bei defektem LTF-Sensor" VALUE 0x1D35AC Kw_Ws16 200.0000 Temp_Cels -50.14000 149.8600 FORMAT "%8.4" EXTENDED_LIMITS -3549.940 3003.560 /end CHARACTERISTIC
/begin CHARACTERISTIC IFCD_DebExcTempDef_C "Fehlerentprellzeit für Übertemperatur" VALUE 0x1D35B0 Kw_Wu16 655350.0 Time_ms 0.00 655350.0 FORMAT "%8.1" /end CHARACTERISTIC
/begin CHARACTERISTIC IFCD_DebExcTempOK_C "Heilungsentprellzeit für Übertemperatur" VALUE 0x1D35B2 Kw_Wu16 655350.0 Time_ms 0.00 655350.0 FORMAT "%8.1" /end CHARACTERISTIC
/begin CHARACTERISTIC IFCD_DebNoLoadDef_C "Fehlerentprellzeit für Lastabfall" VALUE 0x1D35B4 Kw_Wu16 655350.0 Time_ms 0.00 655350.0 FORMAT "%8.1" /end CHARACTERISTIC
/begin CHARACTERISTIC IFCD_DebNoLoadOK_C "Heilungsentprellzeit für Lastabfall" VALUE 0x1D35B6 Kw_Wu16 655350.0 Time_ms 0.00 655350.0 FORMAT "%8.1" /end CHARACTERISTIC
/begin CHARACTERISTIC IFCD_DebShortCircBatDef_C "Fehlerentprellzeit für Kurzschluß nach Batteriespannung" VALUE 0x1D35B8 Kw_Wu16 655350.0 Time_ms 0.00 655350.0 FORMAT "%8.1" /end CHARACTERISTIC
/begin CHARACTERISTIC IFCD_DebShortCircBatOK_C "Heilungsentprellzeit für Kurzschluß nach Batteriespannung" VALUE 0x1D35BA Kw_Wu16 655350.0 Time_ms 0.00 655350.0 FORMAT "%8.1" /end CHARACTERISTIC
/begin CHARACTERISTIC IFCD_DebShortCircGndDef_C "Fehlerentprellzeit für Kurzschluss nach Masse" VALUE 0x1D35BC Kw_Wu16 655350.0 Time_ms 0.00 655350.0 FORMAT "%8.1" /end CHARACTERISTIC
/begin CHARACTERISTIC IFCD_DebShortCircGndOK_C "Heilungsentprellzeit für Kurzschluss nach Masse" VALUE 0x1D35BE Kw_Wu16 655350.0 Time_ms 0.00 655350.0 FORMAT "%8.1" /end CHARACTERISTIC
/begin CHARACTERISTIC IFCD_stInvOut_C "Invertierungsparameter für das Endstufensignal der Lüftersteuerung für den Ladeluftkühler" VALUE 0x1D35C0 Kw_Wu8 1.000 OneToOne 0.00 1.000 FORMAT "%5.3" EXTENDED_LIMITS 0.00 255.0 /end CHARACTERISTIC
/begin CHARACTERISTIC IFCD_stPwrStgActv_C "Statuswort für die Deaktivierung der Endsufe" VALUE 0x1D35C1 Kw_Wu8 255.0 OneToOne 0.00 255.0 FORMAT "%5.1" /end CHARACTERISTIC
/begin CHARACTERISTIC IFCD_stPwrStgDia_C "Status Wort für die Deaktivierung der Diagnose" VALUE 0x1D35C2 Kw_Wu8 255.0 OneToOne 0.00 255.0 FORMAT "%5.1" /end CHARACTERISTIC
/begin CHARACTERISTIC IFCD_tiIFcheckDfpTmr_C "IF Einschaltzeit vor erneuter Fehlerpruefung" VALUE 0x1D35C4 Kw_Wu16 655350.0 Time_ms 0.00 655350.0 FORMAT "%8.1" /end CHARACTERISTIC
/begin CHARACTERISTIC IFCD_tiIFOFFTmr_C "Abschaltzeit fuer IF Endstufe" VALUE 0x1D35C6 Kw_Wu16 655350.0 Time_ms 0.00 655350.0 FORMAT "%8.1" /end CHARACTERISTIC
/begin CHARACTERISTIC IFCtl_stFanOffMsk_C "Bitmaske zur Auswahl der Regenerationsstati für die Abschaltung des Lüfters" VALUE 0x1D35C8 Kw_Wu32 4294967295.00 OneToOne 0.00 4294967295.00 FORMAT "%13.2" /end CHARACTERISTIC
/begin CHARACTERISTIC IFCtl_stOff_C "Abschaltung der Funktion" VALUE 0x1D35CC Kw_Wu8 1.000 OneToOne 0.00 1.000 FORMAT "%5.3" EXTENDED_LIMITS 0.00 255.0 /end CHARACTERISTIC
/begin CHARACTERISTIC IFCtl_tAirHysHi_CUR "Obere Fahrgeschwindigkeitsabhängige Hystereseschwelle für die Lüftersteuerung über  die Ladelufttemperatur" CURVE 0x1D35CE Kl_Xs16_Ws16 250.0000 Temp_Cels -50.14000 199.8600 FORMAT "%8.4" EXTENDED_LIMITS -3549.940 3003.560
 /begin AXIS_DESCR STD_AXIS VSSCD_v Vel 5 0.00 300.0000 FORMAT "%8.4" EXTENDED_LIMITS -327.6800 327.6700 DEPOSIT ABSOLUTE /end AXIS_DESCR
/end CHARACTERISTIC
/begin CHARACTERISTIC IFCtl_tAirHysLo_CUR "Untere geschwindigkeitsabhängige Hysteresisschwelle zur Ventilatorsteuerung über die Einlaßlufttemperatur" CURVE 0x1D35E4 Kl_Xs16_Ws16 250.0000 Temp_Cels -50.14000 199.8600 FORMAT "%8.4" EXTENDED_LIMITS -3549.940 3003.560
 /begin AXIS_DESCR STD_AXIS VSSCD_v Vel 5 0.00 300.0000 FORMAT "%8.4" EXTENDED_LIMITS -327.6800 327.6700 DEPOSIT ABSOLUTE /end AXIS_DESCR
/end CHARACTERISTIC
/begin CHARACTERISTIC IFCtl_tClntThrHiHysHi_CUR "Obere Geschwindigkeitsabhängige Hystereseschwelle für die obere Kühlmitteltemperaturschwelle der Lüftersteuerung" CURVE 0x1D35FA Kl_Xs16_Ws16 200.0000 Temp_Cels -50.14000 149.8600 FORMAT "%8.4" EXTENDED_LIMITS -3549.940 3003.560
 /begin AXIS_DESCR STD_AXIS VSSCD_v Vel 5 0.00 300.0000 FORMAT "%8.4" EXTENDED_LIMITS -327.6800 327.6700 DEPOSIT ABSOLUTE /end AXIS_DESCR
/end CHARACTERISTIC
/begin CHARACTERISTIC IFCtl_tClntThrHiHysLo_CUR "Untere Geschwindigkeitsabhängige Hystereseschwelle für die obere Kühlmitteltemperaturschwelle der Lüftersteuerung" CURVE 0x1D3610 Kl_Xs16_Ws16 200.0000 Temp_Cels -50.14000 149.8600 FORMAT "%8.4" EXTENDED_LIMITS -3549.940 3003.560
 /begin AXIS_DESCR STD_AXIS VSSCD_v Vel 5 0.00 300.0000 FORMAT "%8.4" EXTENDED_LIMITS -327.6800 327.6700 DEPOSIT ABSOLUTE /end AXIS_DESCR
/end CHARACTERISTIC
/begin CHARACTERISTIC IFCtl_tClntThrLoHysHi_C "Obere Hystereseschwelle für die untere Kühlmitteltemperaturschwelle der Lüftersteuerung" VALUE 0x1D3626 Kw_Ws16 200.0000 Temp_Cels -50.14000 149.8600 FORMAT "%8.4" EXTENDED_LIMITS -3549.940 3003.560 /end CHARACTERISTIC
/begin CHARACTERISTIC IFCtl_tClntThrLoHysLo_C "Untere Hysteresisschwelle für die unterere Kühlmitteltemperaturschwelle der Lüftersteuerung" VALUE 0x1D3628 Kw_Ws16 200.0000 Temp_Cels -50.14000 149.8600 FORMAT "%8.4" EXTENDED_LIMITS -3549.940 3003.560 /end CHARACTERISTIC
/begin CHARACTERISTIC ImmCtl_Labelkey_C "Markenkennung" VALUE 0x1D3630 Kw_Wu8 255.0 OneToOne 0.00 255.0 FORMAT "%5.1" /end CHARACTERISTIC
/begin CHARACTERISTIC ImmCtl_P_Class_C "Leistungsklasse MSG" VALUE 0x1D3631 Kw_Wu8 255.0 OneToOne 0.00 255.0 FORMAT "%5.1" /end CHARACTERISTIC
/begin CHARACTERISTIC ImmCtl_stAutoLrnActv_C "Zustand von Erlaubnis des automatischen Lernens" VALUE 0x1D3632 Kw_Wu8 255.0 OneToOne 0.00 255.0 FORMAT "%5.1" /end CHARACTERISTIC
/begin CHARACTERISTIC ImmCtl_stDatChanAcc_C "WFS Datenannahme erlaubt" VALUE 0x1D3633 Kw_Wu8 255.0 OneToOne 0.00 255.0 FORMAT "%5.1" /end CHARACTERISTIC
/begin CHARACTERISTIC ImmCtl_stDatChan_C "Status Wegfahrsperre - Datentransfer erlaubt" VALUE 0x1D3634 Kw_Wu8 255.0 OneToOne 0.00 255.0 FORMAT "%5.1" /end CHARACTERISTIC
/begin CHARACTERISTIC ImmCtl_stDattest_C "WFS Daten-Download vom Diagnosetester erlaubt" VALUE 0x1D3635 Kw_Wu8 255.0 OneToOne 0.00 255.0 FORMAT "%5.1" /end CHARACTERISTIC
/begin CHARACTERISTIC ImmCtl_swtpasswd_ECU_C "Selektiert ob der Kennwort aus der Seriennummer extrahiert wird oder aus der EEPROM gelesen wird" VALUE 0x1D3636 Kw_Wu8 1.000 OneToOne 0.00 1.000 FORMAT "%5.3" EXTENDED_LIMITS 0.00 255.0 /end CHARACTERISTIC
/begin CHARACTERISTIC ImmCtl_swtStartSKC_C "Schalter zur Auswahl des SKC-Starts aus dem EEPROM (1) oder des SKC-Standardstarts (0)" VALUE 0x1D3637 Kw_Wu8 1.000 OneToOne 0.00 1.000 FORMAT "%5.3" EXTENDED_LIMITS 0.00 255.0 /end CHARACTERISTIC
/begin CHARACTERISTIC ImmCtl_tiDataReq_C "Zeit fuer Wiederholungen der Datenanforderung" VALUE 0x1D363C Kw_Wu32 42949672.9500 Time_s 0.00 42949672.9500 FORMAT "%13.4" /end CHARACTERISTIC
/begin CHARACTERISTIC IndSys_tiDebNegErrMonVac_C "Entprellzeit zur Meldung von normalen Druck  im Ansaugkrümmer" VALUE 0x1D3AAE Kw_Wu16 2000.000 TimeDeb 0.00 2000.000 FORMAT "%8.3" EXTENDED_LIMITS 0.00 655350.0 /end CHARACTERISTIC
/begin CHARACTERISTIC IndSys_tiDebPosErrMonVac_C "Entprellzeit zur Meldung von Unterdruck im Ansaugkrümmer" VALUE 0x1D3AB0 Kw_Wu16 2000.000 TimeDeb 0.00 2000.000 FORMAT "%8.3" EXTENDED_LIMITS 0.00 655350.0 /end CHARACTERISTIC
/begin CHARACTERISTIC IndSys_facAPCor_CUR "Atmosphärendruckkorrekturkennlinie zur Dralldeaktivierung" CURVE 0x1D3648 Kl_Xs16_Ws16 1.000000 Fact 0.00 1.000000 FORMAT "%8.6" EXTENDED_LIMITS -4.000000 3.999878
 /begin AXIS_DESCR STD_AXIS APSCD_pVal Pres_hPa 5 0.00 3500.000 FORMAT "%8.3" EXTENDED_LIMITS -32768.00 32767.00 DEPOSIT ABSOLUTE /end AXIS_DESCR
/end CHARACTERISTIC
/begin CHARACTERISTIC IndSys_facWtTempCor_CUR "Kühlmitteltemperaturkorrekturkennlinie zur Dralldeaktivierung" CURVE 0x1D365E Kl_Xs16_Ws16 1.000000 Fact 0.00 1.000000 FORMAT "%8.6" EXTENDED_LIMITS -4.000000 3.999878
 /begin AXIS_DESCR STD_AXIS CTSCD_tClnt Temp_Cels 5 -50.14000 149.8600 FORMAT "%8.4" EXTENDED_LIMITS -3549.940 3003.560 DEPOSIT ABSOLUTE /end AXIS_DESCR
/end CHARACTERISTIC
/begin CHARACTERISTIC IndSys_nAvrg_C "Motordrehzahlgrenze unter der die Erkennung von Unterdruck deaktiviert wird (Motor läuft normal)" VALUE 0x1D3AB2 Kw_Ws16 6500.000 EngN 0.00 6500.000 FORMAT "%8.3" EXTENDED_LIMITS -32768.00 32767.00 /end CHARACTERISTIC
/begin CHARACTERISTIC IndSys_pAdjDiffMax_C "Absolute maximal gültige Differenz für den Abgleich" VALUE 0x1D3B32 Kw_Ws16 32767.00 Pres_hPa 0.00 32767.00 FORMAT "%8.2" EXTENDED_LIMITS -32768.00 32767.00 /end CHARACTERISTIC
/begin CHARACTERISTIC IndSys_pAdjMax_C "Absoluter maximaler gültiger Wert für den Abgleich" VALUE 0x1D3B34 Kw_Ws16 32767.00 Pres_hPa 0.00 32767.00 FORMAT "%8.2" EXTENDED_LIMITS -32768.00 32767.00 /end CHARACTERISTIC
/begin CHARACTERISTIC IndSys_pDiffHigh_CUR "Kennlinie zur Berechnung der oberen Schwelle zur Erkennung des normalen Luftdrucks im Ansaugkrümmer" CURVE 0x1D3AB4 Kl_Xs16_Ws16 7000.000 Pres_hPa -3500.000 3500.000 FORMAT "%8.3" EXTENDED_LIMITS -32768.00 32767.00
 /begin AXIS_DESCR STD_AXIS Eng_nAvrg EngN 15 0.00 6000.000 FORMAT "%8.3" EXTENDED_LIMITS -32768.00 32767.00 DEPOSIT ABSOLUTE /end AXIS_DESCR
/end CHARACTERISTIC
/begin CHARACTERISTIC IndSys_pDiffLow_CUR "Kennlnie zur Berechnung der unteren Schwelle zur Erkennung des Unterdrucks im Ansaugkrümmer" CURVE 0x1D3AF2 Kl_Xs16_Ws16 7000.000 Pres_hPa -3500.000 3500.000 FORMAT "%8.3" EXTENDED_LIMITS -32768.00 32767.00
 /begin AXIS_DESCR STD_AXIS Eng_nAvrg EngN 15 0.00 6000.000 FORMAT "%8.3" EXTENDED_LIMITS -32768.00 32767.00 DEPOSIT ABSOLUTE /end AXIS_DESCR
/end CHARACTERISTIC
/begin CHARACTERISTIC IndSys_rAPCorVSA_MAP "Atmosphärendruckkorrekturkennfeld zur Dralldeaktivierung" MAP 0x1D3674 Kf_Xs16_Ys16_Ws16 100.0000 DtyCyc 0.00 100.0000 FORMAT "%8.4" EXTENDED_LIMITS -327.6800 327.6700
 /begin AXIS_DESCR STD_AXIS Eng_nAvrg EngN 10 -32768.00 32767.00 FORMAT "%8.2" DEPOSIT ABSOLUTE /end AXIS_DESCR
 /begin AXIS_DESCR STD_AXIS InjCtl_qCurr InjMass 10 -327.6800 327.6700 FORMAT "%8.4" DEPOSIT ABSOLUTE /end AXIS_DESCR
/end CHARACTERISTIC
/begin CHARACTERISTIC IndSys_rAPP_C "Fahrpedalposition - Schwelle zur Erkennung von Unterdruck" VALUE 0x1D3B30 Kw_Ws16 100.0000 Prc 0.00 100.0000 FORMAT "%8.4" EXTENDED_LIMITS -327.6800 327.6700 /end CHARACTERISTIC
/begin CHARACTERISTIC IndSys_rEGRLim_C "Grenzwert für erkannte inaktive Abgasrückführung" VALUE 0x1D3768 Kw_Ws16 655.3500 Prc -327.6800 327.6700 FORMAT "%8.4" /end CHARACTERISTIC
/begin CHARACTERISTIC IndSys_rVSAAdd_Vector "Bypass-Label für additiven Bypass von IndSys_rVSA (Nicht verstellen!)" VALUE 0x1C0ABE Kw_Wu8 255.0 OneToOne 0.00 255.0 FORMAT "%5.1" /end CHARACTERISTIC
/begin CHARACTERISTIC IndSys_rVSAAdd_Channel "Bypass-Label für additiven Bypass von IndSys_rVSA (Nicht verstellen!)" VALUE 0x1C0ABF Kw_Wu8 255.0 OneToOne 0.00 255.0 FORMAT "%5.1" /end CHARACTERISTIC
/begin CHARACTERISTIC IndSys_rVSAThresLo_C "Unterer Schwellwert Hysteres Drallniveausteuerung" VALUE 0x1D376A Kw_Ws16 100.0000 DtyCyc 0.00 100.0000 FORMAT "%8.4" EXTENDED_LIMITS -327.6800 327.6700 /end CHARACTERISTIC
/begin CHARACTERISTIC IndSys_rVSAThresHi_C "Oberer Schwellwert Hysterese Drallniveausteuerung" VALUE 0x1D376C Kw_Ws16 100.0000 DtyCyc 0.00 100.0000 FORMAT "%8.4" EXTENDED_LIMITS -327.6800 327.6700 /end CHARACTERISTIC
/begin CHARACTERISTIC IndSys_rVSAYLo_C "applikativer unterer Hystereseausgangswert" VALUE 0x1D376E Kw_Ws16 100.0000 DtyCyc 0.00 100.0000 FORMAT "%8.4" EXTENDED_LIMITS -327.6800 327.6700 /end CHARACTERISTIC
/begin CHARACTERISTIC IndSys_rVSAYHi_C "applikativer oberer Hystereseausgangswert" VALUE 0x1D3770 Kw_Ws16 100.0000 DtyCyc 0.00 100.0000 FORMAT "%8.4" EXTENDED_LIMITS -327.6800 327.6700 /end CHARACTERISTIC
/begin CHARACTERISTIC IndSys_rVSAOpen_C "Tastverhältnis für Drallniveausteller bei inaktiver Abgasrückführung" VALUE 0x1D3772 Kw_Ws16 655.3500 DtyCyc -327.6800 327.6700 FORMAT "%8.4" /end CHARACTERISTIC
/begin CHARACTERISTIC IndSys_rVSA_MAP "Kennfeld für Drallniveausteuerung" MAP 0x1D3774 Kf_Xs16_Ys16_Ws16 100.0000 DtyCyc 0.00 100.0000 FORMAT "%8.4" EXTENDED_LIMITS -327.6800 327.6700
 /begin AXIS_DESCR STD_AXIS Eng_nAvrg EngN 16 -32768.00 32767.00 FORMAT "%8.2" DEPOSIT ABSOLUTE /end AXIS_DESCR
 /begin AXIS_DESCR STD_AXIS InjCtl_qCurr InjMass 16 -327.6800 327.6700 FORMAT "%8.4" DEPOSIT ABSOLUTE /end AXIS_DESCR
/end CHARACTERISTIC
/begin CHARACTERISTIC IndSys_rVSA_Vector "Bypass-Label für IndSys_rVSA (Nicht verstellen!)" VALUE 0x1C0AC0 Kw_Wu8 255.0 OneToOne 0.00 255.0 FORMAT "%5.1" /end CHARACTERISTIC
/begin CHARACTERISTIC IndSys_rVSA_Channel "Bypass-Label für IndSys_rVSA (Nicht verstellen!)" VALUE 0x1C0AC1 Kw_Wu8 255.0 OneToOne 0.00 255.0 FORMAT "%5.1" /end CHARACTERISTIC
/begin CHARACTERISTIC IndSys_rWtTempCorVSA_MAP "Kühlmitteltemperaturkorrekturkennfeld zur Dralldeaktivierung" MAP 0x1D39B8 Kf_Xs16_Ys16_Ws16 100.0000 DtyCyc 0.00 100.0000 FORMAT "%8.4" EXTENDED_LIMITS -327.6800 327.6700
 /begin AXIS_DESCR STD_AXIS Eng_nAvrg EngN 10 -32768.00 32767.00 FORMAT "%8.2" DEPOSIT ABSOLUTE /end AXIS_DESCR
 /begin AXIS_DESCR STD_AXIS InjCtl_qCurr InjMass 10 -327.6800 327.6700 FORMAT "%8.4" DEPOSIT ABSOLUTE /end AXIS_DESCR
/end CHARACTERISTIC
/begin CHARACTERISTIC IndSys_swtHys_C "Auswahlschalter kontinuierliche - 2-Positionsdrallniveausteuerung" VALUE 0x1D3AAC Kw_Wu8 1.000 OneToOne 0.00 1.000 FORMAT "%5.3" EXTENDED_LIMITS 0.00 255.0 /end CHARACTERISTIC
/begin CHARACTERISTIC IndSys_tAirMinAdj_C "Minimale Lufttemperatur zu Druckabgleich zwischen Lade -und Atmosphärendrucksensor" VALUE 0x1D3B36 Kw_Ws16 3003.600 Temp_Cels -0.04000000 3003.560 FORMAT "%8.3" EXTENDED_LIMITS -3549.940 3003.560 /end CHARACTERISTIC
/begin CHARACTERISTIC IndSys_tiDebAdj_C "Wartezeit für vollständige Entprellung der anderen Sensoren" VALUE 0x1D3B38 Kw_Wu16 214700.0 Time_ms 0.00 214700.0 FORMAT "%8.1" EXTENDED_LIMITS 0.00 655350.0 /end CHARACTERISTIC
/begin CHARACTERISTIC IndSys_tiDelAdj_C "Verzugseit seit Init für Druckabgleich zwischen BPS und APS" VALUE 0x1D3B3A Kw_Wu16 214700.0 Time_ms 0.00 214700.0 FORMAT "%8.1" EXTENDED_LIMITS 0.00 655350.0 /end CHARACTERISTIC
/begin CHARACTERISTIC InjCrv_ctTempSel_C "Auszulesende Motortemperatur aus dem Motortemperaturenfeld" VALUE 0x1D3B40 Kw_Wu8 4.00000000000 EngTempFldSel 0.00 4.00000000000 FORMAT "%13.11" /end CHARACTERISTIC
/begin CHARACTERISTIC InjCrv_DebLimDef_C "Fehlerentprellzeit für Begrenzung der Anzahl der Einspritzungen" VALUE 0x1D3B42 Kw_Wu16 65535.00 OneToOne 0.00 65535.00 FORMAT "%8.2" /end CHARACTERISTIC
/begin CHARACTERISTIC InjCrv_DebLimOk_C "Heilungsentprellzeit für Begrenzung der Anzahl der Einspritzungen" VALUE 0x1D3B44 Kw_Wu16 65535.00 OneToOne 0.00 65535.00 FORMAT "%8.2" /end CHARACTERISTIC
/begin CHARACTERISTIC InjCrv_numInjMaxSys_C "Systembedingte maximal erlaubte Anzahl an Einspritzungen" VALUE 0x1D3B46 Kw_Wu8 6.000 OneToOne 0.00 6.000 FORMAT "%5.3" EXTENDED_LIMITS 0.00 255.0 /end CHARACTERISTIC
/begin CHARACTERISTIC InjCrv_pThres_C "Atmosphärendruckschwelle für Betriebsbereichsauswahl" VALUE 0x1D3B48 Kw_Ws16 3500.000 Pres_hPa 0.00 3500.000 FORMAT "%8.3" EXTENDED_LIMITS -32768.00 32767.00 /end CHARACTERISTIC
/begin CHARACTERISTIC InjCrv_rOpRngATSHys_C "Ansauglufttemperatur-Hystereseschwelle zur Bestimmung des Betriebsbereichs" VALUE 0x1D3B4A Kw_Wu16 100.0000 Prc 0.00 100.0000 FORMAT "%8.4" EXTENDED_LIMITS 0.00 655.3500 /end CHARACTERISTIC
/begin CHARACTERISTIC InjCrv_rOpRngETSHys_C "Motortemperatur-Hystereseschwelle zur Bestimmung des Betriebsbereichs" VALUE 0x1D3B4C Kw_Wu16 100.0000 Prc 0.00 100.0000 FORMAT "%8.4" EXTENDED_LIMITS 0.00 655.3500 /end CHARACTERISTIC
/begin CHARACTERISTIC InjCrv_rPiIRlsEngSpdHys_C "Drehzahl Hystereseschwelle für die Auswahl der Freigabestruktur der Voreinspritzungen" VALUE 0x1D3B4E Kw_Wu16 100.0000 Prc 0.00 100.0000 FORMAT "%8.4" EXTENDED_LIMITS 0.00 655.3500 /end CHARACTERISTIC
/begin CHARACTERISTIC InjCrv_rPiIRlsQntHys_C "Mengen-Hystereseschwelle  zur Auswahl der Freigabestruktur der Voreinspritzungen" VALUE 0x1D3B50 Kw_Wu16 100.0000 Prc 0.00 100.0000 FORMAT "%8.4" EXTENDED_LIMITS 0.00 655.3500 /end CHARACTERISTIC
/begin CHARACTERISTIC InjCrv_stInjCharPrioRgn_C "Prioritätsstatus für die Abschaltung der Voreinspritzungen im Regenerationsbetrieb" VALUE 0x1D3B54 Kw_Wu32 4294967295.00 OneToOne 0.00 4294967295.00 FORMAT "%13.2" /end CHARACTERISTIC
/begin CHARACTERISTIC InjCrv_stInjCharPrio_C "Prioritätsstatus für die Abschaltung der Voreinspritzungen" VALUE 0x1D3B58 Kw_Wu32 4294967295.00 OneToOne 0.00 4294967295.00 FORMAT "%13.2" /end CHARACTERISTIC
/begin CHARACTERISTIC InjCrv_stInjCharSetVal_Vector "Konfigurationslabel für Bypass" VALUE 0x1C0AC2 Kw_Wu8 255.0 OneToOne 0.00 255.0 FORMAT "%5.1" /end CHARACTERISTIC
/begin CHARACTERISTIC InjCrv_stInjCharSetVal_Channel "Konfigurationslabels für Bypass" VALUE 0x1C0AC3 Kw_Wu8 255.0 OneToOne 0.00 255.0 FORMAT "%5.1" /end CHARACTERISTIC
/begin CHARACTERISTIC InjCrv_stInjDstSel_C "Status der Darstellung relativer Zeitabstände der Einspritzungen" VALUE 0x1D3B3C Kw_Wu8 255.0 OneToOne 0.00 255.0 FORMAT "%5.1" /end CHARACTERISTIC
/begin CHARACTERISTIC InjCrv_stPiIRlsOpRng11_MAP "Freigabekennfeld im Betriebsbereich 11" MAP 0x1D3B5C Kf_Xs16_Ys16_Ws16 4.000000 OneToOne 1.000000 5.000000 FORMAT "%8.6" EXTENDED_LIMITS -32768.00 32767.00
 /begin AXIS_DESCR STD_AXIS Eng_nAvrg EngN 16 0.00 6000.000 FORMAT "%8.3" EXTENDED_LIMITS -32768.00 32767.00 DEPOSIT ABSOLUTE /end AXIS_DESCR
 /begin AXIS_DESCR STD_AXIS InjCtl_qSetUnBal InjMass 10 0.00 327.6700 FORMAT "%8.4" EXTENDED_LIMITS -327.6800 327.6700 DEPOSIT ABSOLUTE /end AXIS_DESCR
/end CHARACTERISTIC
/begin CHARACTERISTIC InjCrv_stPiIRlsOpRng12_MAP "Freigabekennfeld im Betriebsbereich 12" MAP 0x1D3CD4 Kf_Xs16_Ys16_Ws16 4.000000 OneToOne 1.000000 5.000000 FORMAT "%8.6" EXTENDED_LIMITS -32768.00 32767.00
 /begin AXIS_DESCR STD_AXIS Eng_nAvrg EngN 16 0.00 6000.000 FORMAT "%8.3" EXTENDED_LIMITS -32768.00 32767.00 DEPOSIT ABSOLUTE /end AXIS_DESCR
 /begin AXIS_DESCR STD_AXIS InjCtl_qSetUnBal InjMass 10 0.00 327.6700 FORMAT "%8.4" EXTENDED_LIMITS -327.6800 327.6700 DEPOSIT ABSOLUTE /end AXIS_DESCR
/end CHARACTERISTIC
/begin CHARACTERISTIC InjCrv_stPiIRlsOpRng13_MAP "Freigabekennfeld im Betriebsbereich 13" MAP 0x1D3E4C Kf_Xs16_Ys16_Ws16 4.000000 OneToOne 1.000000 5.000000 FORMAT "%8.6" EXTENDED_LIMITS -32768.00 32767.00
 /begin AXIS_DESCR STD_AXIS Eng_nAvrg EngN 16 0.00 6000.000 FORMAT "%8.3" EXTENDED_LIMITS -32768.00 32767.00 DEPOSIT ABSOLUTE /end AXIS_DESCR
 /begin AXIS_DESCR STD_AXIS InjCtl_qSetUnBal InjMass 10 0.00 327.6700 FORMAT "%8.4" EXTENDED_LIMITS -327.6800 327.6700 DEPOSIT ABSOLUTE /end AXIS_DESCR
/end CHARACTERISTIC
/begin CHARACTERISTIC InjCrv_stPiIRlsOpRng21_MAP "Freigabekennfeld im Betriebsbereich 21" MAP 0x1D3FC4 Kf_Xs16_Ys16_Ws16 4.000000 OneToOne 1.000000 5.000000 FORMAT "%8.6" EXTENDED_LIMITS -32768.00 32767.00
 /begin AXIS_DESCR STD_AXIS Eng_nAvrg EngN 16 0.00 6000.000 FORMAT "%8.3" EXTENDED_LIMITS -32768.00 32767.00 DEPOSIT ABSOLUTE /end AXIS_DESCR
 /begin AXIS_DESCR STD_AXIS InjCtl_qSetUnBal InjMass 10 0.00 327.6700 FORMAT "%8.4" EXTENDED_LIMITS -327.6800 327.6700 DEPOSIT ABSOLUTE /end AXIS_DESCR
/end CHARACTERISTIC
/begin CHARACTERISTIC InjCrv_stPiIRlsOpRng22_MAP "Freigabekennfeld im Betriebsbereich 22" MAP 0x1D413C Kf_Xs16_Ys16_Ws16 4.000000 OneToOne 1.000000 5.000000 FORMAT "%8.6" EXTENDED_LIMITS -32768.00 32767.00
 /begin AXIS_DESCR STD_AXIS Eng_nAvrg EngN 16 0.00 6000.000 FORMAT "%8.3" EXTENDED_LIMITS -32768.00 32767.00 DEPOSIT ABSOLUTE /end AXIS_DESCR
 /begin AXIS_DESCR STD_AXIS InjCtl_qSetUnBal InjMass 10 0.00 327.6700 FORMAT "%8.4" EXTENDED_LIMITS -327.6800 327.6700 DEPOSIT ABSOLUTE /end AXIS_DESCR
/end CHARACTERISTIC
/begin CHARACTERISTIC InjCrv_stPiIRlsOpRng23_MAP "Freigabekennfeld im Betriebsbereich 23" MAP 0x1D42B4 Kf_Xs16_Ys16_Ws16 4.000000 OneToOne 1.000000 5.000000 FORMAT "%8.6" EXTENDED_LIMITS -32768.00 32767.00
 /begin AXIS_DESCR STD_AXIS Eng_nAvrg EngN 16 0.00 6000.000 FORMAT "%8.3" EXTENDED_LIMITS -32768.00 32767.00 DEPOSIT ABSOLUTE /end AXIS_DESCR
 /begin AXIS_DESCR STD_AXIS InjCtl_qSetUnBal InjMass 10 0.00 327.6700 FORMAT "%8.4" EXTENDED_LIMITS -327.6800 327.6700 DEPOSIT ABSOLUTE /end AXIS_DESCR
/end CHARACTERISTIC
/begin CHARACTERISTIC InjCrv_stPiIRlsOpRng31_MAP "Freigabekennfeld im Betriebsbereich 31" MAP 0x1D442C Kf_Xs16_Ys16_Ws16 4.000000 OneToOne 1.000000 5.000000 FORMAT "%8.6" EXTENDED_LIMITS -32768.00 32767.00
 /begin AXIS_DESCR STD_AXIS Eng_nAvrg EngN 16 0.00 6000.000 FORMAT "%8.3" EXTENDED_LIMITS -32768.00 32767.00 DEPOSIT ABSOLUTE /end AXIS_DESCR
 /begin AXIS_DESCR STD_AXIS InjCtl_qSetUnBal InjMass 10 0.00 327.6700 FORMAT "%8.4" EXTENDED_LIMITS -327.6800 327.6700 DEPOSIT ABSOLUTE /end AXIS_DESCR
/end CHARACTERISTIC
/begin CHARACTERISTIC InjCrv_stPiIRlsOpRng32_MAP "Freigabekennfeld im Betriebsbereich 32" MAP 0x1D45A4 Kf_Xs16_Ys16_Ws16 4.000000 OneToOne 1.000000 5.000000 FORMAT "%8.6" EXTENDED_LIMITS -32768.00 32767.00
 /begin AXIS_DESCR STD_AXIS Eng_nAvrg EngN 16 0.00 6000.000 FORMAT "%8.3" EXTENDED_LIMITS -32768.00 32767.00 DEPOSIT ABSOLUTE /end AXIS_DESCR
 /begin AXIS_DESCR STD_AXIS InjCtl_qSetUnBal InjMass 10 0.00 327.6700 FORMAT "%8.4" EXTENDED_LIMITS -327.6800 327.6700 DEPOSIT ABSOLUTE /end AXIS_DESCR
/end CHARACTERISTIC
/begin CHARACTERISTIC InjCrv_stPiIRlsOpRng33_MAP "Freigabekennfeld im Betriebsbereich 33" MAP 0x1D471C Kf_Xs16_Ys16_Ws16 4.000000 OneToOne 1.000000 5.000000 FORMAT "%8.6" EXTENDED_LIMITS -32768.00 32767.00
 /begin AXIS_DESCR STD_AXIS Eng_nAvrg EngN 16 0.00 6000.000 FORMAT "%8.3" EXTENDED_LIMITS -32768.00 32767.00 DEPOSIT ABSOLUTE /end AXIS_DESCR
 /begin AXIS_DESCR STD_AXIS InjCtl_qSetUnBal InjMass 10 0.00 327.6700 FORMAT "%8.4" EXTENDED_LIMITS -327.6800 327.6700 DEPOSIT ABSOLUTE /end AXIS_DESCR
/end CHARACTERISTIC
/begin CHARACTERISTIC InjCrv_stPiIRlsOpRng41_MAP "Freigabekennfeld im Betriebsbereich 41" MAP 0x1D4894 Kf_Xs16_Ys16_Ws16 4.000000 OneToOne 1.000000 5.000000 FORMAT "%8.6" EXTENDED_LIMITS -32768.00 32767.00
 /begin AXIS_DESCR STD_AXIS Eng_nAvrg EngN 16 0.00 6000.000 FORMAT "%8.3" EXTENDED_LIMITS -32768.00 32767.00 DEPOSIT ABSOLUTE /end AXIS_DESCR
 /begin AXIS_DESCR STD_AXIS InjCtl_qSetUnBal InjMass 10 0.00 327.6700 FORMAT "%8.4" EXTENDED_LIMITS -327.6800 327.6700 DEPOSIT ABSOLUTE /end AXIS_DESCR
/end CHARACTERISTIC
/begin CHARACTERISTIC InjCrv_stPiIRlsOpRng42_MAP "Freigabekennfeld im Betriebsbereich 42" MAP 0x1D4A0C Kf_Xs16_Ys16_Ws16 4.000000 OneToOne 1.000000 5.000000 FORMAT "%8.6" EXTENDED_LIMITS -32768.00 32767.00
 /begin AXIS_DESCR STD_AXIS Eng_nAvrg EngN 16 0.00 6000.000 FORMAT "%8.3" EXTENDED_LIMITS -32768.00 32767.00 DEPOSIT ABSOLUTE /end AXIS_DESCR
 /begin AXIS_DESCR STD_AXIS InjCtl_qSetUnBal InjMass 10 0.00 327.6700 FORMAT "%8.4" EXTENDED_LIMITS -327.6800 327.6700 DEPOSIT ABSOLUTE /end AXIS_DESCR
/end CHARACTERISTIC
/begin CHARACTERISTIC InjCrv_stPiIRlsOpRng43_MAP "Freigabekennfeld im Betriebsbereich 43" MAP 0x1D4B84 Kf_Xs16_Ys16_Ws16 4.000000 OneToOne 1.000000 5.000000 FORMAT "%8.6" EXTENDED_LIMITS -32768.00 32767.00
 /begin AXIS_DESCR STD_AXIS Eng_nAvrg EngN 16 0.00 6000.000 FORMAT "%8.3" EXTENDED_LIMITS -32768.00 32767.00 DEPOSIT ABSOLUTE /end AXIS_DESCR
 /begin AXIS_DESCR STD_AXIS InjCtl_qSetUnBal InjMass 10 0.00 327.6700 FORMAT "%8.4" EXTENDED_LIMITS -327.6800 327.6700 DEPOSIT ABSOLUTE /end AXIS_DESCR
/end CHARACTERISTIC
/begin CHARACTERISTIC InjCrv_stPiIRlsOpRng51_MAP "Freigabekennfeld im Betriebsbereich 51" MAP 0x1D4CFC Kf_Xs16_Ys16_Ws16 4.000000 OneToOne 1.000000 5.000000 FORMAT "%8.6" EXTENDED_LIMITS -32768.00 32767.00
 /begin AXIS_DESCR STD_AXIS Eng_nAvrg EngN 16 0.00 6000.000 FORMAT "%8.3" EXTENDED_LIMITS -32768.00 32767.00 DEPOSIT ABSOLUTE /end AXIS_DESCR
 /begin AXIS_DESCR STD_AXIS InjCtl_qSetUnBal InjMass 10 0.00 327.6700 FORMAT "%8.4" EXTENDED_LIMITS -327.6800 327.6700 DEPOSIT ABSOLUTE /end AXIS_DESCR
/end CHARACTERISTIC
/begin CHARACTERISTIC InjCrv_stPiIRlsOpRng52_MAP "Freigabekennfeld im Betriebsbereich 52" MAP 0x1D4E74 Kf_Xs16_Ys16_Ws16 4.000000 OneToOne 1.000000 5.000000 FORMAT "%8.6" EXTENDED_LIMITS -32768.00 32767.00
 /begin AXIS_DESCR STD_AXIS Eng_nAvrg EngN 16 0.00 6000.000 FORMAT "%8.3" EXTENDED_LIMITS -32768.00 32767.00 DEPOSIT ABSOLUTE /end AXIS_DESCR
 /begin AXIS_DESCR STD_AXIS InjCtl_qSetUnBal InjMass 10 0.00 327.6700 FORMAT "%8.4" EXTENDED_LIMITS -327.6800 327.6700 DEPOSIT ABSOLUTE /end AXIS_DESCR
/end CHARACTERISTIC
/begin CHARACTERISTIC InjCrv_stPiIRlsOpRng53_MAP "Freigabekennfeld im Betriebsbereich 53" MAP 0x1D4FEC Kf_Xs16_Ys16_Ws16 4.000000 OneToOne 1.000000 5.000000 FORMAT "%8.6" EXTENDED_LIMITS -32768.00 32767.00
 /begin AXIS_DESCR STD_AXIS Eng_nAvrg EngN 16 0.00 6000.000 FORMAT "%8.3" EXTENDED_LIMITS -32768.00 32767.00 DEPOSIT ABSOLUTE /end AXIS_DESCR
 /begin AXIS_DESCR STD_AXIS InjCtl_qSetUnBal InjMass 10 0.00 327.6700 FORMAT "%8.4" EXTENDED_LIMITS -327.6800 327.6700 DEPOSIT ABSOLUTE /end AXIS_DESCR
/end CHARACTERISTIC
/begin CHARACTERISTIC InjCrv_stPrioRgnMsk_C "Bitmaske für Aktivierung  des Prioritätsstaus im Regenerationsbetrieb" VALUE 0x1D5164 Kw_Wu32 4294967295.00 OneToOne 0.00 4294967295.00 FORMAT "%13.2" /end CHARACTERISTIC
/begin CHARACTERISTIC InjCrv_stRlsGear1_CUR "Auswahlkennlinie fuer PI-Freigabekennfeld im Betriebsbereich 1" CURVE 0x1D5168 Kl_Xs16_Ws16 2.000000 Map_Select 1.000000 3.000000 FORMAT "%8.6" EXTENDED_LIMITS -128.0000 127.9961
 /begin AXIS_DESCR STD_AXIS InjCrv_stGear_mp OneToOne 3 0.00 100.0000 FORMAT "%8.4" EXTENDED_LIMITS -32768.00 32767.00 DEPOSIT ABSOLUTE /end AXIS_DESCR
/end CHARACTERISTIC
/begin CHARACTERISTIC InjCrv_stRlsGear2_CUR "Auswahlkennlinie fuer PI-Freigabekennfeld im Betriebsbereich 2" CURVE 0x1D5176 Kl_Xs16_Ws16 2.000000 Map_Select 1.000000 3.000000 FORMAT "%8.6" EXTENDED_LIMITS -128.0000 127.9961
 /begin AXIS_DESCR STD_AXIS InjCrv_stGear_mp OneToOne 3 0.00 100.0000 FORMAT "%8.4" EXTENDED_LIMITS -32768.00 32767.00 DEPOSIT ABSOLUTE /end AXIS_DESCR
/end CHARACTERISTIC
/begin CHARACTERISTIC InjCrv_stRlsGear3_CUR "Auswahlkennlinie fuer PI-Freigabekennfeld im Betriebsbereich 3" CURVE 0x1D5184 Kl_Xs16_Ws16 2.000000 Map_Select 1.000000 3.000000 FORMAT "%8.6" EXTENDED_LIMITS -128.0000 127.9961
 /begin AXIS_DESCR STD_AXIS InjCrv_stGear_mp OneToOne 3 0.00 100.0000 FORMAT "%8.4" EXTENDED_LIMITS -32768.00 32767.00 DEPOSIT ABSOLUTE /end AXIS_DESCR
/end CHARACTERISTIC
/begin CHARACTERISTIC InjCrv_stRlsGear4_CUR "Auswahlkennlinie fuer PI-Freigabekennfeld im Betriebsbereich 4" CURVE 0x1D5192 Kl_Xs16_Ws16 2.000000 Map_Select 1.000000 3.000000 FORMAT "%8.6" EXTENDED_LIMITS -128.0000 127.9961
 /begin AXIS_DESCR STD_AXIS InjCrv_stGear_mp OneToOne 3 0.00 100.0000 FORMAT "%8.4" EXTENDED_LIMITS -32768.00 32767.00 DEPOSIT ABSOLUTE /end AXIS_DESCR
/end CHARACTERISTIC
/begin CHARACTERISTIC InjCrv_stRlsGear5_CUR "Auswahlkennlinie fuer PI-Freigabekennfeld im Betriebsbereich 5" CURVE 0x1D51A0 Kl_Xs16_Ws16 2.000000 Map_Select 1.000000 3.000000 FORMAT "%8.6" EXTENDED_LIMITS -128.0000 127.9961
 /begin AXIS_DESCR STD_AXIS InjCrv_stGear_mp OneToOne 3 0.00 100.0000 FORMAT "%8.4" EXTENDED_LIMITS -32768.00 32767.00 DEPOSIT ABSOLUTE /end AXIS_DESCR
/end CHARACTERISTIC
/begin CHARACTERISTIC InjCrv_stRlsOpRngThres1_MAP "Betriebsbereichsschwellen für die Freigabe der Voreinspritzungen" MAP 0x1D51AE Kf_Xs16_Ys16_Ws16 4.000000 OneToOne 1.000000 5.000000 FORMAT "%8.6" EXTENDED_LIMITS -32768.00 32767.00
 /begin AXIS_DESCR STD_AXIS InjCrv_tEng Temp_Cels 16 -50.14000 199.8600 FORMAT "%8.4" EXTENDED_LIMITS -3549.940 3003.560 DEPOSIT ABSOLUTE /end AXIS_DESCR
 /begin AXIS_DESCR STD_AXIS IATSCD_tAir Temp_Cels 16 -50.14000 199.8600 FORMAT "%8.4" EXTENDED_LIMITS -3549.940 3003.560 DEPOSIT ABSOLUTE /end AXIS_DESCR
/end CHARACTERISTIC
/begin CHARACTERISTIC InjCrv_stRlsOpRngThres2_MAP "Betriebsbereichsschwellen für die Freigabe der Voreinspritzungen" MAP 0x1D53F2 Kf_Xs16_Ys16_Ws16 4.000000 OneToOne 1.000000 5.000000 FORMAT "%8.6" EXTENDED_LIMITS -32768.00 32767.00
 /begin AXIS_DESCR STD_AXIS InjCrv_tEng Temp_Cels 16 -50.14000 199.8600 FORMAT "%8.4" EXTENDED_LIMITS -3549.940 3003.560 DEPOSIT ABSOLUTE /end AXIS_DESCR
 /begin AXIS_DESCR STD_AXIS IATSCD_tAir Temp_Cels 16 -50.14000 199.8600 FORMAT "%8.4" EXTENDED_LIMITS -3549.940 3003.560 DEPOSIT ABSOLUTE /end AXIS_DESCR
/end CHARACTERISTIC
/begin CHARACTERISTIC InjCrv_stRlsOpRngThresRgn_MAP "Betriebsbereichsschwellen für die Freigabe der Voreinspritzungen im Regenerationsbetrieb" MAP 0x1D5636 Kf_Xs16_Ys16_Ws16 4.000000 OneToOne 1.000000 5.000000 FORMAT "%8.6" EXTENDED_LIMITS -32768.00 32767.00
 /begin AXIS_DESCR STD_AXIS InjCrv_tEng Temp_Cels 16 -50.14000 199.8600 FORMAT "%8.4" EXTENDED_LIMITS -3549.940 3003.560 DEPOSIT ABSOLUTE /end AXIS_DESCR
 /begin AXIS_DESCR STD_AXIS IATSCD_tAir Temp_Cels 16 -50.14000 199.8600 FORMAT "%8.4" EXTENDED_LIMITS -3549.940 3003.560 DEPOSIT ABSOLUTE /end AXIS_DESCR
/end CHARACTERISTIC
/begin CHARACTERISTIC InjCrv_stRlsRgnMsk_C "Bitmaske für Aktivierung des Freigabekennfelds im Regenerationsbetrieb" VALUE 0x1D587C Kw_Wu32 4294967295.00 OneToOne 0.00 4294967295.00 FORMAT "%13.2" /end CHARACTERISTIC
/begin CHARACTERISTIC InjCrv_swtRlsOpRngThres_MAP "Schaltkennfeld für Betriebsbereichsauswahl" MAP 0x1D5880 Kf_Xs16_Ys16_Ws16 1.000000 Map_Select 0.00 1.000000 FORMAT "%8.6" EXTENDED_LIMITS -128.0000 127.9961
 /begin AXIS_DESCR STD_AXIS InjCrv_tEng Temp_Cels 18 -50.14000 199.8600 FORMAT "%8.4" EXTENDED_LIMITS -3549.940 3003.560 DEPOSIT ABSOLUTE /end AXIS_DESCR
 /begin AXIS_DESCR STD_AXIS EngM_ctRevSta OneToOne 20 0.00 32767.00 FORMAT "%8.2" EXTENDED_LIMITS -32768.00 32767.00 DEPOSIT ABSOLUTE /end AXIS_DESCR
/end CHARACTERISTIC
/begin CHARACTERISTIC InjCrv_tiPause_C "physikalische bedingte Mindestzeit zwischen 2 Einspritzungen" VALUE 0x1C0F18 Kw_Ws16 65535.00 InjTime_us -32768.00 32767.00 FORMAT "%8.2" /end CHARACTERISTIC
/begin MEASUREMENT FrmMng_aBRK2Trnvrs "Querbeschleunigung von BRK2" SWORD TrnvrsAcc 1 100 -327.6800 327.6700 FORMAT "%8.4" ECU_ADDRESS 0x7F9878 /end MEASUREMENT
/begin MEASUREMENT FrmMng_dTOSMsgCnt "TOS Botschaftszähler" UBYTE OneToOne 1 100 0.00 255.0 FORMAT "%5.1" ECU_ADDRESS 0x7F93E7 /end MEASUREMENT
/begin MEASUREMENT FrmMng_dtrqTSCLim "Momentengradientenbegrenzung vom EGS" SWORD TrqPerSec 1 100 -32768.00 32767.00 FORMAT "%8.2" ECU_ADDRESS 0x7F987A /end MEASUREMENT
/begin MEASUREMENT FrmMng_lDIA1km "Kilometerzähler die Botschaft Diagnose1." ULONG Dist2_km 1 100 0.00 4294967295.00 FORMAT "%13.2" ECU_ADDRESS 0x7F9CB8 /end MEASUREMENT
/begin MEASUREMENT FrmMng_nDesAST "Synchronisationswunschdrehzahl" SWORD EngN 1 100 -32768.00 32767.00 FORMAT "%8.2" ECU_ADDRESS 0x7F987C /end MEASUREMENT
/begin MEASUREMENT FrmMng_nMin "Leerlaufsolldrehzahl der Getriebe2 Botschaft" SWORD EngN 1 100 -32768.00 32767.00 FORMAT "%8.2" ECU_ADDRESS 0x7F987E /end MEASUREMENT
/begin MEASUREMENT FrmMng_pAC "Kaeltemitteldruck, empfangen von externem Steuergeraet" SWORD PresAC_hPa 1 100 -65536.00 65534.00 FORMAT "%8.2" ECU_ADDRESS 0x7F9882 /end MEASUREMENT
/begin MEASUREMENT FrmMng_pwrBEMAlt "Generatorleistung über CAN" SWORD Pwr 1 100 -308831.1 308821.7 FORMAT "%8.1" ECU_ADDRESS 0x7F988C /end MEASUREMENT
/begin MEASUREMENT FrmMng_rSlpRes "Fahrwiderstandsindex" SWORD PrcHigh 1 100 -32.76800 32.76700 FORMAT "%8.5" ECU_ADDRESS 0x7F9896 /end MEASUREMENT
/begin MEASUREMENT FrmMng_rTransConv "Übertragungsfunktion" SWORD TransR 1 100 -327.6800 327.6700 FORMAT "%8.4" ECU_ADDRESS 0x7F9898 /end MEASUREMENT
/begin MEASUREMENT FrmMng_rtrqACCDes "gewünschtes Moment in %  des Maximalmoments" SWORD rTrqCAN 1 100 -12850.20 12849.81 FORMAT "%8.2" ECU_ADDRESS 0x7F989A /end MEASUREMENT
/begin MEASUREMENT FrmMng_stACC "empfangener Zustand des ACC-SG" UBYTE OneToOne 1 100 0.00 255.0 FORMAT "%5.1" ECU_ADDRESS 0x7F93E9 /end MEASUREMENT
/begin MEASUREMENT FrmMng_stACCaccel "Status ACC-Gearshift" UBYTE OneToOne 1 100 0.00 255.0 FORMAT "%5.1" ECU_ADDRESS 0x7F93EC /end MEASUREMENT
/begin MEASUREMENT FrmMng_stACCBrk "empfangener Zustand des Bremsboosters" UBYTE OneToOne 1 100 0.00 255.0 FORMAT "%5.1" ECU_ADDRESS 0x7F93EA /end MEASUREMENT
/begin MEASUREMENT FrmMng_stAIRBG "Status von AIRBG" UWORD OneToOne 1 100 0.00 65535.00 FORMAT "%8.2" ECU_ADDRESS 0x7F98A0 /end MEASUREMENT
/begin MEASUREMENT FrmMng_stAIRBGTst "Status Airbagsteuergerät im Stellgliedtest" UBYTE OneToOne 1 100 0.00 255.0 FORMAT "%5.1" ECU_ADDRESS 0x7F93ED /end MEASUREMENT
/begin MEASUREMENT FrmMng_stAST "Status ASG-Eingriff" UWORD OneToOne 1 100 0.00 65535.00 FORMAT "%8.2" ECU_ADDRESS 0x7F98A2 /end MEASUREMENT
/begin MEASUREMENT FrmMng_stBEMAOHt "Zustand der Zusatzheizung" UBYTE OneToOne 1 100 0.00 255.0 FORMAT "%5.1" ECU_ADDRESS 0x7F93EF /end MEASUREMENT
/begin MEASUREMENT FrmMng_stBEMLIDem "Status der Leerlaufanhebung" UBYTE OneToOne 1 100 0.00 255.0 FORMAT "%5.1" ECU_ADDRESS 0x7F93F0 /end MEASUREMENT
/begin MEASUREMENT FrmMng_stBRK2Trnvrs "Querbeschleunigung gültig" UBYTE OneToOne 1 100 0.00 255.0 FORMAT "%5.1" ECU_ADDRESS 0x7F93F1 /end MEASUREMENT
/begin MEASUREMENT FrmMng_stBRK8ACCMsg "Fehler bei CAN-Botschaft BRK8" UBYTE OneToOne 1 100 0.00 255.0 FORMAT "%5.1" ECU_ADDRESS 0x7F93F2 /end MEASUREMENT
/begin MEASUREMENT FrmMng_stCANVer "Versionsnummer des CAN- Layouts" UBYTE OneToOne 1 100 0.00 255.0 FORMAT "%5.1" ECU_ADDRESS 0x7F93F5 /end MEASUREMENT
/begin MEASUREMENT FrmMng_stCANVerCCtl "Versionnumber des CAN-Layouts für die CrCtl" UBYTE OneToOne 1 100 0.00 255.0 FORMAT "%5.1" ECU_ADDRESS 0x7F93F6 /end MEASUREMENT
/begin MEASUREMENT FrmMng_stCCDisable "Status variable für Audi-ACC Plausibility Error(NPL)" UBYTE OneToOne 1 100 0.00 255.0 FORMAT "%5.1" ECU_ADDRESS 0x7F93F7 /end MEASUREMENT
/begin MEASUREMENT FrmMng_stConvErr "Kupplungsfehlerzustand über CAN" UBYTE OneToOne 1 100 0.00 255.0 FORMAT "%5.1" ECU_ADDRESS 0x7F93FF /end MEASUREMENT
/begin MEASUREMENT FrmMng_stCrErr "GRA Fehlerzustand über CAN" UBYTE OneToOne 1 100 0.00 255.0 FORMAT "%5.1" ECU_ADDRESS 0x7F9400 /end MEASUREMENT
/begin MEASUREMENT FrmMng_stCrPan "GRA Bedienteilzustand über CAN" UWORD OneToOne 1 100 0.00 65535.00 FORMAT "%8.2" ECU_ADDRESS 0x7F98A4 /end MEASUREMENT
/begin MEASUREMENT FrmMng_stDCS "Status des MSR Momenteneingriffs" UWORD OneToOne 1 100 0.00 65535.00 FORMAT "%8.2" ECU_ADDRESS 0x7F98A6 /end MEASUREMENT
/begin MEASUREMENT FrmMng_stDIA1Invalid "Zustand der Botschaft Diagnose1 (ob gültig oder nicht)" UBYTE OneToOne 1 100 0.00 255.0 FORMAT "%5.1" ECU_ADDRESS 0x7F9401 /end MEASUREMENT
/begin MEASUREMENT FrmMng_stDIA1kmOld "Kilometerzustand (d.h. aktuell oder alt) der Diagnose1-Botschaf" UBYTE OneToOne 1 100 0.00 255.0 FORMAT "%5.1" ECU_ADDRESS 0x7F9403 /end MEASUREMENT
/begin MEASUREMENT FrmMng_stDIA1TimeOld "Zeitzustand (d.h. aktuell oder alt) der Diagnose1-Botschaft" UBYTE OneToOne 1 100 0.00 255.0 FORMAT "%5.1" ECU_ADDRESS 0x7F9402 /end MEASUREMENT
/begin MEASUREMENT FrmMng_stEngFlxSync "Variable zum Synchronisieren der Motor Flexia" UBYTE OneToOne 1 100 0.00 255.0 FORMAT "%5.1" ECU_ADDRESS 0x7F9406 /end MEASUREMENT
/begin MEASUREMENT FrmMng_stEngOff "Anforderung Motor aus" UBYTE OneToOne 1 100 0.00 255.0 FORMAT "%5.1" ECU_ADDRESS 0x7F9407 /end MEASUREMENT
/begin MEASUREMENT FrmMng_stEPBAct "signal EPB zustend" UBYTE OneToOne 1 100 0.00 255.0 FORMAT "%5.1" ECU_ADDRESS 0x7F9404 /end MEASUREMENT
/begin MEASUREMENT FrmMng_stESCU "Status Bordnetzspannungsteuergerät über CAN" SWORD OneToOne 1 100 -32768.00 32767.00 FORMAT "%8.2" ECU_ADDRESS 0x7F98A8 /end MEASUREMENT
/begin MEASUREMENT FrmMng_stESPSysErr "ESP Systemstatusfehler" UBYTE OneToOne 1 100 0.00 255.0 FORMAT "%5.1" ECU_ADDRESS 0x7F9405 /end MEASUREMENT
/begin MEASUREMENT FrmMng_stFanOn "Anforderung Kühlerlüfter einschalten" UBYTE OneToOne 1 100 0.00 255.0 FORMAT "%5.1" ECU_ADDRESS 0x7F9408 /end MEASUREMENT
/begin MEASUREMENT FrmMng_stFlQtyWrng "Kraftstoffmengenwarnsignal" UBYTE OneToOne 1 100 0.00 255.0 FORMAT "%5.1" ECU_ADDRESS 0x7F9409 /end MEASUREMENT
/begin MEASUREMENT FrmMng_stGear "Istganginformation vom CAN" UWORD OneToOne 1 100 0.00 65535.00 FORMAT "%8.2" ECU_ADDRESS 0x7F98AA /end MEASUREMENT
/begin MEASUREMENT FrmMng_stGearLever "Status Wählhebelposition" UWORD OneToOne 1 100 0.00 65535.00 FORMAT "%8.2" ECU_ADDRESS 0x7F98AC /end MEASUREMENT
/begin MEASUREMENT FrmMng_stGW1 "Status für Stop-Lampe fehler,Botschaft Gateway1" UBYTE OneToOne 1 100 0.00 255.0 FORMAT "%5.1" ECU_ADDRESS 0x7F940A /end MEASUREMENT
/begin MEASUREMENT FrmMng_stGW1Wiper "Zustand der Windschutzscheibenwischer" UBYTE OneToOne 1 100 0.00 255.0 FORMAT "%5.1" ECU_ADDRESS 0x7F940B /end MEASUREMENT
/begin MEASUREMENT FrmMng_stGWSlpAck "Sleep acknowledge Zustand der von GW - SG gesendet wird" UBYTE OneToOne 1 100 0.00 255.0 FORMAT "%5.1" ECU_ADDRESS 0x7F940C /end MEASUREMENT
/begin MEASUREMENT FrmMng_stIgn "Zustände der Botschaft ZAS1 (STIGN)" UBYTE OneToOne 1 100 0.00 255.0 FORMAT "%5.1" ECU_ADDRESS 0x7F940D /end MEASUREMENT
/begin MEASUREMENT FrmMng_stLFRAdp "LFR Adaption" UBYTE OneToOne 1 100 0.00 255.0 FORMAT "%5.1" ECU_ADDRESS 0x7F9410 /end MEASUREMENT
/begin MEASUREMENT FrmMng_stMIL "Status MIL" UBYTE OneToOne 1 100 0.00 255.0 FORMAT "%5.1" ECU_ADDRESS 0x7F9411 /end MEASUREMENT
/begin MEASUREMENT FrmMng_stMsgErrAC1 "Fehlerstatus Botschaft AC1" UBYTE OneToOne 1 100 0.00 255.0 FORMAT "%5.1" ECU_ADDRESS 0x7F9412 /end MEASUREMENT
/begin MEASUREMENT FrmMng_stMsgErrACC "Fehlerstatus Botschaft ACC-System" UBYTE OneToOne 1 100 0.00 255.0 FORMAT "%5.1" ECU_ADDRESS 0x7F9413 /end MEASUREMENT
/begin MEASUREMENT FrmMng_stMsgErrAIRBG "Fehlerstatus Botschaft AIRBG" UBYTE OneToOne 1 100 0.00 255.0 FORMAT "%5.1" ECU_ADDRESS 0x7F9414 /end MEASUREMENT
/begin MEASUREMENT FrmMng_stMsgErrAWD1 "Errorstatus Allrad1" UBYTE OneToOne 1 100 0.00 255.0 FORMAT "%5.1" ECU_ADDRESS 0x7F9415 /end MEASUREMENT
/begin MEASUREMENT FrmMng_stMsgErrBEM1 "Fehlerstatus für Botschaft BEM1" UBYTE OneToOne 1 100 0.00 255.0 FORMAT "%5.1" ECU_ADDRESS 0x7F9416 /end MEASUREMENT
/begin MEASUREMENT FrmMng_stMsgErrBRK1 "Fehlerstatus Botschaft BRK1" UBYTE OneToOne 1 100 0.00 255.0 FORMAT "%5.1" ECU_ADDRESS 0x7F9417 /end MEASUREMENT
/begin MEASUREMENT FrmMng_stMsgErrBRK2 "Status der CAN Botschaft - BRK2" UBYTE OneToOne 1 100 0.00 255.0 FORMAT "%5.1" ECU_ADDRESS 0x7F9418 /end MEASUREMENT
/begin MEASUREMENT FrmMng_stMsgErrBRK8 "Fehlerstatus Botschaft BRK8" UBYTE OneToOne 1 100 0.00 255.0 FORMAT "%5.1" ECU_ADDRESS 0x7F9419 /end MEASUREMENT
/begin MEASUREMENT FrmMng_stMsgErrCCTL "Fehlerstatus Botschaft CCTL" UBYTE OneToOne 1 100 0.00 255.0 FORMAT "%5.1" ECU_ADDRESS 0x7F941A /end MEASUREMENT
/begin MEASUREMENT FrmMng_stMsgErrDIA1 "Fehlerstatus für Botschaft DIA1" UBYTE OneToOne 1 100 0.00 255.0 FORMAT "%5.1" ECU_ADDRESS 0x7F941D /end MEASUREMENT
/begin MEASUREMENT FrmMng_stMsgErrDSP1 "Fehlerstatus Botsschaft DSP1" UBYTE OneToOne 1 100 0.00 255.0 FORMAT "%5.1" ECU_ADDRESS 0x7F941E /end MEASUREMENT
/begin MEASUREMENT FrmMng_stMsgErrDSP2 "Fehlerstatus Botschaft DSP2" UBYTE OneToOne 1 100 0.00 255.0 FORMAT "%5.1" ECU_ADDRESS 0x7F941F /end MEASUREMENT
/begin MEASUREMENT FrmMng_stMsgErrESCU "Fehlerstatus Botschaft ESCU" UBYTE OneToOne 1 100 0.00 255.0 FORMAT "%5.1" ECU_ADDRESS 0x7F9420 /end MEASUREMENT
/begin MEASUREMENT FrmMng_stMsgErrGW1 "Fehlerstatus für Botschaft GW1" UBYTE OneToOne 1 100 0.00 255.0 FORMAT "%5.1" ECU_ADDRESS 0x7F9421 /end MEASUREMENT
/begin MEASUREMENT FrmMng_stMsgErrNIVEAU1 "Fehlerstatus Botschaft NIVEAU1" UBYTE OneToOne 1 100 0.00 255.0 FORMAT "%5.1" ECU_ADDRESS 0x7F9422 /end MEASUREMENT
/begin MEASUREMENT FrmMng_stMsgErrStIgn "Fehlerstatus Botschaft ZAS1 (STIGN)" UBYTE OneToOne 1 100 0.00 255.0 FORMAT "%5.1" ECU_ADDRESS 0x7F9423 /end MEASUREMENT
/begin MEASUREMENT FrmMng_stMsgErrTOS "Fehlerstatus für Botschaft TOG" UBYTE OneToOne 1 100 0.00 255.0 FORMAT "%5.1" ECU_ADDRESS 0x7F9424 /end MEASUREMENT
/begin MEASUREMENT FrmMng_stMsgErrTSC1 "Fehlerstatus Botschaft TSC1" UBYTE OneToOne 1 100 0.00 255.0 FORMAT "%5.1" ECU_ADDRESS 0x7F9425 /end MEASUREMENT
/begin MEASUREMENT FrmMng_stMsgErrTSC2 "Fehlerstatus Botschaft TSC2" UBYTE OneToOne 1 100 0.00 255.0 FORMAT "%5.1" ECU_ADDRESS 0x7F9426 /end MEASUREMENT
/begin MEASUREMENT FrmMng_stMsgErrTSC3 "Fehlerstatus Botschaft TSC3" UBYTE OneToOne 1 100 0.00 255.0 FORMAT "%5.1" ECU_ADDRESS 0x7F9427 /end MEASUREMENT
/begin MEASUREMENT FrmMng_stNIVEAU1 "Status Niveausteuergerät" UBYTE OneToOne 1 100 0.00 255.0 FORMAT "%5.1" ECU_ADDRESS 0x7F942A /end MEASUREMENT
/begin MEASUREMENT FrmMng_stOilWrnThres "Status des Öltemperatur - Sensors / Ölwarnschwelle" UBYTE OneToOne 1 100 0.00 255.0 FORMAT "%5.1" ECU_ADDRESS 0x7F942B /end MEASUREMENT
/begin MEASUREMENT FrmMng_stPlsPanErr "Status Plausibilitätsfehler Bedienteil" UWORD OneToOne 1 100 0.00 65535.00 FORMAT "%8.2" ECU_ADDRESS 0x7F98B4 /end MEASUREMENT
/begin MEASUREMENT FrmMng_stPreGlwLamp "Status Vorglühlampe" UBYTE OneToOne 1 100 0.00 255.0 FORMAT "%5.1" ECU_ADDRESS 0x7F942C /end MEASUREMENT
/begin MEASUREMENT FrmMng_stSendACC "StatusACC-Typ (0:Ini,1:AudiTX,2AudiRX,3:VWRX,4:Ungültiger Typ)" UBYTE OneToOne 1 100 0.00 255.0 FORMAT "%5.1" ECU_ADDRESS 0x7F942D /end MEASUREMENT
/begin MEASUREMENT FrmMng_stSendEng6_B1 "Message für Byte 1 in ENG6 (nur für Bypass)" UBYTE OneToOne 1 100 0.00 255.0 FORMAT "%5.1" ECU_ADDRESS 0x7F942E /end MEASUREMENT
/begin MEASUREMENT FrmMng_stSendEng6_B2 "Message für Byte 2 in ENG6 (nur für Bypass)" UBYTE OneToOne 1 100 0.00 255.0 FORMAT "%5.1" ECU_ADDRESS 0x7F942F /end MEASUREMENT
/begin MEASUREMENT FrmMng_stSendEng6_B3 "Message für Byte 3 in ENG6 (nur für Bypass)" UBYTE OneToOne 1 100 0.00 255.0 FORMAT "%5.1" ECU_ADDRESS 0x7F9430 /end MEASUREMENT
/begin MEASUREMENT FrmMng_stSendEng6_B4 "Message für Byte 4 in ENG6 (nur für Bypass)" UBYTE OneToOne 1 100 0.00 255.0 FORMAT "%5.1" ECU_ADDRESS 0x7F9431 /end MEASUREMENT
/begin MEASUREMENT FrmMng_stSendEng6_B5 "Message für Byte 5 in ENG6 (nur für Bypass)" UBYTE OneToOne 1 100 0.00 255.0 FORMAT "%5.1" ECU_ADDRESS 0x7F9432 /end MEASUREMENT
/begin MEASUREMENT FrmMng_stSendEng6_B6 "Message für Byte 6 in ENG6 (nur für Bypass)" UBYTE OneToOne 1 100 0.00 255.0 FORMAT "%5.1" ECU_ADDRESS 0x7F9433 /end MEASUREMENT
/begin MEASUREMENT FrmMng_stSendEng6_B7 "Message für Byte 7 in ENG6 (nur für Bypass)" UBYTE OneToOne 1 100 0.00 255.0 FORMAT "%5.1" ECU_ADDRESS 0x7F9434 /end MEASUREMENT
/begin MEASUREMENT FrmMng_stSendEng6_B8 "Message für Byte 8 in ENG6 (nur für Bypass)" UBYTE OneToOne 1 100 0.00 255.0 FORMAT "%5.1" ECU_ADDRESS 0x7F9435 /end MEASUREMENT
/begin MEASUREMENT FrmMng_stSendEngTrq1_B1 "Message für Byte 1 in ENGTRQ1 (nur für Bypass)" UBYTE OneToOne 1 100 0.00 255.0 FORMAT "%5.1" ECU_ADDRESS 0x7F9436 /end MEASUREMENT
/begin MEASUREMENT FrmMng_stSendEngTrq1_B2 "Message für Byte 2 in ENGTRQ1 (nur für Bypass)" UBYTE OneToOne 1 100 0.00 255.0 FORMAT "%5.1" ECU_ADDRESS 0x7F9437 /end MEASUREMENT
/begin MEASUREMENT FrmMng_stSendEngTrq1_B3 "Message für Byte 3 in ENGTRQ1 (nur für Bypass)" UBYTE OneToOne 1 100 0.00 255.0 FORMAT "%5.1" ECU_ADDRESS 0x7F9438 /end MEASUREMENT
/begin MEASUREMENT FrmMng_stSendEngTrq1_B4 "Message für Byte 4 in ENGTRQ1 (nur für Bypass)" UBYTE OneToOne 1 100 0.00 255.0 FORMAT "%5.1" ECU_ADDRESS 0x7F9439 /end MEASUREMENT
/begin MEASUREMENT FrmMng_stSendEngTrq1_B5 "Message für Byte 5 in ENGTRQ1 (nur für Bypass)" UBYTE OneToOne 1 100 0.00 255.0 FORMAT "%5.1" ECU_ADDRESS 0x7F943A /end MEASUREMENT
/begin MEASUREMENT FrmMng_stSendEngTrq1_B6 "Message für Byte 6 in ENGTRQ1 (nur für Bypass)" UBYTE OneToOne 1 100 0.00 255.0 FORMAT "%5.1" ECU_ADDRESS 0x7F943B /end MEASUREMENT
/begin MEASUREMENT FrmMng_stSendEngTrq1_B7 "Message für Byte 7 in ENGTRQ1 (nur für Bypass)" UBYTE OneToOne 1 100 0.00 255.0 FORMAT "%5.1" ECU_ADDRESS 0x7F943C /end MEASUREMENT
/begin MEASUREMENT FrmMng_stSendEngTrq1_B8 "Message für Byte 8 in ENGTRQ1 (nur für Bypass)" UBYTE OneToOne 1 100 0.00 255.0 FORMAT "%5.1" ECU_ADDRESS 0x7F943D /end MEASUREMENT
/begin MEASUREMENT FrmMng_stSendEngTrq2_B1 "Message für Byte 1 in ENGTRQ2 (nur für Bypass)" UBYTE OneToOne 1 100 0.00 255.0 FORMAT "%5.1" ECU_ADDRESS 0x7F943E /end MEASUREMENT
/begin MEASUREMENT FrmMng_stSendEngTrq2_B2 "Message für Byte 2 in ENGTRQ2 (nur für Bypass)" UBYTE OneToOne 1 100 0.00 255.0 FORMAT "%5.1" ECU_ADDRESS 0x7F943F /end MEASUREMENT
/begin MEASUREMENT FrmMng_stSendEngTrq2_B3 "Message für Byte 3 in ENGTRQ2 (nur für Bypass)" UBYTE OneToOne 1 100 0.00 255.0 FORMAT "%5.1" ECU_ADDRESS 0x7F9440 /end MEASUREMENT
/begin MEASUREMENT FrmMng_stSendEngTrq2_B4 "Message für Byte 4 in ENGTRQ2 (nur für Bypass)" UBYTE OneToOne 1 100 0.00 255.0 FORMAT "%5.1" ECU_ADDRESS 0x7F9441 /end MEASUREMENT
/begin MEASUREMENT FrmMng_stSendEngTrq2_B5 "Message für Byte 5 in ENGTRQ2 (nur für Bypass)" UBYTE OneToOne 1 100 0.00 255.0 FORMAT "%5.1" ECU_ADDRESS 0x7F9442 /end MEASUREMENT
/begin MEASUREMENT FrmMng_stSendEngTrq2_B6 "Message für Byte 6 in ENGTRQ2 (nur für Bypass)" UBYTE OneToOne 1 100 0.00 255.0 FORMAT "%5.1" ECU_ADDRESS 0x7F9443 /end MEASUREMENT
/begin MEASUREMENT FrmMng_stSendEngTrq2_B7 "Message für Byte 7 in ENGTRQ2 (nur für Bypass)" UBYTE OneToOne 1 100 0.00 255.0 FORMAT "%5.1" ECU_ADDRESS 0x7F9444 /end MEASUREMENT
/begin MEASUREMENT FrmMng_stSendEngTrq2_B8 "Message für Byte 8 in ENGTRQ2 (nur für Bypass)" UBYTE OneToOne 1 100 0.00 255.0 FORMAT "%5.1" ECU_ADDRESS 0x7F9445 /end MEASUREMENT
/begin MEASUREMENT FrmMng_stSendEngTrq3_B1 "Message für Byte 1 in ENGTRQ3 (nur für Bypass)" UBYTE OneToOne 1 100 0.00 255.0 FORMAT "%5.1" ECU_ADDRESS 0x7F9446 /end MEASUREMENT
/begin MEASUREMENT FrmMng_stSendEngTrq3_B2 "Message für Byte 2 in ENGTRQ3 (nur für Bypass)" UBYTE OneToOne 1 100 0.00 255.0 FORMAT "%5.1" ECU_ADDRESS 0x7F9447 /end MEASUREMENT
/begin MEASUREMENT FrmMng_stSendEngTrq3_B3 "Message für Byte 3 in ENGTRQ3 (nur für Bypass)" UBYTE OneToOne 1 100 0.00 255.0 FORMAT "%5.1" ECU_ADDRESS 0x7F9448 /end MEASUREMENT
/begin MEASUREMENT FrmMng_stSendEngTrq3_B4 "Message für Byte 4 in ENGTRQ3 (nur für Bypass)" UBYTE OneToOne 1 100 0.00 255.0 FORMAT "%5.1" ECU_ADDRESS 0x7F9449 /end MEASUREMENT
/begin MEASUREMENT FrmMng_stSendEngTrq3_B5 "Message für Byte 5 in ENGTRQ3 (nur für Bypass)" UBYTE OneToOne 1 100 0.00 255.0 FORMAT "%5.1" ECU_ADDRESS 0x7F944A /end MEASUREMENT
/begin MEASUREMENT FrmMng_stSendEngTrq3_B6 "Message für Byte 6 in ENGTRQ3 (nur für Bypass)" UBYTE OneToOne 1 100 0.00 255.0 FORMAT "%5.1" ECU_ADDRESS 0x7F944B /end MEASUREMENT
/begin MEASUREMENT FrmMng_stSendEngTrq3_B7 "Message für Byte 7 in ENGTRQ3 (nur für Bypass)" UBYTE OneToOne 1 100 0.00 255.0 FORMAT "%5.1" ECU_ADDRESS 0x7F944C /end MEASUREMENT
/begin MEASUREMENT FrmMng_stSendEngTrq3_B8 "Message für Byte 8 in ENGTRQ3 (nur für Bypass)" UBYTE OneToOne 1 100 0.00 255.0 FORMAT "%5.1" ECU_ADDRESS 0x7F944D /end MEASUREMENT
/begin MEASUREMENT FrmMng_stSvLpErr "Bitcodierte Messae für Fehlerstatus TOS-Signale" UBYTE OneToOne 1 100 0.00 255.0 FORMAT "%5.1" ECU_ADDRESS 0x7F944E /end MEASUREMENT
/begin MEASUREMENT FrmMng_stTCS "Status des ASR Momenteneingriffs" UWORD OneToOne 1 100 0.00 65535.00 FORMAT "%8.2" ECU_ADDRESS 0x7F98B6 /end MEASUREMENT
/begin MEASUREMENT FrmMng_stTOSSensErr "Status des TOS - Sensor-Errors" UBYTE OneToOne 1 100 0.00 255.0 FORMAT "%5.1" ECU_ADDRESS 0x7F9451 /end MEASUREMENT
/begin MEASUREMENT FrmMng_stTSC "Status EGS-Eingriff" UWORD OneToOne 1 100 0.00 65535.00 FORMAT "%8.2" ECU_ADDRESS 0x7F98B8 /end MEASUREMENT
/begin MEASUREMENT FrmMng_stTSC3 "Status Sollmoment - TSC3 / Status Dynamischer Eingriff" UBYTE OneToOne 1 100 0.00 255.0 FORMAT "%5.1" ECU_ADDRESS 0x7F9453 /end MEASUREMENT
/begin MEASUREMENT FrmMng_stTSC3Trgt "Status Langfristiger Eingriff" UBYTE OneToOne 1 100 0.00 255.0 FORMAT "%5.1" ECU_ADDRESS 0x7F9454 /end MEASUREMENT
/begin MEASUREMENT FrmMng_swtTSC3Type "Switch Typs Botschaft Getriebe3" UBYTE OneToOne 1 100 0.00 255.0 FORMAT "%5.1" ECU_ADDRESS 0x7F9455 /end MEASUREMENT
/begin MEASUREMENT FrmMng_tiDesAST "Synchronisationszeit" SWORD Time_ms 1 100 -327680.0 327670.0 FORMAT "%8.1" ECU_ADDRESS 0x7F98C4 /end MEASUREMENT
/begin MEASUREMENT FrmMng_tiDIA1Date "Datum im JJ-MM-TT Format für Botschaft Diagnose1." ULONG OneToOne 1 100 0.00 4294967295.00 FORMAT "%13.2" ECU_ADDRESS 0x7F9CC4 /end MEASUREMENT
/begin MEASUREMENT FrmMng_tiDIA1Time "Zeit im HH-MM-SS Format  für Botschaft Diagnose1." ULONG OneToOne 1 100 0.00 4294967295.00 FORMAT "%13.2" ECU_ADDRESS 0x7F9CC8 /end MEASUREMENT
/begin MEASUREMENT FrmMng_tiTOSFillLvl1 "Füllstandszeit 1" UWORD Time_RtmLowRes 1 100 0.00 6553.500 FORMAT "%8.3" ECU_ADDRESS 0x7F98C6 /end MEASUREMENT
/begin MEASUREMENT FrmMng_tiTOSFillLvl2 "Füllstandszeit 2" UWORD Time_RtmLowRes 1 100 0.00 6553.500 FORMAT "%8.3" ECU_ADDRESS 0x7F98C8 /end MEASUREMENT
/begin MEASUREMENT FrmMng_tiTOSFillLvl3 "Füllstandszeit 3" UWORD Time_RtmLowRes 1 100 0.00 6553.500 FORMAT "%8.3" ECU_ADDRESS 0x7F98CA /end MEASUREMENT
/begin MEASUREMENT FrmMng_tiTOSFillLvl4 "Füllstandszeit 4" UWORD Time_RtmLowRes 1 100 0.00 6553.500 FORMAT "%8.3" ECU_ADDRESS 0x7F98CC /end MEASUREMENT
/begin MEASUREMENT FrmMng_tiTOSOilT "Öltemperatur - Zeit von CAN(TOS)" UWORD Time_HighRes 1 100 0.00 8191.875 FORMAT "%8.3" ECU_ADDRESS 0x7F98CE /end MEASUREMENT
/begin MEASUREMENT FrmMng_trqACCDes "empfangenes ACC-Wunschmoment" SWORD TrqPrp 1 100 -32768.00 32767.00 FORMAT "%8.2" ECU_ADDRESS 0x7F98D0 /end MEASUREMENT
/begin MEASUREMENT FrmMng_trqACCompr "Momentenanforderung vom Klimakompressor via CAN" SWORD Trq 1 100 -3276.800 3276.700 FORMAT "%8.3" ECU_ADDRESS 0x7F98D2 /end MEASUREMENT
/begin MEASUREMENT FrmMng_trqConvLoss "Wandlerverlustmoment" SWORD Trq 1 100 -3276.800 3276.700 FORMAT "%8.3" ECU_ADDRESS 0x7F98D4 /end MEASUREMENT
/begin MEASUREMENT FrmMng_trqDCS "vom MSR gefordertes Getriebeausgangsmoment" SWORD TrqPrp 1 100 -32768.00 32767.00 FORMAT "%8.2" ECU_ADDRESS 0x7F98D6 /end MEASUREMENT
/begin MEASUREMENT FrmMng_trqDCSraw "DCS Rohwert vom CAN" UBYTE OneToOne 1 100 0.00 255.0 FORMAT "%5.1" ECU_ADDRESS 0x7F9456 /end MEASUREMENT
/begin MEASUREMENT FrmMng_trqFrc "Reibmoment" SWORD Trq 1 100 -3276.800 3276.700 FORMAT "%8.3" ECU_ADDRESS 0x7F98DA /end MEASUREMENT
/begin MEASUREMENT FrmMng_trqInrDCS "Eingriffsmoment MSR" SWORD Trq 1 100 -3276.800 3276.700 FORMAT "%8.3" ECU_ADDRESS 0x7F98DC /end MEASUREMENT
/begin MEASUREMENT FrmMng_trqInrEngNoExtDem "Meßpunkt für inneres Motormoment ohne externe Momente" SWORD Trq 1 100 -3276.800 3276.700 FORMAT "%8.3" ECU_ADDRESS 0x7F98DE /end MEASUREMENT
/begin MEASUREMENT FrmMng_trqInrTCS "Eingriffsmoment ASR" SWORD Trq 1 100 -3276.800 3276.700 FORMAT "%8.3" ECU_ADDRESS 0x7F98E0 /end MEASUREMENT
/begin MEASUREMENT FrmMng_trqInrTSC "Eingriffsmoment EGS" SWORD Trq 1 100 -3276.800 3276.700 FORMAT "%8.3" ECU_ADDRESS 0x7F98E2 /end MEASUREMENT
/begin MEASUREMENT FrmMng_trqTCS "vom ASR gefordertes Getriebeausgangsmoment" SWORD TrqPrp 1 100 -32768.00 32767.00 FORMAT "%8.2" ECU_ADDRESS 0x7F98E8 /end MEASUREMENT
/begin MEASUREMENT FrmMng_trqTCSraw "TCS Rohwert vom CAN" UBYTE OneToOne 1 100 0.00 255.0 FORMAT "%5.1" ECU_ADDRESS 0x7F9457 /end MEASUREMENT
/begin MEASUREMENT FrmMng_trqTSC "Eingriffsmoment EGS" SWORD Trq 1 100 -3276.800 3276.700 FORMAT "%8.3" ECU_ADDRESS 0x7F98EA /end MEASUREMENT
/begin MEASUREMENT FrmMng_trqTSC3 "TSC3 Motorsollmoment" SWORD Trq 1 100 -3276.800 3276.700 FORMAT "%8.3" ECU_ADDRESS 0x7F98EC /end MEASUREMENT
/begin MEASUREMENT FrmMng_trqTSC3Inr "Rohwert Motorsollmoment" SWORD Trq 1 100 -3276.800 3276.700 FORMAT "%8.3" ECU_ADDRESS 0x7F98EE /end MEASUREMENT
/begin MEASUREMENT FrmMng_trqTSC3Trgt "Langfristiger Eingriff" SWORD Trq 1 100 -3276.800 3276.700 FORMAT "%8.3" ECU_ADDRESS 0x7F98F0 /end MEASUREMENT
/begin MEASUREMENT FrmMng_vDspl1 "Fahrzeuggeschwindigkeit" SWORD Vel 1 100 -327.6800 327.6700 FORMAT "%8.4" ECU_ADDRESS 0x7F98F2 /end MEASUREMENT
/begin MEASUREMENT FrmMng_vGS "Fahrzeuggeschwindigkeit über Grund" SWORD Vel 1 100 -327.6800 327.6700 FORMAT "%8.4" ECU_ADDRESS 0x7F98F4 /end MEASUREMENT
/begin MEASUREMENT FrmMng_volFuelFil "Tankfüllstand" UBYTE Fl_Half_L 1 100 0.00 127.5 FORMAT "%5.1" ECU_ADDRESS 0x7F9458 /end MEASUREMENT
/begin MEASUREMENT FTSCD_stPlausibilityTest "Kraftstofftemperatur Plausibilitätstest Status" SWORD OneToOne 1 100 -32768.00 32767.00 FORMAT "%8.2" ECU_ADDRESS 0x7F984C /end MEASUREMENT
/begin MEASUREMENT FTSCD_tDiffAbsCARB "Absolute Kraftstofftemperaturdifferenz des A-Tests" SWORD TempDiff_Kelv 1 100 -3276.800 3276.700 FORMAT "%8.3" ECU_ADDRESS 0x7F984E /end MEASUREMENT
/begin MEASUREMENT FTSCD_tDiffAbs_mp "Absolute Kraftstofftemperaturdifferenz" SWORD TempDiff_Kelv 1 100 -3276.800 3276.700 FORMAT "%8.3" ECU_ADDRESS 0x802ED4 /end MEASUREMENT
/begin MEASUREMENT FTSCD_tDiffMinCARB "Minimale absolute Kraftstofftemperaturdifferenz des A-Tests" SWORD TempDiff_Kelv 1 100 -3276.800 3276.700 FORMAT "%8.3" ECU_ADDRESS 0x7F9850 /end MEASUREMENT
/begin MEASUREMENT FTSCD_tDiff_mp "Absolute Kraftstofftemperaturdifferenzschwelle  - Kopie von FTSCD_tDiff_C für Signale" SWORD TempDiff_Kelv 1 100 -3276.800 3276.700 FORMAT "%8.3" ECU_ADDRESS 0x802ED6 /end MEASUREMENT
/begin MEASUREMENT FTSCD_tFuel "Kraftstofftemperatur" SWORD Temp_Cels 1 100 -3549.940 3003.560 FORMAT "%8.3" ECU_ADDRESS 0x7F9852 /end MEASUREMENT
/begin MEASUREMENT FTSCD_tFuelLin "linearisierter Wert der Kraftstoffstemperatur" SWORD Temp_Cels 1 100 -3549.940 3003.560 FORMAT "%8.3" ECU_ADDRESS 0x7F9854 /end MEASUREMENT
/begin MEASUREMENT FTSCD_tiEngOn_mp "Betriebsstundenzähler seit dem Start des DTI-Tests" ULONG TimeEngOn 1 100 0.00 4294967295.00 FORMAT "%13.2" ECU_ADDRESS 0x802ED8 /end MEASUREMENT
/begin MEASUREMENT FTSCD_tiMaxCARB "Maximale Testdauer des DTI-Test" ULONG TimeEngOn 1 100 0.00 4294967295.00 FORMAT "%13.2" ECU_ADDRESS 0x7F9CAC /end MEASUREMENT
/begin MEASUREMENT FTSCD_tImn_mp "minimale Kraftstofftemperaturdifferenz - Kopie von FTSCD_tImn_C für Signale" SWORD TempDiff_Kelv 1 100 -3276.800 3276.700 FORMAT "%8.3" ECU_ADDRESS 0x802EDC /end MEASUREMENT
/begin MEASUREMENT FTSCD_tInt "Kraftstofftemperaturdifferenz Integralwert" SWORD TempDiff_Kelv 1 100 -3276.800 3276.700 FORMAT "%8.3" ECU_ADDRESS 0x7F9856 /end MEASUREMENT
/begin MEASUREMENT FTSCD_tIntCARB "Integrale Kraftstofftemperaturdifferenz des DTI-Tests" SWORD TempDiff_Kelv 1 100 -3276.800 3276.700 FORMAT "%8.3" ECU_ADDRESS 0x7F9858 /end MEASUREMENT
/begin MEASUREMENT FTSCD_tIntMinCARB "Minimale integrale Kraftstofftemperaturdifferenz des DTI-Tests" SWORD TempDiff_Kelv 1 100 -3276.800 3276.700 FORMAT "%8.3" ECU_ADDRESS 0x7F985A /end MEASUREMENT
/begin MEASUREMENT FTSCD_tInt_Carb_mp "Kraftstofftemperaturdifferenz Integral Schwelle - Kopie von FTSCD_tInt_C für Signale" SWORD TempDiff_Kelv 1 100 -3276.800 3276.700 FORMAT "%8.3" ECU_ADDRESS 0x802EDE /end MEASUREMENT
/begin MEASUREMENT FTSCD_tiTestCARB "Testdauer des DTI-Test" ULONG TimeEngOn 1 100 0.00 4294967295.00 FORMAT "%13.2" ECU_ADDRESS 0x7F9CB0 /end MEASUREMENT
/begin MEASUREMENT FTSCD_tiTestDuration "Kraftstofftemperatur DTI Testdauer" ULONG TimeEngOn 1 100 0.00 4294967295.00 FORMAT "%13.2" ECU_ADDRESS 0x7F9CB4 /end MEASUREMENT
/begin MEASUREMENT FTSCD_tiTmn_mp "minimale Kraftstofftemperatur DTI Testdauer  - Kopie von FTSCD_tiTmn_C für Signale" ULONG TimeEngOn 1 100 0.00 4294967295.00 FORMAT "%13.2" ECU_ADDRESS 0x802EE0 /end MEASUREMENT
/begin MEASUREMENT FTSCD_uRaw "Spannungsrohwert der Kraftstoffstemperatur" SWORD Volt 1 100 -160156.4 160151.5 FORMAT "%8.1" ECU_ADDRESS 0x7F985C /end MEASUREMENT
/begin MEASUREMENT Gearbx_amASTAKT_mp "Integriertes Moment für den AST Eingriff" UWORD AngMom 1 100 0.00 33553.92 FORMAT "%8.2" ECU_ADDRESS 0x802EE8 /end MEASUREMENT
/begin MEASUREMENT Gearbx_amIncFree_mp "Wert des freien Integralmoments" UWORD AngMom 1 100 0.00 33553.92 FORMAT "%8.2" ECU_ADDRESS 0x802EEA /end MEASUREMENT
/begin MEASUREMENT Gearbx_dtrqCANerr_mp "Anstieg des Getriebeeingangsmomentes bei CAN Ausfall" ULONG RmpTrq 1 100 0.00 6553599.99847 FORMAT "%13.5" ECU_ADDRESS 0x802F20 /end MEASUREMENT
/begin MEASUREMENT Gearbx_nASTSyncStepInr_mp "Drehzahlinkrement für Wunschdrehzahlberchnung" SWORD EngN 1 100 -32768.00 32767.00 FORMAT "%8.2" ECU_ADDRESS 0x802EEC /end MEASUREMENT
/begin MEASUREMENT Gearbx_nASTSyncStep_mp "Neue Drehzahlstufe zum Erreichen der Wunschdrehzahl" SWORD EngN 1 100 -32768.00 32767.00 FORMAT "%8.2" ECU_ADDRESS 0x802EEE /end MEASUREMENT
/begin MEASUREMENT Gearbx_nASTSyntmp_mp "Begrenzte Frame Manager Wunschdrehzahl" SWORD EngN 1 100 -32768.00 32767.00 FORMAT "%8.2" ECU_ADDRESS 0x802EF0 /end MEASUREMENT
/begin MEASUREMENT Gearbx_nSyncPrcAST_mp "Präzise Berechnungswert der AST Wunschdrehzahl" ULONG EngN 1 100 0.00 4294967295.00 FORMAT "%13.2" ECU_ADDRESS 0x802EF4 /end MEASUREMENT
/begin MEASUREMENT Gearbx_nSyncTmp_mp "Berechnete AST Wunschdrehzahl" SWORD EngN 1 100 -32768.00 32767.00 FORMAT "%8.2" ECU_ADDRESS 0x802EF8 /end MEASUREMENT
/begin MEASUREMENT Gearbx_nSynGovDev_mp "Reglerabweichung für AST Wunschdrehzahl" SWORD EngN 1 100 -32768.00 32767.00 FORMAT "%8.2" ECU_ADDRESS 0x802EFA /end MEASUREMENT
/begin MEASUREMENT Gearbx_numGearFast "erkannter schneller Getriebegang" SBYTE OneToOne 1 100 -128.0 127.0 FORMAT "%5.1" ECU_ADDRESS 0x7F9459 /end MEASUREMENT
/begin MEASUREMENT Gearbx_rIncFree "Anteils von dem freien Integralmoment" SWORD Prc 1 100 -327.6800 327.6700 FORMAT "%8.4" ECU_ADDRESS 0x7F98F8 /end MEASUREMENT
/begin MEASUREMENT Gearbx_rTrans "Getriebeübersetzung" SWORD TransR 1 100 -327.6800 327.6700 FORMAT "%8.4" ECU_ADDRESS 0x7F98FA /end MEASUREMENT
/begin MEASUREMENT Gearbx_rVnAWDLow_mp "Umgerechnetes v/n Verhältnis zur Berechnung des tatsächlichen Ganges bei aktiver Untersetzung" SWORD VelToN 1 100 -0.3276800 0.3276700 FORMAT "%9.7" ECU_ADDRESS 0x802EE4 /end MEASUREMENT
/begin MEASUREMENT Gearbx_stAST "Status des automatischen Schaltgetriebes" UWORD OneToOne 1 100 0.00 65535.00 FORMAT "%8.2" ECU_ADDRESS 0x7F98FC /end MEASUREMENT
/begin MEASUREMENT Gearbx_stASTLim_mp "Zustand der TII - Begrenzung" UBYTE OneToOne 1 100 0.00 255.0 FORMAT "%5.1" ECU_ADDRESS 0x802EFC /end MEASUREMENT
/begin MEASUREMENT Gearbx_stAWDAct "Getreibezustand abhänging von der Aktivierung der Reduzierung(--)" UBYTE OneToOne 1 100 0.00 255.0 FORMAT "%5.1" ECU_ADDRESS 0x7F945A /end MEASUREMENT
/begin MEASUREMENT Gearbx_stCond1_mp "Meßpunkt für Fehlerbedingungen" UBYTE OneToOne 1 100 0.00 255.0 FORMAT "%5.1" ECU_ADDRESS 0x802F24 /end MEASUREMENT
/begin MEASUREMENT Gearbx_stCond2_mp "Meßpunkt für abgelaufenen Timer" UBYTE OneToOne 1 100 0.00 255.0 FORMAT "%5.1" ECU_ADDRESS 0x802F25 /end MEASUREMENT
/begin MEASUREMENT Gearbx_stDetType "Gangerkennung über CAN oder v/n" UBYTE OneToOne 1 100 0.00 255.0 FORMAT "%5.1" ECU_ADDRESS 0x7F945B /end MEASUREMENT
/begin MEASUREMENT Gearbx_stGear "Ganginformation" SBYTE OneToOne 1 100 -128.0 127.0 FORMAT "%5.1" ECU_ADDRESS 0x7F945C /end MEASUREMENT
/begin MEASUREMENT Gearbx_stParGear "Paramatergang bei aktiver Untersetzung zur Parameterauswahl" SBYTE OneToOne 1 100 -128.0 127.0 FORMAT "%5.1" ECU_ADDRESS 0x7F945D /end MEASUREMENT
/begin MEASUREMENT Gearbx_stRamping_mp "Status der Rampe" UBYTE OneToOne 1 100 0.00 255.0 FORMAT "%5.1" ECU_ADDRESS 0x802F26 /end MEASUREMENT
/begin MEASUREMENT Gearbx_stTrqLim_mp "Status der Momentenselektion" UBYTE OneToOne 1 100 0.00 255.0 FORMAT "%5.1" ECU_ADDRESS 0x802F27 /end MEASUREMENT
/begin MEASUREMENT Gearbx_stTSC "Status des TSC-Eingriffes (zB.: EGS aktiv ja/nein)" UWORD OneToOne 1 100 0.00 65535.00 FORMAT "%8.2" ECU_ADDRESS 0x7F98FE /end MEASUREMENT
/begin MEASUREMENT Gearbx_stTSC3MaxLim_mp "Status der Momentenselektion von TSC3" UBYTE OneToOne 1 100 0.00 255.0 FORMAT "%5.1" ECU_ADDRESS 0x802F28 /end MEASUREMENT
/begin MEASUREMENT Gearbx_stTSCErr_mp "Fehler Status des TSC-Eingriffes (begrenzte Eingriffszeit)" UBYTE OneToOne 1 100 0.00 255.0 FORMAT "%5.1" ECU_ADDRESS 0x802EFD /end MEASUREMENT
/begin MEASUREMENT Gearbx_swtASTFrc_mp "Schalterwert für Reibmomentkorrektur" UBYTE OneToOne 1 100 0.00 255.0 FORMAT "%5.1" ECU_ADDRESS 0x802EFE /end MEASUREMENT
/begin MEASUREMENT Gearbx_swtDemtype "Ausgang des Softwareschalters für die Freigabe des TSC Eingriffs" UBYTE OneToOne 1 100 0.00 255.0 FORMAT "%5.1" ECU_ADDRESS 0x7F945E /end MEASUREMENT
/begin MEASUREMENT Gearbx_swtType "Getriebetyp (0: manuell(MT); 1: automatisch(AT); 2: Schaltautomatisch(AST); 3: StufenlosesGetriebe (CVT); 4:automatic Z-Car)" UBYTE OneToOne 1 100 0.00 255.0 FORMAT "%5.1" ECU_ADDRESS 0x7F945F /end MEASUREMENT
/begin MEASUREMENT Gearbx_tiHoldTmr_mp "Timerwert des Haltetimers des Getriebeschutzes" UWORD Time_ms 1 100 0.00 655350.0 FORMAT "%8.1" ECU_ADDRESS 0x802F2A /end MEASUREMENT
/begin MEASUREMENT Gearbx_tiTSCINT_mp "Wert des Zeitintegrals TSC (EGS)" SWORD OneToOne 1 100 -32768.00 32767.00 FORMAT "%8.2" ECU_ADDRESS 0x802F00 /end MEASUREMENT
/begin MEASUREMENT Gearbx_trqASTMax_mp "Momentengrenzwert für den AST Eingriff" SWORD Trq 1 100 -3276.800 3276.700 FORMAT "%8.3" ECU_ADDRESS 0x802F02 /end MEASUREMENT
/begin MEASUREMENT Gearbx_trqASTMon_mp "Wert des Überwachungsmoments" SWORD Trq 1 100 -3276.800 3276.700 FORMAT "%8.3" ECU_ADDRESS 0x802F04 /end MEASUREMENT
/begin MEASUREMENT Gearbx_trqAST_mp "Meßpunkt für berechnetes AST Eingriffsmoment" SWORD Trq 1 100 -3276.800 3276.700 FORMAT "%8.3" ECU_ADDRESS 0x802F06 /end MEASUREMENT
/begin MEASUREMENT Gearbx_trqCANerrMax_mp "Ersatzwert nach Haltezeit" SWORD Trq 1 100 -3276.800 3276.700 FORMAT "%8.3" ECU_ADDRESS 0x802F2C /end MEASUREMENT
/begin MEASUREMENT Gearbx_trqCluNoExtDem_mp "Fahrerwunschmoment an der Kupplung ohne externe Eingriffe" SWORD Trq 1 100 -3276.800 3276.700 FORMAT "%8.3" ECU_ADDRESS 0x802F08 /end MEASUREMENT
/begin MEASUREMENT Gearbx_trqDec "erniedrigender Momenteneingriff vom Getriebe" SWORD Trq 1 100 -3276.800 3276.700 FORMAT "%8.3" ECU_ADDRESS 0x7F9900 /end MEASUREMENT
/begin MEASUREMENT Gearbx_trqExtAST_mp "AST Ersatzeingriffsmoment" SWORD Trq 1 100 -3276.800 3276.700 FORMAT "%8.3" ECU_ADDRESS 0x802F0A /end MEASUREMENT
/begin MEASUREMENT Gearbx_trqFrc "aktuelles Verlustmoment Getriebe" SWORD Trq 1 100 -3276.800 3276.700 FORMAT "%8.3" ECU_ADDRESS 0x7F9902 /end MEASUREMENT
/begin MEASUREMENT Gearbx_trqInc "erhöhender Momenteneingriff vom Getriebe" SWORD Trq 1 100 -3276.800 3276.700 FORMAT "%8.3" ECU_ADDRESS 0x7F9906 /end MEASUREMENT
/begin MEASUREMENT Gearbx_trqInMax "maximales Getriebeeingangsmoment" SWORD Trq 1 100 -3276.800 3276.700 FORMAT "%8.3" ECU_ADDRESS 0x7F9904 /end MEASUREMENT
/begin MEASUREMENT Gearbx_trqInMax_mp "Meßpunkt für maximales Getriebeeingangsmoment ohne beschränkung" SWORD Trq 1 100 -3276.800 3276.700 FORMAT "%8.3" ECU_ADDRESS 0x802F2E /end MEASUREMENT
/begin MEASUREMENT Gearbx_trqMaxCur_mp "maximales Getriebeeingangsmoment aus Kennlinie" SWORD Trq 1 100 -3276.800 3276.700 FORMAT "%8.3" ECU_ADDRESS 0x802F30 /end MEASUREMENT
/begin MEASUREMENT Gearbx_trqNetTSC3_mp "Wert des Nettomoments" SWORD Trq 1 100 -3276.800 3276.700 FORMAT "%8.3" ECU_ADDRESS 0x802F0C /end MEASUREMENT
/begin MEASUREMENT Gearbx_trqNoExtDem_mp "Fahrerwunschmoment ohne externer Eingriffe mit Leerlaufregler" SWORD Trq 1 100 -3276.800 3276.700 FORMAT "%8.3" ECU_ADDRESS 0x802F0E /end MEASUREMENT
/begin MEASUREMENT Gearbx_trqNoExtLiLtd "Begrenztes Fahrerwunschmoment ohne externer Eingriffe mit Leerlaufregler" SWORD Trq 1 100 -3276.800 3276.700 FORMAT "%8.3" ECU_ADDRESS 0x7F9908 /end MEASUREMENT
/begin MEASUREMENT Gearbx_trqPGvnrOut_mp "Reglerausgang des AST-drehzahlreglers" SWORD Trq 1 100 -3276.800 3276.700 FORMAT "%8.3" ECU_ADDRESS 0x802F10 /end MEASUREMENT
/begin MEASUREMENT Gearbx_trqPreCtlLtd_mp "Vorsteuermoment nach Berücksichtigung des Leerlaufreglers ohne Begrenzung auf Null" SWORD Trq 1 100 -3276.800 3276.700 FORMAT "%8.3" ECU_ADDRESS 0x802F12 /end MEASUREMENT
/begin MEASUREMENT Gearbx_trqPreCtlOp_mp "AST Eingriffsmoment , Reglerausgang nach Berücksichtigung der Vorsteuerung" SWORD Trq 1 100 -3276.800 3276.700 FORMAT "%8.3" ECU_ADDRESS 0x802F14 /end MEASUREMENT
/begin MEASUREMENT Gearbx_trqPreCtl_mp "AST Vorsteuermoment" SWORD Trq 1 100 -3276.800 3276.700 FORMAT "%8.3" ECU_ADDRESS 0x802F16 /end MEASUREMENT
/begin MEASUREMENT Gearbx_trqRotMass_mp "Wert des dynamischer Moments" SWORD Trq 1 100 -3276.800 3276.700 FORMAT "%8.3" ECU_ADDRESS 0x802F18 /end MEASUREMENT
/begin MEASUREMENT Gearbx_trqSprTSC_mp "Ersatzmoment von TSC" SWORD Trq 1 100 -3276.800 3276.700 FORMAT "%8.3" ECU_ADDRESS 0x802F1A /end MEASUREMENT
/begin MEASUREMENT Gearbx_trqTSC3Max_mp "maximales Getriebeeingangsmoment von entspricht Getriebe" SWORD Trq 1 100 -3276.800 3276.700 FORMAT "%8.3" ECU_ADDRESS 0x802F32 /end MEASUREMENT
/begin MEASUREMENT Gearbx_trqTSCAftSpr_mp "Getriebeeingriff TSC vor Plausibilität mit dem Zeitintegral" SWORD Trq 1 100 -3276.800 3276.700 FORMAT "%8.3" ECU_ADDRESS 0x802F1C /end MEASUREMENT
/begin MEASUREMENT GlwCD_Codwbuffer_mp "Codierwortbuffer zeigt die einzelnen Codierworte" UWORD OneToOne 1 100 0.00 65535.00 FORMAT "%8.2" ECU_ADDRESS 0x802F34 /end MEASUREMENT
/begin MEASUREMENT GlwCD_rGSK "an den Ausgang geschicktes GSK3-Tastverhältnis" SWORD DtyCyc 1 100 -327.6800 327.6700 FORMAT "%8.4" ECU_ADDRESS 0x7F990A /end MEASUREMENT
/begin MEASUREMENT GlwCD_rHWELampOut_mp "Glühkontrolllampe" UWORD OneToOne 1 100 0.00 65535.00 FORMAT "%8.2" ECU_ADDRESS 0x802F36 /end MEASUREMENT
/begin MEASUREMENT GlwCD_stActrRun_mp "Laufzeit Meßpunkt" UWORD OneToOne 1 100 0.00 65535.00 FORMAT "%8.2" ECU_ADDRESS 0x802F38 /end MEASUREMENT
/begin MEASUREMENT GlwCD_stCodeRdy "Codierung GZS aus EEPROM" UBYTE OneToOne 1 100 0.00 255.0 FORMAT "%5.1" ECU_ADDRESS 0x7F9460 /end MEASUREMENT
/begin MEASUREMENT GlwCD_stDebVal "Entprellter Eingang Glühkontrolle" UBYTE OneToOne 1 100 0.00 255.0 FORMAT "%5.1" ECU_ADDRESS 0x7F9461 /end MEASUREMENT
/begin MEASUREMENT GlwCD_stDiag_mp "status der GSK3 Diagnose" UBYTE OneToOne 1 100 0.00 255.0 FORMAT "%5.1" ECU_ADDRESS 0x802F3A /end MEASUREMENT
/begin MEASUREMENT GlwCD_stDigInRun_mp "veraltetes Label nur für Testzwecke, nicht beachten" UWORD OneToOne 1 100 0.00 65535.00 FORMAT "%8.2" ECU_ADDRESS 0x802F3C /end MEASUREMENT
/begin MEASUREMENT GlwCD_stGSK3 "GSK3-Fehlerdiagnoseergebnis" UWORD OneToOne 1 100 0.00 65535.00 FORMAT "%8.2" ECU_ADDRESS 0x7F990C /end MEASUREMENT
/begin MEASUREMENT GlwCD_stLampRun_mp "Laufzeitmeßpunkt (GlwCD_LampOut_Proc)" UWORD OneToOne 1 100 0.00 65535.00 FORMAT "%8.2" ECU_ADDRESS 0x802F3E /end MEASUREMENT
/begin MEASUREMENT GlwCD_stLogVal_mp "Rückmeldeeingangssignal nicht entprellt" UBYTE OneToOne 1 100 0.00 255.0 FORMAT "%5.1" ECU_ADDRESS 0x802F40 /end MEASUREMENT
/begin MEASUREMENT GlwCD_stOutHWE_mp "Glührelais Steller Ansteuersignal" UBYTE OneToOne 1 100 0.00 255.0 FORMAT "%5.1" ECU_ADDRESS 0x802F41 /end MEASUREMENT
/begin MEASUREMENT GlwCD_stPwrStg "Status der Vorglühlampe über CAN" SWORD OneToOne 1 100 -32768.00 32767.00 FORMAT "%8.2" ECU_ADDRESS 0x7F990E /end MEASUREMENT
/begin MEASUREMENT GlwCD_stRawVal "Roheingangswert Glühsteuerung" UBYTE OneToOne 1 100 0.00 255.0 FORMAT "%5.1" ECU_ADDRESS 0x7F9462 /end MEASUREMENT
/begin MEASUREMENT GlwCD_stValueOK_mp "Debuginfo" UWORD OneToOne 1 100 0.00 65535.00 FORMAT "%8.2" ECU_ADDRESS 0x802F42 /end MEASUREMENT
/begin MEASUREMENT GlwCtl_facGlwPwrRed_mp "Faktor der Glühleistungsreduzierung" SWORD Fact1 1 100 -256.0000 255.9922 FORMAT "%8.4" ECU_ADDRESS 0x802F5C /end MEASUREMENT
/begin MEASUREMENT GlwCtl_qPost_mp "Mengenschwelle für Nachglühen aus Kennfeld" SWORD InjMass 1 100 -327.6800 327.6700 FORMAT "%8.4" ECU_ADDRESS 0x802F44 /end MEASUREMENT
/begin MEASUREMENT GlwCtl_rGSK3Raw "nicht batteriespannungskorrigiertes GSK3-Tastverhältnis" SWORD DtyCyc 1 100 -327.6800 327.6700 FORMAT "%8.4" ECU_ADDRESS 0x7F9910 /end MEASUREMENT
/begin MEASUREMENT GlwCtl_rOutPre_mp "GSK3 Tastverhältnis im Vorglühfall" SWORD DtyCyc 1 100 -327.6800 327.6700 FORMAT "%8.4" ECU_ADDRESS 0x802F5E /end MEASUREMENT
/begin MEASUREMENT GlwCtl_rOut_mp "GSK3 Tastverhältnis für bereitschaftsglühen, Nachglühen und Zwischenglühen" SWORD DtyCyc 1 100 -327.6800 327.6700 FORMAT "%8.4" ECU_ADDRESS 0x802F60 /end MEASUREMENT
/begin MEASUREMENT GlwCtl_stActrOut "Ausgang Glührelais" UBYTE OneToOne 1 100 0.00 255.0 FORMAT "%5.1" ECU_ADDRESS 0x7F9463 /end MEASUREMENT
/begin MEASUREMENT GlwCtl_stAftRunDelDem "Statusbit des Glühkerzen Abkühl-Timers des Steuergeräte-Nachlaufs" UBYTE OneToOne 1 100 0.00 255.0 FORMAT "%5.1" ECU_ADDRESS 0x7F9464 /end MEASUREMENT
/begin MEASUREMENT GlwCtl_stAllw_mp "Status, ob von ""Kein Glühen"" in ""warten auf Zwischenglühen"" gewechselt werden darf" UBYTE OneToOne 1 100 0.00 255.0 FORMAT "%5.1" ECU_ADDRESS 0x802F46 /end MEASUREMENT
/begin MEASUREMENT GlwCtl_stGlwBitEco "Status Vorglühlampe" UBYTE OneToOne 1 100 0.00 255.0 FORMAT "%5.1" ECU_ADDRESS 0x7F9466 /end MEASUREMENT
/begin MEASUREMENT GlwCtl_stGlwPwrRed "Status der Glühleistungsreduzierung" UBYTE OneToOne 1 100 0.00 255.0 FORMAT "%5.1" ECU_ADDRESS 0x7F9467 /end MEASUREMENT
/begin MEASUREMENT GlwCtl_stGlwPwrRedHys_mp "Status der Glühleistungsreduzierung nach der Hysterese" UBYTE OneToOne 1 100 0.00 255.0 FORMAT "%5.1" ECU_ADDRESS 0x802F62 /end MEASUREMENT
/begin MEASUREMENT GlwCtl_stGlwPwrRed_mp "Meßpunkt für Status der Glühleistungsreduzierung" UBYTE OneToOne 1 100 0.00 255.0 FORMAT "%5.1" ECU_ADDRESS 0x802F63 /end MEASUREMENT
/begin MEASUREMENT GlwCtl_stGSKHighPreGlowActive "Status - Vorglühen mit Energieeintrag" UBYTE OneToOne 1 100 0.00 255.0 FORMAT "%5.1" ECU_ADDRESS 0x7F9465 /end MEASUREMENT
/begin MEASUREMENT GlwCtl_stLampOut "Zustand der Glühanzeige" UBYTE OneToOne 1 100 0.00 255.0 FORMAT "%5.1" ECU_ADDRESS 0x7F9468 /end MEASUREMENT
/begin MEASUREMENT GlwCtl_stLogic "aktueller Zustand der Glühzeitsteuerung" UWORD OneToOne 1 100 0.00 65535.00 FORMAT "%8.2" ECU_ADDRESS 0x7F9912 /end MEASUREMENT
/begin MEASUREMENT GlwCtl_stPshDisable_mp "Status der Pushen Freigabe (0:freigegeben, 1: gesperrt (über Temperaturfehler))" UBYTE OneToOne 1 100 0.00 255.0 FORMAT "%5.1" ECU_ADDRESS 0x802F47 /end MEASUREMENT
/begin MEASUREMENT GlwCtl_stPshEna "Status ob aktuell gepusht werden soll (GSK3)" UBYTE OneToOne 1 100 0.00 255.0 FORMAT "%5.1" ECU_ADDRESS 0x7F9469 /end MEASUREMENT
/begin MEASUREMENT GlwCtl_stPshRd "Push information, die vom EEPROM für den aktuellen Fahrzyklus gelesen wurde" UBYTE OneToOne 1 100 0.00 255.0 FORMAT "%5.1" ECU_ADDRESS 0x7F946A /end MEASUREMENT
/begin MEASUREMENT GlwCtl_stPshWr "Push information, die in das EEPROM für den nächsten Fahrzyklus geschrieben wird" UBYTE OneToOne 1 100 0.00 255.0 FORMAT "%5.1" ECU_ADDRESS 0x7F946B /end MEASUREMENT
/begin MEASUREMENT GlwCtl_stRly_mp "Aktivierungsstatus der Glühkerzen" UBYTE OneToOne 1 100 0.00 255.0 FORMAT "%5.1" ECU_ADDRESS 0x802F64 /end MEASUREMENT
/begin MEASUREMENT GlwCtl_stShOff_mp "Abschaltbedingung für Glühkerzen und Glühkontrolllampe" UBYTE OneToOne 1 100 0.00 255.0 FORMAT "%5.1" ECU_ADDRESS 0x802F65 /end MEASUREMENT
/begin MEASUREMENT GlwCtl_stStrtOk_mp "Status ob erster Start beendet" UBYTE OneToOne 1 100 0.00 255.0 FORMAT "%5.1" ECU_ADDRESS 0x802F48 /end MEASUREMENT
/begin MEASUREMENT GlwCtl_stTmr_mp "Status des Glühkerzen Abkühl-Timers (0: gestoppt, 1: läuft)" UBYTE OneToOne 1 100 0.00 255.0 FORMAT "%5.1" ECU_ADDRESS 0x802F49 /end MEASUREMENT
/begin MEASUREMENT GlwCtl_swtEnergPreEna "Freigabe schalter - Vorglühen mit Energieeintrag" UBYTE OneToOne 1 100 0.00 255.0 FORMAT "%5.1" ECU_ADDRESS 0x7F946C /end MEASUREMENT
/begin MEASUREMENT GlwCtl_swtGSKMode "Schalterwert zur Wahl von GSK-Modus" UBYTE OneToOne 1 100 0.00 255.0 FORMAT "%5.1" ECU_ADDRESS 0x7F946D /end MEASUREMENT
/begin MEASUREMENT GlwCtl_swtPreGlow "EEPROM Schalter für Glühkontrolllampenansteuerung" UBYTE OneToOne 1 100 0.00 255.0 FORMAT "%5.1" ECU_ADDRESS 0x7F946E /end MEASUREMENT
/begin MEASUREMENT GlwCtl_tDefVal_mp "Temperaturwert von dem Array Eng_tFld" SWORD Temp_Cels 1 100 -3549.940 3003.560 FORMAT "%8.3" ECU_ADDRESS 0x802F4A /end MEASUREMENT
/begin MEASUREMENT GlwCtl_tEng "Motortemperatur für das Glühsystem" SWORD Temp_Cels 1 100 -3549.940 3003.560 FORMAT "%8.3" ECU_ADDRESS 0x7F9914 /end MEASUREMENT
/begin MEASUREMENT GlwCtl_tEngAdj "Motortemperatur für Glühsystem nach Korrektur über Abgleichwert" SWORD Temp_Cels 1 100 -3549.940 3003.560 FORMAT "%8.3" ECU_ADDRESS 0x7F9916 /end MEASUREMENT
/begin MEASUREMENT GlwCtl_tiLamp_mp "Einschaltdauer Glühanzeige" ULONG GlwCtl_Time_ms 1 100 0.00 429496729500. FORMAT "%13.0" ECU_ADDRESS 0x802F68 /end MEASUREMENT
/begin MEASUREMENT GlwCtl_tiOut1 "GSK3 Vorglühzeit Bereich 1" ULONG GlwCtl_Time_ms 1 100 0.00 429496729500. FORMAT "%13.0" ECU_ADDRESS 0x7F9CD0 /end MEASUREMENT
/begin MEASUREMENT GlwCtl_tiOut_mp "Vorglühzeit für GSK3" ULONG GlwCtl_Time_ms 1 100 0.00 429496729500. FORMAT "%13.0" ECU_ADDRESS 0x802F4C /end MEASUREMENT
/begin MEASUREMENT GlwCtl_tiPost_mp "Vorglühzeit" ULONG GlwCtl_Time_ms 1 100 0.00 429496729500. FORMAT "%13.0" ECU_ADDRESS 0x802F50 /end MEASUREMENT
/begin MEASUREMENT GlwCtl_tiPre "Vorglühzeit" ULONG GlwCtl_Time_ms 1 100 0.00 429496729500. FORMAT "%13.0" ECU_ADDRESS 0x7F9CD4 /end MEASUREMENT
/begin MEASUREMENT GlwCtl_tiPreGlw "Verbleibende Vorglühzeit" UWORD GlwCtl_Time_ms 1 100 0.00 6553500. FORMAT "%8.0" ECU_ADDRESS 0x7F9918 /end MEASUREMENT
/begin MEASUREMENT GlwCtl_tiThresFl1_mp "errechnete Wartezeit für Übergang ""Kein Glühen"" zu ""Warten auf Zwischenglühen""" SWORD Time_ms 1 100 -327680.0 327670.0 FORMAT "%8.1" ECU_ADDRESS 0x802F54 /end MEASUREMENT
/begin MEASUREMENT GlwCtl_tValEEP_mp "Temperaturabgleichwert aus dem EEPROM" SWORD TempDiff_Kelv 1 100 -3276.800 3276.700 FORMAT "%8.3" ECU_ADDRESS 0x802F56 /end MEASUREMENT
/begin MEASUREMENT GlwCtl_wEnergPre_mp "Messpunkt Energie aus dem Kennlinie - GlwCtl_wEnergPre_CUR" UWORD SqrVltg_s 1 100 0.00 6553.500 FORMAT "%8.3" ECU_ADDRESS 0x802F58 /end MEASUREMENT
/begin MEASUREMENT GlwCtl_wIntegEnerg_mp "Messpunkt Energie aus dem Integrator" UWORD SqrVltg_s 1 100 0.00 6553.500 FORMAT "%8.3" ECU_ADDRESS 0x802F5A /end MEASUREMENT
/begin MEASUREMENT HDSCD_prcAir "Prozent der Heizungstemperaturanforderung" SWORD Prc 1 100 -327.6800 327.6700 FORMAT "%8.4" ECU_ADDRESS 0x7F991A /end MEASUREMENT
/begin MEASUREMENT HDSCD_prcAirLin "Prozent der Heizungsanforderungstemperatur linearisiert" SWORD Prc 1 100 -327.6800 327.6700 FORMAT "%8.4" ECU_ADDRESS 0x7F991C /end MEASUREMENT
/begin MEASUREMENT HDSCD_uRaw "Rohwert des HZA-Senorsignals" SWORD Volt 1 100 -160156.4 160151.5 FORMAT "%8.1" ECU_ADDRESS 0x7F991E /end MEASUREMENT
/begin MEASUREMENT HPUn_dvolPmpMaxCor_mp "Wirkungsgrad korrigiertes physikalisches Maximum des Volumenstroms einer Hochdruckpumpe" SWORD Qp_mm3_sec 1 100 -327680.0 327670.0 FORMAT "%8.1" ECU_ADDRESS 0x802F6C /end MEASUREMENT
/begin MEASUREMENT HPUn_dvolPmpMax_mp "Physikalisches Maximum des Volumenstroms einer Hochdruckpumpe" SWORD Qp_mm3_sec 1 100 -327680.0 327670.0 FORMAT "%8.1" ECU_ADDRESS 0x802F6E /end MEASUREMENT
/begin MEASUREMENT HPUn_etaPmpFlTemp_mp "Kraftstofftemperaturabhängiger Wirkungsgrad der Hochdruckpumpe" SWORD Eta 1 100 -256.0000 255.9922 FORMAT "%8.4" ECU_ADDRESS 0x802F70 /end MEASUREMENT
/begin MEASUREMENT HPUn_etaPmpMaxAged_mp "maximaler Wirkungsgrad einer gealterten Hochdruckpumpe" SWORD Eta 1 100 -256.0000 255.9922 FORMAT "%8.4" ECU_ADDRESS 0x802F72 /end MEASUREMENT
/begin MEASUREMENT HPUn_numInjQntBal "Maximale Anzahl an Einspritzungen aufgrund der Mengenbilanz der Hochdruckpumpe" UBYTE OneToOne 1 100 0.00 255.0 FORMAT "%5.1" ECU_ADDRESS 0x7F946F /end MEASUREMENT
/begin MEASUREMENT HPUn_pRailDvtFlt_mp "Gefilterte Raildruck Regelabweichung" SWORD Pres_Rail 1 100 -3276800. 3276700. FORMAT "%8.0" ECU_ADDRESS 0x802F7A /end MEASUREMENT
/begin MEASUREMENT HPUn_qBalLim_mp "Begrenzungsmenge auf Grund der Mengenbilanz der Hochdruckpumpe" SWORD InjMassCyc 1 100 -327.6800 327.6700 FORMAT "%8.4" ECU_ADDRESS 0x802F74 /end MEASUREMENT
/begin MEASUREMENT HPUn_qFlTempLim_mp "Begrenzungsmenge abhängig der Kraftstofftemperatur" SWORD InjMassCyc 1 100 -327.6800 327.6700 FORMAT "%8.4" ECU_ADDRESS 0x802F76 /end MEASUREMENT
/begin MEASUREMENT HPUn_qLim "Begrenzungsmenge der Hochdruckpumpe" SWORD InjMassCyc 1 100 -327.6800 327.6700 FORMAT "%8.4" ECU_ADDRESS 0x7F9920 /end MEASUREMENT
/begin MEASUREMENT HPUn_stNumInjMax_mp "Statusvariable, Mengebilanz der Hochruckpumpe" UBYTE OneToOne 1 100 0.00 255.0 FORMAT "%5.1" ECU_ADDRESS 0x802F7C /end MEASUREMENT
/begin MEASUREMENT HPUn_stQntBal_mp "Status der Mengenbilanz der Hochdruckpumpe" UBYTE OneToOne 1 100 0.00 255.0 FORMAT "%5.1" ECU_ADDRESS 0x802F78 /end MEASUREMENT
/begin MEASUREMENT HPUn_trqDes "Momentenanforderung der Hochdruckpumpe" SWORD Trq 1 100 -3276.800 3276.700 FORMAT "%8.3" ECU_ADDRESS 0x7F9922 /end MEASUREMENT
/begin MEASUREMENT HWEMon_ctRecovery "Anzahl der während 2 Sekunden aufgetretenen Recoverys" UBYTE OneToOne 1 100 0.00 255.0 FORMAT "%5.1" ECU_ADDRESS 0x7F9470 /end MEASUREMENT
/begin MEASUREMENT HWEMon_numRecovery "Herkunft des letzten Reset ( >0 = Recovery )" UWORD OneToOne 1 100 0.00 65535.00 FORMAT "%8.2" ECU_ADDRESS 0x7F9924 /end MEASUREMENT
/begin MEASUREMENT HWEMon_stVoltMon_mp "Latchbetrieb der Überspannungsüberwachung (1 = Latch aktiv)" UBYTE OneToOne 1 100 0.00 255.0 FORMAT "%5.1" ECU_ADDRESS 0x802F7D /end MEASUREMENT
/begin MEASUREMENT IATSCD_swtSig "Signalquelle Schalter ADC/CAN" UBYTE OneToOne 1 100 0.00 255.0 FORMAT "%5.1" ECU_ADDRESS 0x7F9471 /end MEASUREMENT
/begin MEASUREMENT IATSCD_tAir "Ansauglufttemperatur" SWORD Temp_Cels 1 100 -3549.940 3003.560 FORMAT "%8.3" ECU_ADDRESS 0x7F9928 /end MEASUREMENT
/begin MEASUREMENT IATSCD_tAirLin "linearisierter Wert aus HWK vorm Aufruf der Übergangsfunktion" SWORD Temp_Cels 1 100 -3549.940 3003.560 FORMAT "%8.3" ECU_ADDRESS 0x7F992A /end MEASUREMENT
/begin MEASUREMENT IATSCD_uRaw "Lufttemperatur Spannungsrohwert" SWORD Volt 1 100 -160156.4 160151.5 FORMAT "%8.1" ECU_ADDRESS 0x7F992C /end MEASUREMENT
/begin MEASUREMENT IFCD_stOutHWE_mp "Ausgabewert zur Hardware nach der Fehlerbehandlung" SWORD OneToOne 1 100 -32768.00 32767.00 FORMAT "%8.2" ECU_ADDRESS 0x802F7E /end MEASUREMENT
/begin MEASUREMENT IFCtl_stFan "Status der Lüfteranforderung für den Ladeluftkühler" UBYTE OneToOne 1 100 0.00 255.0 FORMAT "%5.1" ECU_ADDRESS 0x7F9472 /end MEASUREMENT
/begin MEASUREMENT IFCtl_stFantAir_mp "Lüfterstatus aufgrund Lufttemperatur" UBYTE OneToOne 1 100 0.00 255.0 FORMAT "%5.1" ECU_ADDRESS 0x802F80 /end MEASUREMENT
/begin MEASUREMENT IFCtl_stFantClnt_mp "Lüfterstatus aufgrund Kühlmitteltemperatur" UBYTE OneToOne 1 100 0.00 255.0 FORMAT "%5.1" ECU_ADDRESS 0x802F81 /end MEASUREMENT
/begin MEASUREMENT IgnLck_st "Abschaltanforderungen für Immobilizer/Wegfahrsperre" UBYTE OneToOne 1 100 0.00 255.0 FORMAT "%5.1" ECU_ADDRESS 0x7F9476 /end MEASUREMENT
/begin MEASUREMENT ImmCtl_ctImmo2_mp "Zaehler 2 fuer Wegfahrsperre" UBYTE OneToOne 1 100 0.00 255.0 FORMAT "%5.1" ECU_ADDRESS 0x802F84 /end MEASUREMENT
/begin MEASUREMENT ImmCtl_dRndNr_mp "Zufallszahl, berechnet vom MSG" ULONG OneToOne 1 100 0.00 4294967295.00 FORMAT "%13.2" ECU_ADDRESS 0x802F88 /end MEASUREMENT
/begin MEASUREMENT ImmCtl_lrnRndNr "Zufallszahl" ULONG OneToOne 1 100 0.00 4294967295.00 FORMAT "%13.2" ECU_ADDRESS 0x7F9CD8 /end MEASUREMENT
/begin MEASUREMENT ImmCtl_stAftRunRdy "Nachlauf für Wegfahrsperre fertig" UBYTE OneToOne 1 100 0.00 255.0 FORMAT "%5.1" ECU_ADDRESS 0x7F9477 /end MEASUREMENT
/begin MEASUREMENT ImmCtl_StateImmCtl_mp "Wegfahrsperre - Status Lern-state-machine" UBYTE OneToOne 1 100 0.00 255.0 FORMAT "%5.1" ECU_ADDRESS 0x802F8C /end MEASUREMENT
/begin MEASUREMENT ImmCtl_stCom "Kommunikationsstatus der Wegfahrsperre" UBYTE OneToOne 1 100 0.00 255.0 FORMAT "%5.1" ECU_ADDRESS 0x7F9478 /end MEASUREMENT
/begin MEASUREMENT ImmCtl_stImmo "Status der Wegfahrsperre" UBYTE OneToOne 1 100 0.00 255.0 FORMAT "%5.1" ECU_ADDRESS 0x7F9479 /end MEASUREMENT
/begin MEASUREMENT ImmCtl_stOnOff "Status der Wegfahrsperre (Aktiv/Inaktiv)" UBYTE OneToOne 1 100 0.00 255.0 FORMAT "%5.1" ECU_ADDRESS 0x7F947A /end MEASUREMENT
/begin MEASUREMENT ImmCtl_stProcess "Prozessinformation der Wegfahrsperre" UWORD OneToOne 1 100 0.00 65535.00 FORMAT "%8.2" ECU_ADDRESS 0x7F993E /end MEASUREMENT
/begin MEASUREMENT ImmCtl_stStartEnable "Motorstart erlaubt" UBYTE OneToOne 1 100 0.00 255.0 FORMAT "%5.1" ECU_ADDRESS 0x7F947B /end MEASUREMENT
/begin MEASUREMENT ImmCtl_stVersion "Wegfahrsperrengeneration -> 1 = WFS4; 0 = WFS3" UBYTE OneToOne 1 100 0.00 255.0 FORMAT "%5.1" ECU_ADDRESS 0x7F947C /end MEASUREMENT
/begin MEASUREMENT ImmCtl_tiLockCount "Sperrzeit vom Combi-Instrument" UBYTE OneToOne 1 100 0.00 255.0 FORMAT "%5.1" ECU_ADDRESS 0x7F947D /end MEASUREMENT
/begin MEASUREMENT IndSys_pAdj "Ansaugluftdruck-Abgleichwert Berechnung" SWORD Pres_hPa 1 100 -32768.00 32767.00 FORMAT "%8.2" ECU_ADDRESS 0x7F9940 /end MEASUREMENT
/begin MEASUREMENT IndSys_pAdjDiff "Abgleichdruckdifferenz" SWORD Pres_hPa 1 100 -32768.00 32767.00 FORMAT "%8.2" ECU_ADDRESS 0x7F9942 /end MEASUREMENT
/begin MEASUREMENT IndSys_pAdjDiff_mp "Begrenzte Druckdifferenz zwischen Lade -und Atmosphärendruck" SWORD Pres_hPa 1 100 -32768.00 32767.00 FORMAT "%8.2" ECU_ADDRESS 0x802FA0 /end MEASUREMENT
/begin MEASUREMENT IndSys_pAdjNew "Interne Speichergröße für neuen Abgleichwert" SWORD Pres_hPa 1 100 -32768.00 32767.00 FORMAT "%8.2" ECU_ADDRESS 0x7F9944 /end MEASUREMENT
/begin MEASUREMENT IndSys_pDiffHigh_mp "Druckdifferenz obere Schwelle zwischen Lade -und Atmosphärendruck" SWORD Pres_hPa 1 100 -32768.00 32767.00 FORMAT "%8.2" ECU_ADDRESS 0x802F98 /end MEASUREMENT
/begin MEASUREMENT IndSys_pDiffLow_mp "Druckdifferenz untere Schwelle zwischen Lade -und Atmosphärendruck" SWORD Pres_hPa 1 100 -32768.00 32767.00 FORMAT "%8.2" ECU_ADDRESS 0x802F9A /end MEASUREMENT
/begin MEASUREMENT IndSys_pDiff_mp "Ansaugluftdruck nachdem der Atmosphären und der Abgleichdruck vom Ladedruck subtrahiert wurden" SWORD Pres_hPa 1 100 -32768.00 32767.00 FORMAT "%8.2" ECU_ADDRESS 0x802F9C /end MEASUREMENT
/begin MEASUREMENT IndSys_rAPCorVSA_mp "Luftdruckkorrekturwert des Drallniveaus" SWORD DtyCyc 1 100 -327.6800 327.6700 FORMAT "%8.4" ECU_ADDRESS 0x802F8E /end MEASUREMENT
/begin MEASUREMENT IndSys_rVSA "Sollposition für Einlaßkanalabschaltung" SWORD DtyCyc 1 100 -327.6800 327.6700 FORMAT "%8.4" ECU_ADDRESS 0x7F9946 /end MEASUREMENT
/begin MEASUREMENT IndSys_rVSABefHys_mp "Drallniveau" SWORD DtyCyc 1 100 -327.6800 327.6700 FORMAT "%8.4" ECU_ADDRESS 0x802F90 /end MEASUREMENT
/begin MEASUREMENT IndSys_rVSAByp_mp "Bypass-Label, Kopie von IndSys_rVSA" SWORD DtyCyc 1 100 -327.6800 327.6700 FORMAT "%8.4" ECU_ADDRESS 0x802F92 /end MEASUREMENT
/begin MEASUREMENT IndSys_rVSACorBefHys_mp "Drallniveau nach Korrektur durch Akustikerweiterung" SWORD DtyCyc 1 100 -327.6800 327.6700 FORMAT "%8.4" ECU_ADDRESS 0x802F94 /end MEASUREMENT
/begin MEASUREMENT IndSys_rWtTempCorVSA_mp "Wassertemperaturkorrekturwert des Drallniveaus" SWORD DtyCyc 1 100 -327.6800 327.6700 FORMAT "%8.4" ECU_ADDRESS 0x802F96 /end MEASUREMENT
/begin MEASUREMENT IndSys_stAdj "Zustandsgröße die den Status des Abgleichs anzeigt" UBYTE OneToOne 1 100 0.00 255.0 FORMAT "%5.1" ECU_ADDRESS 0x7F947E /end MEASUREMENT
/begin MEASUREMENT IndSys_stAdjEna_mp "Status ob Abgleich möglich" UBYTE OneToOne 1 100 0.00 255.0 FORMAT "%5.1" ECU_ADDRESS 0x802FA2 /end MEASUREMENT
/begin MEASUREMENT IndSys_stBPLoDetActv "Unterdruckstatus im Ansaugkrümmer 1: Unterdruck erkannt  0: kein Unterdruck" UBYTE OneToOne 1 100 0.00 255.0 FORMAT "%5.1" ECU_ADDRESS 0x7F947F /end MEASUREMENT
/begin MEASUREMENT IndSys_stOldNewAdjVal_mp "Status ob der aktuelle oder der Abgleichwert vom EEPROM verwendet wird" UBYTE OneToOne 1 100 0.00 255.0 FORMAT "%5.1" ECU_ADDRESS 0x802FA3 /end MEASUREMENT
/begin MEASUREMENT IndSys_stPDiffSrcSel_mp "Quelle der Druckdifferenz" UBYTE OneToOne 1 100 0.00 255.0 FORMAT "%5.1" ECU_ADDRESS 0x802FA4 /end MEASUREMENT
/begin MEASUREMENT IndSys_stRead_mp "Zustand des Lesens vom EEPROM Wert für IndSys_pAdj" SWORD OneToOne 1 100 -32768.00 32767.00 FORMAT "%8.2" ECU_ADDRESS 0x802FA6 /end MEASUREMENT
/begin MEASUREMENT IndSys_stVacRaw_mp "Roher Unterdruck-Status nach Entprellung" UBYTE OneToOne 1 100 0.00 255.0 FORMAT "%5.1" ECU_ADDRESS 0x802F9E /end MEASUREMENT
/begin MEASUREMENT IndSys_stWrite_mp "Zustand des Schreibens vom Wert IndSys_pAdj in das EEPROM" SWORD OneToOne 1 100 -32768.00 32767.00 FORMAT "%8.2" ECU_ADDRESS 0x802FA8 /end MEASUREMENT
/begin MEASUREMENT IndSys_swtVacMonOn "Unterdruck Überwachung erlaubt (0) , nicht erlaubt (1)" UBYTE OneToOne 1 100 0.00 255.0 FORMAT "%5.1" ECU_ADDRESS 0x7F9480 /end MEASUREMENT
/begin MEASUREMENT InjCrv_numInjDes_mp "gewünschte Anzahl an Einspritzungen pro Arbeitsspiel" UBYTE OneToOne 1 100 0.00 255.0 FORMAT "%5.1" ECU_ADDRESS 0x802FAA /end MEASUREMENT
/begin MEASUREMENT InjCrv_numInjLim_mp "Erlaubte Anzahl an Einspritzungen" UBYTE OneToOne 1 100 0.00 255.0 FORMAT "%5.1" ECU_ADDRESS 0x802FAB /end MEASUREMENT
/begin MEASUREMENT InjCrv_numInjMaxSys "Systembedingte maximal erlaubte Anzahl an Einspritzungen" UBYTE OneToOne 1 100 0.00 255.0 FORMAT "%5.1" ECU_ADDRESS 0x7F9481 /end MEASUREMENT
/begin MEASUREMENT InjCrv_PoI2RgnVal "Aktivierungswert für die Freigabe der PoI2 über das Abgasnachbehandlungssystem" ULONG EGTSwt 1 100 0.00 262.143999939 FORMAT "%13.9" ECU_ADDRESS 0x7F9CE0 /end MEASUREMENT
/begin MEASUREMENT InjCrv_qLmbdCtl "Lambdakontrollmenge" SWORD InjMassCyc 1 100 -327.6800 327.6700 FORMAT "%8.4" ECU_ADDRESS 0x7F99B0 /end MEASUREMENT
/begin MEASUREMENT InjCrv_qTot "Gesamteinspritzmenge" SWORD InjMassCyc 1 100 -327.6800 327.6700 FORMAT "%8.4" ECU_ADDRESS 0x7F99DA /end MEASUREMENT
/begin MEASUREMENT InjCrv_stGear_mp "Messpunkt fuer aktuelle Ganginformation, eingefroren waehrend Schaltvorgang" SWORD OneToOne 1 100 -32768.00 32767.00 FORMAT "%8.2" ECU_ADDRESS 0x802FAC /end MEASUREMENT
/begin MEASUREMENT InjCrv_stInjCharActVal "Einspritzverlauf aktueller Wert" UBYTE OneToOne 1 100 0.00 255.0 FORMAT "%5.1" ECU_ADDRESS 0x7F9482 /end MEASUREMENT
/begin MEASUREMENT InjCrv_stInjCharDes_mp "Wunscheinspritzverlauf" UBYTE OneToOne 1 100 0.00 255.0 FORMAT "%5.1" ECU_ADDRESS 0x802FAE /end MEASUREMENT
/begin MEASUREMENT InjCrv_stInjCharPrio "Prioritätenstatus zur Abschaltung der Einspritzung" ULONG OneToOne 1 100 0.00 4294967295.00 FORMAT "%13.2" ECU_ADDRESS 0x7F9CE4 /end MEASUREMENT
/begin MEASUREMENT InjCrv_stInjCharSetVal "Einspritzverlauf Sollwert (drehzahlsynchron)" UBYTE OneToOne 1 100 0.00 255.0 FORMAT "%5.1" ECU_ADDRESS 0x7F9483 /end MEASUREMENT
/begin MEASUREMENT InjCrv_stInjCharSetVal_mp "Messpunkt vor dem Ascet Freischnitt" UBYTE OneToOne 1 100 0.00 255.0 FORMAT "%5.1" ECU_ADDRESS 0x802FAF /end MEASUREMENT
/begin MEASUREMENT InjCrv_stLmbdCtl "Freigabestatus Lambdakontrollmenge" UBYTE OneToOne 1 100 0.00 255.0 FORMAT "%5.1" ECU_ADDRESS 0x7F9484 /end MEASUREMENT
/begin MEASUREMENT InjCrv_stPiIRlsOpRng_mp "aktueller Betriebsbereich für die Freigabe der Voreinspritzungen" SWORD OneToOne 1 100 -32768.00 32767.00 FORMAT "%8.2" ECU_ADDRESS 0x802FB0 /end MEASUREMENT
/begin MEASUREMENT InjCrv_stPiIRlsStruct_mp "Freigabestruktur der Voreinspritzungen" SWORD OneToOne 1 100 -32768.00 32767.00 FORMAT "%8.2" ECU_ADDRESS 0x802FB2 /end MEASUREMENT
/begin MEASUREMENT InjCrv_stRlsGear_mp "Messpunkt fuer Freigabekennlinienauswahl" SWORD OneToOne 1 100 -32768.00 32767.00 FORMAT "%8.2" ECU_ADDRESS 0x802FB4 /end MEASUREMENT
/begin MEASUREMENT InjCrv_tEng "selektierte Motortemperatur für das Einspritzsystem" SWORD Temp_Cels 1 100 -3549.940 3003.560 FORMAT "%8.3" ECU_ADDRESS 0x7F99DC /end MEASUREMENT
/begin FUNCTION frmmng_var_msg ""
 /begin OUT_MEASUREMENT FrmMng_aBRK2Trnvrs FrmMng_dTOSMsgCnt FrmMng_dtrqTSCLim FrmMng_lDIA1km FrmMng_nDesAST FrmMng_nMin FrmMng_pAC FrmMng_pwrBEMAlt FrmMng_rSlpRes FrmMng_rTransConv FrmMng_rtrqACCDes FrmMng_stACC FrmMng_stACCaccel FrmMng_stACCBrk FrmMng_stAIRBG FrmMng_stAIRBGTst FrmMng_stAST FrmMng_stBEMAOHt FrmMng_stBEMLIDem FrmMng_stBRK2Trnvrs FrmMng_stBRK8ACCMsg FrmMng_stCANVer FrmMng_stCANVerCCtl FrmMng_stCCDisable FrmMng_stConvErr FrmMng_stCrErr FrmMng_stCrPan FrmMng_stDCS FrmMng_stDIA1Invalid FrmMng_stDIA1kmOld FrmMng_stDIA1TimeOld FrmMng_stEngFlxSync FrmMng_stEngOff FrmMng_stEPBAct FrmMng_stESCU FrmMng_stESPSysErr FrmMng_stFanOn FrmMng_stFlQtyWrng FrmMng_stGear FrmMng_stGearLever FrmMng_stGW1 FrmMng_stGW1Wiper FrmMng_stGWSlpAck FrmMng_stIgn FrmMng_stLFRAdp FrmMng_stMIL FrmMng_stMsgErrAC1 FrmMng_stMsgErrACC FrmMng_stMsgErrAIRBG FrmMng_stMsgErrAWD1 FrmMng_stMsgErrBEM1 FrmMng_stMsgErrBRK1 FrmMng_stMsgErrBRK2 FrmMng_stMsgErrBRK8 FrmMng_stMsgErrCCTL FrmMng_stMsgErrDIA1 FrmMng_stMsgErrDSP1 FrmMng_stMsgErrDSP2 FrmMng_stMsgErrESCU FrmMng_stMsgErrGW1 FrmMng_stMsgErrNIVEAU1 FrmMng_stMsgErrStIgn FrmMng_stMsgErrTOS FrmMng_stMsgErrTSC1 FrmMng_stMsgErrTSC2 FrmMng_stMsgErrTSC3 FrmMng_stNIVEAU1 FrmMng_stOilWrnThres FrmMng_stPlsPanErr FrmMng_stPreGlwLamp FrmMng_stSendACC FrmMng_stSendEng6_B1 FrmMng_stSendEng6_B2 FrmMng_stSendEng6_B3 FrmMng_stSendEng6_B4 FrmMng_stSendEng6_B5 FrmMng_stSendEng6_B6 FrmMng_stSendEng6_B7 FrmMng_stSendEng6_B8 FrmMng_stSendEngTrq1_B1 FrmMng_stSendEngTrq1_B2 FrmMng_stSendEngTrq1_B3 FrmMng_stSendEngTrq1_B4 FrmMng_stSendEngTrq1_B5 FrmMng_stSendEngTrq1_B6 FrmMng_stSendEngTrq1_B7 FrmMng_stSendEngTrq1_B8 FrmMng_stSendEngTrq2_B1 FrmMng_stSendEngTrq2_B2 FrmMng_stSendEngTrq2_B3 FrmMng_stSendEngTrq2_B4 FrmMng_stSendEngTrq2_B5 FrmMng_stSendEngTrq2_B6 FrmMng_stSendEngTrq2_B7 FrmMng_stSendEngTrq2_B8 FrmMng_stSendEngTrq3_B1 FrmMng_stSendEngTrq3_B2 FrmMng_stSendEngTrq3_B3 FrmMng_stSendEngTrq3_B4 FrmMng_stSendEngTrq3_B5 FrmMng_stSendEngTrq3_B6 FrmMng_stSendEngTrq3_B7 FrmMng_stSendEngTrq3_B8 FrmMng_stSvLpErr FrmMng_stTCS FrmMng_stTOSSensErr FrmMng_stTSC FrmMng_stTSC3 FrmMng_stTSC3Trgt FrmMng_swtTSC3Type FrmMng_tiDesAST FrmMng_tiDIA1Date FrmMng_tiDIA1Time FrmMng_tiTOSFillLvl1 FrmMng_tiTOSFillLvl2 FrmMng_tiTOSFillLvl3 FrmMng_tiTOSFillLvl4 FrmMng_tiTOSOilT FrmMng_trqACCDes FrmMng_trqACCompr FrmMng_trqConvLoss FrmMng_trqDCS FrmMng_trqDCSraw FrmMng_trqFrc FrmMng_trqInrDCS FrmMng_trqInrEngNoExtDem FrmMng_trqInrTCS FrmMng_trqInrTSC FrmMng_trqTCS FrmMng_trqTCSraw FrmMng_trqTSC FrmMng_trqTSC3 FrmMng_trqTSC3Inr FrmMng_trqTSC3Trgt FrmMng_vDspl1 FrmMng_vGS FrmMng_volFuelFil /end OUT_MEASUREMENT
/end FUNCTION
/begin FUNCTION ftscd "Kraftstofftemperatur Komponententreiber"
 /begin DEF_CHARACTERISTIC FTSCD_uSRCMin_C FTSCD_uSRCMax_C FTSCD_tLin_CUR FTSCD_DebNplDef_C FTSCD_DebNplOk_C FTSCD_DebSigDef_C FTSCD_DebSigOk_C FTSCD_DebSRCHighDef_C FTSCD_DebSRCHighOk_C FTSCD_DebSRCLowDef_C FTSCD_DebSRCLowOk_C FTSCD_dtRmpSlpUp_C FTSCD_dtRmpSlpDwn_C FTSCD_stPRDY_C FTSCD_tDiff_C FTSCD_tImn_C FTSCD_tInt_C FTSCD_tiTmn_C FTSCD_tiT_C FTSCD_stSensIDWord_C FTSCD_tDfl_C /end DEF_CHARACTERISTIC
 /begin IN_MEASUREMENT FTSCD_uRaw /end IN_MEASUREMENT
/end FUNCTION
/begin FUNCTION ftscd_msg ""
 /begin OUT_MEASUREMENT FTSCD_stPlausibilityTest FTSCD_tDiffAbsCARB FTSCD_tDiffMinCARB FTSCD_tFuel FTSCD_tFuelLin FTSCD_tiMaxCARB FTSCD_tInt FTSCD_tIntCARB FTSCD_tIntMinCARB FTSCD_tiTestCARB FTSCD_tiTestDuration FTSCD_uRaw /end OUT_MEASUREMENT
/end FUNCTION
/begin FUNCTION ftscd_uic ""
 /begin OUT_MEASUREMENT FTSCD_tDiffAbs_mp FTSCD_tDiff_mp FTSCD_tiEngOn_mp FTSCD_tImn_mp FTSCD_tInt_Carb_mp FTSCD_tiTmn_mp /end OUT_MEASUREMENT
/end FUNCTION
/begin FUNCTION gearbx_data "Getriebeinformation"
 /begin DEF_CHARACTERISTIC Gearbx_swtTypeStr_C Gearbx_swtTypeVal_C Gearbx_swtTypeType_C /end DEF_CHARACTERISTIC
/end FUNCTION
/begin FUNCTION gearbx_data_uic "" /end FUNCTION
/begin FUNCTION gearbx_geardet "Gangerkennung"
 /begin DEF_CHARACTERISTIC Gearbx_tiDebGearbxMTErrDef_C Gearbx_tiDebGearbxMTErrOk_C Gearbx_rAWDLo_C Gearbx_rTrans1_C Gearbx_rTrans2_C Gearbx_rTrans3_C Gearbx_rTrans4_C Gearbx_rTrans5_C Gearbx_rTrans6_C Gearbx_rTransR_C Gearbx_rVn1H_C Gearbx_rVn1L_C Gearbx_rVn2H_C Gearbx_rVn2L_C Gearbx_rVn3H_C Gearbx_rVn3L_C Gearbx_rVn4H_C Gearbx_rVn4L_C Gearbx_rVn5H_C Gearbx_rVn5L_C Gearbx_rVn6H_C Gearbx_rVn6L_C Gearbx_rVnRH_C Gearbx_rVnRL_C /end DEF_CHARACTERISTIC
/end FUNCTION
/begin FUNCTION gearbx_geardet_uic "" /begin OUT_MEASUREMENT Gearbx_rVnAWDLow_mp /end OUT_MEASUREMENT /end FUNCTION
/begin FUNCTION gearbx_msg ""
 /begin OUT_MEASUREMENT Gearbx_numGearFast Gearbx_rTrans Gearbx_stAWDAct Gearbx_stDetType Gearbx_stGear Gearbx_stParGear Gearbx_swtType Gearbx_trqFrc Gearbx_trqInMax /end OUT_MEASUREMENT
/end FUNCTION
/begin FUNCTION gearbx_trqfrc "aktuelles Verlustmoment Getriebe" /end FUNCTION
/begin FUNCTION gearbx_trqfrc_uic "" /end FUNCTION
/begin FUNCTION gearbx_trqintv "Getriebeeingriff auf Motormoment"
 /begin DEF_CHARACTERISTIC Gearbx_amASTMax_C Gearbx_ASTCtlPKp_C Gearbx_ASTCtlPKpPos_C Gearbx_ASTCtlPKpNeg_C Gearbx_ASTCtlPWinPos_C Gearbx_ASTCtlPWinNeg_C Gearbx_dtrqRmpSlpUpAST_C Gearbx_dtrqRmpSlpDwnAST_C Gearbx_dtrqRmpSlpUpTSC_C Gearbx_dtrqRmpSlpDwnTSC_C Gearbx_itrqMot_C Gearbx_nASTMax_C Gearbx_nASTMin_C Gearbx_stTSCLim_C Gearbx_swtASTFrc_C Gearbx_swtASTPreCtl_C Gearbx_swtAST_C Gearbx_swtDemtypeVal_C Gearbx_swtDemtypeType_C Gearbx_swtRotMass_C Gearbx_tiASThighDefect_C Gearbx_tiASThighOK_C Gearbx_tiASTlowDefect_C Gearbx_tiASTlowOK_C Gearbx_tiTSChighDefect_C Gearbx_tiTSChighOK_C Gearbx_tiStepTSC_C Gearbx_tiTSC_C Gearbx_trqASTM2_C Gearbx_trqASTMax_C Gearbx_trqASTToG_C Gearbx_trqFrcMin_C Gearbx_trqMoveOFF_CUR Gearbx_trqToB_C Gearbx_vASTMin_C Gearbx_vThres_C /end DEF_CHARACTERISTIC
 /begin IN_MEASUREMENT Eng_nAvrg /end IN_MEASUREMENT
/end FUNCTION
/begin FUNCTION gearbx_trqintv_msg ""
 /begin OUT_MEASUREMENT Gearbx_rIncFree Gearbx_stAST Gearbx_stTSC Gearbx_swtDemtype Gearbx_trqDec Gearbx_trqInc Gearbx_trqNoExtLiLtd /end OUT_MEASUREMENT
/end FUNCTION
/begin FUNCTION gearbx_trqintv_uic ""
 /begin OUT_MEASUREMENT Gearbx_amASTAKT_mp Gearbx_amIncFree_mp Gearbx_nASTSyncStepInr_mp Gearbx_nASTSyncStep_mp Gearbx_nASTSyntmp_mp Gearbx_nSyncPrcAST_mp Gearbx_nSyncTmp_mp Gearbx_nSynGovDev_mp Gearbx_stASTLim_mp Gearbx_stTSCErr_mp Gearbx_swtASTFrc_mp Gearbx_tiTSCINT_mp Gearbx_trqASTMax_mp Gearbx_trqASTMon_mp Gearbx_trqAST_mp Gearbx_trqCluNoExtDem_mp Gearbx_trqExtAST_mp Gearbx_trqNetTSC3_mp Gearbx_trqNoExtDem_mp Gearbx_trqPGvnrOut_mp Gearbx_trqPreCtlLtd_mp Gearbx_trqPreCtlOp_mp Gearbx_trqPreCtl_mp Gearbx_trqRotMass_mp Gearbx_trqSprTSC_mp Gearbx_trqTSCAftSpr_mp /end OUT_MEASUREMENT
/end FUNCTION
/begin FUNCTION gearbx_trqlim "Getriebeschutz"
 /begin DEF_CHARACTERISTIC Gearbx_tiCANerrHold_C Gearbx_tiCANerrRmp_C Gearbx_trqCANerrMax_C Gearbx_trqCANerrMax_MAP Gearbx_trqInMax_C Gearbx_trqMaxGear1_CUR Gearbx_trqMaxGear2_CUR Gearbx_trqMaxGear3_CUR Gearbx_trqMaxGear4_CUR Gearbx_trqMaxGear5_CUR Gearbx_trqMaxGear6_CUR Gearbx_trqMaxGearR_CUR /end DEF_CHARACTERISTIC
 /begin IN_MEASUREMENT Eng_nAvrg VSSCD_v /end IN_MEASUREMENT
/end FUNCTION
/begin FUNCTION gearbx_trqlim_uic "" /begin DEF_CHARACTERISTIC Gearbx_trqInMax_Vector Gearbx_trqInMax_Channel /end DEF_CHARACTERISTIC
 /begin OUT_MEASUREMENT Gearbx_dtrqCANerr_mp Gearbx_stCond1_mp Gearbx_stCond2_mp Gearbx_stRamping_mp Gearbx_stTrqLim_mp Gearbx_stTSC3MaxLim_mp Gearbx_tiHoldTmr_mp Gearbx_trqCANerrMax_mp Gearbx_trqInMax_mp Gearbx_trqMaxCur_mp Gearbx_trqTSC3Max_mp /end OUT_MEASUREMENT
/end FUNCTION
/begin FUNCTION glwcd "Komponententreiber Glühanlage"
 /begin DEF_CHARACTERISTIC GlwCD_ActrDebExcTempDef_C GlwCD_ActrDebExcTempOk_C GlwCD_ActrDebNoLoadDef_C GlwCD_ActrDebNoLoadOk_C GlwCD_ActrDebShortCircBatDef_C GlwCD_ActrDebShortCircBatOk_C GlwCD_ActrDebShortCircGndDef_C GlwCD_ActrDebShortCircGndOk_C GlwCD_CntEepWrtAtm_C GlwCD_Cod2of3DebPlaDef_C GlwCD_Cod2of3DebPlaOk_C GlwCD_Cod3diffDebPlaDef_C GlwCD_Cod3diffDebPlaOk_C GlwCD_ctsyncmin_C GlwCD_ctTimeOutInit_C GlwCD_ctTimeOutReload_C GlwCD_DebExcTempDef_C GlwCD_DebExcTempOk_C GlwCD_DebNoLoadDef_C GlwCD_DebNoLoadOk_C GlwCD_DebShortCircBatDef_C GlwCD_DebShortCircBatOk_C GlwCD_DebShortCircGndDef_C GlwCD_DebShortCircGndOk_C GlwCD_tiDigInDebNeg_C GlwCD_tiDigInDebPos_C GlwCD_GSK3DiagDebPlaDef_C GlwCD_GSK3DiagDebPlaOk_C GlwCD_GSK3Error1DebPlaDef_C GlwCD_GSK3Error1DebPlaOk_C GlwCD_GSK3Error2DebPlaDef_C GlwCD_GSK3Error2DebPlaOk_C GlwCD_GSK3Plug0DebPlaDef_C GlwCD_GSK3Plug0DebPlaOk_C GlwCD_GSK3Plug1DebPlaDef_C GlwCD_GSK3Plug1DebPlaOk_C GlwCD_GSK3Plug2DebPlaDef_C GlwCD_GSK3Plug2DebPlaOk_C GlwCD_GSK3Plug3DebPlaDef_C GlwCD_GSK3Plug3DebPlaOk_C GlwCD_GSK3Plug4DebPlaDef_C GlwCD_GSK3Plug4DebPlaOk_C GlwCD_GSK3Plug5DebPlaDef_C GlwCD_GSK3Plug5DebPlaOk_C GlwCD_LampCanDebNplDef_C GlwCD_LampCanDebNplOk_C GlwCD_LampDebExcTempDef_C GlwCD_LampDebExcTempOk_C GlwCD_LampDebNoLoadDef_C GlwCD_LampDebNoLoadOk_C GlwCD_LampDebShortCircBatDef_C GlwCD_LampDebShortCircBatOk_C GlwCD_LampDebShortCircGndDef_C GlwCD_LampDebShortCircGndOk_C GlwCD_numStepDef_C GlwCD_numStepOK_C GlwCD_stInvOut_C GlwCD_tiPer_C GlwCD_rGSKCode_C GlwCD_rGSKHighPreGlow_C GlwCD_rGSKmax_C GlwCD_rGSKmin_C GlwCD_rGSKtst_C GlwCD_rTst_C GlwCD_stActrInvOut_C GlwCD_stDigInvIn_C GlwCD_stGlwUnType_C GlwCD_stLampInvOut_C GlwCD_stPwrStgActrActv_C GlwCD_stPwrStgActrDia_C GlwCD_stPwrStgLampActv_C GlwCD_stPwrStgLampDia_C GlwCD_swtDigInPresent_C GlwCD_swtLampCan_C GlwCD_swtVarSfd_C GlwCD_tiBtwTst_C GlwCD_tiMaxDef_C GlwCD_tiMaxOk_C GlwCD_tiMinDef_C GlwCD_tiMinOk_C GlwCD_tiDelay_C GlwCD_tiGlwCDOFFTmr_C GlwCD_tiGlwcheckDfpTmr_C GlwCD_uDfl_C GlwCD_uPush_C /end DEF_CHARACTERISTIC
/end FUNCTION
/begin FUNCTION glwcd_msg ""
 /begin OUT_MEASUREMENT GlwCD_rGSK GlwCD_stCodeRdy GlwCD_stDebVal GlwCD_stGSK3 GlwCD_stPwrStg GlwCD_stRawVal /end OUT_MEASUREMENT
/end FUNCTION
/begin FUNCTION glwcd_uic ""
 /begin OUT_MEASUREMENT GlwCD_Codwbuffer_mp GlwCD_rHWELampOut_mp GlwCD_stActrRun_mp GlwCD_stDiag_mp GlwCD_stDigInRun_mp GlwCD_stLampRun_mp GlwCD_stLogVal_mp GlwCD_stOutHWE_mp GlwCD_stValueOK_mp /end OUT_MEASUREMENT
/end FUNCTION
/begin FUNCTION glwctl_logic "Glühzeitkontrolle"
 /begin DEF_CHARACTERISTIC GlwCtl_nPost_C GlwCtl_nPre_C GlwCtl_nReady_C GlwCtl_nThresGSK3_C GlwCtl_qPost_CUR GlwCtl_qThresFlQty_C GlwCtl_qThresFl_C GlwCtl_swtEnergPreEnaVal_C GlwCtl_swtGSKModeVal_C GlwCtl_swtGSKModeType_C GlwCtl_swtPshDisable_C GlwCtl_swtSpareStrtEn_C GlwCtl_swtTempDef_C GlwCtl_swtVarBatt_C GlwCtl_tAdjMax_C GlwCtl_tAdjMin_C GlwCtl_tAdjVal_C GlwCtl_tDflEng_C GlwCtl_tiChk_C GlwCtl_tiClgHigh_C GlwCtl_tiClgLow_C GlwCtl_tiDebPre_C GlwCtl_tiDebT50_C GlwCtl_tiDel_C GlwCtl_tiGlowMax_C GlwCtl_tiOut1_CUR GlwCtl_tiPost_CUR GlwCtl_tiPre1_MAP GlwCtl_tiPre2_MAP GlwCtl_tiReady_C GlwCtl_tiSpareStrtDel_C GlwCtl_tiStrt_C GlwCtl_tiThresFl1_CUR GlwCtl_tiThresFl2_C GlwCtl_tiThresFl3_C GlwCtl_tStrt_C GlwCtl_tThresSwttiClg_C GlwCtl_wEnergPreMax_C GlwCtl_wEnergPre_CUR /end DEF_CHARACTERISTIC
 /begin IN_MEASUREMENT APSCD_pVal BattCD_u GlwCtl_tEng GlwCtl_tEngAdj IATSCD_tAir /end IN_MEASUREMENT
/end FUNCTION
/begin FUNCTION glwctl_logic_msg ""
 /begin OUT_MEASUREMENT GlwCtl_stAftRunDelDem GlwCtl_stGlwBitEco GlwCtl_stGSKHighPreGlowActive GlwCtl_stLogic GlwCtl_stPshEna GlwCtl_stPshRd GlwCtl_stPshWr GlwCtl_swtEnergPreEna GlwCtl_swtGSKMode GlwCtl_tEng GlwCtl_tEngAdj GlwCtl_tiOut1 GlwCtl_tiPre GlwCtl_tiPreGlw /end OUT_MEASUREMENT
/end FUNCTION
/begin FUNCTION glwctl_logic_uic ""
 /begin OUT_MEASUREMENT GlwCtl_qPost_mp GlwCtl_stAllw_mp GlwCtl_stPshDisable_mp GlwCtl_stStrtOk_mp GlwCtl_stTmr_mp GlwCtl_tDefVal_mp GlwCtl_tiOut_mp GlwCtl_tiPost_mp GlwCtl_tiThresFl1_mp GlwCtl_tValEEP_mp GlwCtl_wEnergPre_mp GlwCtl_wIntegEnerg_mp /end OUT_MEASUREMENT
/end FUNCTION
/begin FUNCTION glwctl_rly "Steuerung für Glührelais"
 /begin DEF_CHARACTERISTIC GlwCtl_facGlwPwrRed_MAP GlwCtl_rOut1_C GlwCtl_rOut2_C GlwCtl_rOut3_C GlwCtl_rOut_MAP GlwCtl_rStrt_C GlwCtl_uXLow_C GlwCtl_uXHigh_C GlwCtl_YLow_C GlwCtl_YHigh_C GlwCtl_swtPreGlowVal_C GlwCtl_swtPreGlowType_C GlwCtl_swtRatStrt_C GlwCtl_tiDebPwrRed_C GlwCtl_tiOut2_C GlwCtl_tiPreGlowPsh_CUR GlwCtl_tiPreGlow_CUR GlwCtl_uThresHighGSK3_C GlwCtl_uThresLowGSK3_C /end DEF_CHARACTERISTIC
 /begin IN_MEASUREMENT Eng_nAvrg GlwCtl_tEng InjCtl_qAct InjCtl_qCurr /end IN_MEASUREMENT
/end FUNCTION
/begin FUNCTION glwctl_rly_msg ""
 /begin OUT_MEASUREMENT GlwCtl_rGSK3Raw GlwCtl_stActrOut GlwCtl_stGlwPwrRed GlwCtl_stLampOut GlwCtl_swtPreGlow /end OUT_MEASUREMENT
/end FUNCTION
/begin FUNCTION glwctl_rly_uic ""
 /begin OUT_MEASUREMENT GlwCtl_facGlwPwrRed_mp GlwCtl_rOutPre_mp GlwCtl_rOut_mp GlwCtl_stGlwPwrRedHys_mp GlwCtl_stGlwPwrRed_mp GlwCtl_stRly_mp GlwCtl_stShOff_mp GlwCtl_tiLamp_mp /end OUT_MEASUREMENT
/end FUNCTION
/begin FUNCTION hdscd ""
 /begin DEF_CHARACTERISTIC HDSCD_uSRCMin_C HDSCD_uSRCMax_C HDSCD_prcLin_CUR HDSCD_DebSRCHighDef_C HDSCD_DebSRCHighOk_C HDSCD_DebSRCLowDef_C HDSCD_DebSRCLowOk_C HDSCD_dprcRmpSlpUp_C HDSCD_dprcRmpSlpDwn_C HDSCD_stSensIDWord_C HDSCD_prcAirDfl_C /end DEF_CHARACTERISTIC
 /begin IN_MEASUREMENT HDSCD_uRaw /end IN_MEASUREMENT
/end FUNCTION
/begin FUNCTION hdscd_msg "" /begin OUT_MEASUREMENT HDSCD_prcAir HDSCD_prcAirLin HDSCD_uRaw /end OUT_MEASUREMENT /end FUNCTION
/begin FUNCTION hpun "Hochdruckpumpe" /end FUNCTION
/begin FUNCTION hpun_co "Hochdruckpumpe"
 /begin DEF_CHARACTERISTIC HPUn_dvolMeUnMax_C HPUn_etaPmpFlTemp_CUR HPUn_etaPmpMaxAged_CUR HPUn_etaPmpMech_C HPUn_nMin_C HPUn_qBalLim_CUR HPUn_qFlTempLim_MAP HPUn_rTransCrS_C HPUn_volPmp_C /end DEF_CHARACTERISTIC
 /begin IN_MEASUREMENT Eng_nAvrg FlSys_t FTSCD_tFuel /end IN_MEASUREMENT
/end FUNCTION
/begin FUNCTION hpun_co_msg "" /begin OUT_MEASUREMENT HPUn_numInjQntBal /end OUT_MEASUREMENT /end FUNCTION
/begin FUNCTION hpun_co_uic ""
 /begin OUT_MEASUREMENT HPUn_dvolPmpMaxCor_mp HPUn_dvolPmpMax_mp HPUn_etaPmpFlTemp_mp HPUn_etaPmpMaxAged_mp HPUn_qBalLim_mp HPUn_qFlTempLim_mp HPUn_stQntBal_mp /end OUT_MEASUREMENT
/end FUNCTION
/begin FUNCTION hpun_msg "" /begin OUT_MEASUREMENT HPUn_qLim HPUn_trqDes /end OUT_MEASUREMENT /end FUNCTION
/begin FUNCTION hpun_qntbalinjlim "maximale Anzahl an Einspritzungen aufgrund der Mengenbilanz der Hochdruckpumpe"
 /begin DEF_CHARACTERISTIC HPUn_numInjMin_C HPUn_pRailDvtOk_C HPUn_tiPresDvtFlt_C HPUn_tiQntBalDel_C /end DEF_CHARACTERISTIC
/end FUNCTION
/begin FUNCTION hpun_qntbalinjlim_uic "" /begin OUT_MEASUREMENT HPUn_pRailDvtFlt_mp HPUn_stNumInjMax_mp /end OUT_MEASUREMENT /end FUNCTION
/begin FUNCTION hwemon "Monitoring of Hardware Encapsulation Functions"
 /begin DEF_CHARACTERISTIC HWEMon_DebComStepDown_C HWEMon_DebComStepUp_C HWEMon_DebComDef_C HWEMon_DebComOk_C HWEMon_nThres_C HWEMon_numTrigRecovery_C /end DEF_CHARACTERISTIC
/end FUNCTION
/begin FUNCTION hwemon_msg "" /begin OUT_MEASUREMENT HWEMon_ctRecovery HWEMon_numRecovery /end OUT_MEASUREMENT /end FUNCTION
/begin FUNCTION hwemon_uic "" /begin OUT_MEASUREMENT HWEMon_stVoltMon_mp /end OUT_MEASUREMENT /end FUNCTION
/begin FUNCTION iatscd "Lufttemperaturfühler Komponententreiber"
 /begin DEF_CHARACTERISTIC IATSCD_uSRCMin_C IATSCD_uSRCMax_C IATSCD_tLin_CUR IATSCD_DebSigDef_C IATSCD_DebSigOk_C IATSCD_DebSRCHighDef_C IATSCD_DebSRCHighOk_C IATSCD_DebSRCLowDef_C IATSCD_DebSRCLowOk_C IATSCD_dtRmpSlpUp_C IATSCD_dtRmpSlpDwn_C IATSCD_swtSigVal_C IATSCD_stSensIDWord_C IATSCD_tDfl_C /end DEF_CHARACTERISTIC
 /begin IN_MEASUREMENT IATSCD_uRaw /end IN_MEASUREMENT
/end FUNCTION
/begin FUNCTION iatscd_msg "" /begin OUT_MEASUREMENT IATSCD_swtSig IATSCD_tAir IATSCD_tAirLin IATSCD_uRaw /end OUT_MEASUREMENT /end FUNCTION
/begin FUNCTION iatscd_uic "" /end FUNCTION
/begin FUNCTION iatscd_var_msg "" /end FUNCTION
/begin FUNCTION ifcd "Lüftersteuerung für den Ladeluftkühler Komponententrteiber"
 /begin DEF_CHARACTERISTIC IFCD_DebExcTempDef_C IFCD_DebExcTempOK_C IFCD_DebNoLoadDef_C IFCD_DebNoLoadOK_C IFCD_DebShortCircBatDef_C IFCD_DebShortCircBatOK_C IFCD_DebShortCircGndDef_C IFCD_DebShortCircGndOK_C IFCD_stInvOut_C IFCD_stPwrStgActv_C IFCD_stPwrStgDia_C IFCD_tiIFcheckDfpTmr_C IFCD_tiIFOFFTmr_C /end DEF_CHARACTERISTIC
/end FUNCTION
/begin FUNCTION ifcd_uic "" /begin OUT_MEASUREMENT IFCD_stOutHWE_mp /end OUT_MEASUREMENT /end FUNCTION
/begin FUNCTION ifctl "Lüftersteuerung für den Ladeluftkühler"
 /begin DEF_CHARACTERISTIC IFCtl_stFanOffMsk_C IFCtl_stOff_C IFCtl_tAirHysHi_CUR IFCtl_tAirHysLo_CUR IFCtl_tClntThrHiHysHi_CUR IFCtl_tClntThrHiHysLo_CUR IFCtl_tClntThrLoHysHi_C IFCtl_tClntThrLoHysLo_C /end DEF_CHARACTERISTIC
 /begin IN_MEASUREMENT VSSCD_v /end IN_MEASUREMENT
/end FUNCTION
/begin FUNCTION ifctl_msg "" /begin OUT_MEASUREMENT IFCtl_stFan /end OUT_MEASUREMENT /end FUNCTION
/begin FUNCTION ifctl_uic "" /begin OUT_MEASUREMENT IFCtl_stFantAir_mp IFCtl_stFantClnt_mp /end OUT_MEASUREMENT /end FUNCTION
/begin FUNCTION ignlck "Zündschloss" /end FUNCTION
/begin FUNCTION ignlck_msg "" /begin OUT_MEASUREMENT IgnLck_st /end OUT_MEASUREMENT /end FUNCTION
/begin FUNCTION ignlck_uic "" /end FUNCTION
/begin FUNCTION immctl "Steuerung Wegfahrsperre"
 /begin DEF_CHARACTERISTIC ImmCtl_Labelkey_C ImmCtl_P_Class_C ImmCtl_stAutoLrnActv_C ImmCtl_stDatChanAcc_C ImmCtl_stDatChan_C ImmCtl_stDattest_C ImmCtl_swtpasswd_ECU_C ImmCtl_swtStartSKC_C ImmCtl_tiDataReq_C /end DEF_CHARACTERISTIC
/end FUNCTION
/begin FUNCTION immctl_msg ""
 /begin OUT_MEASUREMENT ImmCtl_lrnRndNr ImmCtl_stAftRunRdy ImmCtl_stCom ImmCtl_stImmo ImmCtl_stOnOff ImmCtl_stProcess ImmCtl_stStartEnable ImmCtl_stVersion ImmCtl_tiLockCount /end OUT_MEASUREMENT
/end FUNCTION
/begin FUNCTION immctl_uic "" /begin OUT_MEASUREMENT ImmCtl_ctImmo2_mp ImmCtl_dRndNr_mp ImmCtl_StateImmCtl_mp /end OUT_MEASUREMENT /end FUNCTION
/begin FUNCTION indsys_calcswirl "Drallniveausteuerung"
 /begin DEF_CHARACTERISTIC IndSys_facAPCor_CUR IndSys_facWtTempCor_CUR IndSys_rAPCorVSA_MAP IndSys_rEGRLim_C IndSys_rVSAThresLo_C IndSys_rVSAThresHi_C IndSys_rVSAYLo_C IndSys_rVSAYHi_C IndSys_rVSAOpen_C IndSys_rVSA_MAP IndSys_rWtTempCorVSA_MAP IndSys_swtHys_C /end DEF_CHARACTERISTIC
 /begin IN_MEASUREMENT APSCD_pVal CTSCD_tClnt Eng_nAvrg InjCtl_qCurr /end IN_MEASUREMENT
/end FUNCTION
/begin FUNCTION indsys_calcswirl_uic ""
 /begin DEF_CHARACTERISTIC IndSys_rVSAAdd_Vector IndSys_rVSAAdd_Channel IndSys_rVSA_Vector IndSys_rVSA_Channel /end DEF_CHARACTERISTIC
 /begin OUT_MEASUREMENT IndSys_rAPCorVSA_mp IndSys_rVSABefHys_mp IndSys_rVSAByp_mp IndSys_rVSACorBefHys_mp IndSys_rWtTempCorVSA_mp /end OUT_MEASUREMENT
/end FUNCTION
/begin FUNCTION indsys_monvac "Ansaugluft-Unterdruckerkennung"
 /begin DEF_CHARACTERISTIC IndSys_tiDebNegErrMonVac_C IndSys_tiDebPosErrMonVac_C IndSys_nAvrg_C IndSys_pDiffHigh_CUR IndSys_pDiffLow_CUR IndSys_rAPP_C /end DEF_CHARACTERISTIC
 /begin IN_MEASUREMENT Eng_nAvrg /end IN_MEASUREMENT
/end FUNCTION
/begin FUNCTION indsys_monvac_uic ""
 /begin OUT_MEASUREMENT IndSys_pDiffHigh_mp IndSys_pDiffLow_mp IndSys_pDiff_mp IndSys_stVacRaw_mp /end OUT_MEASUREMENT
/end FUNCTION
/begin FUNCTION indsys_msg "" /begin OUT_MEASUREMENT IndSys_rVSA /end OUT_MEASUREMENT /end FUNCTION
/begin FUNCTION indsys_padj "Ansaugluftdruck-Abgleichwert Berechnung"
 /begin DEF_CHARACTERISTIC IndSys_pAdjDiffMax_C IndSys_pAdjMax_C IndSys_tAirMinAdj_C IndSys_tiDebAdj_C IndSys_tiDelAdj_C /end DEF_CHARACTERISTIC
/end FUNCTION
/begin FUNCTION indsys_padj_uic ""
 /begin OUT_MEASUREMENT IndSys_pAdjDiff_mp IndSys_stAdjEna_mp IndSys_stOldNewAdjVal_mp IndSys_stPDiffSrcSel_mp IndSys_stRead_mp IndSys_stWrite_mp /end OUT_MEASUREMENT
/end FUNCTION
/begin FUNCTION indsys_uic "" /end FUNCTION
/begin FUNCTION indsys_var_msg ""
 /begin OUT_MEASUREMENT IndSys_pAdj IndSys_pAdjDiff IndSys_pAdjNew IndSys_stAdj IndSys_stBPLoDetActv IndSys_swtVacMonOn /end OUT_MEASUREMENT
/end FUNCTION
/begin FUNCTION injcrv "Einspritzverlauf" /begin DEF_CHARACTERISTIC InjCrv_stInjDstSel_C InjCrv_tiPause_C /end DEF_CHARACTERISTIC /end FUNCTION
/begin FUNCTION injcrv_co "Spritzbeginn Sollwertbildung"
 /begin DEF_CHARACTERISTIC InjCrv_ctTempSel_C InjCrv_DebLimDef_C InjCrv_DebLimOk_C InjCrv_numInjMaxSys_C InjCrv_pThres_C InjCrv_rOpRngATSHys_C InjCrv_rOpRngETSHys_C InjCrv_rPiIRlsEngSpdHys_C InjCrv_rPiIRlsQntHys_C InjCrv_stInjCharPrioRgn_C InjCrv_stInjCharPrio_C InjCrv_stPiIRlsOpRng11_MAP InjCrv_stPiIRlsOpRng12_MAP InjCrv_stPiIRlsOpRng13_MAP InjCrv_stPiIRlsOpRng21_MAP InjCrv_stPiIRlsOpRng22_MAP InjCrv_stPiIRlsOpRng23_MAP InjCrv_stPiIRlsOpRng31_MAP InjCrv_stPiIRlsOpRng32_MAP InjCrv_stPiIRlsOpRng33_MAP InjCrv_stPiIRlsOpRng41_MAP InjCrv_stPiIRlsOpRng42_MAP InjCrv_stPiIRlsOpRng43_MAP InjCrv_stPiIRlsOpRng51_MAP InjCrv_stPiIRlsOpRng52_MAP InjCrv_stPiIRlsOpRng53_MAP InjCrv_stPrioRgnMsk_C InjCrv_stRlsGear1_CUR InjCrv_stRlsGear2_CUR InjCrv_stRlsGear3_CUR InjCrv_stRlsGear4_CUR InjCrv_stRlsGear5_CUR InjCrv_stRlsOpRngThres1_MAP InjCrv_stRlsOpRngThres2_MAP InjCrv_stRlsOpRngThresRgn_MAP InjCrv_stRlsRgnMsk_C InjCrv_swtRlsOpRngThres_MAP /end DEF_CHARACTERISTIC
 /begin IN_MEASUREMENT EngM_ctRevSta Eng_nAvrg IATSCD_tAir InjCrv_stGear_mp InjCrv_tEng InjCtl_qSetUnBal /end IN_MEASUREMENT
/end FUNCTION
/begin FUNCTION injcrv_co_msg ""
 /begin OUT_MEASUREMENT InjCrv_numInjMaxSys InjCrv_PoI2RgnVal InjCrv_stInjCharActVal InjCrv_stInjCharPrio InjCrv_stInjCharSetVal InjCrv_tEng /end OUT_MEASUREMENT
/end FUNCTION
/begin FUNCTION injcrv_co_uic ""
 /begin DEF_CHARACTERISTIC InjCrv_stInjCharSetVal_Vector InjCrv_stInjCharSetVal_Channel /end DEF_CHARACTERISTIC
 /begin OUT_MEASUREMENT InjCrv_numInjDes_mp InjCrv_numInjLim_mp InjCrv_stGear_mp InjCrv_stInjCharDes_mp InjCrv_stInjCharSetVal_mp InjCrv_stPiIRlsOpRng_mp InjCrv_stPiIRlsStruct_mp InjCrv_stRlsGear_mp /end OUT_MEASUREMENT
/end FUNCTION
/begin FUNCTION injcrv_ctlqnt "" /end FUNCTION
/begin FUNCTION injcrv_ctlqnt_msg "" /begin OUT_MEASUREMENT InjCrv_qLmbdCtl InjCrv_qTot InjCrv_stLmbdCtl /end OUT_MEASUREMENT /end FUNCTION
/begin FUNCTION injcrv_ctlqnt_uic "" /end FUNCTION
/begin COMPU_METHOD AngMom "Drehimpuls" RAT_FUNC "%6.3" "[Nms]" COEFFS 0 1.953125 0 0 0 1 /end COMPU_METHOD
/begin COMPU_METHOD Dist2_km "Umrechnungsformel für Strecke in km" RAT_FUNC "%6.2" "[km]" COEFFS 0 1 0 0 0 1 /end COMPU_METHOD
/begin COMPU_METHOD DtyCyc "Tastverhaeltnis" RAT_FUNC "%6.4" "[%]" COEFFS 0 100 0 0 0 1 /end COMPU_METHOD
/begin COMPU_METHOD EGTSwt "Umrechnung für EGT Rampenschalter (1 / 1000*2^14 )" RAT_FUNC "%10.9" "-" COEFFS 0 16384000 0 0 0 1 /end COMPU_METHOD
/begin COMPU_METHOD EngN "Motordrehzahl" RAT_FUNC "%6.2" "[rpm]" COEFFS 0 1 0 0 0 1 /end COMPU_METHOD
/begin COMPU_METHOD EngTempFldSel "Verbale Umrechnung für Auswahl aus dem Motortemperatur-Feld Eng_tFld" TAB_VERB "%6.3" "" COMPU_TAB_REF EngTempFldSel /end COMPU_METHOD
/begin COMPU_VTAB EngTempFldSel "Verbale Umrechnung für Auswahl aus dem Motortemperatur-Feld Eng_tFld" TAB_VERB 5 0 "Coolant_Temperature" 1 "Oil_Temperature" 2 "Engine_Temperature" 3 "Fuel_Temperature" 4 "Coolant_Temperature_CAN" /end COMPU_VTAB
/begin COMPU_METHOD Eta "Umrechnugsformel für Wirkungsgradfaktor eta" RAT_FUNC "%6.4" "Nm/(mg/cyc)" COEFFS 0 128 0 0 0 1 /end COMPU_METHOD
/begin COMPU_METHOD Fact "Faktor mit Auflösung 1 / 8192, hauptsächlich für einen Faktorenbereich 0...1 verwendet" RAT_FUNC "%6.5" "[-]" COEFFS 0 8192 0 0 0 1 /end COMPU_METHOD
/begin COMPU_METHOD Fact1 "Faktor mit Auflösung 0,01 (100 mal höherer Bereich als Fact)" RAT_FUNC "%6.4" "[-]" COEFFS 0 128 0 0 0 1 /end COMPU_METHOD
/begin COMPU_METHOD Fl_Half_L "Kraftstoffverbrauchsintegral" RAT_FUNC "%6.3" "[l]" COEFFS 0 2 0 0 0 1 /end COMPU_METHOD
/begin COMPU_METHOD GlwCtl_Time_ms "zur Zeitumrechnung von um den Faktor 10 größeren Zeiten als Time_ms" RAT_FUNC "%6.0" "[ms]" COEFFS 0 0.01 0 0 0 1 /end COMPU_METHOD
/begin COMPU_METHOD InjMass "Einspritzmenge" RAT_FUNC "%6.4" "[mg/hub]" COEFFS 0 100 0 0 0 1 /end COMPU_METHOD
/begin COMPU_METHOD InjMassCyc "Einspritzmenge pro Zyklus (mg/Zyklus)" RAT_FUNC "%6.4" "[mg/cyc]" COEFFS 0 100 0 0 0 1 /end COMPU_METHOD
/begin COMPU_METHOD InjTime_us "Zeit in Microsekunden für das Einspritztiming" RAT_FUNC "%6.2" "[us]" COEFFS 0 1 0 0 0 1 /end COMPU_METHOD
/begin COMPU_METHOD Kp_rpm2Nm "Proportionale Verstärkung Kp (Motordrehzahl EngN zu Moment Trq)" RAT_FUNC "%8.7" "[Nm/rpm]" COEFFS 0 655360 0 0 0 1 /end COMPU_METHOD
/begin COMPU_METHOD Map_Select "Umsetzungsfaktor von Kennfeldern fuer vierdimensionale Raeume" RAT_FUNC "%6.4" "[-]" COEFFS 0 256 0 0 0 1 /end COMPU_METHOD
/begin COMPU_METHOD Moment_Inertia "Moment of Inertia" RAT_FUNC "%6.4" "[kg * m^2]" COEFFS 0 100 0 0 0 1 /end COMPU_METHOD
/begin COMPU_METHOD OneToOne "eins zu eins (physikalischer Wert ist gleich dem internen Wert)" RAT_FUNC "%6.2" "[-]" COEFFS 0 1 0 0 0 1 /end COMPU_METHOD
/begin COMPU_METHOD Period "Periodendauer" RAT_FUNC "%6.3" "[ms]" COEFFS 0 10 0 0 0 1 /end COMPU_METHOD
/begin COMPU_METHOD PmpQnt "Fördermenge der Pumpe / Umdrehung" RAT_FUNC "%6.3" "[mm^3/rev]" COEFFS 0 10 0 0 0 1 /end COMPU_METHOD
/begin COMPU_METHOD Prc "Prozent, gleiche interne Auflösung wie Fact, aber Darstellung in Prozent (0...100%)" RAT_FUNC "%6.4" "[%]" COEFFS 0 100 0 0 0 1 /end COMPU_METHOD
/begin COMPU_METHOD PrcHigh "Höch prozentanteil auflösung" RAT_FUNC "%6.5" "[%]" COEFFS 0 1000 0 0 0 1 /end COMPU_METHOD
/begin COMPU_METHOD PresAC_hPa "Druck (Klimatisierung) angezeigt in [hPa]" RAT_FUNC "%6.2" "[hPa]" COEFFS 0 0.5 0 0 0 1 /end COMPU_METHOD
/begin COMPU_METHOD Pres_hPa "Druck (angezeigt in [hPa])" RAT_FUNC "%6.2" "[hPa]" COEFFS 0 1 0 0 0 1 /end COMPU_METHOD
/begin COMPU_METHOD Pres_Rail "Raildruck in hPa" RAT_FUNC "%6.0" "[hPa]" COEFFS 0 0.01 0 0 0 1 /end COMPU_METHOD
/begin COMPU_METHOD Pwr "Leistung" RAT_FUNC "%6.2" "[W]" COEFFS 0 0.10610329539459 0 0 0 1 /end COMPU_METHOD
/begin COMPU_METHOD Pwr_HiRes "Hochaufloesung der Leistung" RAT_FUNC "%6.3" "[W]" COEFFS 0 2 0 0 0 1 /end COMPU_METHOD
/begin COMPU_METHOD Qp_mm3_sec "Umrechnung für Volumenstrom" RAT_FUNC "%6.1" "mm3/s" COEFFS 0 0.1 0 0 0 1 /end COMPU_METHOD
/begin COMPU_METHOD RmpPrc "Prozent Rampengradient" RAT_FUNC "%6.5" "[%/s]" COEFFS 0 6553.6 0 0 0 1 /end COMPU_METHOD
/begin COMPU_METHOD RmpTemp "Rampengradient für Temperatur" RAT_FUNC "%6.4" "[deg C/s]" COEFFS 0 655.36 0 0 0 1 /end COMPU_METHOD
/begin COMPU_METHOD RmpTrq "Rampengradient für Motormoment" RAT_FUNC "%6.4" "[Nm/s]" COEFFS 0 655.36 0 0 0 1 /end COMPU_METHOD
/begin COMPU_METHOD rTrqCAN "Momentenverhältnis für CAN" RAT_FUNC "%6.3" "[%]" COEFFS 0 2.54999910750031 0 0 0 1 /end COMPU_METHOD
/begin COMPU_METHOD SqrVltg_s "Umrechnung für Batterie-Spannungs-Quadrat mehr als eine Sekunde" RAT_FUNC "%6.3" "[V^2s]" COEFFS 0 10 0 0 0 1 /end COMPU_METHOD
/begin COMPU_METHOD TempDiff_Kelv "Offsettemperatur dargestellt in [K]" RAT_FUNC "%6.3" "[ deg C ]" COEFFS 0 10 0 0 0 1 /end COMPU_METHOD
/begin COMPU_METHOD Temp_Cels "Temperatur dargestellt in °C (gleiche interne Darstellung wie Temp_Kelv)" RAT_FUNC "%6.1" "[deg C]" COEFFS 0 10 2731.4 0 0 1 /end COMPU_METHOD
/begin COMPU_METHOD TimeDeb "Entprellzeit in Millisekunden für Libraryfunktion Debounce" RAT_FUNC "%6.1" "[ms]" COEFFS 0 0.1 0 0 0 1 /end COMPU_METHOD
/begin COMPU_METHOD TimeDelay_s "Zeitkonstante T1 (in s) für PT1, DT1, etc." RAT_FUNC "%9.3" "[s]" COEFFS 0 0 1 0 0.00023283064365387 0 /end COMPU_METHOD
/begin COMPU_METHOD TimeDT "Abtastzeit (in us) für Library Regler, Filter, etc." RAT_FUNC "%6.2" "[us]" COEFFS 0 1 0 0 0 1 /end COMPU_METHOD
/begin COMPU_METHOD TimeEngOn "Motorbetriebszeit in Sekunden" RAT_FUNC "%6.2" "[s]" COEFFS 0 1 0 0 0 1 /end COMPU_METHOD
/begin COMPU_METHOD Time_HighRes "Höhere Auflösung für Zeit in Sekunden" RAT_FUNC "%6.3" "[ms]" COEFFS 0 8 0 0 0 1 /end COMPU_METHOD
/begin COMPU_METHOD Time_ms "Zeit in ms für Fehlerentprellung (DSM) und SW-Timer" RAT_FUNC "%6.1" "[ms]" COEFFS 0 0.1 0 0 0 1 /end COMPU_METHOD
/begin COMPU_METHOD Time_RtmLowRes "Zeit mit niedriger Auflösung für Laufzeitmessung" RAT_FUNC "%6.3" "[ms]" COEFFS 0 10 0 0 0 1 /end COMPU_METHOD
/begin COMPU_METHOD Time_s "Zeit in s für Fehlerentprellung (DSM) und SW-Timer" RAT_FUNC "%6.4" "[s]" COEFFS 0 100 0 0 0 1 /end COMPU_METHOD
/begin COMPU_METHOD TransR "Übersetzungsverhältnis (Getriebe etc.)" RAT_FUNC "%6.4" "[-]" COEFFS 0 100 0 0 0 1 /end COMPU_METHOD
/begin COMPU_METHOD TrnvrsAcc "Umrechnung für Querbeschleunigung" RAT_FUNC "%6.4" "[g]" COEFFS 0 100 0 0 0 1 /end COMPU_METHOD
/begin COMPU_METHOD Trq "Motormoment" RAT_FUNC "%6.3" "[Nm]" COEFFS 0 10 0 0 0 1 /end COMPU_METHOD
/begin COMPU_METHOD TrqPerSec "Motormomentengradient" RAT_FUNC "%6.2" "[Nm/s]" COEFFS 0 1 0 0 0 1 /end COMPU_METHOD
/begin COMPU_METHOD TrqPrp "Vortriebsmoment" RAT_FUNC "%6.2" "[Nm]" COEFFS 0 1 0 0 0 1 /end COMPU_METHOD
/begin COMPU_METHOD Vel "Fahrzeuggeschwindigkeit, gleiche interne Auflösung wie Vel_SI" RAT_FUNC "%6.4" "[km/h]" COEFFS 0 100 0 0 0 1 /end COMPU_METHOD
/begin COMPU_METHOD VelToN "Verhältnis Fahrzeuggeschwindigkeit zu Motordrehzahl v/n" RAT_FUNC "%8.7" "[(km/h)/rpm]" COEFFS 0 100000 0 0 0 1 /end COMPU_METHOD
/begin COMPU_METHOD Volt "Spannung in V (von ADC)" RAT_FUNC "%6.2" "[mV]" COEFFS 0 0.2046 0 0 0 1 /end COMPU_METHOD
/begin COMPU_METHOD Volt_Batt "Batteriespannung" RAT_FUNC "%6.1" "[mV]" COEFFS 0 0.0492252911173131 0 0 0 1 /end COMPU_METHOD
/begin COMPU_METHOD defaultAscii "" RAT_FUNC "%6.2" "" COEFFS 0 1 0 0 0 1 /end COMPU_METHOD
/begin RECORD_LAYOUT Kf_Xs16_Ys16_Ws16 NO_AXIS_PTS_X 1 SWORD NO_AXIS_PTS_Y 2 SWORD AXIS_PTS_X 3 SWORD INDEX_INCR DIRECT AXIS_PTS_Y 4 SWORD INDEX_INCR DIRECT FNC_VALUES 5 SWORD COLUMN_DIR DIRECT /end RECORD_LAYOUT
/begin RECORD_LAYOUT Kl_Xs16_Ws16 NO_AXIS_PTS_X 1 SWORD AXIS_PTS_X 2 SWORD INDEX_INCR DIRECT FNC_VALUES 3 SWORD COLUMN_DIR DIRECT /end RECORD_LAYOUT
/begin RECORD_LAYOUT Ktx FNC_VALUES 1 UBYTE COLUMN_DIR DIRECT /end RECORD_LAYOUT
/begin RECORD_LAYOUT Kw_Ws16 FNC_VALUES 1 SWORD COLUMN_DIR DIRECT /end RECORD_LAYOUT
/begin RECORD_LAYOUT Kw_Wu16 FNC_VALUES 1 UWORD COLUMN_DIR DIRECT /end RECORD_LAYOUT
/begin RECORD_LAYOUT Kw_Wu32 FNC_VALUES 1 ULONG COLUMN_DIR DIRECT /end RECORD_LAYOUT
/begin RECORD_LAYOUT Kw_Wu8 FNC_VALUES 1 UBYTE COLUMN_DIR DIRECT /end RECORD_LAYOUT
/end MODULE
/end PROJECT
