ASAP2_VERSION 1 3
/begin PROJECT C177 "EDC16CP"
/begin HEADER "" VERSION "VCP7A3" PROJECT_NO C177 /end HEADER
/begin MODULE DIM ""
/begin MOD_COMMON "" BYTE_ORDER MSB_FIRST ALIGNMENT_BYTE 1 ALIGNMENT_WORD 2 ALIGNMENT_LONG 4 ALIGNMENT_FLOAT32_IEEE 4 /end MOD_COMMON
/begin CHARACTERISTIC FanCtl_dcycFan1_Vector "Konfigurationsdatei für Bypass Schnittstelle." VALUE 0x1C0A6A Kw_Wu8 255.0 OneToOne 0.00 255.0 FORMAT "%5.1" /end CHARACTERISTIC
/begin CHARACTERISTIC FanCtl_dcycFan1_Channel "Konfigurationslabel für Bypass message" VALUE 0x1C0A6B Kw_Wu8 255.0 OneToOne 0.00 255.0 FORMAT "%5.1" /end CHARACTERISTIC
/begin CHARACTERISTIC FanCtl_dcycFan2_Vector "Konfigurationsdatei für Bypass Schnittstelle." VALUE 0x1C0A6C Kw_Wu8 255.0 OneToOne 0.00 255.0 FORMAT "%5.1" /end CHARACTERISTIC
/begin CHARACTERISTIC FanCtl_dcycFan2_Channel "Konfigurationsdatei für die Bypass Schnittstelle." VALUE 0x1C0A6D Kw_Wu8 255.0 OneToOne 0.00 255.0 FORMAT "%5.1" /end CHARACTERISTIC
/begin CHARACTERISTIC FanCtl_prcCAN_Vector "Konfigurationslabel für Bypass message" VALUE 0x1C0A6E Kw_Wu8 255.0 OneToOne 0.00 255.0 FORMAT "%5.1" /end CHARACTERISTIC
/begin CHARACTERISTIC FanCtl_prcCAN_Channel "Konfigurationslabel für Bypass message" VALUE 0x1C0A6F Kw_Wu8 255.0 OneToOne 0.00 255.0 FORMAT "%5.1" /end CHARACTERISTIC
/begin CHARACTERISTIC FBC_AACoeff_C "Antialiasingfilterkoeffizienten" VAL_BLK 0x1D0388 Kwb_Wr32 2.00000000 OneToOne -1.00000000 1.00000000 FORMAT "%10.8" EXTENDED_LIMITS -1.00000000E+37 1.00000000E+37 NUMBER 9 /end CHARACTERISTIC
/begin CHARACTERISTIC FBC_AAOrd_C "Filterordnung des Antialiasingfilter" VALUE 0x1D03AC Kw_Wu8 8.000 OneToOne 0.00 8.000 FORMAT "%5.3" EXTENDED_LIMITS 0.00 255.0 /end CHARACTERISTIC
/begin CHARACTERISTIC FBC_Act_C "=0: Geberradadaption inaktiv; =1 aktiv; =2 lösche Adaptionsergebnisspeicher (EEPROM)" VALUE 0x1D03AD Kw_Wu8 2.000 OneToOne 0.00 2.000 FORMAT "%5.3" EXTENDED_LIMITS 0.00 255.0 /end CHARACTERISTIC
/begin CHARACTERISTIC FBC_BPFac1NumG_CUR "drehmomentübersetzungsabhänige Nockenwellenbandpassverstärkung" CURVE 0x1D0298 Kl_Xs16_Ws16 40.00000 FBC_BPfac -20.00000 20.00000 FORMAT "%8.5" EXTENDED_LIMITS -20.00061 20.00000
 /begin AXIS_DESCR STD_AXIS DrvTrn_rTransDT TransR 6 0.00 100.0000 FORMAT "%8.4" EXTENDED_LIMITS -327.6800 327.6700 DEPOSIT ABSOLUTE /end AXIS_DESCR
/end CHARACTERISTIC
/begin CHARACTERISTIC FBC_dBPFacNumLo_CA "Bandpass array: Zählerkoeffizienten für unteren Drehzahlbereich" VAL_BLK 0x1D02B4 Kwb_Wr32 30.0000000 OneToOne -15.0000000 15.0000000 FORMAT "%10.7" EXTENDED_LIMITS -1.00000000E+37 1.00000000E+37 NUMBER 3 /end CHARACTERISTIC
/begin CHARACTERISTIC FBC_dBPFacNumHi_CA "Bandpass array: Zählerkoeffizienten für den oberen Drehzahlbereich" VAL_BLK 0x1D02C0 Kwb_Wr32 30.0000000 OneToOne -15.0000000 15.0000000 FORMAT "%10.7" EXTENDED_LIMITS -1.00000000E+37 1.00000000E+37 NUMBER 3 /end CHARACTERISTIC
/begin CHARACTERISTIC FBC_dBPFacNumZFC_CA "Bandpassverstärkungen für Schubbetrieb" VAL_BLK 0x1D02CC Kwb_Wr32 30.0000000 OneToOne -15.0000000 15.0000000 FORMAT "%10.7" EXTENDED_LIMITS -1.00000000E+37 1.00000000E+37 NUMBER 3 /end CHARACTERISTIC
/begin CHARACTERISTIC FBC_dBPFacDen1_CA "Bandpass Array: Nenner 1" VAL_BLK 0x1D02D8 Kwb_Wr32 20.0000000 OneToOne -10.0000000 10.0000000 FORMAT "%10.7" EXTENDED_LIMITS -1.00000000E+37 1.00000000E+37 NUMBER 3 /end CHARACTERISTIC
/begin CHARACTERISTIC FBC_dBPFacDen2_CA "Bandpass Array: Nenner 2" VAL_BLK 0x1D02E4 Kwb_Wr32 20.0000000 OneToOne -10.0000000 10.0000000 FORMAT "%10.7" EXTENDED_LIMITS -1.00000000E+37 1.00000000E+37 NUMBER 3 /end CHARACTERISTIC
/begin CHARACTERISTIC FBC_ctSegOffset_C "Abstand zwischen FBC-Berechnung und entsprechendem OT" VALUE 0x1D02F0 Kw_Ws8 0.00 OneToOne 3.000 3.000 FORMAT "%5.3" EXTENDED_LIMITS -128.0 127.0 /end CHARACTERISTIC
/begin CHARACTERISTIC FBC_dSegNhiCaS_C "Segmentwert für Eng_nAvrg > FBC_nThresFbc_C" VAL_BLK 0x1D02F2 Kwb_Wu16 255.9961 Per_Ratio 0.00 255.9961 FORMAT "%8.4" NUMBER 3 /end CHARACTERISTIC
/begin CHARACTERISTIC FBC_dSegNloCaS_C "Segmentwert für Eng_nAvrg < FBC_nThresFbc_C" VAL_BLK 0x1D02F8 Kwb_Wu16 255.9961 Per_Ratio 0.00 255.9961 FORMAT "%8.4" NUMBER 3 /end CHARACTERISTIC
/begin CHARACTERISTIC FBC_dSegZFCCaS_C "Segmentwahl für Schubbetrieb" VAL_BLK 0x1D02FE Kwb_Wu16 255.9961 Per_Ratio 0.00 255.9961 FORMAT "%8.4" NUMBER 3 /end CHARACTERISTIC
/begin CHARACTERISTIC FBC_dSyn_C "Abstand OT Zyl.1 zu Segmentzählerstand 0 (bezogen auf CrSCD_numSeg)" VALUE 0x1D0304 Kw_Ws8 24.00 OneToOne -12.00 12.00 FORMAT "%5.2" EXTENDED_LIMITS -128.0 127.0 /end CHARACTERISTIC
/begin CHARACTERISTIC FBC_DXadptl_C "Untere Schwelle der Adaptionsgüte" VALUE 0x1D03B0 Kw_Wr32 1.00000000 Prc_float 0.00 1.00000000 FORMAT "%10.8" EXTENDED_LIMITS -1.00000000E+39 1.00000000E+39 /end CHARACTERISTIC
/begin CHARACTERISTIC FBC_DXadptu_C "Obere Schwelle der Adaptionsgüte" VALUE 0x1D03B4 Kw_Wr32 1.00000000 Prc_float 0.00 1.00000000 FORMAT "%10.8" EXTENDED_LIMITS -1.00000000E+39 1.00000000E+39 /end CHARACTERISTIC
/begin CHARACTERISTIC FBC_DXalf0_C "Startwerte für FBC_DXSfn, FBC_DXSfp" VALUE 0x1D03B8 Kw_Wr32 3.00000000 Prc_float 0.00 3.00000000 FORMAT "%10.8" EXTENDED_LIMITS -1.00000000E+39 1.00000000E+39 READ_ONLY /end CHARACTERISTIC
/begin CHARACTERISTIC FBC_fSurge_CUR "drehmomentübersetzungsabhängige Ruckelfrequenzen" CURVE 0x1D0306 Kl_Xs16_Ws16 20.00000 Surge_Frq 0.00 20.00000 FORMAT "%8.5" EXTENDED_LIMITS -273.0667 273.0583
 /begin AXIS_DESCR STD_AXIS DrvTrn_rTransDT TransR 6 0.00 100.0000 FORMAT "%8.4" EXTENDED_LIMITS -327.6800 327.6700 DEPOSIT ABSOLUTE /end AXIS_DESCR
/end CHARACTERISTIC
/begin CHARACTERISTIC FBC_GvrnIKi_C "Regler: Integrationskonstante" VALUE 0x1D0320 Kw_Wr32 1.00000000 FBC_GvrnIKi_float 0.00 1.00000000 FORMAT "%10.8" EXTENDED_LIMITS -1.00000000E+37 1.00000000E+37 /end CHARACTERISTIC
/begin CHARACTERISTIC FBC_GvrnIKiPos_C "Regler: Integrationskonstante" VALUE 0x1D0324 Kw_Wr32 1.00000000 FBC_GvrnIKi_float 0.00 1.00000000 FORMAT "%10.8" EXTENDED_LIMITS -1.00000000E+37 1.00000000E+37 READ_ONLY /end CHARACTERISTIC
/begin CHARACTERISTIC FBC_GvrnIKiNeg_C "Regler: Integrationskonstante" VALUE 0x1D0328 Kw_Wr32 1.00000000 FBC_GvrnIKi_float 0.00 1.00000000 FORMAT "%10.8" EXTENDED_LIMITS -1.00000000E+37 1.00000000E+37 READ_ONLY /end CHARACTERISTIC
/begin CHARACTERISTIC FBC_GvrnIWinPos_C "Regler: I-Parameter" VALUE 0x1D032C Kw_Wr32 12200.0000 EngN_float -6100.00000 6100.00000 FORMAT "%10.5" EXTENDED_LIMITS -1.00000000E+37 1.00000000E+37 READ_ONLY /end CHARACTERISTIC
/begin CHARACTERISTIC FBC_GvrnIWinNeg_C "Regler: I-Parameter" VALUE 0x1D0330 Kw_Wr32 12200.0000 EngN_float -6100.00000 6100.00000 FORMAT "%10.5" EXTENDED_LIMITS -1.00000000E+37 1.00000000E+37 READ_ONLY /end CHARACTERISTIC
/begin CHARACTERISTIC FBC_GvrnPKp_C "Regler: Proportionaltitätskonstante" VALUE 0x1D0334 Kw_Wr32 1.00000000 FBC_GvrnPKp_float 0.00 1.00000000 FORMAT "%10.8" EXTENDED_LIMITS -1.00000000E+37 1.00000000E+37 /end CHARACTERISTIC
/begin CHARACTERISTIC FBC_GvrnPKpPos_C "Regler: Proportionaltitätskonstante" VALUE 0x1D0338 Kw_Wr32 1.00000000 FBC_GvrnPKp_float 0.00 1.00000000 FORMAT "%10.8" EXTENDED_LIMITS -1.00000000E+37 1.00000000E+37 READ_ONLY /end CHARACTERISTIC
/begin CHARACTERISTIC FBC_GvrnPKpNeg_C "Regler: Proportionaltitätskonstante" VALUE 0x1D033C Kw_Wr32 1.00000000 FBC_GvrnPKp_float 0.00 1.00000000 FORMAT "%10.8" EXTENDED_LIMITS -1.00000000E+37 1.00000000E+37 READ_ONLY /end CHARACTERISTIC
/begin CHARACTERISTIC FBC_GvrnPWinPos_C "Regler: P-Parameter" VALUE 0x1D0340 Kw_Wr32 12200.0000 EngN_float -6100.00000 6100.00000 FORMAT "%10.5" EXTENDED_LIMITS -1.00000000E+37 1.00000000E+37 READ_ONLY /end CHARACTERISTIC
/begin CHARACTERISTIC FBC_GvrnPWinNeg_C "Regler: P-Parameter" VALUE 0x1D0344 Kw_Wr32 12200.0000 EngN_float -6100.00000 6100.00000 FORMAT "%10.5" EXTENDED_LIMITS -1.00000000E+37 1.00000000E+37 READ_ONLY /end CHARACTERISTIC
/begin CHARACTERISTIC FBC_lrn_Vector "Bypass Label, nicht ändern!" VALUE 0x1C0A72 Kw_Wu8 255.0 OneToOne 0.00 255.0 FORMAT "%5.1" /end CHARACTERISTIC
/begin CHARACTERISTIC FBC_lrn_Channel "Bypass Label, nicht ändern!" VALUE 0x1C0A73 Kw_Wu8 255.0 OneToOne 0.00 255.0 FORMAT "%5.1" /end CHARACTERISTIC
/begin CHARACTERISTIC FBC_nCtlOfsMin_C "Offset der unteren drehzahlabhängigen Steuerschwelle zur aktuellen Leerlaufdrehzahl" VALUE 0x1D0348 Kw_Ws16 65535.00 EngN -32768.00 32767.00 FORMAT "%8.2" /end CHARACTERISTIC
/begin CHARACTERISTIC FBC_nCtlThresMax_C "obere Drehzahlsteuerschwelle" VALUE 0x1D034A Kw_Ws16 65535.00 EngN -32768.00 32767.00 FORMAT "%8.2" /end CHARACTERISTIC
/begin CHARACTERISTIC FBC_nGvrnOfsMin_C "Offset der unteren drehzahlabhängigen Regelschwelle zur aktuellen Leerlaufdrehzahl" VALUE 0x1D034C Kw_Ws16 65535.00 EngN -32768.00 32767.00 FORMAT "%8.2" /end CHARACTERISTIC
/begin CHARACTERISTIC FBC_nGvrnThresMax_C "obere Drehzahlregelschwelle" VALUE 0x1D034E Kw_Ws16 6000.000 EngN 0.00 6000.000 FORMAT "%8.3" EXTENDED_LIMITS -32768.00 32767.00 /end CHARACTERISTIC
/begin CHARACTERISTIC FBC_nHyst_C "Drehzahlhysterese" VALUE 0x1D0350 Kw_Ws16 100.0000 EngN 0.00 100.0000 FORMAT "%8.4" EXTENDED_LIMITS -32768.00 32767.00 /end CHARACTERISTIC
/begin CHARACTERISTIC FBC_nLrnThres_C "Drehzahlschwellen der Lernbereiche der Geberradadaption" VAL_BLK 0x1D03BC Kwb_Ws16 6000.000 EngN 0.00 6000.000 FORMAT "%8.3" EXTENDED_LIMITS -32768.00 32767.00 NUMBER 3 /end CHARACTERISTIC
/begin CHARACTERISTIC FBC_nSurgeOffset_C "pos. Offset zur kritischen Drehzahl, bei der fNW=fRuck gilt." VALUE 0x1D0352 Kw_Ws16 1000.000 EngN 0.00 1000.000 FORMAT "%8.3" EXTENDED_LIMITS -32768.00 32767.00 /end CHARACTERISTIC
/begin CHARACTERISTIC FBC_nThresFbc_C "Komfortdrehzahlbereich für Segmentwerte" VALUE 0x1D03C2 Kw_Ws16 65535.00 EngN -32768.00 32767.00 FORMAT "%8.2" /end CHARACTERISTIC
/begin CHARACTERISTIC FBC_nZFCThresMax_C "obere Drehzahlschwelle für ZFC Unterstützung im Schubbetrieb" VALUE 0x1D0354 Kw_Ws16 6000.000 EngN 0.00 6000.000 FORMAT "%8.3" EXTENDED_LIMITS -32768.00 32767.00 /end CHARACTERISTIC
/begin CHARACTERISTIC FBC_qCtlOfsMax_C "Offset für obere mengenabhängige Steuerschwelle" VALUE 0x1D0356 Kw_Ws16 655.3500 InjMass -327.6800 327.6700 FORMAT "%8.4" /end CHARACTERISTIC
/begin CHARACTERISTIC FBC_qCtlThresMin_C "untere Mengensteuerschwelle" VALUE 0x1D0358 Kw_Ws16 655.3500 InjMass -327.6800 327.6700 FORMAT "%8.4" /end CHARACTERISTIC
/begin CHARACTERISTIC FBC_qGvrnThresMax_CUR "obere mengenabhängige Regelschwelle" CURVE 0x1D035A Kl_Xs16_Ws16 327.6700 InjMass 0.00 327.6700 FORMAT "%8.4" EXTENDED_LIMITS -327.6800 327.6700
 /begin AXIS_DESCR STD_AXIS Eng_nAvrg EngN 4 0.00 6000.000 FORMAT "%8.3" EXTENDED_LIMITS -32768.00 32767.00 DEPOSIT ABSOLUTE /end AXIS_DESCR
/end CHARACTERISTIC
/begin CHARACTERISTIC FBC_qGvrnThresMin_C "untere Mengenregelschwelle" VALUE 0x1D036C Kw_Ws16 655.3500 InjMass -327.6800 327.6700 FORMAT "%8.4" /end CHARACTERISTIC
/begin CHARACTERISTIC FBC_qLim_CUR "mengenabhängige Korrekturmengenbegrenzung" CURVE 0x1D036E Kl_Xs16_Ws16 327.6700 InjMass 0.00 327.6700 FORMAT "%8.4" EXTENDED_LIMITS -327.6800 327.6700
 /begin AXIS_DESCR STD_AXIS InjCtl_qSetUnBal InjMass 4 0.00 327.6700 FORMAT "%8.4" EXTENDED_LIMITS -327.6800 327.6700 DEPOSIT ABSOLUTE /end AXIS_DESCR
/end CHARACTERISTIC
/begin CHARACTERISTIC FBC_q_Vector "Bypass Label, nicht ändern!" VALUE 0x1C0A70 Kw_Wu8 255.0 OneToOne 0.00 255.0 FORMAT "%5.1" /end CHARACTERISTIC
/begin CHARACTERISTIC FBC_q_Channel "Bypass Label, nicht ändern!" VALUE 0x1C0A71 Kw_Wu8 255.0 OneToOne 0.00 255.0 FORMAT "%5.1" /end CHARACTERISTIC
/begin CHARACTERISTIC FBC_stInitI_C "Initialisierung des I-Anteils im Zustand ""inaktiv"": '0' einfrieren, '1' mit 0 initialisieren." VALUE 0x1D0380 Kw_Ws8 1.000 OneToOne 0.00 1.000 FORMAT "%5.3" EXTENDED_LIMITS -128.0 127.0 /end CHARACTERISTIC
/begin CHARACTERISTIC FBC_stMskRgn_C "Maske für Regenerationsstatus (NOx-Kat)" VALUE 0x1D0384 Kw_Ws32 4294967295.00 OneToOne -2147483648.00 2147483647.00 FORMAT "%13.2" /end CHARACTERISTIC
/begin CHARACTERISTIC FBC_TFlrn_C "Filterkoeffizient des Bewertungsfilters" VALUE 0x1D03C4 Kw_Wr32 1.00000000 OneToOne 0.00 1.00000000 FORMAT "%10.8" EXTENDED_LIMITS -1.00000000E+37 1.00000000E+37 /end CHARACTERISTIC
/begin CHARACTERISTIC FBC_TF_C "Filterkoeffizient des Adaptionsfilters" VALUE 0x1D03C8 Kw_Wr32 1.00000000 OneToOne 0.00 1.00000000 FORMAT "%10.8" EXTENDED_LIMITS -1.00000000E+37 1.00000000E+37 /end CHARACTERISTIC
/begin CHARACTERISTIC FBC_ThresDyn_C "Drehzahldynamikgrenzwert um die Adaption zu deaktivieren" VALUE 0x1D03CC Kw_Wr32 1.00000000 OneToOne 0.00 1.00000000 FORMAT "%10.8" EXTENDED_LIMITS -1.00000000E+37 1.00000000E+37 /end CHARACTERISTIC
/begin CHARACTERISTIC FBC_TSm_C "Koeffizienten für Mittelwertfilter" VAL_BLK 0x1D03D0 Kwb_Wr32 13.0000000 OneToOne -6.00000000 7.00000000 FORMAT "%10.8" EXTENDED_LIMITS -1.00000000E+37 1.00000000E+37 NUMBER 2 /end CHARACTERISTIC
/begin CHARACTERISTIC FlMng_dSmokeMapNr_CUR "Auswahl Kennfeld zur Rauchbegrenzung aus Motortemperatur" CURVE 0x1D0D30 Kl_Xs16_Ws16 2.000000 Map_Select 0.00 2.000000 FORMAT "%8.6" EXTENDED_LIMITS -128.0000 127.9961
 /begin AXIS_DESCR STD_AXIS Eng_tEng Temp_Cels 2 -50.14000 199.8600 FORMAT "%8.4" EXTENDED_LIMITS -3549.940 3003.560 DEPOSIT ABSOLUTE /end AXIS_DESCR
/end CHARACTERISTIC
/begin CHARACTERISTIC FlMng_facCorAirTemp_CUR "Lufttemperaturkorrektur für PWG abhängige Rauchbegrenzung" CURVE 0x1D03D8 Kl_Xs16_Ws16 1.000000 Fact 0.00 1.000000 FORMAT "%8.6" EXTENDED_LIMITS -4.000000 3.999878
 /begin AXIS_DESCR STD_AXIS FlMng_AirTemp_mp Temp_Cels 12 -50.14000 199.8600 FORMAT "%8.4" EXTENDED_LIMITS -3549.940 3003.560 DEPOSIT ABSOLUTE /end AXIS_DESCR
/end CHARACTERISTIC
/begin CHARACTERISTIC FlMng_facCorAP_CUR "Atmosphärendruckkorrektur für PWG abhängige Rauchbegrenzung" CURVE 0x1D040A Kl_Xs16_Ws16 1.000000 Fact 0.00 1.000000 FORMAT "%8.6" EXTENDED_LIMITS -4.000000 3.999878
 /begin AXIS_DESCR STD_AXIS APSCD_pVal Pres_hPa 12 0.00 3500.000 FORMAT "%8.3" EXTENDED_LIMITS -32768.00 32767.00 DEPOSIT ABSOLUTE /end AXIS_DESCR
/end CHARACTERISTIC
/begin CHARACTERISTIC FlMng_facCorEngTemp_CUR "Motortemperaturkorrektur für PWG abhängige Rauchbegrenzung" CURVE 0x1D043C Kl_Xs16_Ws16 1.000000 Fact 0.00 1.000000 FORMAT "%8.6" EXTENDED_LIMITS -4.000000 3.999878
 /begin AXIS_DESCR STD_AXIS Eng_tEng Temp_Cels 12 -50.14000 199.8600 FORMAT "%8.4" EXTENDED_LIMITS -3549.940 3003.560 DEPOSIT ABSOLUTE /end AXIS_DESCR
/end CHARACTERISTIC
/begin CHARACTERISTIC FlMng_facLmbdSmkSOE_CUR "Korrekturfaktor aufgrund Saugrohrdruck" CURVE 0x1D046E Kl_Xs16_Ws16 6.000000 Fact -3.000000 3.000000 FORMAT "%8.6" EXTENDED_LIMITS -4.000000 3.999878
 /begin AXIS_DESCR STD_AXIS FlMng_pValSel_mp Pres_hPa 6 0.00 3500.000 FORMAT "%8.3" EXTENDED_LIMITS -32768.00 32767.00 DEPOSIT ABSOLUTE /end AXIS_DESCR
/end CHARACTERISTIC
/begin CHARACTERISTIC FlMng_FullLdRglIKi_CUR "Drehzahlabhängige Ki-Parameter der Vollastregelung" CURVE 0x1D0CB0 Kl_Xs16_Ws16 762.9162 Ki_LmbdRec2InjMass 0.00 762.9162 FORMAT "%8.4" EXTENDED_LIMITS -762.9395 762.9162
 /begin AXIS_DESCR STD_AXIS Eng_nAvrg EngN 7 0.00 6000.000 FORMAT "%8.3" EXTENDED_LIMITS -32768.00 32767.00 DEPOSIT ABSOLUTE /end AXIS_DESCR
/end CHARACTERISTIC
/begin CHARACTERISTIC FlMng_qFullLdRglMax_C "Maximale Stellgröße für Vollastregler" VALUE 0x1D0CCE Kw_Ws16 327.6700 InjMass 0.00 327.6700 FORMAT "%8.4" EXTENDED_LIMITS -327.6800 327.6700 /end CHARACTERISTIC
/begin CHARACTERISTIC FlMng_qFullLdRglMin_C "Minimale Stellgröße für Volllastregler" VALUE 0x1D0CD0 Kw_Ws16 327.6800 InjMass -327.6800 0.00 FORMAT "%8.4" EXTENDED_LIMITS -327.6800 327.6700 /end CHARACTERISTIC
/begin CHARACTERISTIC FlMng_FullLdRglPKp_CUR "Drehzahlabhängige P-Parameter der Vollastregelung" CURVE 0x1D0CD2 Kl_Xs16_Ws16 399.9878 Kp_LmbdRec2InjMass_1 0.00 399.9878 FORMAT "%8.4" EXTENDED_LIMITS -400.0000 399.9878
 /begin AXIS_DESCR STD_AXIS Eng_nAvrg EngN 7 0.00 6000.000 FORMAT "%8.3" EXTENDED_LIMITS -32768.00 32767.00 DEPOSIT ABSOLUTE /end AXIS_DESCR
/end CHARACTERISTIC
/begin CHARACTERISTIC FlMng_mAirPerCylMin_C "untere Begrenzung der Luftmasse" VALUE 0x1D0488 Kw_Ws16 6553.500 AirMassPerCyl -3276.800 3276.700 FORMAT "%8.3" /end CHARACTERISTIC
/begin CHARACTERISTIC FlMng_pIATCorr_MAP "Kennfeld zur Korrektur Druck f. Rauchbegrenzung" MAP 0x1D0D3A Kf_Xs16_Ys16_Ws16 3500.000 Pres_hPa 0.00 3500.000 FORMAT "%8.3" EXTENDED_LIMITS -32768.00 32767.00
 /begin AXIS_DESCR STD_AXIS FlMng_pBPAPCorr_mp Pres_hPa 16 0.00 3500.000 FORMAT "%8.3" EXTENDED_LIMITS -32768.00 32767.00 DEPOSIT ABSOLUTE /end AXIS_DESCR
 /begin AXIS_DESCR STD_AXIS IATSCD_tAir Temp_Cels 10 -50.14000 199.8600 FORMAT "%8.4" EXTENDED_LIMITS -3549.940 3003.560 DEPOSIT ABSOLUTE /end AXIS_DESCR
/end CHARACTERISTIC
/begin CHARACTERISTIC FlMng_qAFSCDSmoke_MAP "Rauchkennfeld" MAP 0x1D0EB2 Kf_Xs16_Ys16_Ws16 327.6700 InjMass 0.00 327.6700 FORMAT "%8.4" EXTENDED_LIMITS -327.6800 327.6700
 /begin AXIS_DESCR STD_AXIS Eng_nAvrg EngN 16 0.00 6000.000 FORMAT "%8.3" EXTENDED_LIMITS -32768.00 32767.00 DEPOSIT ABSOLUTE /end AXIS_DESCR
 /begin AXIS_DESCR STD_AXIS AFSCD_mAirPerCylFlt AirMassPerCyl 13 0.00 2000.000 FORMAT "%8.3" EXTENDED_LIMITS -3276.800 3276.700 DEPOSIT ABSOLUTE /end AXIS_DESCR
/end CHARACTERISTIC
/begin CHARACTERISTIC FlMng_qAFSCDtEngSmoke0_MAP "Kennfeld 0 aus Rauchkennraum" MAP 0x1D1090 Kf_Xs16_Ys16_Ws16 327.6700 InjMass 0.00 327.6700 FORMAT "%8.4" EXTENDED_LIMITS -327.6800 327.6700
 /begin AXIS_DESCR STD_AXIS Eng_nAvrg EngN 2 0.00 6000.000 FORMAT "%8.3" EXTENDED_LIMITS -32768.00 32767.00 DEPOSIT ABSOLUTE /end AXIS_DESCR
 /begin AXIS_DESCR STD_AXIS AFSCD_mAirPerCylFlt AirMassPerCyl 2 0.00 2000.000 FORMAT "%8.3" EXTENDED_LIMITS -3276.800 3276.700 DEPOSIT ABSOLUTE /end AXIS_DESCR
/end CHARACTERISTIC
/begin CHARACTERISTIC FlMng_qAFSCDtEngSmoke1_MAP "Kennfeld 1 aus Rauchkennraum" MAP 0x1D10A4 Kf_Xs16_Ys16_Ws16 327.6700 InjMass 0.00 327.6700 FORMAT "%8.4" EXTENDED_LIMITS -327.6800 327.6700
 /begin AXIS_DESCR STD_AXIS Eng_nAvrg EngN 2 0.00 6000.000 FORMAT "%8.3" EXTENDED_LIMITS -32768.00 32767.00 DEPOSIT ABSOLUTE /end AXIS_DESCR
 /begin AXIS_DESCR STD_AXIS AFSCD_mAirPerCylFlt AirMassPerCyl 2 0.00 2000.000 FORMAT "%8.3" EXTENDED_LIMITS -3276.800 3276.700 DEPOSIT ABSOLUTE /end AXIS_DESCR
/end CHARACTERISTIC
/begin CHARACTERISTIC FlMng_qAFSCDtEngSmoke2_MAP "Kennfeld 2 aus Rauchkennraum" MAP 0x1D10B8 Kf_Xs16_Ys16_Ws16 327.6700 InjMass 0.00 327.6700 FORMAT "%8.4" EXTENDED_LIMITS -327.6800 327.6700
 /begin AXIS_DESCR STD_AXIS Eng_nAvrg EngN 2 0.00 6000.000 FORMAT "%8.3" EXTENDED_LIMITS -32768.00 32767.00 DEPOSIT ABSOLUTE /end AXIS_DESCR
 /begin AXIS_DESCR STD_AXIS AFSCD_mAirPerCylFlt AirMassPerCyl 2 0.00 2000.000 FORMAT "%8.3" EXTENDED_LIMITS -3276.800 3276.700 DEPOSIT ABSOLUTE /end AXIS_DESCR
/end CHARACTERISTIC
/begin CHARACTERISTIC FlMng_qLimSmk_Vector "Konfigurationslabel für Bypass message" VALUE 0x1C0A74 Kw_Wu8 255.0 OneToOne 0.00 255.0 FORMAT "%5.1" /end CHARACTERISTIC
/begin CHARACTERISTIC FlMng_qLimSmk_Channel "Konfigurationslabel für Bypass message" VALUE 0x1C0A75 Kw_Wu8 255.0 OneToOne 0.00 255.0 FORMAT "%5.1" /end CHARACTERISTIC
/begin CHARACTERISTIC FlMng_qPresSmoke_MAP "Kennfeld für Rauchmenge aus Druck" MAP 0x1D10CC Kf_Xs16_Ys16_Ws16 327.6700 InjMass 0.00 327.6700 FORMAT "%8.4" EXTENDED_LIMITS -327.6800 327.6700
 /begin AXIS_DESCR STD_AXIS Eng_nAvrg EngN 16 0.00 6000.000 FORMAT "%8.3" EXTENDED_LIMITS -32768.00 32767.00 DEPOSIT ABSOLUTE /end AXIS_DESCR
 /begin AXIS_DESCR STD_AXIS FlMng_pIATCorr_mp Pres_hPa 13 0.00 3500.000 FORMAT "%8.3" EXTENDED_LIMITS -32768.00 32767.00 DEPOSIT ABSOLUTE /end AXIS_DESCR
/end CHARACTERISTIC
/begin CHARACTERISTIC FlMng_qTempFuel_MAP "Kennfeld für motortemperaturabhängige Vollastkorrektur" MAP 0x1D12AA Kf_Xs16_Ys16_Ws16 655.0000 dQnt_dT1 0.00 655.0000 FORMAT "%8.4" EXTENDED_LIMITS -655.3600 655.3400
 /begin AXIS_DESCR STD_AXIS Eng_nAvrg EngN 10 0.00 6000.000 FORMAT "%8.3" EXTENDED_LIMITS -32768.00 32767.00 DEPOSIT ABSOLUTE /end AXIS_DESCR
 /begin AXIS_DESCR STD_AXIS InjCtl_qAct InjMass 10 0.00 327.6700 FORMAT "%8.4" EXTENDED_LIMITS -327.6800 327.6700 DEPOSIT ABSOLUTE /end AXIS_DESCR
/end CHARACTERISTIC
/begin CHARACTERISTIC FlMng_rLmbdPartLd_CUR "Kennlinie für PWG abhängige Rauchbegrenzung" CURVE 0x1D048A Kl_Xs16_Ws16 32.00000 lambda 0.00 32.00000 FORMAT "%8.5" EXTENDED_LIMITS -32.76800 32.76700
 /begin AXIS_DESCR STD_AXIS AccPed_rChkdVal Prc 12 -327.6800 327.6700 FORMAT "%8.4" DEPOSIT ABSOLUTE /end AXIS_DESCR
/end CHARACTERISTIC
/begin CHARACTERISTIC FlMng_rLmbdRecDvtMax_C "Maximale reziproke Lamda-Regelabweichung der Volllastregelung" VALUE 0x1D0CF0 Kw_Ws16 1.330000 lambdaRec 0.00 1.330000 FORMAT "%8.6" EXTENDED_LIMITS -3.276800 3.276700 /end CHARACTERISTIC
/begin CHARACTERISTIC FlMng_rLmbdRecDvtMin_C "Minimale reziproke Lambda-Regelabweichung der Vollastregelung" VALUE 0x1D0CF2 Kw_Ws16 1.330000 lambdaRec -1.330000 0.00 FORMAT "%8.6" EXTENDED_LIMITS -3.276800 3.276700 /end CHARACTERISTIC
/begin CHARACTERISTIC FlMng_rLmbdSmkEGT_MAP "Kennfeld zur Ermittlung des Lambda-Werts der Rauchbegrenzung während der Partikelfilterregeneration" MAP 0x1D04BC Kf_Xs16_Ys16_Ws16 32.00000 lambda 0.00 32.00000 FORMAT "%8.5" EXTENDED_LIMITS -32.76800 32.76700
 /begin AXIS_DESCR STD_AXIS Eng_nAvrg EngN 12 0.00 6000.000 FORMAT "%8.3" EXTENDED_LIMITS -32768.00 32767.00 DEPOSIT ABSOLUTE /end AXIS_DESCR
 /begin AXIS_DESCR STD_AXIS AFSCD_mAirPerCylFlt AirMassPerCyl 12 0.00 2500.000 FORMAT "%8.3" EXTENDED_LIMITS -3276.800 3276.700 DEPOSIT ABSOLUTE /end AXIS_DESCR
/end CHARACTERISTIC
/begin CHARACTERISTIC FlMng_rLmbdSmkLim0_MAP "Kennfeld 0 aus Kennraum zur Ermittlung des Lambda-Werts der Rauchbegrenzung" MAP 0x1D0610 Kf_Xs16_Ys16_Ws16 32.00000 lambda 0.00 32.00000 FORMAT "%8.5" EXTENDED_LIMITS -32.76800 32.76700
 /begin AXIS_DESCR STD_AXIS Eng_nAvrg EngN 16 0.00 6000.000 FORMAT "%8.3" EXTENDED_LIMITS -32768.00 32767.00 DEPOSIT ABSOLUTE /end AXIS_DESCR
 /begin AXIS_DESCR STD_AXIS AFSCD_mAirPerCylFlt AirMassPerCyl 13 0.00 2500.000 FORMAT "%8.3" EXTENDED_LIMITS -3276.800 3276.700 DEPOSIT ABSOLUTE /end AXIS_DESCR
/end CHARACTERISTIC
/begin CHARACTERISTIC FlMng_rLmbdSmkLim1_MAP "Kennfeld 1 aus Kennraum zur Ermittlung des Lambda-Werts der Rauchbegrenzung" MAP 0x1D07EE Kf_Xs16_Ys16_Ws16 32.00000 lambda 0.00 32.00000 FORMAT "%8.5" EXTENDED_LIMITS -32.76800 32.76700
 /begin AXIS_DESCR STD_AXIS Eng_nAvrg EngN 16 0.00 6000.000 FORMAT "%8.3" EXTENDED_LIMITS -32768.00 32767.00 DEPOSIT ABSOLUTE /end AXIS_DESCR
 /begin AXIS_DESCR STD_AXIS AFSCD_mAirPerCylFlt AirMassPerCyl 13 0.00 2500.000 FORMAT "%8.3" EXTENDED_LIMITS -3276.800 3276.700 DEPOSIT ABSOLUTE /end AXIS_DESCR
/end CHARACTERISTIC
/begin CHARACTERISTIC FlMng_rLmbdSmkLim2_MAP "Kennfeld 2 aus Kennraum zur Ermittlung des Lambda-Werts der Rauchbegrenzung" MAP 0x1D09CC Kf_Xs16_Ys16_Ws16 32.00000 lambda 0.00 32.00000 FORMAT "%8.5" EXTENDED_LIMITS -32.76800 32.76700
 /begin AXIS_DESCR STD_AXIS Eng_nAvrg EngN 16 0.00 6000.000 FORMAT "%8.3" EXTENDED_LIMITS -32768.00 32767.00 DEPOSIT ABSOLUTE /end AXIS_DESCR
 /begin AXIS_DESCR STD_AXIS AFSCD_mAirPerCylFlt AirMassPerCyl 13 0.00 2500.000 FORMAT "%8.3" EXTENDED_LIMITS -3276.800 3276.700 DEPOSIT ABSOLUTE /end AXIS_DESCR
/end CHARACTERISTIC
/begin CHARACTERISTIC FlMng_rLmbdSmkLimNr_CUR "Kennlinie zur Interpolation zwischen den Kennfeldern FlMng_rLmbdSmkLim0-2" CURVE 0x1D0BAA Kl_Xs16_Ws16 2.000000 Map_Select 0.00 2.000000 FORMAT "%8.6" EXTENDED_LIMITS -128.0000 127.9961
 /begin AXIS_DESCR STD_AXIS Eng_tEng Temp_Cels 3 -50.14000 199.8600 FORMAT "%8.4" EXTENDED_LIMITS -3549.940 3003.560 DEPOSIT ABSOLUTE /end AXIS_DESCR
/end CHARACTERISTIC
/begin CHARACTERISTIC FlMng_rLmbdSmkSOE_MAP "Lambdakorrekturwert durch Ansteuerbeginn - Frühverstellung" MAP 0x1D0BB8 Kf_Xs16_Ys16_Ws16 640.0000 lambda -320.0000 320.0000 FORMAT "%8.4" EXTENDED_LIMITS -32.76800 32.76700
 /begin AXIS_DESCR STD_AXIS Eng_nAvrg EngN 16 0.00 6000.000 FORMAT "%8.3" EXTENDED_LIMITS -32768.00 32767.00 DEPOSIT ABSOLUTE /end AXIS_DESCR
 /begin AXIS_DESCR STD_AXIS InjCrv_phiMIPCRCor AngleCrS 6 -90.00000 90.00000 FORMAT "%8.5" EXTENDED_LIMITS -768.0000 767.9766 DEPOSIT ABSOLUTE /end AXIS_DESCR
/end CHARACTERISTIC
/begin CHARACTERISTIC FlMng_dqSlpPos_C "Positive Steigung der Abklingrampe der Vollastregelung" VALUE 0x1D0CF4 Kw_Wu32 655359.499817 RmpInjMass 0.500030517578 655359.999847 FORMAT "%13.6" EXTENDED_LIMITS 0.00 655359.999847 /end CHARACTERISTIC
/begin CHARACTERISTIC FlMng_dqSlpNeg_C "Negative Steigung der Abklingrampe der Vollastregelung" VALUE 0x1D0CF8 Kw_Wu32 655359.499817 RmpInjMass 0.500030517578 655359.999847 FORMAT "%13.6" EXTENDED_LIMITS 0.00 655359.999847 /end CHARACTERISTIC
/begin CHARACTERISTIC FlMng_stEGTRglOff_C "Maske zur Abschaltung des Reglers bei Regenerationsbetrieb bei Abgasnachbehandlung" VALUE 0x1D0CFC Kw_Ws32 4294967295.00 OneToOne -2147483648.00 2147483647.00 FORMAT "%13.2" /end CHARACTERISTIC
/begin CHARACTERISTIC FlMng_stRgnMsk_C "Maske zur Umschaltung der Rauchbegrenzung bei Regenerationsbetrieb des Parikelfilters" VALUE 0x1D0CA8 Kw_Wu32 4294967295.00 OneToOne 0.00 4294967295.00 FORMAT "%13.2" /end CHARACTERISTIC
/begin CHARACTERISTIC FlMng_swtAirTemp_C "Temperaturauswahlschalter für PWG abhängige Rauchbegrenzung" VALUE 0x1D0CAC Kw_Wu8 1.000 OneToOne 0.00 1.000 FORMAT "%5.3" EXTENDED_LIMITS 0.00 255.0 /end CHARACTERISTIC
/begin CHARACTERISTIC FlMng_swtBPAP_C "Schalter für Eingangsdruck Rauchbegrenzung" VALUE 0x1D139E Kw_Wu8 1.000 OneToOne 0.00 1.000 FORMAT "%5.3" EXTENDED_LIMITS 0.00 255.0 /end CHARACTERISTIC
/begin CHARACTERISTIC FlMng_swtFullLdRglVal_C "Schalter um Volllastregelung zu (de)aktivieren" VALUE 0x1D0D00 Kw_Wu8 0.00 OneToOne 0.00 0.00 FORMAT "%5.2" EXTENDED_LIMITS 0.00 255.0 /end CHARACTERISTIC
/begin CHARACTERISTIC FlMng_swtFullLdRglType_C "Typ des Schalters um Volllastregelung zu (de)aktivieren" VALUE 0x1D0D01 Kw_Wu8 1.000 OneToOne 1.000 2.000 FORMAT "%5.3" EXTENDED_LIMITS 0.00 255.0 /end CHARACTERISTIC
/begin CHARACTERISTIC FlMng_swtMIAPSSrcSel_C "Auswahlschalter für Druck für Korrektur durch Ansteuerbeginn - Frühverstellung" VALUE 0x1D0CAD Kw_Wu8 1.000 OneToOne 0.00 1.000 FORMAT "%5.3" EXTENDED_LIMITS 0.00 255.0 /end CHARACTERISTIC
/begin CHARACTERISTIC FlMng_swtqLimSmkQ_C "Auswahl Rauchbegrenzung über Lambda (0) oder Menge (1)" VALUE 0x1D0CAE Kw_Wu8 1.000 OneToOne 0.00 1.000 FORMAT "%5.3" EXTENDED_LIMITS 0.00 255.0 /end CHARACTERISTIC
/begin CHARACTERISTIC FlMng_swtSmokeSpace_C "Auswahl Rauchbegrenzung über Kennfeld (0) oder Kennraum (1)" VALUE 0x1D139F Kw_Wu8 1.000 OneToOne 0.00 1.000 FORMAT "%5.3" EXTENDED_LIMITS 0.00 255.0 /end CHARACTERISTIC
/begin CHARACTERISTIC FlMng_swtSmokeVariant_C "Schalter Rauchbegrenzung zwischen Luftmasse oder Luftdruck" VALUE 0x1D13A0 Kw_Wu8 1.000 OneToOne 0.00 1.000 FORMAT "%5.3" EXTENDED_LIMITS 0.00 255.0 /end CHARACTERISTIC
/begin CHARACTERISTIC FlMng_tFueRef_C "Referenztemperatur Treibstoff für Rauchbegrenzung" VALUE 0x1D13A2 Kw_Ws16 200.0000 Temp_Cels -50.14000 149.8600 FORMAT "%8.4" EXTENDED_LIMITS -3549.940 3003.560 /end CHARACTERISTIC
/begin CHARACTERISTIC FlMng_tiFullLdRglDel_CUR "Drehzahlabhängige Einschaltverzögerung der Vollastregelung" CURVE 0x1D0D02 Kl_Xs16_Ws16 327670.0 Time_ms 0.00 327670.0 FORMAT "%8.1" EXTENDED_LIMITS -327680.0 327670.0
 /begin AXIS_DESCR STD_AXIS Eng_nAvrg EngN 10 0.00 6000.000 FORMAT "%8.3" EXTENDED_LIMITS -32768.00 32767.00 DEPOSIT ABSOLUTE /end AXIS_DESCR
/end CHARACTERISTIC
/begin CHARACTERISTIC FlMng_trqEpsLim_C "halbe Intervallbreite für Abfrage der Abschaltbedingung" VALUE 0x1D0D2C Kw_Ws16 3276.700 Trq 0.00 3276.700 FORMAT "%8.3" EXTENDED_LIMITS -3276.800 3276.700 /end CHARACTERISTIC
/begin CHARACTERISTIC FlMng_trqEps_C "Hysterese für Momentenschwellwert der Vollastregelung" VALUE 0x1D0D2E Kw_Ws16 3276.700 Trq 0.00 3276.700 FORMAT "%8.3" EXTENDED_LIMITS -3276.800 3276.700 /end CHARACTERISTIC
/begin CHARACTERISTIC FlPpCD_DebExcTempDef_C "Defekterkennungszeit Übertemperatur für FlPpCD Endstufe" VALUE 0x1D13A4 Kw_Wu16 655350.0 Time_ms 0.00 655350.0 FORMAT "%8.1" /end CHARACTERISTIC
/begin CHARACTERISTIC FlPpCD_DebExcTempOk_C "Heilzeit Übertemperatur für FlPpCD Endstufe" VALUE 0x1D13A6 Kw_Wu16 655350.0 Time_ms 0.00 655350.0 FORMAT "%8.1" /end CHARACTERISTIC
/begin CHARACTERISTIC FlPpCD_DebNoLoadDef_C "Defekterkennungszeit Leerlauf für FlPpCD Endstufe" VALUE 0x1D13A8 Kw_Wu16 655350.0 Time_ms 0.00 655350.0 FORMAT "%8.1" /end CHARACTERISTIC
/begin CHARACTERISTIC FlPpCD_DebNoLoadOk_C "Heilzeit Leerlauf für FlPpCD Endstufe" VALUE 0x1D13AA Kw_Wu16 655350.0 Time_ms 0.00 655350.0 FORMAT "%8.1" /end CHARACTERISTIC
/begin CHARACTERISTIC FlPpCD_DebShortCircBatDef_C "Defekterkennungszeit Kurzschluß Batterie für FlPpCD Endstufe" VALUE 0x1D13AC Kw_Wu16 655350.0 Time_ms 0.00 655350.0 FORMAT "%8.1" /end CHARACTERISTIC
/begin CHARACTERISTIC FlPpCD_DebShortCircBatOk_C "Heilzeit Kurzschluß Batterie für FlPpCD Endstufe" VALUE 0x1D13AE Kw_Wu16 655350.0 Time_ms 0.00 655350.0 FORMAT "%8.1" /end CHARACTERISTIC
/begin CHARACTERISTIC FlPpCD_DebShortCircGndDef_C "Defekterkennungszeit Kurzschluß Masse für FlPpCD Endstufe" VALUE 0x1D13B0 Kw_Wu16 655350.0 Time_ms 0.00 655350.0 FORMAT "%8.1" /end CHARACTERISTIC
/begin CHARACTERISTIC FlPpCD_DebShortCircGndOk_C "Heilzeit Kurzschluß Masse für FlPpCD Endstufe" VALUE 0x1D13B2 Kw_Wu16 655350.0 Time_ms 0.00 655350.0 FORMAT "%8.1" /end CHARACTERISTIC
/begin CHARACTERISTIC FlPpCD_stInvOut_C "Invertierung des Ausgangssignales" VALUE 0x1D13B4 Kw_Wu8 1.000 OneToOne 0.00 1.000 FORMAT "%5.3" EXTENDED_LIMITS 0.00 255.0 /end CHARACTERISTIC
/begin CHARACTERISTIC FlPpCD_swtFlPpAct_C "Kraftstoffumwälzpumpe AKTIV/INAKTIV" VALUE 0x1D13B5 Kw_Wu8 1.000 OneToOne 0.00 1.000 FORMAT "%5.3" EXTENDED_LIMITS 0.00 255.0 /end CHARACTERISTIC
/begin CHARACTERISTIC FlPpCD_swtFlPpActVal_C "Wert des EEPROM Schalters fuer die Kraftstoffumwaelzpumpe" VALUE 0x1D13B6 Kw_Wu8 1.000 OneToOne 0.00 1.000 FORMAT "%5.3" EXTENDED_LIMITS 0.00 255.0 /end CHARACTERISTIC
/begin CHARACTERISTIC FlPpCD_swtFlPpActType_C "Type des Schalters fuer die Kraftstoffumwaelzpumpe" VALUE 0x1D13B7 Kw_Wu8 0.00 OneToOne 1.000 1.000 FORMAT "%5.3" EXTENDED_LIMITS 0.00 255.0 /end CHARACTERISTIC
/begin CHARACTERISTIC FlPpCD_tiFlPpcheckDfpTmr_C "FlPp Einschaltzeit vor erneuter Fehlerpruefung" VALUE 0x1D13B8 Kw_Wu16 655350.0 Time_ms 0.00 655350.0 FORMAT "%8.1" /end CHARACTERISTIC
/begin CHARACTERISTIC FlPpCD_tiFlPpOFFTmr_C "Abschaltzeit fuer FlPp Endstufe" VALUE 0x1D13BA Kw_Wu16 655350.0 Time_ms 0.00 655350.0 FORMAT "%8.1" /end CHARACTERISTIC
/begin CHARACTERISTIC FlSCD_uSRCMin_C "Untere Schwelle für den SRC-Min" VALUE 0x1D13BC Kw_Ws16 5200.391 Volt 0.00 5200.391 FORMAT "%8.3" EXTENDED_LIMITS -160156.4 160151.5 /end CHARACTERISTIC
/begin CHARACTERISTIC FlSCD_uSRCMax_C "Obere Schwelle für SRC-Max" VALUE 0x1D13BE Kw_Ws16 5200.391 Volt 0.00 5200.391 FORMAT "%8.3" EXTENDED_LIMITS -160156.4 160151.5 /end CHARACTERISTIC
/begin CHARACTERISTIC FlSCD_volTotalLin_CUR "Kennlinie um Pegelmesswert in Kraftstoffvolumen umzuwandeln" CURVE 0x1D13C0 Kl_Xs16_Ws16 300.0000 Fl_Half_L 0.00 300.0000 FORMAT "%8.4" EXTENDED_LIMITS -16384.00 16383.50
 /begin AXIS_DESCR STD_AXIS FlSCD_uLvlRawT1 Volt 25 0.00 5200.391 FORMAT "%8.3" EXTENDED_LIMITS -160156.4 160151.5 DEPOSIT ABSOLUTE /end AXIS_DESCR
/end CHARACTERISTIC
/begin CHARACTERISTIC FlSCD_DebSigDef_C "Defektentprellung fuer CAN-Fehler" VALUE 0x1D1426 Kw_Wu16 655350.0 Time_ms 0.00 655350.0 FORMAT "%8.1" /end CHARACTERISTIC
/begin CHARACTERISTIC FlSCD_DebSigOK_C "Heilungsentprellung fuer CAN-Fehler" VALUE 0x1D1428 Kw_Wu16 655350.0 Time_ms 0.00 655350.0 FORMAT "%8.1" /end CHARACTERISTIC
/begin CHARACTERISTIC FlSCD_DebSRCMaxDef_C "Error debounce for SRC-High error" VALUE 0x1D142A Kw_Wu16 655350.0 Time_ms 0.00 655350.0 FORMAT "%8.1" /end CHARACTERISTIC
/begin CHARACTERISTIC FlSCD_DebSRCMaxOk_C "Healing debounce for SRC-High error" VALUE 0x1D142C Kw_Wu16 655350.0 Time_ms 0.00 655350.0 FORMAT "%8.1" /end CHARACTERISTIC
/begin CHARACTERISTIC FlSCD_DebSRCMinDef_C "Error debounce for SRC-Low error" VALUE 0x1D142E Kw_Wu16 655350.0 Time_ms 0.00 655350.0 FORMAT "%8.1" /end CHARACTERISTIC
/begin CHARACTERISTIC FlSCD_DebSRCMinOk_C "Healing debounce for SRC-Low error" VALUE 0x1D1430 Kw_Wu16 655350.0 Time_ms 0.00 655350.0 FORMAT "%8.1" /end CHARACTERISTIC
/begin CHARACTERISTIC FlSCD_dvolRmpSlpUp_C "ramp slope up" VALUE 0x1D1434 Kw_Wu32 32767999.9924 RmpFuel 0.00 32767999.9924 FORMAT "%13.4" /end CHARACTERISTIC
/begin CHARACTERISTIC FlSCD_dvolRmpSlpDwn_C "ramp slope down" VALUE 0x1D1438 Kw_Wu32 32767999.9924 RmpFuel 0.00 32767999.9924 FORMAT "%13.4" /end CHARACTERISTIC
/begin CHARACTERISTIC FlSCD_swtFuelSens_C "Schalter für Konstantwert Kraftstoffvolumen" VALUE 0x1D143C Kw_Wu8 1.000 OneToOne 0.00 1.000 FORMAT "%5.3" EXTENDED_LIMITS 0.00 255.0 /end CHARACTERISTIC
/begin CHARACTERISTIC FlSCD_swtSig_C "Schalter für Eingangssignal ADC oder CAN für Tankstandssensor" VALUE 0x1D143D Kw_Wu8 1.000 OneToOne 0.00 1.000 FORMAT "%5.3" EXTENDED_LIMITS 0.00 255.0 /end CHARACTERISTIC
/begin CHARACTERISTIC FlSCD_stSensIDWord_C "Geberkennwort FlSCD" VALUE 0x1D143E Kw_Wu16 7.000000 OneToOne 0.00 7.000000 FORMAT "%8.6" EXTENDED_LIMITS 0.00 65535.00 /end CHARACTERISTIC
/begin CHARACTERISTIC FlSCD_volTotalDflVal_C "default value if error is there" VALUE 0x1D1440 Kw_Ws16 300.0000 Fl_Half_L 0.00 300.0000 FORMAT "%8.4" EXTENDED_LIMITS -16384.00 16383.50 /end CHARACTERISTIC
/begin CHARACTERISTIC FlSCD_volTotal_C "Konstantwert für Kraftstoffvolumen am Prüfstand" VALUE 0x1D1442 Kw_Ws16 300.0000 Fl_Half_L 0.00 300.0000 FORMAT "%8.4" EXTENDED_LIMITS -16384.00 16383.50 /end CHARACTERISTIC
/begin CHARACTERISTIC FlSys_nHysXLow_C "Untere Schaltdrehzahl der Drehzahlhysterese" VALUE 0x1D149C Kw_Ws16 5960.000 EngN 40.00000 6000.000 FORMAT "%8.3" EXTENDED_LIMITS -32768.00 32767.00 /end CHARACTERISTIC
/begin CHARACTERISTIC FlSys_nHysXHigh_C "Obere Schaltdrehzahl der Drehzahlhysterese" VALUE 0x1D149E Kw_Ws16 5960.000 EngN 40.00000 6000.000 FORMAT "%8.3" EXTENDED_LIMITS -32768.00 32767.00 /end CHARACTERISTIC
/begin CHARACTERISTIC FlSys_stnHysYLow_C "Ausgang Drehzahlhysterese unterer Wert" VALUE 0x1D14A0 Kw_Ws16 1.000000 OneToOne 0.00 1.000000 FORMAT "%8.6" EXTENDED_LIMITS -32768.00 32767.00 /end CHARACTERISTIC
/begin CHARACTERISTIC FlSys_stnHysYHigh_C "Ausgang Drehzahlhysterese oberer Wert" VALUE 0x1D14A2 Kw_Ws16 1.000000 OneToOne 0.00 1.000000 FORMAT "%8.6" EXTENDED_LIMITS -32768.00 32767.00 /end CHARACTERISTIC
/begin CHARACTERISTIC FlSys_tHysXLow_C "Untere Schalttemperatur der Temperaturhysterese" VALUE 0x1D14A4 Kw_Ws16 200.0000 Temp_Cels -50.14000 149.8600 FORMAT "%8.4" EXTENDED_LIMITS -3549.940 3003.560 /end CHARACTERISTIC
/begin CHARACTERISTIC FlSys_tHysXHigh_C "Obere Schalttemperatur der Temperaturhysterese" VALUE 0x1D14A6 Kw_Ws16 200.0000 Temp_Cels -50.14000 149.8600 FORMAT "%8.4" EXTENDED_LIMITS -3549.940 3003.560 /end CHARACTERISTIC
/begin CHARACTERISTIC FlSys_sttHysYLow_C "Ausgang Temperaturhysterese unterer Wert" VALUE 0x1D14A8 Kw_Ws16 1.000000 OneToOne 0.00 1.000000 FORMAT "%8.6" EXTENDED_LIMITS -32768.00 32767.00 /end CHARACTERISTIC
/begin CHARACTERISTIC FlSys_sttHysYHigh_C "Ausgang Temperaturhysterese oberer Wert" VALUE 0x1D14AA Kw_Ws16 1.000000 OneToOne 0.00 1.000000 FORMAT "%8.6" EXTENDED_LIMITS -32768.00 32767.00 /end CHARACTERISTIC
/begin CHARACTERISTIC FlSys_nAvrgUpLim_C "Obere Grenze für Leerlaufdrehzahl" VALUE 0x1D1474 Kw_Ws16 65535.00 EngN -32768.00 32767.00 FORMAT "%8.2" /end CHARACTERISTIC
/begin CHARACTERISTIC FlSys_nDeflateMax_C "obere Drehzahlschwelle für die Entlueftung Niederdruckkreis" VALUE 0x1D146C Kw_Ws16 32767.00 EngN 0.00 32767.00 FORMAT "%8.2" EXTENDED_LIMITS -32768.00 32767.00 /end CHARACTERISTIC
/begin CHARACTERISTIC FlSys_nDeflateMin_C "untere Drehzahlschwelle für die Entlueftung Niederdruckkreis" VALUE 0x1D146E Kw_Ws16 32767.00 EngN 0.00 32767.00 FORMAT "%8.2" EXTENDED_LIMITS -32768.00 32767.00 /end CHARACTERISTIC
/begin CHARACTERISTIC FlSys_pDeflate_C "Raildruckschwelle für die Entlueftung Niederdruckkreis" VALUE 0x1D1470 Kw_Ws16 1800000. Pres_Rail 0.00 1800000. FORMAT "%8.0" EXTENDED_LIMITS -3276800. 3276700. /end CHARACTERISTIC
/begin CHARACTERISTIC FlSys_qCurrLoLim_C "Untere Bereichsgrenze für Leerlaufeinspritzmenge" VALUE 0x1D1476 Kw_Ws16 655.3500 InjMassCyc -327.6800 327.6700 FORMAT "%8.4" /end CHARACTERISTIC
/begin CHARACTERISTIC FlSys_qCurrUpLim_C "Obere Bereichsgrenze für Leerlaufeinspritzmenge" VALUE 0x1D1478 Kw_Ws16 655.3500 InjMassCyc -327.6800 327.6700 FORMAT "%8.4" /end CHARACTERISTIC
/begin CHARACTERISTIC FlSys_rhoFl_C "Kraftstoffdichte bei Normtemperatur" VALUE 0x1D1444 Kw_Ws16 999.9000 RhoFuel 0.1000000 1000.000 FORMAT "%8.3" EXTENDED_LIMITS -3276.800 3276.700 /end CHARACTERISTIC
/begin CHARACTERISTIC FlSys_rhoFl_CUR "temperaturabhängige Kraftstoffdichte" CURVE 0x1D1446 Kl_Xs16_Ws16 999.9000 RhoFuel 0.1000000 1000.000 FORMAT "%8.3" EXTENDED_LIMITS -3276.800 3276.700
 /begin AXIS_DESCR STD_AXIS FTSCD_tFuel Temp_Cels 9 -50.14000 149.8600 FORMAT "%8.4" EXTENDED_LIMITS -3549.940 3003.560 DEPOSIT ABSOLUTE /end AXIS_DESCR
/end CHARACTERISTIC
/begin CHARACTERISTIC FlSys_swtAutoMet_C "Softwareschalter zur Aktivierung der automatischen Additivdosierung" VALUE 0x1D147A Kw_Wu8 255.0 OneToOne 0.00 255.0 FORMAT "%5.1" /end CHARACTERISTIC
/begin CHARACTERISTIC FlSys_swtTempSel_C "Auswahl der Kraftstoffsystemtemperatur" VALUE 0x1D14B2 Kw_Wu8 2.000 OneToOne 0.00 2.000 FORMAT "%5.3" EXTENDED_LIMITS 0.00 255.0 /end CHARACTERISTIC
/begin CHARACTERISTIC FlSys_swtTempSensCfgVal_C "Schalterwert, ob Kraftstofftemperaturfühler vorhanden" VALUE 0x1D14B3 Kw_Wu8 1.000 OneToOne 0.00 1.000 FORMAT "%5.3" EXTENDED_LIMITS 0.00 255.0 /end CHARACTERISTIC
/begin CHARACTERISTIC FlSys_swtTempSensCfgType_C "Auswahl der Quelle des Softwareschalters ob Kraftstofftemperaturfühler vorhanden. (Datensatz oder EEPROM)" VALUE 0x1D14B4 Kw_Wu8 0.00 OneToOne 2.000 2.000 FORMAT "%5.3" EXTENDED_LIMITS 0.00 255.0 /end CHARACTERISTIC
/begin CHARACTERISTIC FlSys_tDfl_C "Ersatzwert für Kraftstoffsystemtemperatur" VALUE 0x1D14B6 Kw_Ws16 200.0000 Temp_Cels -50.14000 149.8600 FORMAT "%8.4" EXTENDED_LIMITS -3549.940 3003.560 /end CHARACTERISTIC
/begin CHARACTERISTIC FlSys_tiAddFlPpActv_C "Zeit der Aktivierung nach dem Startabwurf" VALUE 0x1D14AC Kw_Wu16 655350.0 Time_ms 0.00 655350.0 FORMAT "%8.1" /end CHARACTERISTIC
/begin CHARACTERISTIC FlSys_tiDeflateDel_C "Verzoegerungszeit für die Entlueftung Niederdruckkreis" VALUE 0x1D1472 Kw_Wu16 655350.0 Time_ms 0.00 655350.0 FORMAT "%8.1" /end CHARACTERISTIC
/begin CHARACTERISTIC FlSys_tiDelAddFlPpActv_C "Wartezeit fuer die Aktivierung nach dem Startabwurf" VALUE 0x1D14AE Kw_Wu16 655350.0 Time_ms 0.00 655350.0 FORMAT "%8.1" /end CHARACTERISTIC
/begin CHARACTERISTIC FlSys_tiRefuelDebHiLo_C "Entprellungszeit der Nachtankerkennung High/Low [s]" VALUE 0x1D147C Kw_Wu16 655350.0 TimeDeb 0.00 655350.0 FORMAT "%8.1" /end CHARACTERISTIC
/begin CHARACTERISTIC FlSys_tiRefuelDebLoHi_C "Entprellungszeit der Nachtankerkennung Low/High [s]" VALUE 0x1D147E Kw_Wu16 655350.0 TimeDeb 0.00 655350.0 FORMAT "%8.1" /end CHARACTERISTIC
/begin CHARACTERISTIC FlSys_tiDetRefuelEna_C "Wartezeit nach Systemstart bis Zustandsautomatenfreigabe [s]" VALUE 0x1D1480 Kw_Wu16 655140.0 Time_ms 0.00 655140.0 FORMAT "%8.1" EXTENDED_LIMITS 0.00 655350.0 /end CHARACTERISTIC
/begin CHARACTERISTIC FlSys_tiFuelVolStrtValPT1_C "Filterzeitkonstante des Füllstandsersatzwertfilters" VALUE 0x1D1484 Kw_Wu32 4294.9673 TimeDelay_s 0.0000010000000 4294.9673 FORMAT "%9.4" /end CHARACTERISTIC
/begin CHARACTERISTIC FlSys_tiMinFlPpActv_C "Zeit für die Mindesteinschaltdauer der Aktivierung" VALUE 0x1D14B0 Kw_Wu16 655350.0 Time_ms 0.00 655350.0 FORMAT "%8.1" /end CHARACTERISTIC
/begin CHARACTERISTIC FlSys_tiOvrRefuelDebHiLo_C "Entprellungszeit der Übertankerkennung [s]" VALUE 0x1D1488 Kw_Wu16 655350.0 TimeDeb 0.00 655350.0 FORMAT "%8.1" /end CHARACTERISTIC
/begin CHARACTERISTIC FlSys_tiOvrRefuelDebLoHi_C "Entprellungszeit der Übertankerkennung [s]" VALUE 0x1D148A Kw_Wu16 655350.0 TimeDeb 0.00 655350.0 FORMAT "%8.1" /end CHARACTERISTIC
/begin CHARACTERISTIC FlSys_tiFuelVolPT1_C "Filterzeitkonstante des Tankstandssignals [s]" VALUE 0x1D148C Kw_Wu32 4294.9673 TimeDelay_s 0.0000010000000 4294.9673 FORMAT "%9.4" /end CHARACTERISTIC
/begin CHARACTERISTIC FlSys_volOvrRefuelMin_C "Minimale zu erkennende Übertankmenge [l]" VALUE 0x1D1490 Kw_Ws16 32767.50 Fl_Half_L -16384.00 16383.50 FORMAT "%8.2" /end CHARACTERISTIC
/begin CHARACTERISTIC FlSys_volRefuelMin_C "Minimale zu erkennende Nachtankmenge [l]" VALUE 0x1D1492 Kw_Ws16 32767.50 Fl_Half_L -16384.00 16383.50 FORMAT "%8.2" /end CHARACTERISTIC
/begin CHARACTERISTIC FlSys_volTankMax_C "Maximal messbarer Tankfüllstand [l]" VALUE 0x1D1494 Kw_Ws16 32767.50 Fl_Half_L -16384.00 16383.50 FORMAT "%8.2" /end CHARACTERISTIC
/begin CHARACTERISTIC FlSys_volTankMin_C "Minimaler Tankfüllstand, unterhalb dessen die automatische Additivdosierung bei der Tankfüllstandsersatzfunktion aktiviert wird" VALUE 0x1D1496 Kw_Ws16 32767.50 Fl_Half_L -16384.00 16383.50 FORMAT "%8.2" /end CHARACTERISTIC
/begin CHARACTERISTIC FlSys_vVehMin_C "Geschwindigkeitsschwelle zur Nachtankerkennung [km/h]" VALUE 0x1D1498 Kw_Ws16 300.0000 Vel 0.00 300.0000 FORMAT "%8.4" EXTENDED_LIMITS -327.6800 327.6700 /end CHARACTERISTIC
/begin CHARACTERISTIC FMA_dfacSwtOffMax_C "Maximal zulässige Änderungsgeschwindigkeit der temperaturabhängigen Abschaltfaktoren" VALUE 0x1D1504 Kw_Wu32 49.9940011650 Rmp_Fact 0.00599958002567 50.0000007451 FORMAT "%13.10" EXTENDED_LIMITS 0.00 7999.99999814 /end CHARACTERISTIC
/begin CHARACTERISTIC FMA_dqThrs_C "Schwelle für Erkennung starker Einspritzmengenänderungen der FMA" VALUE 0x1D1508 Kw_Ws16 200.0000 InjMassSec 0.00 200.0000 FORMAT "%8.4" EXTENDED_LIMITS -327.6800 327.6700 /end CHARACTERISTIC
/begin CHARACTERISTIC FMA_drLmbdThrs_C "Schwelle für Erkennung starker Lambdaänderung der FMA" VALUE 0x1D150A Kw_Ws16 10.20000 lambdaSec -0.2000000 10.00000 FORMAT "%8.5" EXTENDED_LIMITS -32.76800 32.76700 /end CHARACTERISTIC
/begin CHARACTERISTIC FMA_facAirSwtOff_CUR "Kennlinie des ansauglufttemperaturabhängigen Abschaltfaktors der FMA" CURVE 0x1D150C Kl_Xs16_Ws16 1.000000 Fact 0.00 1.000000 FORMAT "%8.6" EXTENDED_LIMITS -4.000000 3.999878
 /begin AXIS_DESCR STD_AXIS IATSCD_tAir Temp_Cels 8 -50.14000 199.8600 FORMAT "%8.4" EXTENDED_LIMITS -3549.940 3003.560 DEPOSIT ABSOLUTE /end AXIS_DESCR
/end CHARACTERISTIC
/begin CHARACTERISTIC FMA_facEngSwtOff_CUR "Kennlinie des motortemperaturabhängigen Abschaltfaktors der FMA" CURVE 0x1D152E Kl_Xs16_Ws16 1.000000 Fact 0.00 1.000000 FORMAT "%8.6" EXTENDED_LIMITS -4.000000 3.999878
 /begin AXIS_DESCR STD_AXIS Eng_tEng Temp_Cels 8 -50.14000 149.8600 FORMAT "%8.4" EXTENDED_LIMITS -3549.940 3003.560 DEPOSIT ABSOLUTE /end AXIS_DESCR
/end CHARACTERISTIC
/begin CHARACTERISTIC FMA_facFlSwtOff_CUR "Kennlinie des kraftstofftemperaturabhängigen Abschaltfaktors der FMA" CURVE 0x1D1550 Kl_Xs16_Ws16 1.000000 Fact 0.00 1.000000 FORMAT "%8.6" EXTENDED_LIMITS -4.000000 3.999878
 /begin AXIS_DESCR STD_AXIS FTSCD_tFuel Temp_Cels 8 -50.14000 149.8600 FORMAT "%8.4" EXTENDED_LIMITS -3549.940 3003.560 DEPOSIT ABSOLUTE /end AXIS_DESCR
/end CHARACTERISTIC
/begin CHARACTERISTIC FMA_IKi_C "Integriererverstärkung der FMA bei Kleinsignalen" VALUE 0x1D14BC Kw_Wu32 4.00003045797 Ki 0.00 4.00003045797 FORMAT "%13.11" EXTENDED_LIMITS 0.00 999999.999767 /end CHARACTERISTIC
/begin CHARACTERISTIC FMA_IKiPos_C "Integriererverstärkung der FMA bei positiven Großsignalen" VALUE 0x1D14C0 Kw_Wu32 4.00003045797 Ki 0.00 4.00003045797 FORMAT "%13.11" EXTENDED_LIMITS 0.00 999999.999767 /end CHARACTERISTIC
/begin CHARACTERISTIC FMA_IKiNeg_C "Integriererverstärkung der FMA bei negativen Großsignalen" VALUE 0x1D14C4 Kw_Wu32 4.00003045797 Ki 0.00 4.00003045797 FORMAT "%13.11" EXTENDED_LIMITS 0.00 999999.999767 /end CHARACTERISTIC
/begin CHARACTERISTIC FMA_qIWinPos_C "Obere Kleinsignalgrenze für Integratoren der FMA" VALUE 0x1D14C8 Kw_Ws16 20.00000 InjMass 0.00 20.00000 FORMAT "%8.5" EXTENDED_LIMITS -327.6800 327.6700 /end CHARACTERISTIC
/begin CHARACTERISTIC FMA_qIWinNeg_C "Untere Kleinsignalgrenze für Integratoren der FMA" VALUE 0x1D14CA Kw_Ws16 20.00000 InjMass -20.00000 0.00 FORMAT "%8.5" EXTENDED_LIMITS -327.6800 327.6700 /end CHARACTERISTIC
/begin CHARACTERISTIC FMA_nGrid_C "Vektor der Drehzahlwerte der Kennfeldstützstellen" VAL_BLK 0x1D14CC Kwb_Ws16 4000.000 EngN 0.00 4000.000 FORMAT "%8.3" EXTENDED_LIMITS -32768.00 32767.00 NUMBER 8 /end CHARACTERISTIC
/begin CHARACTERISTIC FMA_nHysMap_C "Hysteresebreite für Lernpunktbestimmung des adaptiven Kennfelds in Drehzahlrichtung" VALUE 0x1D14DC Kw_Ws16 8000.000 EngN 0.00 8000.000 FORMAT "%8.3" EXTENDED_LIMITS -32768.00 32767.00 /end CHARACTERISTIC
/begin CHARACTERISTIC FMA_nThrs_C "Drehzahlschwelle für Schuberkennung der FMA" VALUE 0x1D1572 Kw_Ws16 5960.000 EngN 40.00000 6000.000 FORMAT "%8.3" EXTENDED_LIMITS -32768.00 32767.00 /end CHARACTERISTIC
/begin CHARACTERISTIC FMA_numNGrid_C "Anzahl der Drehzahlstützstellen des adaptiven Kenfelds" VALUE 0x1D14DE Kw_Wu8 6.000 OneToOne 2.000 8.000 FORMAT "%5.3" EXTENDED_LIMITS 0.00 255.0 /end CHARACTERISTIC
/begin CHARACTERISTIC FMA_numQGrid_C "Anzahl der Mengenstützstellen des adaptiven Kenfelds" VALUE 0x1D14DF Kw_Wu8 6.000 OneToOne 2.000 8.000 FORMAT "%5.3" EXTENDED_LIMITS 0.00 255.0 /end CHARACTERISTIC
/begin CHARACTERISTIC FMA_tiPT1_C "Zeitkonstante der PT1-Filter zur Filterung des aktuellen Mengenfehlers" VALUE 0x1D14E0 Kw_Wu32 4294.9663 TimeDelay_s 0.0010000001 4294.9673 FORMAT "%9.4" EXTENDED_LIMITS 0.0000010000000 4294.9673 /end CHARACTERISTIC
/begin CHARACTERISTIC FMA_qGrid_C "Vektor der Mengenwerte der Kennfeldstützstellen" VAL_BLK 0x1D14E4 Kwb_Ws16 80.00000 InjMass -40.00000 40.00000 FORMAT "%8.5" EXTENDED_LIMITS -327.6800 327.6700 NUMBER 8 /end CHARACTERISTIC
/begin CHARACTERISTIC FMA_qHysMap_C "Hysteresebreite für Lernpunktbestimmung des adaptiven Kennfelds in Mengenrichtung" VALUE 0x1D14F4 Kw_Ws16 80.00000 InjMass -40.00000 40.00000 FORMAT "%8.5" EXTENDED_LIMITS -327.6800 327.6700 /end CHARACTERISTIC
/begin CHARACTERISTIC FMA_qIncMap_C "Betrag der Veränderung der Kennfeldwerte bei der Glättung des adaptiven Kennfelds" VALUE 0x1D14F6 Kw_Ws16 0.1000000 InjMassCorr 0.00 0.1000000 FORMAT "%9.7" EXTENDED_LIMITS -32.76800 32.76700 /end CHARACTERISTIC
/begin CHARACTERISTIC FMA_qIntMax_C "Maximal zulässiger Wert für adaptierte Mengenfehler in den Lernpunkten , d.h. für Zustände der Integratoren und PT1-Glieder" VALUE 0x1D14F8 Kw_Ws16 80.00000 InjMass -40.00000 40.00000 FORMAT "%8.5" EXTENDED_LIMITS -327.6800 327.6700 /end CHARACTERISTIC
/begin CHARACTERISTIC FMA_qIntMin_C "Minimal zulässiger Wert für adaptierte Mengenfehler in den Lernpunkten , d.h. für Zustände der Integratoren und PT1-Glieder" VALUE 0x1D14FA Kw_Ws16 80.00000 InjMass -40.00000 40.00000 FORMAT "%8.5" EXTENDED_LIMITS -327.6800 327.6700 /end CHARACTERISTIC
/begin CHARACTERISTIC FMA_qSlpNMax_C "Betragsmäßig zulässige Steigung in Drehzahlrichtung für Glättung des adaptiven Kennfelds" VALUE 0x1D14FC Kw_Ws16 6.000000 InjMassNSlp -3.000000 3.000000 FORMAT "%8.6" EXTENDED_LIMITS -3.276800 3.276700 /end CHARACTERISTIC
/begin CHARACTERISTIC FMA_qSlpQMax_C "Betragsmäßig zulässige Steigung in Mengenrichtung für Glättung des adaptiven Kennfelds" VALUE 0x1D14FE Kw_Ws16 80.00000 InjMassQSlp -40.00000 40.00000 FORMAT "%8.5" EXTENDED_LIMITS -327.6800 327.6700 /end CHARACTERISTIC
/begin CHARACTERISTIC FMA_qThrs_C "Einspritzmengenschwelle für Schuberkennung der FMA" VALUE 0x1D1574 Kw_Ws16 40.00000 InjMass 0.00 40.00000 FORMAT "%8.5" EXTENDED_LIMITS -327.6800 327.6700 /end CHARACTERISTIC
/begin CHARACTERISTIC FMA_rLmbdThrsMax_C "Obere Grenze des für FMA zulässigen Lambdabereichs" VALUE 0x1D1576 Kw_Ws16 10.20000 lambda -0.2000000 10.00000 FORMAT "%8.5" EXTENDED_LIMITS -32.76800 32.76700 /end CHARACTERISTIC
/begin CHARACTERISTIC FMA_rLmbdThrsMin_C "Untere Grenze des für FMA zulässigen Lambdabereichs" VALUE 0x1D1578 Kw_Ws16 10.20000 lambda -0.2000000 10.00000 FORMAT "%8.5" EXTENDED_LIMITS -32.76800 32.76700 /end CHARACTERISTIC
/begin CHARACTERISTIC FMA_stRgnMsk_C "Bitmaske zur Abschaltung der FMA bei bestimmten Regenerationszuständen EGT_st" VALUE 0x1D157C Kw_Wu32 4294967295.00 OneToOne 0.00 4294967295.00 FORMAT "%13.2" /end CHARACTERISTIC
/begin CHARACTERISTIC FMA_swtIC_C "Schalter für Betriebsartauswahl der FMA (Indirect Control - Direct Control)" VALUE 0x1D14B8 Kw_Wu8 1.000 OneToOne 0.00 1.000 FORMAT "%5.3" EXTENDED_LIMITS 0.00 255.0 READ_ONLY /end CHARACTERISTIC
/begin CHARACTERISTIC FMA_swtOnFMA_C "Schalter zum Ein-/Ausschalten der gesamten FMA" VALUE 0x1D1580 Kw_Wu8 1.000 OneToOne 0.00 1.000 FORMAT "%5.3" EXTENDED_LIMITS 0.00 255.0 /end CHARACTERISTIC
/begin CHARACTERISTIC FMA_swtResetMap_C "Schalter für reinitialisierung des adaptiven Kennfelds der FMA (1- Reset)" VALUE 0x1D1500 Kw_Wu8 1.000 OneToOne 0.00 1.000 FORMAT "%5.3" EXTENDED_LIMITS 0.00 255.0 /end CHARACTERISTIC
/begin CHARACTERISTIC FMA_tiDLmbdThrs_C "Wartezeit bis der FMA- Lambdaänderungsstatus nach Ende der Lambdaänderung zurückgesetzt wird" VALUE 0x1D1582 Kw_Wu16 20.00000 Time_s 0.00 20.00000 FORMAT "%8.5" EXTENDED_LIMITS 0.00 655.3500 /end CHARACTERISTIC
/begin CHARACTERISTIC FMA_tiDynThrs_C "Wartezeit bis der FMA-Einspritzmengendynamikstatus nach Ende der Einspritzmengenänderung zurückgesetzt wird" VALUE 0x1D1584 Kw_Wu16 20.00000 Time_s 0.00 20.00000 FORMAT "%8.5" EXTENDED_LIMITS 0.00 655.3500 /end CHARACTERISTIC
/begin CHARACTERISTIC FMA_tiFaultRmp_C "Dauer des rampenförmigen Abschaltens der FMA bei schweren Systemfehlern" VALUE 0x1D1588 Kw_Wu32 40.0000000000 Time_s 0.00 40.0000000000 FORMAT "%13.10" EXTENDED_LIMITS 0.00 42949672.9500 /end CHARACTERISTIC
/begin CHARACTERISTIC FMA_tiLmbdDT1_C "Verzögerungszeitkonstante der Differentiation von Lambda in der FMA" VALUE 0x1D158C Kw_Wu32 3.9980385 TimeDelay_s 0.0010000001 3.9990385 FORMAT "%9.7" EXTENDED_LIMITS 0.0000010000000 4294.9673 /end CHARACTERISTIC
/begin CHARACTERISTIC FMA_tiLmbdThrs_C "Wartezeit bis der FMA- Lambdabereichstatus nach Bereichs-verletzung zurückgesetzt wird" VALUE 0x1D1590 Kw_Wu16 20.00000 Time_s 0.00 20.00000 FORMAT "%8.5" EXTENDED_LIMITS 0.00 655.3500 /end CHARACTERISTIC
/begin CHARACTERISTIC FMA_tiOvrRun_C "Wartezeit bis der FMA-Schbstatus nach Schubende zurückgesetzt wird" VALUE 0x1D1592 Kw_Wu16 20.00000 Time_s 0.00 20.00000 FORMAT "%8.5" EXTENDED_LIMITS 0.00 655.3500 /end CHARACTERISTIC
/begin CHARACTERISTIC FMA_tiQDT1_C "Vezögerungszeitkonstante der Differentiation der Einspritzmenge für Erkennung starker Mengenänderungen der FMA" VALUE 0x1D1594 Kw_Wu32 3.9980385 TimeDelay_s 0.0010000001 3.9990385 FORMAT "%9.7" EXTENDED_LIMITS 0.0000010000000 4294.9673 /end CHARACTERISTIC
/begin CHARACTERISTIC FMA_tiQLmbd_C "Verzögerungszeit nach einer Resetierung um die Adaption zuzulassen" VALUE 0x1D1598 Kw_Wu16 20.00000 Time_s 0.00 20.00000 FORMAT "%8.5" EXTENDED_LIMITS 0.00 655.3500 /end CHARACTERISTIC
/begin CHARACTERISTIC FMTC_eta0_C "fester Wirkungsgradfaktor zur Umrechnung Startmoment in Startmenge" VALUE 0x1D159C Kw_Ws16 100.0000 Eta 0.00 100.0000 FORMAT "%8.4" EXTENDED_LIMITS -256.0000 255.9922 /end CHARACTERISTIC
/begin CHARACTERISTIC FMTC_etaCurr_Vector "Bypass Label, nicht ändern!" VALUE 0x1C0A76 Kw_Wu8 255.0 OneToOne 0.00 255.0 FORMAT "%5.1" /end CHARACTERISTIC
/begin CHARACTERISTIC FMTC_etaCurr_Channel "Bypass Label, nicht ändern!" VALUE 0x1C0A77 Kw_Wu8 255.0 OneToOne 0.00 255.0 FORMAT "%5.1" /end CHARACTERISTIC
/begin CHARACTERISTIC FMTC_qStrt_Vector "Konfigurationslabel für Bypass Freischnitt" VALUE 0x1C0A78 Kw_Wu8 255.0 OneToOne 0.00 255.0 FORMAT "%5.1" /end CHARACTERISTIC
/begin CHARACTERISTIC FMTC_qStrt_Channel "Konfigurationslabel für Bypass Freischnitt" VALUE 0x1C0A79 Kw_Wu8 255.0 OneToOne 0.00 255.0 FORMAT "%5.1" /end CHARACTERISTIC
/begin CHARACTERISTIC FMTC_stRgnMsk1_C "applizierbare Bitmaske für Regenerationsstatus 1" VALUE 0x1D15A0 Kw_Wu32 4294967295.00 OneToOne 0.00 4294967295.00 FORMAT "%13.2" /end CHARACTERISTIC
/begin CHARACTERISTIC FMTC_stRgnMsk2_C "applizierbare Bitmaske für Regenerationsstatus 2" VALUE 0x1D15A4 Kw_Wu32 4294967295.00 OneToOne 0.00 4294967295.00 FORMAT "%13.2" /end CHARACTERISTIC
/begin CHARACTERISTIC FMTC_stRgnMsk3_C "applizierbare Bitmaske für Regenerationsstatus 3" VALUE 0x1D15A8 Kw_Wu32 4294967295.00 OneToOne 0.00 4294967295.00 FORMAT "%13.2" /end CHARACTERISTIC
/begin CHARACTERISTIC FMTC_stRgnMsk4_C "applizierbare Bitmaske für Regenerationsstatus 4" VALUE 0x1D15AC Kw_Wu32 4294967295.00 OneToOne 0.00 4294967295.00 FORMAT "%13.2" /end CHARACTERISTIC
/begin CHARACTERISTIC FMTC_tiRmpSlp_C "Rampenlaufzeit für Mehrfachschalter" VALUE 0x1D15B0 Kw_Wu32 31.775030303030302 TimeEGTRmp 0.99296969696969695 32.768000000000001 FORMAT "%19.16" EXTENDED_LIMITS 0.000000015258789066052715 65.536000000000001 /end CHARACTERISTIC
/begin CHARACTERISTIC FMTC_trq2qBas_MAP "Grundkennfeld für Moment/Menge Umrechnung als Funktion des Arbeitspunktes" MAP 0x1D15B4 Kf_Xs16_Ys16_Ws16 327.6700 InjMassCyc 0.00 327.6700 FORMAT "%8.4" EXTENDED_LIMITS -327.6800 327.6700
 /begin AXIS_DESCR STD_AXIS Eng_nAvrg EngN 16 0.00 6000.000 FORMAT "%8.3" EXTENDED_LIMITS -32768.00 32767.00 DEPOSIT ABSOLUTE /end AXIS_DESCR
 /begin AXIS_DESCR STD_AXIS CoEng_trqInrSet Trq 18 -500.0000 1000.000 FORMAT "%8.3" EXTENDED_LIMITS -3276.800 3276.700 DEPOSIT ABSOLUTE /end AXIS_DESCR
/end CHARACTERISTIC
/begin CHARACTERISTIC FMTC_trq2qRgn1_MAP "Grundkennfeld für Moment-/Mengenumrechnung unter Regenerationsanforderung 1 der Abgasnachbehandlung" MAP 0x1D183C Kf_Xs16_Ys16_Ws16 327.6700 InjMassCyc 0.00 327.6700 FORMAT "%8.4" EXTENDED_LIMITS -327.6800 327.6700
 /begin AXIS_DESCR STD_AXIS Eng_nAvrg EngN 16 0.00 6000.000 FORMAT "%8.3" EXTENDED_LIMITS -32768.00 32767.00 DEPOSIT ABSOLUTE /end AXIS_DESCR
 /begin AXIS_DESCR STD_AXIS CoEng_trqInrSet Trq 18 -500.0000 1000.000 FORMAT "%8.3" EXTENDED_LIMITS -3276.800 3276.700 DEPOSIT ABSOLUTE /end AXIS_DESCR
/end CHARACTERISTIC
/begin CHARACTERISTIC FMTC_trq2qRgn2_MAP "Grundkennfeld für Moment-/Mengenumrechnung unter Regenerationsanforderung 2 der Abgasnachbehandlung" MAP 0x1D1AC4 Kf_Xs16_Ys16_Ws16 327.6700 InjMassCyc 0.00 327.6700 FORMAT "%8.4" EXTENDED_LIMITS -327.6800 327.6700
 /begin AXIS_DESCR STD_AXIS Eng_nAvrg EngN 16 0.00 6000.000 FORMAT "%8.3" EXTENDED_LIMITS -32768.00 32767.00 DEPOSIT ABSOLUTE /end AXIS_DESCR
 /begin AXIS_DESCR STD_AXIS CoEng_trqInrSet Trq 18 -500.0000 1000.000 FORMAT "%8.3" EXTENDED_LIMITS -3276.800 3276.700 DEPOSIT ABSOLUTE /end AXIS_DESCR
/end CHARACTERISTIC
/begin CHARACTERISTIC FMTC_trq2qRgn3_MAP "Grundkennfeld für Moment-/Mengenumrechnung unter Regenerationsanforderung 3 der Abgasnachbehandlung" MAP 0x1D1D4C Kf_Xs16_Ys16_Ws16 327.6700 InjMassCyc 0.00 327.6700 FORMAT "%8.4" EXTENDED_LIMITS -327.6800 327.6700
 /begin AXIS_DESCR STD_AXIS Eng_nAvrg EngN 16 0.00 6000.000 FORMAT "%8.3" EXTENDED_LIMITS -32768.00 32767.00 DEPOSIT ABSOLUTE /end AXIS_DESCR
 /begin AXIS_DESCR STD_AXIS CoEng_trqInrSet Trq 18 -500.0000 1000.000 FORMAT "%8.3" EXTENDED_LIMITS -3276.800 3276.700 DEPOSIT ABSOLUTE /end AXIS_DESCR
/end CHARACTERISTIC
/begin CHARACTERISTIC FMTC_trq2qRgn4_MAP "Grundkennfeld für Moment-/Mengenumrechnung unter Regenerationsanforderung 4 der Abgasnachbehandlung" MAP 0x1D1FD4 Kf_Xs16_Ys16_Ws16 327.6700 InjMassCyc 0.00 327.6700 FORMAT "%8.4" EXTENDED_LIMITS -327.6800 327.6700
 /begin AXIS_DESCR STD_AXIS Eng_nAvrg EngN 16 0.00 6000.000 FORMAT "%8.3" EXTENDED_LIMITS -32768.00 32767.00 DEPOSIT ABSOLUTE /end AXIS_DESCR
 /begin AXIS_DESCR STD_AXIS CoEng_trqInrSet Trq 18 -500.0000 1000.000 FORMAT "%8.3" EXTENDED_LIMITS -3276.800 3276.700 DEPOSIT ABSOLUTE /end AXIS_DESCR
/end CHARACTERISTIC
/begin CHARACTERISTIC FMTC_trqInrLimSmk_Vector "Konfigurationslabel für Bypass" VALUE 0x1C0A7A Kw_Wu8 255.0 OneToOne 0.00 255.0 FORMAT "%5.1" /end CHARACTERISTIC
/begin CHARACTERISTIC FMTC_trqInrLimSmk_Channel "Konfigurationslabels für Bypass" VALUE 0x1C0A7B Kw_Wu8 255.0 OneToOne 0.00 255.0 FORMAT "%5.1" /end CHARACTERISTIC
/begin CHARACTERISTIC FQlSCD_uSRCMin_C "SRC Low Schwelle" VALUE 0x1D225C Kw_Ws16 5200.391 Volt 0.00 5200.391 FORMAT "%8.3" EXTENDED_LIMITS -160156.4 160151.5 /end CHARACTERISTIC
/begin CHARACTERISTIC FQlSCD_uSRCMax_C "SRC High Schwelle" VALUE 0x1D225E Kw_Ws16 5200.391 Volt 0.00 5200.391 FORMAT "%8.3" EXTENDED_LIMITS -160156.4 160151.5 /end CHARACTERISTIC
/begin CHARACTERISTIC FQlSCD_rLin_CUR "Linearisierungskennlinie für RME" CURVE 0x1D2260 Kl_Xs16_Ws16 100.0000 Prc 0.00 100.0000 FORMAT "%8.4" EXTENDED_LIMITS -327.6800 327.6700
 /begin AXIS_DESCR STD_AXIS FQlSCD_uRaw Volt 20 0.00 5200.391 FORMAT "%8.3" EXTENDED_LIMITS -160156.4 160151.5 DEPOSIT ABSOLUTE /end AXIS_DESCR
/end CHARACTERISTIC
/begin CHARACTERISTIC FQlSCD_DebSigDef_C "Fehlerentprellzeit für CAN Fehler" VALUE 0x1D22B2 Kw_Wu16 655350.0 Time_ms 0.00 655350.0 FORMAT "%8.1" /end CHARACTERISTIC
/begin CHARACTERISTIC FQlSCD_DebSigOk_C "Heilungsentprellzeit für CAN Fehler" VALUE 0x1D22B4 Kw_Wu16 655350.0 Time_ms 0.00 655350.0 FORMAT "%8.1" /end CHARACTERISTIC
/begin CHARACTERISTIC FQlSCD_DebSRCHighDef_C "Fehlerentprellzeit für SRC Fehler High" VALUE 0x1D22B6 Kw_Wu16 655350.0 Time_ms 0.00 655350.0 FORMAT "%8.1" /end CHARACTERISTIC
/begin CHARACTERISTIC FQlSCD_DebSRCHighOk_C "Heilungsentprellzeit für SRC Fehler High" VALUE 0x1D22B8 Kw_Wu16 655350.0 Time_ms 0.00 655350.0 FORMAT "%8.1" /end CHARACTERISTIC
/begin CHARACTERISTIC FQlSCD_DebSRCLowDef_C "Fehlerentprellzeit für SRC Fehler Low" VALUE 0x1D22BA Kw_Wu16 655350.0 Time_ms 0.00 655350.0 FORMAT "%8.1" /end CHARACTERISTIC
/begin CHARACTERISTIC FQlSCD_DebSRCLowOk_C "Heilungsentprellzeit für SRC Fehler Low" VALUE 0x1D22BC Kw_Wu16 655350.0 Time_ms 0.00 655350.0 FORMAT "%8.1" /end CHARACTERISTIC
/begin CHARACTERISTIC FQlSCD_numSSp_C "Wahlschalter für Sensorversorgungsschaltermonitor für RME-Sensor" VALUE 0x1D22BE Kw_Wu8 2.000 OneToOne 1.000 3.000 FORMAT "%5.3" EXTENDED_LIMITS 0.00 255.0 /end CHARACTERISTIC
/begin CHARACTERISTIC FQlSCD_dtRmpSlpUp_C "Rampe für Analogeingang Struktur" VALUE 0x1D22C0 Kw_Wu32 655358.999786 RmpPrc 1.00006103516 655359.999847 FORMAT "%13.6" EXTENDED_LIMITS 0.00 655359.999847 /end CHARACTERISTIC
/begin CHARACTERISTIC FQlSCD_dtRmpSlpDwn_C "Rampe für Analogeingang Struktur" VALUE 0x1D22C4 Kw_Wu32 655358.999786 RmpPrc 1.00006103516 655359.999847 FORMAT "%13.6" EXTENDED_LIMITS 0.00 655359.999847 /end CHARACTERISTIC
/begin CHARACTERISTIC FQlSCD_rRpOilHi_C "Obere Hystereseschwelle für Erkennung Kraftstoffart" VALUE 0x1D22C8 Kw_Ws16 100.0000 Prc 0.00 100.0000 FORMAT "%8.4" EXTENDED_LIMITS -327.6800 327.6700 /end CHARACTERISTIC
/begin CHARACTERISTIC FQlSCD_rRpOilLo_C "Untere Hystereschwelle für Erkennung Kraftstoffart" VALUE 0x1D22CA Kw_Ws16 100.0000 Prc 0.00 100.0000 FORMAT "%8.4" EXTENDED_LIMITS -327.6800 327.6700 /end CHARACTERISTIC
/begin CHARACTERISTIC FQlSCD_swtSig_C "Auswahlschalter RME über ADC oder CAN" VALUE 0x1D22CC Kw_Wu8 1.000 OneToOne 0.00 1.000 FORMAT "%5.3" EXTENDED_LIMITS 0.00 255.0 /end CHARACTERISTIC
/begin CHARACTERISTIC FQlSCD_stSensIDWord_C "Status ID für Statemaschine" VALUE 0x1D22CE Kw_Wu16 65535.00 OneToOne 0.00 65535.00 FORMAT "%8.2" /end CHARACTERISTIC
/begin CHARACTERISTIC FQlSCD_rDfl_C "Ersatzwert bei Fehler" VALUE 0x1D22D0 Kw_Ws16 100.0000 Prc 0.00 100.0000 FORMAT "%8.4" EXTENDED_LIMITS -327.6800 327.6700 /end CHARACTERISTIC
/begin CHARACTERISTIC FrmMng_aACC_Offset_C "Can-Umrechnungsparameter Offset für Beschleunigung" VALUE 0x1D23BE Kw_Ws16 65.53500 Acc -32.76800 32.76700 FORMAT "%8.5" /end CHARACTERISTIC
/begin CHARACTERISTIC FrmMng_facAACC_Slope_C "Can-Umrechnungsparameter Steigung für beschleunigung" VALUE 0x1D23C0 Kw_Ws16 7.999878 Fact -4.000000 3.999878 FORMAT "%8.6" /end CHARACTERISTIC
/begin CHARACTERISTIC FrmMng_aTrnvrs_Offset_C "Offset Umrechung CAN -> SG für Querbeschelunigung" VALUE 0x1D2422 Kw_Ws16 655.3500 TrnvrsAcc -327.6800 327.6700 FORMAT "%8.4" /end CHARACTERISTIC
/begin CHARACTERISTIC FrmMng_facATrnvrs_Slope_C "Steigung fuer Umwandlung von Querbeschleunigung" VALUE 0x1D2424 Kw_Ws16 7.999878 Fact -4.000000 3.999878 FORMAT "%8.6" /end CHARACTERISTIC
/begin CHARACTERISTIC FrmMng_BRK_ENABLEMASK_C "Bitmaske für Statusbits in FrmMng_stBrk" VALUE 0x1D2426 Kw_Wu8 255.0 OneToOne 0.00 255.0 FORMAT "%5.1" /end CHARACTERISTIC
/begin CHARACTERISTIC FrmMng_dACC1Byte1_C "Initialisierungswert für die ACC1-CAN-Sendebotschaft" VALUE 0x1D22D4 Kw_Wu8 255.0 OneToOne 0.00 255.0 FORMAT "%5.1" /end CHARACTERISTIC
/begin CHARACTERISTIC FrmMng_dACC1Byte2_C "Initialisierungswert für die ACC1-CAN-Sendebotschaft" VALUE 0x1D22D5 Kw_Wu8 255.0 OneToOne 0.00 255.0 FORMAT "%5.1" /end CHARACTERISTIC
/begin CHARACTERISTIC FrmMng_dACC1Byte3_C "Initialisierungswert für die ACC1-CAN-Sendebotschaft" VALUE 0x1D22D6 Kw_Wu8 255.0 OneToOne 0.00 255.0 FORMAT "%5.1" /end CHARACTERISTIC
/begin CHARACTERISTIC FrmMng_dACC1Byte4_C "Initialisierungswert für die ACC1-CAN-Sendebotschaft" VALUE 0x1D22D7 Kw_Wu8 255.0 OneToOne 0.00 255.0 FORMAT "%5.1" /end CHARACTERISTIC
/begin CHARACTERISTIC FrmMng_dACC1Byte5_C "Initialisierungswert für die ACC1-CAN-Sendebotschaft" VALUE 0x1D22D8 Kw_Wu8 255.0 OneToOne 0.00 255.0 FORMAT "%5.1" /end CHARACTERISTIC
/begin CHARACTERISTIC FrmMng_dACC1Byte6_C "Initialisierungswert für die ACC1-CAN-Sendebotschaft" VALUE 0x1D22D9 Kw_Wu8 255.0 OneToOne 0.00 255.0 FORMAT "%5.1" /end CHARACTERISTIC
/begin CHARACTERISTIC FrmMng_dACC1Byte7_C "Initialisierungswert für die ACC1-CAN-Sendebotschaft" VALUE 0x1D22DA Kw_Wu8 255.0 OneToOne 0.00 255.0 FORMAT "%5.1" /end CHARACTERISTIC
/begin CHARACTERISTIC FrmMng_dACC1Byte8_C "Initialisierungswert für die ACC1-CAN-Sendebotschaft" VALUE 0x1D22DB Kw_Wu8 255.0 OneToOne 0.00 255.0 FORMAT "%5.1" /end CHARACTERISTIC
/begin CHARACTERISTIC FrmMng_dCCtlByte1_C "Initialisierungswert für die FGR-CAN-Sende- und Empfangsbotschaft" VALUE 0x1D22DC Kw_Wu8 255.0 OneToOne 0.00 255.0 FORMAT "%5.1" /end CHARACTERISTIC
/begin CHARACTERISTIC FrmMng_dCCtlByte2_C "Initialisierungswert für die FGR-CAN-Sende- und Empfangsbotschaft" VALUE 0x1D22DD Kw_Wu8 255.0 OneToOne 0.00 255.0 FORMAT "%5.1" /end CHARACTERISTIC
/begin CHARACTERISTIC FrmMng_dCCtlByte3_C "Initialisierungswert für die FGR-CAN-Sende- und Empfangsbotschaft" VALUE 0x1D22DE Kw_Wu8 255.0 OneToOne 0.00 255.0 FORMAT "%5.1" /end CHARACTERISTIC
/begin CHARACTERISTIC FrmMng_dCCtlByte4_C "Initialisierungswert für die FGR-CAN-Sende- und Empfangsbotschaft" VALUE 0x1D22DF Kw_Wu8 255.0 OneToOne 0.00 255.0 FORMAT "%5.1" /end CHARACTERISTIC
/begin CHARACTERISTIC FrmMng_dCCtlByte5_C "Initialisierungswert für die FGR-CAN-Sende- und Empfangsbotschaft" VALUE 0x1D22E0 Kw_Wu8 255.0 OneToOne 0.00 255.0 FORMAT "%5.1" /end CHARACTERISTIC
/begin CHARACTERISTIC FrmMng_dCCtlByte6_C "Initialisierungswert für die FGR-CAN-Sende- und Empfangsbotschaft" VALUE 0x1D22E1 Kw_Wu8 255.0 OneToOne 0.00 255.0 FORMAT "%5.1" /end CHARACTERISTIC
/begin CHARACTERISTIC FrmMng_dCCtlByte7_C "Initialisierungswert für die FGR-CAN-Sende- und Empfangsbotschaft" VALUE 0x1D22E2 Kw_Wu8 255.0 OneToOne 0.00 255.0 FORMAT "%5.1" /end CHARACTERISTIC
/begin CHARACTERISTIC FrmMng_dCCtlByte8_C "Initialisierungswert für die FGR-CAN-Sende- und Empfangsbotschaft" VALUE 0x1D22E3 Kw_Wu8 255.0 OneToOne 0.00 255.0 FORMAT "%5.1" /end CHARACTERISTIC
/begin CHARACTERISTIC FrmMng_DebAAGCNTDef_C "Entprellzeit Timeout-Fehler für AAG" VALUE 0x1D2480 Kw_Wu16 655350.0 Time_ms 0.00 655350.0 FORMAT "%8.1" /end CHARACTERISTIC
/begin CHARACTERISTIC FrmMng_DebAAGCNTOk_C "Heilzeit Timeout-Fehler für AAG" VALUE 0x1D2482 Kw_Wu16 655350.0 Time_ms 0.00 655350.0 FORMAT "%8.1" /end CHARACTERISTIC
/begin CHARACTERISTIC FrmMng_DebAAGTODef_C "Entprellzeit Timeout-Fehler für AAG" VALUE 0x1D2484 Kw_Wu16 655350.0 Time_ms 0.00 655350.0 FORMAT "%8.1" /end CHARACTERISTIC
/begin CHARACTERISTIC FrmMng_DebAAGTOOk_C "Heilzeit Timeout-Fehler für AAG" VALUE 0x1D2486 Kw_Wu16 655350.0 Time_ms 0.00 655350.0 FORMAT "%8.1" /end CHARACTERISTIC
/begin CHARACTERISTIC FrmMng_DebAC1DLCDef_C "Entprellzeit für DLC-Fehler der Botschaft-AC1" VALUE 0x1D23AC Kw_Wu16 655350.0 Time_ms 0.00 655350.0 FORMAT "%8.1" /end CHARACTERISTIC
/begin CHARACTERISTIC FrmMng_DebAC1DLCOk_C "Heilungszeit für DLC-Fehler der Botschaft-AC1" VALUE 0x1D23AE Kw_Wu16 655350.0 Time_ms 0.00 655350.0 FORMAT "%8.1" /end CHARACTERISTIC
/begin CHARACTERISTIC FrmMng_DebAC1TODef_C "Zeit bis AC1Time Out Fehler defekt" VALUE 0x1D23B0 Kw_Wu16 655350.0 Time_ms 0.00 655350.0 FORMAT "%8.1" /end CHARACTERISTIC
/begin CHARACTERISTIC FrmMng_DebAC1TOOk_C "Zeit bis Fehler AC1 Time Out geheilt" VALUE 0x1D23B2 Kw_Wu16 655350.0 Time_ms 0.00 655350.0 FORMAT "%8.1" /end CHARACTERISTIC
/begin CHARACTERISTIC FrmMng_DebACCCNTDef_C "Entprellzeit für Botschaftszähler-Fehler ACC Botschaft" VALUE 0x1D23C2 Kw_Wu16 655350.0 Time_ms 0.00 655350.0 FORMAT "%8.1" /end CHARACTERISTIC
/begin CHARACTERISTIC FrmMng_DebACCCNTOk_C "Heilzeit für Botschaftszähler-Fehler ACC Botschaft" VALUE 0x1D23C4 Kw_Wu16 655350.0 Time_ms 0.00 655350.0 FORMAT "%8.1" /end CHARACTERISTIC
/begin CHARACTERISTIC FrmMng_DebACCCSDef_C "Fehlerentprell-Ereignisse  für ACC-System Checksummenfehler" VALUE 0x1D23C6 Kw_Wu16 65535.00 OneToOne 0.00 65535.00 FORMAT "%8.2" /end CHARACTERISTIC
/begin CHARACTERISTIC FrmMng_DebACCCSOk_C "Fehlerheilungs-Ereignisse  für ACC-System Checksummenfehler" VALUE 0x1D23C8 Kw_Wu16 65535.00 OneToOne 0.00 65535.00 FORMAT "%8.2" READ_ONLY /end CHARACTERISTIC
/begin CHARACTERISTIC FrmMng_DebACCDLCDef_C "Entprellzeit für DLC-Fehler der Botschaft-ACC" VALUE 0x1D23CA Kw_Wu16 655350.0 Time_ms 0.00 655350.0 FORMAT "%8.1" /end CHARACTERISTIC
/begin CHARACTERISTIC FrmMng_DebACCDLCOk_C "Heilungszeit für DLC-Fehler der Botschaft-ACC" VALUE 0x1D23CC Kw_Wu16 655350.0 Time_ms 0.00 655350.0 FORMAT "%8.1" /end CHARACTERISTIC
/begin CHARACTERISTIC FrmMng_DebACCTODef_C "Zeit bis ACC-System Time Out Fehler defekt" VALUE 0x1D23CE Kw_Wu16 655350.0 Time_ms 0.00 655350.0 FORMAT "%8.1" /end CHARACTERISTIC
/begin CHARACTERISTIC FrmMng_DebACCTOOk_C "Zeit bis ACC-System Fehler Time Out Fehler geheilt" VALUE 0x1D23D0 Kw_Wu16 655350.0 Time_ms 0.00 655350.0 FORMAT "%8.1" /end CHARACTERISTIC
/begin CHARACTERISTIC FrmMng_DebAIRBGCNTDef_C "Entprellzeit für Botschaftszähler-Fehler Airbag Botschaft" VALUE 0x1D23DA Kw_Wu16 655350.0 Time_ms 0.00 655350.0 FORMAT "%8.1" /end CHARACTERISTIC
/begin CHARACTERISTIC FrmMng_DebAIRBGCNTOk_C "Heilzeit für Botschaftszähler-Fehler Airbag Botschaft" VALUE 0x1D23DC Kw_Wu16 655350.0 Time_ms 0.00 655350.0 FORMAT "%8.1" /end CHARACTERISTIC
/begin CHARACTERISTIC FrmMng_DebAIRBGCSDef_C "Fehlerentprell-Ereignisse für AIRBAG-System Checksummenfehler" VALUE 0x1D23DE Kw_Wu16 65535.00 OneToOne 0.00 65535.00 FORMAT "%8.2" /end CHARACTERISTIC
/begin CHARACTERISTIC FrmMng_DebAIRBGCSOk_C "Fehlerheilungs-Ereignisse für AIRBAG-System Checksummenfehler" VALUE 0x1D23E0 Kw_Wu16 65535.00 OneToOne 0.00 65535.00 FORMAT "%8.2" READ_ONLY /end CHARACTERISTIC
/begin CHARACTERISTIC FrmMng_DebAIRBGDLCDef_C "Entprellzeit für DLC-Fehler der Botschaft-AIRBG1" VALUE 0x1D23E2 Kw_Wu16 655350.0 Time_ms 0.00 655350.0 FORMAT "%8.1" /end CHARACTERISTIC
/begin CHARACTERISTIC FrmMng_DebAIRBGDLCOk_C "Heilungszeit für DLC-Fehler der Botschaft-AIRBG1" VALUE 0x1D23E4 Kw_Wu16 655350.0 Time_ms 0.00 655350.0 FORMAT "%8.1" /end CHARACTERISTIC
/begin CHARACTERISTIC FrmMng_DebAIRBGTODef_C "Zeit bis AIRBGTO Fehler defekt" VALUE 0x1D23E6 Kw_Wu16 655350.0 Time_ms 0.00 655350.0 FORMAT "%8.1" /end CHARACTERISTIC
/begin CHARACTERISTIC FrmMng_DebAIRBGTOOk_C "Zeit bis Fehler AIRBGTO geheilt" VALUE 0x1D23E8 Kw_Wu16 655350.0 Time_ms 0.00 655350.0 FORMAT "%8.1" /end CHARACTERISTIC
/begin CHARACTERISTIC FrmMng_DebAWD1CNTDef_C "Entprellzeit für Botschaftszähler-Fehler Allrad1 Botschaft" VALUE 0x1D23F0 Kw_Wu16 655350.0 Time_ms 0.00 655350.0 FORMAT "%8.1" /end CHARACTERISTIC
/begin CHARACTERISTIC FrmMng_DebAWD1CNTOk_C "Heilzeit für Botschaftszähler-Fehler Allrad 1 Botschaft" VALUE 0x1D23F2 Kw_Wu16 655350.0 Time_ms 0.00 655350.0 FORMAT "%8.1" /end CHARACTERISTIC
/begin CHARACTERISTIC FrmMng_DebAWD1DLCDef_C "Entprellzeit für DLC-Fehler der Botschaft-AWD1" VALUE 0x1D23F4 Kw_Wu16 655350.0 Time_ms 0.00 655350.0 FORMAT "%8.1" /end CHARACTERISTIC
/begin CHARACTERISTIC FrmMng_DebAWD1DLCOk_C "Heilungszeit für DLC-Fehler der Botschaft-AWD1" VALUE 0x1D23F6 Kw_Wu16 655350.0 Time_ms 0.00 655350.0 FORMAT "%8.1" /end CHARACTERISTIC
/begin CHARACTERISTIC FrmMng_DebAWD1TODef_C "Entprellzeit für CAN Botschaft Allrad1 Fehler defekt" VALUE 0x1D23F8 Kw_Wu16 655350.0 Time_ms 0.00 655350.0 FORMAT "%8.1" /end CHARACTERISTIC
/begin CHARACTERISTIC FrmMng_DebAWD1TOOk_C "Entprellzeit für CAN Botschaft Allrad1 Fehler geheilt" VALUE 0x1D23FA Kw_Wu16 655350.0 Time_ms 0.00 655350.0 FORMAT "%8.1" /end CHARACTERISTIC
/begin CHARACTERISTIC FrmMng_DebBEM1CNTDef_C "Entprellzeit für Botschaftszähler-Fehler BEM1 Botschaft" VALUE 0x1D2408 Kw_Wu16 655350.0 Time_ms 0.00 655350.0 FORMAT "%8.1" /end CHARACTERISTIC
/begin CHARACTERISTIC FrmMng_DebBEM1CNTOk_C "Heilzeit für Botschaftszähler-Fehler BEM1 Botschaft" VALUE 0x1D240A Kw_Wu16 655350.0 Time_ms 0.00 655350.0 FORMAT "%8.1" /end CHARACTERISTIC
/begin CHARACTERISTIC FrmMng_DebBEM1CSDef_C "Fehlerentprell-Ereignisse für BEM1  Checksummenfehler" VALUE 0x1D240C Kw_Wu16 65535.00 OneToOne 0.00 65535.00 FORMAT "%8.2" /end CHARACTERISTIC
/begin CHARACTERISTIC FrmMng_DebBEM1CSOk_C "Fehlerheilungs-Ereignisse für BEM1 Checksummenfehler" VALUE 0x1D240E Kw_Wu16 65535.00 OneToOne 0.00 65535.00 FORMAT "%8.2" READ_ONLY /end CHARACTERISTIC
/begin CHARACTERISTIC FrmMng_DebBEM1DLCDef_C "Entprellzeit für DLC-Fehler der Botschaft-BEM1" VALUE 0x1D2410 Kw_Wu16 655350.0 Time_ms 0.00 655350.0 FORMAT "%8.1" /end CHARACTERISTIC
/begin CHARACTERISTIC FrmMng_DebBEM1DLCOk_C "Heilungszeit für DLC-Fehler der Botschaft-BEM1" VALUE 0x1D2412 Kw_Wu16 655350.0 Time_ms 0.00 655350.0 FORMAT "%8.1" /end CHARACTERISTIC
/begin CHARACTERISTIC FrmMng_DebBEM1TODef_C "Entprellzeit für Timeout von BEM1-Botschaft" VALUE 0x1D2414 Kw_Wu16 655350.0 Time_ms 0.00 655350.0 FORMAT "%8.1" /end CHARACTERISTIC
/begin CHARACTERISTIC FrmMng_DebBEM1TOOk_C "Heilungszeit für Timeout von BEM1-Botschaft" VALUE 0x1D2416 Kw_Wu16 655350.0 Time_ms 0.00 655350.0 FORMAT "%8.1" /end CHARACTERISTIC
/begin CHARACTERISTIC FrmMng_DebBRK1CNTDef_C "Entprellzeit für Botschaftszähler-Fehler Bremse 1 Botschaft" VALUE 0x1D2428 Kw_Wu16 655350.0 Time_ms 0.00 655350.0 FORMAT "%8.1" /end CHARACTERISTIC
/begin CHARACTERISTIC FrmMng_DebBRK1CNTOk_C "Heilzeit für Botschaftszähler-Fehler Bremse 1 Botschaft" VALUE 0x1D242A Kw_Wu16 655350.0 Time_ms 0.00 655350.0 FORMAT "%8.1" /end CHARACTERISTIC
/begin CHARACTERISTIC FrmMng_DebBRK1DLCDef_C "Entprellzeit für DLC-Fehler der Botschaft-BRK1" VALUE 0x1D242C Kw_Wu16 655350.0 Time_ms 0.00 655350.0 FORMAT "%8.1" /end CHARACTERISTIC
/begin CHARACTERISTIC FrmMng_DebBRK1DLCOk_C "Heilungszeit für DLC-Fehler der Botschaft-BRK1" VALUE 0x1D242E Kw_Wu16 655350.0 Time_ms 0.00 655350.0 FORMAT "%8.1" /end CHARACTERISTIC
/begin CHARACTERISTIC FrmMng_DebBRK1TODef_C "Zeit bis BRK1TO Fehler defekt" VALUE 0x1D2430 Kw_Wu16 655350.0 Time_ms 0.00 655350.0 FORMAT "%8.1" /end CHARACTERISTIC
/begin CHARACTERISTIC FrmMng_DebBRK1TOOk_C "Zeit bis Fehler BRK1TO geheilt" VALUE 0x1D2432 Kw_Wu16 655350.0 Time_ms 0.00 655350.0 FORMAT "%8.1" /end CHARACTERISTIC
/begin CHARACTERISTIC FrmMng_DebBRK2DLCDef_C "Entprellzeit für DLC-Fehler der Botschaft-BRK2" VALUE 0x1D2434 Kw_Wu16 655350.0 Time_ms 0.00 655350.0 FORMAT "%8.1" /end CHARACTERISTIC
/begin CHARACTERISTIC FrmMng_DebBRK2DLCOk_C "Heilungszeit für DLC-Fehler der Botschaft-BRK2" VALUE 0x1D2436 Kw_Wu16 655350.0 Time_ms 0.00 655350.0 FORMAT "%8.1" /end CHARACTERISTIC
/begin CHARACTERISTIC FrmMng_DebBRK2TODef_C "Zeit bis BRK2 TO Fehler defekt" VALUE 0x1D2438 Kw_Wu16 655350.0 Time_ms 0.00 655350.0 FORMAT "%8.1" /end CHARACTERISTIC
/begin CHARACTERISTIC FrmMng_DebBRK2TOOk_C "Zeit bis Fehler BRK2 TO  geheilt" VALUE 0x1D243A Kw_Wu16 655350.0 Time_ms 0.00 655350.0 FORMAT "%8.1" /end CHARACTERISTIC
/begin CHARACTERISTIC FrmMng_DebBRK8CNTDef_C "Entprellzeit für Botschaftszähler-Fehler Bremse 8 Botschaft" VALUE 0x1D243C Kw_Wu16 655350.0 Time_ms 0.00 655350.0 FORMAT "%8.1" /end CHARACTERISTIC
/begin CHARACTERISTIC FrmMng_DebBRK8CNTOk_C "Heilzeit für Botschaftszähler-Fehler Bremse 8 Botschaft" VALUE 0x1D243E Kw_Wu16 655350.0 Time_ms 0.00 655350.0 FORMAT "%8.1" /end CHARACTERISTIC
/begin CHARACTERISTIC FrmMng_DebBRK8CSDef_C "Fehlerentprell-Ereignisse für BRK8  Checksummenfehler" VALUE 0x1D2440 Kw_Wu16 65535.00 OneToOne 0.00 65535.00 FORMAT "%8.2" /end CHARACTERISTIC
/begin CHARACTERISTIC FrmMng_DebBRK8CSOk_C "Fehlerheilungs-Ereignisse für BRK8 Checksummenfehler" VALUE 0x1D2442 Kw_Wu16 65535.00 OneToOne 0.00 65535.00 FORMAT "%8.2" READ_ONLY /end CHARACTERISTIC
/begin CHARACTERISTIC FrmMng_DebBRK8DLCDef_C "Entprellzeit für DLC-Fehler der Botschaft-BRK8" VALUE 0x1D2444 Kw_Wu16 655350.0 Time_ms 0.00 655350.0 FORMAT "%8.1" /end CHARACTERISTIC
/begin CHARACTERISTIC FrmMng_DebBRK8DLCOk_C "Heilungszeit für DLC-Fehler der Botschaft-BRK8" VALUE 0x1D2446 Kw_Wu16 655350.0 Time_ms 0.00 655350.0 FORMAT "%8.1" /end CHARACTERISTIC
/begin CHARACTERISTIC FrmMng_DebBRK8TODef_C "Zeit bis BRK8 TO Fehler defekt" VALUE 0x1D2448 Kw_Wu16 655350.0 Time_ms 0.00 655350.0 FORMAT "%8.1" /end CHARACTERISTIC
/begin CHARACTERISTIC FrmMng_DebBRK8TOOk_C "Zeit bis Fehler BRK8 TO geheilt" VALUE 0x1D244A Kw_Wu16 655350.0 Time_ms 0.00 655350.0 FORMAT "%8.1" /end CHARACTERISTIC
/begin CHARACTERISTIC FrmMng_DebCCTLCNTDef_C "Entprellzeit für Botschaftszähler-Fehler Cruise Control Botschaft" VALUE 0x1D2398 Kw_Wu16 655350.0 Time_ms 0.00 655350.0 FORMAT "%8.1" /end CHARACTERISTIC
/begin CHARACTERISTIC FrmMng_DebCCTLCNTOk_C "Heilzeit für Botschaftszähler-Fehler Cruise Control Botschaft" VALUE 0x1D239A Kw_Wu16 655350.0 Time_ms 0.00 655350.0 FORMAT "%8.1" /end CHARACTERISTIC
/begin CHARACTERISTIC FrmMng_DebCCTLCSDef_C "Zeit bis CCTLCS Fehler defekt" VALUE 0x1D239C Kw_Wu16 65535.00 OneToOne 0.00 65535.00 FORMAT "%8.2" /end CHARACTERISTIC
/begin CHARACTERISTIC FrmMng_DebCCTLCSOk_C "Zeit bis CCTLCS Fehler geheilt" VALUE 0x1D239E Kw_Wu16 65535.00 OneToOne 0.00 65535.00 FORMAT "%8.2" READ_ONLY /end CHARACTERISTIC
/begin CHARACTERISTIC FrmMng_DebCCTLDLCDef_C "Entprellzeit für DLC-Fehler der Botschaft-CCTL" VALUE 0x1D23A0 Kw_Wu16 655350.0 Time_ms 0.00 655350.0 FORMAT "%8.1" /end CHARACTERISTIC
/begin CHARACTERISTIC FrmMng_DebCCTLDLCOk_C "Heilungszeit für DLC-Fehler der Botschaft-CCTL" VALUE 0x1D23A2 Kw_Wu16 655350.0 Time_ms 0.00 655350.0 FORMAT "%8.1" /end CHARACTERISTIC
/begin CHARACTERISTIC FrmMng_DebCCTLTODef_C "Zeit bis CCTLTO Fehler defekt" VALUE 0x1D23A4 Kw_Wu16 655350.0 Time_ms 0.00 655350.0 FORMAT "%8.1" /end CHARACTERISTIC
/begin CHARACTERISTIC FrmMng_DebCCTLTOOk_C "Zeit bis Fehler CCTLTO geheilt" VALUE 0x1D23A6 Kw_Wu16 655350.0 Time_ms 0.00 655350.0 FORMAT "%8.1" /end CHARACTERISTIC
/begin CHARACTERISTIC FrmMng_DebDIA1DLCDef_C "Entprellzeit für DLC-Fehler der Botschaft-DIA1" VALUE 0x1D2488 Kw_Wu16 655350.0 Time_ms 0.00 655350.0 FORMAT "%8.1" /end CHARACTERISTIC
/begin CHARACTERISTIC FrmMng_DebDIA1DLCOk_C "Heilungszeit für DLC-Fehler der Botschaft-DIA1" VALUE 0x1D248A Kw_Wu16 655350.0 Time_ms 0.00 655350.0 FORMAT "%8.1" /end CHARACTERISTIC
/begin CHARACTERISTIC FrmMng_DebDIA1TODef_C "Entprellzeit für Tiomeoutfehler von DIA1-Botschaft" VALUE 0x1D248C Kw_Wu16 655350.0 Time_ms 0.00 655350.0 FORMAT "%8.1" /end CHARACTERISTIC
/begin CHARACTERISTIC FrmMng_DebDIA1TOOk_C "Heilungszeit für Timeoutfehler von DIA1-Botschaft" VALUE 0x1D248E Kw_Wu16 655350.0 Time_ms 0.00 655350.0 FORMAT "%8.1" /end CHARACTERISTIC
/begin CHARACTERISTIC FrmMng_DebDSP1CNTDef_C "Zeit bis DPS1CNT Fehler defekt" VALUE 0x1D2456 Kw_Wu16 655350.0 Time_ms 0.00 655350.0 FORMAT "%8.1" /end CHARACTERISTIC
/begin CHARACTERISTIC FrmMng_DebDSP1CNTOk_C "Zeit bis Fehler DSP1CNT geheilt" VALUE 0x1D2458 Kw_Wu16 655350.0 Time_ms 0.00 655350.0 FORMAT "%8.1" /end CHARACTERISTIC
/begin CHARACTERISTIC FrmMng_DebDSP1DLCDef_C "Entprellzeit für DLC-Fehler der Botschaft-DSP1" VALUE 0x1D245A Kw_Wu16 655350.0 Time_ms 0.00 655350.0 FORMAT "%8.1" /end CHARACTERISTIC
/begin CHARACTERISTIC FrmMng_DebDSP1DLCOk_C "Heilungszeit für DLC-Fehler der Botschaft-DSP1" VALUE 0x1D245C Kw_Wu16 655350.0 Time_ms 0.00 655350.0 FORMAT "%8.1" /end CHARACTERISTIC
/begin CHARACTERISTIC FrmMng_DebDSP1TODef_C "Zeit bis DPS1TO Fehler defekt" VALUE 0x1D245E Kw_Wu16 655350.0 Time_ms 0.00 655350.0 FORMAT "%8.1" /end CHARACTERISTIC
/begin CHARACTERISTIC FrmMng_DebDSP1TOOk_C "Zeit bis Fehler DSP1TO geheilt" VALUE 0x1D2460 Kw_Wu16 655350.0 Time_ms 0.00 655350.0 FORMAT "%8.1" /end CHARACTERISTIC
/begin CHARACTERISTIC FrmMng_DebDSP2DLCDef_C "Entprellzeit für DLC-Fehler der Botschaft-DSP2" VALUE 0x1D2462 Kw_Wu16 655350.0 Time_ms 0.00 655350.0 FORMAT "%8.1" /end CHARACTERISTIC
/begin CHARACTERISTIC FrmMng_DebDSP2DLCOk_C "Heilungszeit für DLC-Fehler der Botschaft-DSP2" VALUE 0x1D2464 Kw_Wu16 655350.0 Time_ms 0.00 655350.0 FORMAT "%8.1" /end CHARACTERISTIC
/begin CHARACTERISTIC FrmMng_DebDSP2TODef_C "Zeit bis DPS2TO Fehler defekt" VALUE 0x1D2466 Kw_Wu16 655350.0 Time_ms 0.00 655350.0 FORMAT "%8.1" /end CHARACTERISTIC
/begin CHARACTERISTIC FrmMng_DebDSP2TOOk_C "Zeit bis Fehler DSP2TO geheilt" VALUE 0x1D2468 Kw_Wu16 655350.0 Time_ms 0.00 655350.0 FORMAT "%8.1" /end CHARACTERISTIC
/begin CHARACTERISTIC FrmMng_DebESCUDLCDef_C "Entprellzeit für DLC-Fehler der Botschaft-ESCU" VALUE 0x1D2476 Kw_Wu16 655350.0 Time_ms 0.00 655350.0 FORMAT "%8.1" /end CHARACTERISTIC
/begin CHARACTERISTIC FrmMng_DebESCUDLCOk_C "Heilungszeit für DLC-Fehler der Botschaft-ESCU" VALUE 0x1D2478 Kw_Wu16 655350.0 Time_ms 0.00 655350.0 FORMAT "%8.1" /end CHARACTERISTIC
/begin CHARACTERISTIC FrmMng_DebESCUTODef_C "Zeit bis ESCUTO Fehler defekt" VALUE 0x1D247A Kw_Wu16 655350.0 Time_ms 0.00 655350.0 FORMAT "%8.1" /end CHARACTERISTIC
/begin CHARACTERISTIC FrmMng_DebESCUTOOk_C "Zeit bis Fehler ESCUTO geheilt" VALUE 0x1D247C Kw_Wu16 655350.0 Time_ms 0.00 655350.0 FORMAT "%8.1" /end CHARACTERISTIC
/begin CHARACTERISTIC FrmMng_DebGW1DLCDef_C "Entprellzeit für DLC-Fehler der Botschaft-GW1" VALUE 0x1D2490 Kw_Wu16 655350.0 Time_ms 0.00 655350.0 FORMAT "%8.1" /end CHARACTERISTIC
/begin CHARACTERISTIC FrmMng_DebGW1DLCOk_C "Heilungszeit für DLC-Fehler der Botschaft-GW1" VALUE 0x1D2492 Kw_Wu16 655350.0 Time_ms 0.00 655350.0 FORMAT "%8.1" /end CHARACTERISTIC
/begin CHARACTERISTIC FrmMng_DebGW1TODef_C "Entprellzeit für Tiomeoutfehler von GW1-Botschaft" VALUE 0x1D2494 Kw_Wu16 655350.0 Time_ms 0.00 655350.0 FORMAT "%8.1" /end CHARACTERISTIC
/begin CHARACTERISTIC FrmMng_DebGW1TOOk_C "Heilungszeit für Timeoutfehler von BGW1-Botschaft" VALUE 0x1D2496 Kw_Wu16 655350.0 Time_ms 0.00 655350.0 FORMAT "%8.1" /end CHARACTERISTIC
/begin CHARACTERISTIC FrmMng_DebILMCNTDef_C "Entprellzeit Timeout-Fehler für AAG" VALUE 0x1D2498 Kw_Wu16 655350.0 Time_ms 0.00 655350.0 FORMAT "%8.1" /end CHARACTERISTIC
/begin CHARACTERISTIC FrmMng_DebILMCNTOk_C "Heilzeit Timeout-Fehler für AAG" VALUE 0x1D249A Kw_Wu16 655350.0 Time_ms 0.00 655350.0 FORMAT "%8.1" /end CHARACTERISTIC
/begin CHARACTERISTIC FrmMng_DebILMTODef_C "Entprellzeit Timeout-Fehler für ILM" VALUE 0x1D249C Kw_Wu16 655350.0 Time_ms 0.00 655350.0 FORMAT "%8.1" /end CHARACTERISTIC
/begin CHARACTERISTIC FrmMng_DebILMTOOk_C "Heilzeit Timeout-Fehler für ILM" VALUE 0x1D249E Kw_Wu16 655350.0 Time_ms 0.00 655350.0 FORMAT "%8.1" /end CHARACTERISTIC
/begin CHARACTERISTIC FrmMng_tiDebNIV1WrngCodDef_C "Fehlerentprellzeit für Codierungsfehler-NIVEAU Steuergerät" VALUE 0x1D24A6 Kw_Wu16 655350.0 Time_ms 0.00 655350.0 FORMAT "%8.1" /end CHARACTERISTIC
/begin CHARACTERISTIC FrmMng_tiDebNIV1WrngCodOk_C "Heilungsentprellzeit für Codierungsfehler-NIVEAU Steuergerät" VALUE 0x1D24A8 Kw_Wu16 655350.0 Time_ms 0.00 655350.0 FORMAT "%8.1" /end CHARACTERISTIC
/begin CHARACTERISTIC FrmMng_DebNIVEAU1CNTDef_C "Entprellzeit für Botschaftszähler-Fehler NIVEAU1-Botschaft" VALUE 0x1D24AA Kw_Wu16 655350.0 Time_ms 0.00 655350.0 FORMAT "%8.1" /end CHARACTERISTIC
/begin CHARACTERISTIC FrmMng_DebNIVEAU1CNTOk_C "Heilzeit für Botschaftszähler-Fehler NIVEAU1 Botschaft" VALUE 0x1D24AC Kw_Wu16 655350.0 Time_ms 0.00 655350.0 FORMAT "%8.1" /end CHARACTERISTIC
/begin CHARACTERISTIC FrmMng_DebNIVEAU1CSDef_C "Fehlerentprell-Ereignisse für NIVEAU1-System Checksummenfehler" VALUE 0x1D24AE Kw_Wu16 65535.00 OneToOne 0.00 65535.00 FORMAT "%8.2" /end CHARACTERISTIC
/begin CHARACTERISTIC FrmMng_DebNIVEAU1CSOk_C "Heilzeit für NIVEAU1-Checksummenfehler" VALUE 0x1D24B0 Kw_Wu16 65535.00 OneToOne 0.00 65535.00 FORMAT "%8.2" READ_ONLY /end CHARACTERISTIC
/begin CHARACTERISTIC FrmMng_DebNIVEAU1DLCDef_C "Entprellzeit für DLC-Fehler der Botschaft-NIVEAU1" VALUE 0x1D24B2 Kw_Wu16 655350.0 Time_ms 0.00 655350.0 FORMAT "%8.1" /end CHARACTERISTIC
/begin CHARACTERISTIC FrmMng_DebNIVEAU1DLCOk_C "Heilungszeit für DLC-Fehler der Botschaft-NIVEAU1" VALUE 0x1D24B4 Kw_Wu16 655350.0 Time_ms 0.00 655350.0 FORMAT "%8.1" /end CHARACTERISTIC
/begin CHARACTERISTIC FrmMng_DebNIVEAU1TODef_C "Fehlerdefekterkennungszeit für NIVEAU1 Botschafts-Timeout Fehler" VALUE 0x1D24B6 Kw_Wu16 655350.0 Time_ms 0.00 655350.0 FORMAT "%8.1" /end CHARACTERISTIC
/begin CHARACTERISTIC FrmMng_DebNIVEAU1TOOk_C "Entprellzeit für die Heilung eines Toggle-Bit Fehlers der NIVEAU1-Botschaft" VALUE 0x1D24B8 Kw_Wu16 655350.0 Time_ms 0.00 655350.0 FORMAT "%8.1" /end CHARACTERISTIC
/begin CHARACTERISTIC FrmMng_DebSTIGNDLCDef_C "Entprellzeit für DLC-Fehler der Botschaft-STIGN" VALUE 0x1D24C2 Kw_Wu16 655350.0 Time_ms 0.00 655350.0 FORMAT "%8.1" /end CHARACTERISTIC
/begin CHARACTERISTIC FrmMng_DebSTIGNDLCOk_C "Heilungszeit für DLC-Fehler der Botschaft-STIGN" VALUE 0x1D24C4 Kw_Wu16 655350.0 Time_ms 0.00 655350.0 FORMAT "%8.1" /end CHARACTERISTIC
/begin CHARACTERISTIC FrmMng_DebStIgnTODef_C "Zeit bis StIgn-TO (ZAS1) Fehler defekt" VALUE 0x1D24C6 Kw_Wu16 655350.0 Time_ms 0.00 655350.0 FORMAT "%8.1" /end CHARACTERISTIC
/begin CHARACTERISTIC FrmMng_DebStIgnTOOk_C "Zeit bis Fehler StIgn-TO (ZAS1) geheilt" VALUE 0x1D24C8 Kw_Wu16 655350.0 Time_ms 0.00 655350.0 FORMAT "%8.1" /end CHARACTERISTIC
/begin CHARACTERISTIC FrmMng_dEng1Byte1_C "Initialisierungswert für die CAN-Sendebotschaft" VALUE 0x1D22E4 Kw_Wu8 255.0 OneToOne 0.00 255.0 FORMAT "%5.1" /end CHARACTERISTIC
/begin CHARACTERISTIC FrmMng_dEng1Byte2_C "Initialisierungswert für die CAN-Sendebotschaft" VALUE 0x1D22E5 Kw_Wu8 255.0 OneToOne 0.00 255.0 FORMAT "%5.1" /end CHARACTERISTIC
/begin CHARACTERISTIC FrmMng_dEng1Byte3_C "Initialisierungswert für die CAN-Sendebotschaft" VALUE 0x1D22E6 Kw_Wu8 255.0 OneToOne 0.00 255.0 FORMAT "%5.1" /end CHARACTERISTIC
/begin CHARACTERISTIC FrmMng_dEng1Byte4_C "Initialisierungswert für die CAN-Sendebotschaft" VALUE 0x1D22E7 Kw_Wu8 255.0 OneToOne 0.00 255.0 FORMAT "%5.1" /end CHARACTERISTIC
/begin CHARACTERISTIC FrmMng_dEng1Byte5_C "Initialisierungswert für die CAN-Sendebotschaft" VALUE 0x1D22E8 Kw_Wu8 255.0 OneToOne 0.00 255.0 FORMAT "%5.1" /end CHARACTERISTIC
/begin CHARACTERISTIC FrmMng_dEng1Byte6_C "Initialisierungswert für die CAN-Sendebotschaft" VALUE 0x1D22E9 Kw_Wu8 255.0 OneToOne 0.00 255.0 FORMAT "%5.1" /end CHARACTERISTIC
/begin CHARACTERISTIC FrmMng_dEng1Byte7_C "Initialisierungswert für die CAN-Sendebotschaft" VALUE 0x1D22EA Kw_Wu8 255.0 OneToOne 0.00 255.0 FORMAT "%5.1" /end CHARACTERISTIC
/begin CHARACTERISTIC FrmMng_dEng1Byte8_C "Initialisierungswert für die CAN-Sendebotschaft" VALUE 0x1D22EB Kw_Wu8 255.0 OneToOne 0.00 255.0 FORMAT "%5.1" /end CHARACTERISTIC
/begin CHARACTERISTIC FrmMng_dEng2Byte1_C "Initialisierungswert für die CAN-Sendebotschaft" VALUE 0x1D22EC Kw_Wu8 255.0 OneToOne 0.00 255.0 FORMAT "%5.1" /end CHARACTERISTIC
/begin CHARACTERISTIC FrmMng_dEng2Byte2_C "Initialisierungswert für die CAN-Sendebotschaft" VALUE 0x1D22ED Kw_Wu8 255.0 OneToOne 0.00 255.0 FORMAT "%5.1" /end CHARACTERISTIC
/begin CHARACTERISTIC FrmMng_dEng2Byte3_C "Initialisierungswert für die CAN-Sendebotschaft" VALUE 0x1D22EE Kw_Wu8 255.0 OneToOne 0.00 255.0 FORMAT "%5.1" /end CHARACTERISTIC
/begin CHARACTERISTIC FrmMng_dEng2Byte4_C "Initialisierungswert für die CAN-Sendebotschaft" VALUE 0x1D22EF Kw_Wu8 255.0 OneToOne 0.00 255.0 FORMAT "%5.1" /end CHARACTERISTIC
/begin CHARACTERISTIC FrmMng_dEng2Byte5_C "Initialisierungswert für die CAN-Sendebotschaft" VALUE 0x1D22F0 Kw_Wu8 255.0 OneToOne 0.00 255.0 FORMAT "%5.1" /end CHARACTERISTIC
/begin CHARACTERISTIC FrmMng_dEng2Byte6_C "Initialisierungswert für die CAN-Sendebotschaft" VALUE 0x1D22F1 Kw_Wu8 255.0 OneToOne 0.00 255.0 FORMAT "%5.1" /end CHARACTERISTIC
/begin CHARACTERISTIC FrmMng_dEng2Byte7_C "Initialisierungswert für die CAN-Sendebotschaft" VALUE 0x1D22F2 Kw_Wu8 255.0 OneToOne 0.00 255.0 FORMAT "%5.1" /end CHARACTERISTIC
/begin CHARACTERISTIC FrmMng_dEng2Byte8_C "Initialisierungswert für die CAN-Sendebotschaft" VALUE 0x1D22F3 Kw_Wu8 255.0 OneToOne 0.00 255.0 FORMAT "%5.1" /end CHARACTERISTIC
/begin CHARACTERISTIC FrmMng_dEng3Byte1_C "Initialisierungswert für die CAN-Sendebotschaft" VALUE 0x1D22F4 Kw_Wu8 255.0 OneToOne 0.00 255.0 FORMAT "%5.1" /end CHARACTERISTIC
/begin CHARACTERISTIC FrmMng_dEng3Byte2_C "Initialisierungswert für die CAN-Sendebotschaft" VALUE 0x1D22F5 Kw_Wu8 255.0 OneToOne 0.00 255.0 FORMAT "%5.1" /end CHARACTERISTIC
/begin CHARACTERISTIC FrmMng_dEng3Byte3_C "Initialisierungswert für die CAN-Sendebotschaft" VALUE 0x1D22F6 Kw_Wu8 255.0 OneToOne 0.00 255.0 FORMAT "%5.1" /end CHARACTERISTIC
/begin CHARACTERISTIC FrmMng_dEng3Byte4_C "Initialisierungswert für die CAN-Sendebotschaft" VALUE 0x1D22F7 Kw_Wu8 255.0 OneToOne 0.00 255.0 FORMAT "%5.1" /end CHARACTERISTIC
/begin CHARACTERISTIC FrmMng_dEng3Byte5_C "Initialisierungswert für die CAN-Sendebotschaft" VALUE 0x1D22F8 Kw_Wu8 255.0 OneToOne 0.00 255.0 FORMAT "%5.1" /end CHARACTERISTIC
/begin CHARACTERISTIC FrmMng_dEng3Byte6_C "Initialisierungswert für die CAN-Sendebotschaft" VALUE 0x1D22F9 Kw_Wu8 255.0 OneToOne 0.00 255.0 FORMAT "%5.1" /end CHARACTERISTIC
/begin CHARACTERISTIC FrmMng_dEng3Byte7_C "Initialisierungswert für die CAN-Sendebotschaft" VALUE 0x1D22FA Kw_Wu8 255.0 OneToOne 0.00 255.0 FORMAT "%5.1" /end CHARACTERISTIC
/begin CHARACTERISTIC FrmMng_dEng3Byte8_C "Initialisierungswert für die CAN-Sendebotschaft" VALUE 0x1D22FB Kw_Wu8 255.0 OneToOne 0.00 255.0 FORMAT "%5.1" /end CHARACTERISTIC
/begin CHARACTERISTIC FrmMng_dEng5Byte1_C "Initialisierungswert für die CAN-Sendebotschaft" VALUE 0x1D22FC Kw_Wu8 255.0 OneToOne 0.00 255.0 FORMAT "%5.1" /end CHARACTERISTIC
/begin CHARACTERISTIC FrmMng_dEng5Byte2_C "Initialisierungswert für die CAN-Sendebotschaft" VALUE 0x1D22FD Kw_Wu8 255.0 OneToOne 0.00 255.0 FORMAT "%5.1" /end CHARACTERISTIC
/begin CHARACTERISTIC FrmMng_dEng5Byte3_C "Initialisierungswert für die CAN-Sendebotschaft" VALUE 0x1D22FE Kw_Wu8 255.0 OneToOne 0.00 255.0 FORMAT "%5.1" /end CHARACTERISTIC
/begin CHARACTERISTIC FrmMng_dEng5Byte4_C "Initialisierungswert für die CAN-Sendebotschaft" VALUE 0x1D22FF Kw_Wu8 255.0 OneToOne 0.00 255.0 FORMAT "%5.1" /end CHARACTERISTIC
/begin CHARACTERISTIC FrmMng_dEng5Byte5_C "Initialisierungswert für die CAN-Sendebotschaft" VALUE 0x1D2300 Kw_Wu8 255.0 OneToOne 0.00 255.0 FORMAT "%5.1" /end CHARACTERISTIC
/begin CHARACTERISTIC FrmMng_dEng5Byte6_C "Initialisierungswert für die CAN-Sendebotschaft" VALUE 0x1D2301 Kw_Wu8 255.0 OneToOne 0.00 255.0 FORMAT "%5.1" /end CHARACTERISTIC
/begin CHARACTERISTIC FrmMng_dEng5Byte7_C "Initialisierungswert für die CAN-Sendebotschaft" VALUE 0x1D2302 Kw_Wu8 255.0 OneToOne 0.00 255.0 FORMAT "%5.1" /end CHARACTERISTIC
/begin CHARACTERISTIC FrmMng_dEng5Byte8_C "Initialisierungswert für die CAN-Sendebotschaft" VALUE 0x1D2303 Kw_Wu8 255.0 OneToOne 0.00 255.0 FORMAT "%5.1" /end CHARACTERISTIC
/begin CHARACTERISTIC FrmMng_dEng6Byte1_C "Initialisierungswert für die CAN-Sendebotschaft" VALUE 0x1D2304 Kw_Wu8 255.0 OneToOne 0.00 255.0 FORMAT "%5.1" /end CHARACTERISTIC
/begin CHARACTERISTIC FrmMng_dEng6Byte2_C "Initialisierungswert für die CAN-Sendebotschaft" VALUE 0x1D2305 Kw_Wu8 255.0 OneToOne 0.00 255.0 FORMAT "%5.1" /end CHARACTERISTIC
/begin CHARACTERISTIC FrmMng_dEng6Byte3_C "Initialisierungswert für die CAN-Sendebotschaft" VALUE 0x1D2306 Kw_Wu8 255.0 OneToOne 0.00 255.0 FORMAT "%5.1" /end CHARACTERISTIC
/begin CHARACTERISTIC FrmMng_dEng6Byte4_C "Initialisierungswert für die CAN-Sendebotschaft" VALUE 0x1D2307 Kw_Wu8 255.0 OneToOne 0.00 255.0 FORMAT "%5.1" /end CHARACTERISTIC
/begin CHARACTERISTIC FrmMng_dEng6Byte5_C "Initialisierungswert für die CAN-Sendebotschaft" VALUE 0x1D2308 Kw_Wu8 255.0 OneToOne 0.00 255.0 FORMAT "%5.1" /end CHARACTERISTIC
/begin CHARACTERISTIC FrmMng_dEng6Byte6_C "Initialisierungswert für die CAN-Sendebotschaft" VALUE 0x1D2309 Kw_Wu8 255.0 OneToOne 0.00 255.0 FORMAT "%5.1" /end CHARACTERISTIC
/begin CHARACTERISTIC FrmMng_dEng6Byte7_C "Initialisierungswert für die CAN-Sendebotschaft" VALUE 0x1D230A Kw_Wu8 255.0 OneToOne 0.00 255.0 FORMAT "%5.1" /end CHARACTERISTIC
/begin CHARACTERISTIC FrmMng_dEng6Byte8_C "Initialisierungswert für die CAN-Sendebotschaft" VALUE 0x1D230B Kw_Wu8 255.0 OneToOne 0.00 255.0 FORMAT "%5.1" /end CHARACTERISTIC
/begin CHARACTERISTIC FrmMng_dEng7Byte1_C "Initialisierungswert für die CAN-Sendebotschaft" VALUE 0x1D230C Kw_Wu8 255.0 OneToOne 0.00 255.0 FORMAT "%5.1" /end CHARACTERISTIC
/begin CHARACTERISTIC FrmMng_dEng7Byte2_C "Initialisierungswert für die CAN-Sendebotschaft" VALUE 0x1D230D Kw_Wu8 255.0 OneToOne 0.00 255.0 FORMAT "%5.1" /end CHARACTERISTIC
/begin CHARACTERISTIC FrmMng_dEng7Byte3_C "Initialisierungswert für die CAN-Sendebotschaft" VALUE 0x1D230E Kw_Wu8 255.0 OneToOne 0.00 255.0 FORMAT "%5.1" /end CHARACTERISTIC
/begin CHARACTERISTIC FrmMng_dEng7Byte4_C "Initialisierungswert für die CAN-Sendebotschaft" VALUE 0x1D230F Kw_Wu8 255.0 OneToOne 0.00 255.0 FORMAT "%5.1" /end CHARACTERISTIC
/begin CHARACTERISTIC FrmMng_dEng7Byte5_C "Initialisierungswert für die CAN-Sendebotschaft" VALUE 0x1D2310 Kw_Wu8 255.0 OneToOne 0.00 255.0 FORMAT "%5.1" /end CHARACTERISTIC
/begin CHARACTERISTIC FrmMng_dEng7Byte6_C "Initialisierungswert für die CAN-Sendebotschaft" VALUE 0x1D2311 Kw_Wu8 255.0 OneToOne 0.00 255.0 FORMAT "%5.1" /end CHARACTERISTIC
/begin CHARACTERISTIC FrmMng_dEng7Byte7_C "Initialisierungswert für die CAN-Sendebotschaft" VALUE 0x1D2312 Kw_Wu8 255.0 OneToOne 0.00 255.0 FORMAT "%5.1" /end CHARACTERISTIC
/begin CHARACTERISTIC FrmMng_dEng7Byte8_C "Initialisierungswert für die CAN-Sendebotschaft" VALUE 0x1D2313 Kw_Wu8 255.0 OneToOne 0.00 255.0 FORMAT "%5.1" /end CHARACTERISTIC
/begin CHARACTERISTIC FrmMng_dENGACTR1Byte1_C "Initialisierungswert für die ENGACTR1-CAN-Sendebotschaft" VALUE 0x1D2314 Kw_Wu8 255.0 OneToOne 0.00 255.0 FORMAT "%5.1" /end CHARACTERISTIC
/begin CHARACTERISTIC FrmMng_dENGACTR1Byte2_C "Initialisierungswert für die ENGACTR1-CAN-Sendebotschaft" VALUE 0x1D2315 Kw_Wu8 255.0 OneToOne 0.00 255.0 FORMAT "%5.1" /end CHARACTERISTIC
/begin CHARACTERISTIC FrmMng_dENGACTR1Byte3_C "Initialisierungswert für die ENGACTR1-CAN-Sendebotschaft" VALUE 0x1D2316 Kw_Wu8 255.0 OneToOne 0.00 255.0 FORMAT "%5.1" /end CHARACTERISTIC
/begin CHARACTERISTIC FrmMng_dENGACTR1Byte4_C "Initialisierungswert für die ENGACTR1-CAN-Sendebotschaft" VALUE 0x1D2317 Kw_Wu8 255.0 OneToOne 0.00 255.0 FORMAT "%5.1" /end CHARACTERISTIC
/begin CHARACTERISTIC FrmMng_dENGACTR1Byte5_C "Initialisierungswert für die ENGACTR1-CAN-Sendebotschaft" VALUE 0x1D2318 Kw_Wu8 255.0 OneToOne 0.00 255.0 FORMAT "%5.1" /end CHARACTERISTIC
/begin CHARACTERISTIC FrmMng_dENGACTR1Byte6_C "Initialisierungswert für die ENGACTR1-CAN-Sendebotschaft" VALUE 0x1D2319 Kw_Wu8 255.0 OneToOne 0.00 255.0 FORMAT "%5.1" /end CHARACTERISTIC
/begin CHARACTERISTIC FrmMng_dENGACTR1Byte7_C "Initialisierungswert für die ENGACTR1-CAN-Sendebotschaft" VALUE 0x1D231A Kw_Wu8 255.0 OneToOne 0.00 255.0 FORMAT "%5.1" /end CHARACTERISTIC
/begin CHARACTERISTIC FrmMng_dENGACTR1Byte8_C "Initialisierungswert für die ENGACTR1-CAN-Sendebotschaft" VALUE 0x1D231B Kw_Wu8 255.0 OneToOne 0.00 255.0 FORMAT "%5.1" /end CHARACTERISTIC
/begin CHARACTERISTIC FrmMng_dEngflxByte1_C "Initialisierungswert für die CAN-Sendebotschaft" VALUE 0x1D231C Kw_Wu8 255.0 OneToOne 0.00 255.0 FORMAT "%5.1" /end CHARACTERISTIC
/begin CHARACTERISTIC FrmMng_dEngflxByte2_C "Initialisierungswert für die CAN-Sendebotschaft" VALUE 0x1D231D Kw_Wu8 255.0 OneToOne 0.00 255.0 FORMAT "%5.1" /end CHARACTERISTIC
/begin CHARACTERISTIC FrmMng_dEngflxByte3_C "Initialisierungswert für die CAN-Sendebotschaft" VALUE 0x1D231E Kw_Wu8 255.0 OneToOne 0.00 255.0 FORMAT "%5.1" /end CHARACTERISTIC
/begin CHARACTERISTIC FrmMng_dEngflxByte4_C "Initialisierungswert für die CAN-Sendebotschaft" VALUE 0x1D231F Kw_Wu8 255.0 OneToOne 0.00 255.0 FORMAT "%5.1" /end CHARACTERISTIC
/begin CHARACTERISTIC FrmMng_dEngflxByte5_C "Initialisierungswert für die CAN-Sendebotschaft" VALUE 0x1D2320 Kw_Wu8 255.0 OneToOne 0.00 255.0 FORMAT "%5.1" /end CHARACTERISTIC
/begin CHARACTERISTIC FrmMng_dEngflxByte6_C "Initialisierungswert für die CAN-Sendebotschaft" VALUE 0x1D2321 Kw_Wu8 255.0 OneToOne 0.00 255.0 FORMAT "%5.1" /end CHARACTERISTIC
/begin CHARACTERISTIC FrmMng_dEngflxByte7_C "Initialisierungswert für die CAN-Sendebotschaft" VALUE 0x1D2322 Kw_Wu8 255.0 OneToOne 0.00 255.0 FORMAT "%5.1" /end CHARACTERISTIC
/begin CHARACTERISTIC FrmMng_dEngflxByte8_C "Initialisierungswert für die CAN-Sendebotschaft" VALUE 0x1D2323 Kw_Wu8 255.0 OneToOne 0.00 255.0 FORMAT "%5.1" /end CHARACTERISTIC
/begin CHARACTERISTIC FrmMng_dEngTRQ1Byte1_C "Initialisierungswert für die CAN-Sendebotschaft" VALUE 0x1D2324 Kw_Wu8 255.0 OneToOne 0.00 255.0 FORMAT "%5.1" /end CHARACTERISTIC
/begin CHARACTERISTIC FrmMng_dEngTRQ1Byte2_C "Initialisierungswert für die CAN-Sendebotschaft" VALUE 0x1D2325 Kw_Wu8 255.0 OneToOne 0.00 255.0 FORMAT "%5.1" /end CHARACTERISTIC
/begin CHARACTERISTIC FrmMng_dEngTRQ1Byte3_C "Initialisierungswert für die CAN-Sendebotschaft" VALUE 0x1D2326 Kw_Wu8 255.0 OneToOne 0.00 255.0 FORMAT "%5.1" /end CHARACTERISTIC
/begin CHARACTERISTIC FrmMng_dEngTRQ1Byte4_C "Initialisierungswert für die CAN-Sendebotschaft" VALUE 0x1D2327 Kw_Wu8 255.0 OneToOne 0.00 255.0 FORMAT "%5.1" /end CHARACTERISTIC
/begin CHARACTERISTIC FrmMng_dEngTRQ1Byte5_C "Initialisierungswert für die CAN-Sendebotschaft" VALUE 0x1D2328 Kw_Wu8 255.0 OneToOne 0.00 255.0 FORMAT "%5.1" /end CHARACTERISTIC
/begin CHARACTERISTIC FrmMng_dEngTRQ1Byte6_C "Initialisierungswert für die CAN-Sendebotschaft" VALUE 0x1D2329 Kw_Wu8 255.0 OneToOne 0.00 255.0 FORMAT "%5.1" /end CHARACTERISTIC
/begin CHARACTERISTIC FrmMng_dEngTRQ1Byte7_C "Initialisierungswert für die CAN-Sendebotschaft" VALUE 0x1D232A Kw_Wu8 255.0 OneToOne 0.00 255.0 FORMAT "%5.1" /end CHARACTERISTIC
/begin CHARACTERISTIC FrmMng_dEngTRQ1Byte8_C "Initialisierungswert für die CAN-Sendebotschaft" VALUE 0x1D232B Kw_Wu8 255.0 OneToOne 0.00 255.0 FORMAT "%5.1" /end CHARACTERISTIC
/begin CHARACTERISTIC FrmMng_dEngTRQ2Byte1_C "Initialisierungswert für die CAN-Sendebotschaft" VALUE 0x1D232C Kw_Wu8 255.0 OneToOne 0.00 255.0 FORMAT "%5.1" /end CHARACTERISTIC
/begin CHARACTERISTIC FrmMng_dEngTRQ2Byte2_C "Initialisierungswert für die CAN-Sendebotschaft" VALUE 0x1D232D Kw_Wu8 255.0 OneToOne 0.00 255.0 FORMAT "%5.1" /end CHARACTERISTIC
/begin CHARACTERISTIC FrmMng_dEngTRQ2Byte3_C "Initialisierungswert für die CAN-Sendebotschaft" VALUE 0x1D232E Kw_Wu8 255.0 OneToOne 0.00 255.0 FORMAT "%5.1" /end CHARACTERISTIC
/begin CHARACTERISTIC FrmMng_dEngTRQ2Byte4_C "Initialisierungswert für die CAN-Sendebotschaft" VALUE 0x1D232F Kw_Wu8 255.0 OneToOne 0.00 255.0 FORMAT "%5.1" /end CHARACTERISTIC
/begin CHARACTERISTIC FrmMng_dEngTRQ2Byte5_C "Initialisierungswert für die CAN-Sendebotschaft" VALUE 0x1D2330 Kw_Wu8 255.0 OneToOne 0.00 255.0 FORMAT "%5.1" /end CHARACTERISTIC
/begin CHARACTERISTIC FrmMng_dEngTRQ2Byte6_C "Initialisierungswert für die CAN-Sendebotschaft" VALUE 0x1D2331 Kw_Wu8 255.0 OneToOne 0.00 255.0 FORMAT "%5.1" /end CHARACTERISTIC
/begin CHARACTERISTIC FrmMng_dEngTRQ2Byte7_C "Initialisierungswert für die CAN-Sendebotschaft" VALUE 0x1D2332 Kw_Wu8 255.0 OneToOne 0.00 255.0 FORMAT "%5.1" /end CHARACTERISTIC
/begin CHARACTERISTIC FrmMng_dEngTRQ2Byte8_C "Initialisierungswert für die CAN-Sendebotschaft" VALUE 0x1D2333 Kw_Wu8 255.0 OneToOne 0.00 255.0 FORMAT "%5.1" /end CHARACTERISTIC
/begin CHARACTERISTIC FrmMng_dEngTRQ3Byte1_C "Initialisierungswert für die CAN-Sendebotschaft" VALUE 0x1D2334 Kw_Wu8 255.0 OneToOne 0.00 255.0 FORMAT "%5.1" /end CHARACTERISTIC
/begin CHARACTERISTIC FrmMng_dEngTRQ3Byte2_C "Initialisierungswert für die CAN-Sendebotschaft" VALUE 0x1D2335 Kw_Wu8 255.0 OneToOne 0.00 255.0 FORMAT "%5.1" /end CHARACTERISTIC
/begin CHARACTERISTIC FrmMng_dEngTRQ3Byte3_C "Initialisierungswert für die CAN-Sendebotschaft" VALUE 0x1D2336 Kw_Wu8 255.0 OneToOne 0.00 255.0 FORMAT "%5.1" /end CHARACTERISTIC
/begin CHARACTERISTIC FrmMng_dEngTRQ3Byte4_C "Initialisierungswert für die CAN-Sendebotschaft" VALUE 0x1D2337 Kw_Wu8 255.0 OneToOne 0.00 255.0 FORMAT "%5.1" /end CHARACTERISTIC
/begin CHARACTERISTIC FrmMng_dEngTRQ3Byte5_C "Initialisierungswert für die CAN-Sendebotschaft" VALUE 0x1D2338 Kw_Wu8 255.0 OneToOne 0.00 255.0 FORMAT "%5.1" /end CHARACTERISTIC
/begin CHARACTERISTIC FrmMng_dEngTRQ3Byte6_C "Initialisierungswert für die CAN-Sendebotschaft" VALUE 0x1D2339 Kw_Wu8 255.0 OneToOne 0.00 255.0 FORMAT "%5.1" /end CHARACTERISTIC
/begin CHARACTERISTIC FrmMng_dEngTRQ3Byte7_C "Initialisierungswert für die CAN-Sendebotschaft" VALUE 0x1D233A Kw_Wu8 255.0 OneToOne 0.00 255.0 FORMAT "%5.1" /end CHARACTERISTIC
/begin CHARACTERISTIC FrmMng_dEngTRQ3Byte8_C "Initialisierungswert für die CAN-Sendebotschaft" VALUE 0x1D233B Kw_Wu8 255.0 OneToOne 0.00 255.0 FORMAT "%5.1" /end CHARACTERISTIC
/begin CHARACTERISTIC FrmMng_LimRawMax_C "CAN Begrenzungsrohwert" VALUE 0x1D233C Kw_Ws32 4294967295.00 OneToOne -2147483648.00 2147483647.00 FORMAT "%13.2" /end CHARACTERISTIC
/begin CHARACTERISTIC FrmMng_RawErr_C "CAN Fehlerkennzeichen Rohwert" VALUE 0x1D2340 Kw_Ws32 4294967295.00 OneToOne -2147483648.00 2147483647.00 FORMAT "%13.2" /end CHARACTERISTIC
/begin CHARACTERISTIC FrmMng_MaxDiffAAG_C "Maximale Differenz damit auf Botschaftszähler unplausibel erkannt wird für AAG" VALUE 0x1D24A0 Kw_Wu8 255.0 OneToOne 0.00 255.0 FORMAT "%5.1" /end CHARACTERISTIC
/begin CHARACTERISTIC FrmMng_MaxDiffACC_C "Maximale Zählerdifferenz für Botschaftszähler ACC-System" VALUE 0x1D23D2 Kw_Wu8 255.0 OneToOne 0.00 255.0 FORMAT "%5.1" /end CHARACTERISTIC
/begin CHARACTERISTIC FrmMng_MaxDiffAirbg_C "Maximale Zählerdifferenz für Botschaftszähler Airbag1" VALUE 0x1D23EA Kw_Wu8 255.0 OneToOne 0.00 255.0 FORMAT "%5.1" /end CHARACTERISTIC
/begin CHARACTERISTIC FrmMng_MaxDiffAWD1_C "Maximale Botschaftszählerdifferenz für Botschaftszähler Allrad1" VALUE 0x1D23FC Kw_Wu8 255.0 OneToOne 0.00 255.0 FORMAT "%5.1" /end CHARACTERISTIC
/begin CHARACTERISTIC FrmMng_MaxDiffBEM1_C "Maximale Zählerdifferenz für Botschaftszähler BEM1" VALUE 0x1D2418 Kw_Wu8 255.0 OneToOne 0.00 255.0 FORMAT "%5.1" /end CHARACTERISTIC
/begin CHARACTERISTIC FrmMng_MaxDiffBRK1_C "Maximale Zählerdifferenz für Botschaftszähler BRK1" VALUE 0x1D244C Kw_Wu8 255.0 OneToOne 0.00 255.0 FORMAT "%5.1" /end CHARACTERISTIC
/begin CHARACTERISTIC FrmMng_MaxDiffBRK8_C "Maximale Zählerdifferenz für Botschaftszähler BRK8" VALUE 0x1D244D Kw_Wu8 255.0 OneToOne 0.00 255.0 FORMAT "%5.1" /end CHARACTERISTIC
/begin CHARACTERISTIC FrmMng_MaxDiffCCTL_C "Maximale Zählerdifferenz für Botschaftszähler Cruise Control" VALUE 0x1D23A8 Kw_Wu8 255.0 OneToOne 0.00 255.0 FORMAT "%5.1" /end CHARACTERISTIC
/begin CHARACTERISTIC FrmMng_MaxDiffDSP1_C "Maximale Zählerdifferenz für Botschaftszähler Kombi1" VALUE 0x1D246A Kw_Wu8 255.0 OneToOne 0.00 255.0 FORMAT "%5.1" /end CHARACTERISTIC
/begin CHARACTERISTIC FrmMng_MaxDiffILM_C "Maximale Differenz damit auf Botschaftszähler unplausibel erkannt wird für ILM" VALUE 0x1D24A1 Kw_Wu8 255.0 OneToOne 0.00 255.0 FORMAT "%5.1" /end CHARACTERISTIC
/begin CHARACTERISTIC FrmMng_MaxDiffNIVEAU1_C "Maximale Zählerdifferenz für Botschaftszähler NIVEAU1" VALUE 0x1D24BA Kw_Wu8 255.0 OneToOne 0.00 255.0 FORMAT "%5.1" /end CHARACTERISTIC
/begin CHARACTERISTIC FrmMng_MaxPerAAG_C "Maximale Anzahl der Perioden bevor auf stehenden Botschaftszähler erkannt wird für AAG" VALUE 0x1D24A2 Kw_Wu8 255.0 OneToOne 0.00 255.0 FORMAT "%5.1" /end CHARACTERISTIC
/begin CHARACTERISTIC FrmMng_MaxPerACC_C "Maximale Periodenzahl für Botschaftszähler ACC-System" VALUE 0x1D23D3 Kw_Wu8 255.0 OneToOne 0.00 255.0 FORMAT "%5.1" /end CHARACTERISTIC
/begin CHARACTERISTIC FrmMng_MaxPerAirbg_C "Maximale Periodenzahl für Botschaftszähler Airbag1" VALUE 0x1D23EB Kw_Wu8 255.0 OneToOne 0.00 255.0 FORMAT "%5.1" /end CHARACTERISTIC
/begin CHARACTERISTIC FrmMng_MaxPerAWD1_C "Maximale Perioden für Botschaftszähler Allrad1" VALUE 0x1D23FD Kw_Wu8 255.0 OneToOne 0.00 255.0 FORMAT "%5.1" /end CHARACTERISTIC
/begin CHARACTERISTIC FrmMng_MaxPerBEM1_C "Maximale Periodenzahl für Botschaftszähler BEM1" VALUE 0x1D2419 Kw_Wu8 255.0 OneToOne 0.00 255.0 FORMAT "%5.1" /end CHARACTERISTIC
/begin CHARACTERISTIC FrmMng_MaxPerBRK1_C "Maximale Periodenzahl für Botschaftszähler BRK1" VALUE 0x1D244E Kw_Wu8 255.0 OneToOne 0.00 255.0 FORMAT "%5.1" /end CHARACTERISTIC
/begin CHARACTERISTIC FrmMng_MaxPerBRK8_C "Maximale Periodenzahl für Botschaftszähler BRK8" VALUE 0x1D244F Kw_Wu8 255.0 OneToOne 0.00 255.0 FORMAT "%5.1" /end CHARACTERISTIC
/begin CHARACTERISTIC FrmMng_MaxPerCCTL_C "Maximale Periodenzahl für Botschaftszähler Cruise Control" VALUE 0x1D23A9 Kw_Wu8 255.0 OneToOne 0.00 255.0 FORMAT "%5.1" /end CHARACTERISTIC
/begin CHARACTERISTIC FrmMng_MaxPerDSP1_C "Maximale Periodenzahl für Botschaftszähler Kombi1" VALUE 0x1D246B Kw_Wu8 255.0 OneToOne 0.00 255.0 FORMAT "%5.1" /end CHARACTERISTIC
/begin CHARACTERISTIC FrmMng_MaxPerILM_C "Maximale Anzahl der Perioden bevor auf stehenden Botschaftszähler erkannt wird für ILM" VALUE 0x1D24A3 Kw_Wu8 255.0 OneToOne 0.00 255.0 FORMAT "%5.1" /end CHARACTERISTIC
/begin CHARACTERISTIC FrmMng_MaxPerNIVEAU1_C "Maximale Perioden for Botschaftszähler Niveau1" VALUE 0x1D24BB Kw_Wu8 255.0 OneToOne 0.00 255.0 FORMAT "%5.1" /end CHARACTERISTIC
/begin CHARACTERISTIC FrmMng_nDes_Offset_C "Offset Umrechung SG->CAN für Drehzahl" VALUE 0x1D2344 Kw_Ws16 65535.00 EngN -32768.00 32767.00 FORMAT "%8.2" /end CHARACTERISTIC
/begin CHARACTERISTIC FrmMng_facNDes_Slope_C "Steigung Umrechung SG->CAN für Drehzahl" VALUE 0x1D2346 Kw_Ws16 511.9922 Fact1 -256.0000 255.9922 FORMAT "%8.4" /end CHARACTERISTIC
/begin CHARACTERISTIC FrmMng_nLI_Offset_C "Offset Umrechung SG->CAN für Drehzahl" VALUE 0x1D2348 Kw_Ws16 65535.00 EngN -32768.00 32767.00 FORMAT "%8.2" /end CHARACTERISTIC
/begin CHARACTERISTIC FrmMng_facNLI_Slope_C "Steigung Umrechung SG->CAN für Drehzahl" VALUE 0x1D234A Kw_Ws16 511.9922 Fact1 -256.0000 255.9922 FORMAT "%8.4" /end CHARACTERISTIC
/begin CHARACTERISTIC FrmMng_nmax_Offset_C "Offset Umrechung SG->CAN für Drehzahl bei max. Drehmoment" VALUE 0x1D234C Kw_Ws16 65535.00 EngN -32768.00 32767.00 FORMAT "%8.2" /end CHARACTERISTIC
/begin CHARACTERISTIC FrmMng_facnmax_Slope_C "Steigung Umrechung SG->CAN für Drehzahl bei max. Drehmoment" VALUE 0x1D234E Kw_Ws16 511.9922 Fact1 -256.0000 255.9922 FORMAT "%8.4" /end CHARACTERISTIC
/begin CHARACTERISTIC FrmMng_nMulinfo5_1_C "Multiplex Info 1, Botschaft Motor5, Drehzahl bei Momentenmaximum" VALUE 0x1D2350 Kw_Wu16 6000.000 EngN 0.00 6000.000 FORMAT "%8.3" EXTENDED_LIMITS 0.00 65535.00 /end CHARACTERISTIC
/begin CHARACTERISTIC FrmMng_pACPress_Offset_C "Offset Umrechung SG->CAN für Klima - Kältemitteldruck" VALUE 0x1D23B4 Kw_Ws16 131070.0 PresAC_hPa -65536.00 65534.00 FORMAT "%8.2" /end CHARACTERISTIC
/begin CHARACTERISTIC FrmMng_facACPress_Slope_C "Steigung Umrechung SG->CAN für Klima - Kältemitteldruck" VALUE 0x1D23B6 Kw_Ws16 7.999878 Fact -4.000000 3.999878 FORMAT "%8.6" /end CHARACTERISTIC
/begin CHARACTERISTIC FrmMng_tiPlausCANVerDebDef_C "Fehlerentprellzeit für CAN-Version Fehler" VALUE 0x1D24BC Kw_Wu16 655350.0 Time_ms 0.00 655350.0 FORMAT "%8.1" /end CHARACTERISTIC
/begin CHARACTERISTIC FrmMng_tiPlausCANVerDebOk_C "Heiltzeit für CAN-Version Fehler" VALUE 0x1D24BE Kw_Wu16 655350.0 Time_ms 0.00 655350.0 FORMAT "%8.1" /end CHARACTERISTIC
/begin CHARACTERISTIC FrmMng_pwrBEMAltInit_C "Wert für Generatorleistung, wenn keine gültige Botschaft empfangen wird" VALUE 0x1D241A Kw_Ws16 32767.00 OneToOne 0.00 32767.00 FORMAT "%8.2" EXTENDED_LIMITS -32768.00 32767.00 /end CHARACTERISTIC
/begin CHARACTERISTIC FrmMng_pwrInr_Offset_C "Offset für CAN-Generatorleistung" VALUE 0x1D241C Kw_Ws16 617652.8 Pwr -308831.1 308821.7 FORMAT "%8.1" /end CHARACTERISTIC
/begin CHARACTERISTIC FrmMng_facRpwr_Slope_C "Steigung für Generatorleistung über CAN" VALUE 0x1D241E Kw_Ws16 511.9922 Fact1 -256.0000 255.9922 FORMAT "%8.4" /end CHARACTERISTIC
/begin CHARACTERISTIC FrmMng_p_Offset_C "Offset Umrechung SG->CAN für Druck" VALUE 0x1D2352 Kw_Ws16 65535.00 Pres_hPa -32768.00 32767.00 FORMAT "%8.2" /end CHARACTERISTIC
/begin CHARACTERISTIC FrmMng_facP_Slope_C "Steigung Umrechung SG->CAN für Druck" VALUE 0x1D2354 Kw_Ws16 7.999878 Fact -4.000000 3.999878 FORMAT "%8.6" /end CHARACTERISTIC
/begin CHARACTERISTIC FrmMng_rAPP_Offset_C "Offset Umrechung SG->CAN für Pedalwertgeber" VALUE 0x1D2356 Kw_Ws16 655.3500 Prc -327.6800 327.6700 FORMAT "%8.4" /end CHARACTERISTIC
/begin CHARACTERISTIC FrmMng_facRAPP_Slope_C "Steigung Umrechung SG->CAN für Pedalwertgeber" VALUE 0x1D2358 Kw_Ws16 7.999878 Fact -4.000000 3.999878 FORMAT "%8.6" /end CHARACTERISTIC
/begin CHARACTERISTIC FrmMng_rFan_Offset_C "Offset Umrechnung SG -> CAN für Kühlerlüftersteuerung" VALUE 0x1D235A Kw_Ws16 655.3500 Prc -327.6800 327.6700 FORMAT "%8.4" /end CHARACTERISTIC
/begin CHARACTERISTIC FrmMng_facrFan_Slope_C "Steigung Umrechnung SG -> für Kühlerlüftersteuerung" VALUE 0x1D235C Kw_Ws16 7.999878 Fact -4.000000 3.999878 FORMAT "%8.6" /end CHARACTERISTIC
/begin CHARACTERISTIC FrmMng_rGearbx_Offset_C "Offset Umrechung SG->CAN für Gearbx System" VALUE 0x1D235E Kw_Ws16 655.3500 Prc -327.6800 327.6700 FORMAT "%8.4" /end CHARACTERISTIC
/begin CHARACTERISTIC FrmMng_facRGearbx_Slope_C "Steigung Umrechung SG->CAN für Anteils von dem Freien Integralmoment" VALUE 0x1D2360 Kw_Ws16 7.999878 Fact -4.000000 3.999878 FORMAT "%8.6" /end CHARACTERISTIC
/begin CHARACTERISTIC FrmMng_rInrTrq_Offset_C "Offset Umrechung SG->CAN für indiziertes inneres Moment" VALUE 0x1D2362 Kw_Ws16 25700.01 rTrqCAN -12850.20 12849.81 FORMAT "%8.2" /end CHARACTERISTIC
/begin CHARACTERISTIC FrmMng_facRInrTrq_Slope_C "Steigung Umrechung SG->CAN für indiziertes inneres Moment" VALUE 0x1D2364 Kw_Ws16 7.999878 Fact -4.000000 3.999878 FORMAT "%8.6" /end CHARACTERISTIC
/begin CHARACTERISTIC FrmMng_rTrqLim_Offset_C "Offset Umrechung SG->CAN für Begrenzungsmoment" VALUE 0x1D23FE Kw_Ws16 25700.01 rTrqCAN -12850.20 12849.81 FORMAT "%8.2" /end CHARACTERISTIC
/begin CHARACTERISTIC FrmMng_facRTrqLim_Slope_C "Steigung Umrechung SG->CAN für Begrenzungsmoment" VALUE 0x1D2400 Kw_Ws16 7.999878 Fact -4.000000 3.999878 FORMAT "%8.6" /end CHARACTERISTIC
/begin CHARACTERISTIC FrmMng_stCCSelPlaus_C "Label zum Aktivieren des Plausibilitätschecks für AUDI_ACC (ACC1 -RX)" VALUE 0x1D23D4 Kw_Wu8 1.000 OneToOne 0.00 1.000 FORMAT "%5.3" EXTENDED_LIMITS 0.00 255.0 /end CHARACTERISTIC
/begin CHARACTERISTIC FrmMng_stGWTipUpDnInfo_C "Freischalten Empfang von Tip Up und Tip Down über CAN" VALUE 0x1D23AA Kw_Wu8 1.000 OneToOne 0.00 1.000 FORMAT "%5.3" EXTENDED_LIMITS 0.00 255.0 /end CHARACTERISTIC
/begin CHARACTERISTIC FrmMng_stTORxMsgAlcECU_CA "Zuordnung welche Empfangs-Botschaft jeden Steuergerät zugeordnet ist" VAL_BLK 0x1D2366 Kwb_Wu8 255.0 OneToOne 0.00 255.0 FORMAT "%5.1" NUMBER 32 /end CHARACTERISTIC
/begin CHARACTERISTIC FrmMng_swtAC1Ena_C "Freischaltung für CAN-Botschaft Klima1" VALUE 0x1D23B8 Kw_Wu8 1.000 OneToOne 0.00 1.000 FORMAT "%5.3" EXTENDED_LIMITS 0.00 255.0 /end CHARACTERISTIC
/begin CHARACTERISTIC FrmMng_swtACC1Ena_C "Freischaltung der ACC1-Botschaft" VALUE 0x1D23D5 Kw_Wu8 1.000 OneToOne 0.00 1.000 FORMAT "%5.3" EXTENDED_LIMITS 0.00 255.0 /end CHARACTERISTIC
/begin CHARACTERISTIC FrmMng_swtACCSysEna_C "Freischaltung für CAN-Botschaft ACC System" VALUE 0x1D23D6 Kw_Wu8 1.000 OneToOne 0.00 1.000 FORMAT "%5.3" EXTENDED_LIMITS 0.00 255.0 /end CHARACTERISTIC
/begin CHARACTERISTIC FrmMng_swtAIRBG1Ena_C "Freischaltung für CAN-Botschaft Airbag1" VALUE 0x1D23EC Kw_Wu8 1.000 OneToOne 0.00 1.000 FORMAT "%5.3" EXTENDED_LIMITS 0.00 255.0 /end CHARACTERISTIC
/begin CHARACTERISTIC FrmMng_swtAWD1Ena_C "Aktivierungsschalter für CAN Botschaft Allrad1" VALUE 0x1D2402 Kw_Wu8 1.000 OneToOne 0.00 1.000 FORMAT "%5.3" EXTENDED_LIMITS 0.00 255.0 /end CHARACTERISTIC
/begin CHARACTERISTIC FrmMng_swtBEM1Ena_C "Freischaltung BEM1-Empfangsbotschaft" VALUE 0x1D2420 Kw_Wu8 1.000 OneToOne 0.00 1.000 FORMAT "%5.3" EXTENDED_LIMITS 0.00 255.0 /end CHARACTERISTIC
/begin CHARACTERISTIC FrmMng_swtBRK1Ena_C "Freischaltung für CAN-Botschaft Bremse1" VALUE 0x1D2450 Kw_Wu8 1.000 OneToOne 0.00 1.000 FORMAT "%5.3" EXTENDED_LIMITS 0.00 255.0 /end CHARACTERISTIC
/begin CHARACTERISTIC FrmMng_swtBRK2Ena_C "Freischaltung für CAN-Botschaft Bremse2" VALUE 0x1D2451 Kw_Wu8 1.000 OneToOne 0.00 1.000 FORMAT "%5.3" EXTENDED_LIMITS 0.00 255.0 /end CHARACTERISTIC
/begin CHARACTERISTIC FrmMng_swtBRK8Ena_C "Freischaltung für CAN-Botschaft BRK8" VALUE 0x1D2452 Kw_Wu8 1.000 OneToOne 0.00 1.000 FORMAT "%5.3" EXTENDED_LIMITS 0.00 255.0 /end CHARACTERISTIC
/begin CHARACTERISTIC FrmMng_swtCCTLEna_C "Freischaltung für CAN-Botschaft CCTL" VALUE 0x1D23AB Kw_Wu8 1.000 OneToOne 0.00 1.000 FORMAT "%5.3" EXTENDED_LIMITS 0.00 255.0 /end CHARACTERISTIC
/begin CHARACTERISTIC FrmMng_swtDIA1Ena_C "Freischaltung DIA1-Empfangsbotschaft" VALUE 0x1D24A4 Kw_Wu8 1.000 OneToOne 0.00 1.000 FORMAT "%5.3" EXTENDED_LIMITS 0.00 255.0 /end CHARACTERISTIC
/begin CHARACTERISTIC FrmMng_swtDSP1Ena_C "Freischaltung für CAN-Botschaft Kombi1 (DSP1)" VALUE 0x1D246C Kw_Wu8 1.000 OneToOne 0.00 1.000 FORMAT "%5.3" EXTENDED_LIMITS 0.00 255.0 /end CHARACTERISTIC
/begin CHARACTERISTIC FrmMng_swtDSP2Ena_C "Freischaltung für CAN-Botschaft Kombi2 (DSP2)" VALUE 0x1D246D Kw_Wu8 1.000 OneToOne 0.00 1.000 FORMAT "%5.3" EXTENDED_LIMITS 0.00 255.0 /end CHARACTERISTIC
/begin CHARACTERISTIC FrmMng_swtESCUEna_C "Freischaltung für CAN-Botschaft BSG-Last" VALUE 0x1D247E Kw_Wu8 1.000 OneToOne 0.00 1.000 FORMAT "%5.3" EXTENDED_LIMITS 0.00 255.0 /end CHARACTERISTIC
/begin CHARACTERISTIC FrmMng_swtGW1Ena_C "Freischaltung GW1-Empfangsbotschaft" VALUE 0x1D24A5 Kw_Wu8 1.000 OneToOne 0.00 1.000 FORMAT "%5.3" EXTENDED_LIMITS 0.00 255.0 /end CHARACTERISTIC
/begin CHARACTERISTIC FrmMng_swtNIVEAU1Ena_C "Freischaltung für CAN-Botschaft Niveau1" VALUE 0x1D24C0 Kw_Wu8 1.000 OneToOne 0.00 1.000 FORMAT "%5.3" EXTENDED_LIMITS 0.00 255.0 /end CHARACTERISTIC
/begin CHARACTERISTIC FrmMng_swtSTIGNEna_C "Freischaltung für CAN-Botschaft ZAS1" VALUE 0x1D24CA Kw_Wu8 1.000 OneToOne 0.00 1.000 FORMAT "%5.3" EXTENDED_LIMITS 0.00 255.0 /end CHARACTERISTIC
/begin CHARACTERISTIC FrmMng_tEnv_Offset_C "Offset Umrechung SG->CAN für Umgebungstemperatur" VALUE 0x1D246E Kw_Ws16 6553.500 Temp_Cels -3549.940 3003.560 FORMAT "%8.3" /end CHARACTERISTIC
/begin CHARACTERISTIC FrmMng_facTEnv_Slope_C "Steigung Umrechung SG->CAN für Umgebungstemperatur" VALUE 0x1D2470 Kw_Ws16 7.999878 Fact -4.000000 3.999878 FORMAT "%8.6" /end CHARACTERISTIC
/begin CHARACTERISTIC FrmMng_tiAdpStrt_C "Speicherzeit bei Schwellwertüberschreitung" VALUE 0x1D23EE Kw_Wu16 655350.0 Time_ms 0.00 655350.0 FORMAT "%8.1" /end CHARACTERISTIC
/begin CHARACTERISTIC FrmMng_tiDebTO_C "Rampendauer für Abschaltung bei short TO Error in AUDI-RX(ACC1-RX Message)" VALUE 0x1D23D8 Kw_Wu16 5.000000 Time_s 0.00 5.000000 FORMAT "%8.6" EXTENDED_LIMITS 0.00 655.3500 /end CHARACTERISTIC
/begin CHARACTERISTIC FrmMng_tOil_Offset_C "Offset Umrechung SG->CAN für Öl-Temperatur" VALUE 0x1D2386 Kw_Ws16 6553.500 Temp_Cels -3549.940 3003.560 FORMAT "%8.3" /end CHARACTERISTIC
/begin CHARACTERISTIC FrmMng_facTOil_Slope_C "Steigung Umrechung SG->CAN für Öl-Temperatur" VALUE 0x1D2388 Kw_Ws16 7.999878 Fact -4.000000 3.999878 FORMAT "%8.6" /end CHARACTERISTIC
/begin CHARACTERISTIC FrmMng_trqAbs_Offset_C "Offset Umrechung SG->CAN für max. Drehmoment" VALUE 0x1D238A Kw_Ws16 6553.500 Trq -3276.800 3276.700 FORMAT "%8.3" /end CHARACTERISTIC
/begin CHARACTERISTIC FrmMng_factrqAbs_Slope_C "Steigung Umrechung SG->CAN für max. Drehmoment" VALUE 0x1D238C Kw_Ws16 511.9922 Fact1 -256.0000 255.9922 FORMAT "%8.4" /end CHARACTERISTIC
/begin CHARACTERISTIC FrmMng_trqACComprLoad_Offset_C "Offset Umrechung SG->CAN für Klimawunschmoment" VALUE 0x1D23BA Kw_Ws16 6553.500 Trq -3276.800 3276.700 FORMAT "%8.3" /end CHARACTERISTIC
/begin CHARACTERISTIC FrmMng_facACComprLoad_Slope_C "Steigung Umrechung SG->CAN für Klimawunschmoment" VALUE 0x1D23BC Kw_Ws16 7.999878 Fact -4.000000 3.999878 FORMAT "%8.6" /end CHARACTERISTIC
/begin CHARACTERISTIC FrmMng_trqMulinfo2_3_C "Multiplex Info 3, Botschaft Motor2, maximales Moment" VALUE 0x1D238E Kw_Wu16 630.0000 Trq 0.00 630.0000 FORMAT "%8.4" EXTENDED_LIMITS 0.00 6553.500 /end CHARACTERISTIC
/begin CHARACTERISTIC FrmMng_t_Offset_C "Offset Umrechung SG->CAN für Temperatur" VALUE 0x1D2390 Kw_Ws16 6553.500 Temp_Cels -3549.940 3003.560 FORMAT "%8.3" /end CHARACTERISTIC
/begin CHARACTERISTIC FrmMng_facT_Slope_C "Steigung Umrechung SG->CAN für Temperatur" VALUE 0x1D2392 Kw_Ws16 7.999878 Fact -4.000000 3.999878 FORMAT "%8.6" /end CHARACTERISTIC
/begin CHARACTERISTIC FrmMng_vGSInitVal_C "Init-wert für FrmMng_vGS" VALUE 0x1D2454 Kw_Ws16 655.3500 Vel -327.6800 327.6700 FORMAT "%8.4" /end CHARACTERISTIC
/begin CHARACTERISTIC FrmMng_vLim_Offset_C "Offset Umrechung SG->CAN für Höchstgeschwindigkeit" VALUE 0x1D2404 Kw_Ws16 655.3500 Vel -327.6800 327.6700 FORMAT "%8.4" /end CHARACTERISTIC
/begin CHARACTERISTIC FrmMng_facVLim_Slope_C "Steigung Umrechung SG->CAN für Höchstgeschwindigkeit" VALUE 0x1D2406 Kw_Ws16 7.999878 Fact -4.000000 3.999878 FORMAT "%8.6" /end CHARACTERISTIC
/begin CHARACTERISTIC FrmMng_volTnk_Offset_C "Offset Umrechung SG->CAN für Volumen Tankfüllung" VALUE 0x1D2472 Kw_Ws16 32767.50 Fl_Half_L -16384.00 16383.50 FORMAT "%8.2" /end CHARACTERISTIC
/begin CHARACTERISTIC FrmMng_facVolTnk_Slope_C "Steigung Umrechung SG->CAN für Volumen Tankfüllung" VALUE 0x1D2474 Kw_Ws16 7.999878 Fact -4.000000 3.999878 FORMAT "%8.6" /end CHARACTERISTIC
/begin CHARACTERISTIC FrmMng_v_Offset_C "Offset Umrechung SG->CAN für Fahrgeschwindigkeit" VALUE 0x1D2394 Kw_Ws16 655.3500 Vel -327.6800 327.6700 FORMAT "%8.4" /end CHARACTERISTIC
/begin CHARACTERISTIC FrmMng_facV_Slope_C "Steigung Umrechung SG->CAN für Fahrgeschwindigkeit" VALUE 0x1D2396 Kw_Ws16 7.999878 Fact -4.000000 3.999878 FORMAT "%8.6" /end CHARACTERISTIC
/begin MEASUREMENT FanCtl_dcycFan1Byp_mp "Messpunkt um ASCET bevor bybass Wert zu lesen" SWORD DtyCyc 1 100 -327.6800 327.6700 FORMAT "%8.4" ECU_ADDRESS 0x802C24 /end MEASUREMENT
/begin MEASUREMENT FanCtl_dcycFan1Preset3_mp "Rampeanfangswert für dutycycle für fan 1" SWORD DtyCyc 1 100 -327.6800 327.6700 FORMAT "%8.4" ECU_ADDRESS 0x802C26 /end MEASUREMENT
/begin MEASUREMENT FanCtl_dcycFan1RampSwtAR_mp "Augenblickwert von Duty cycle für fan1 nach erste Rampe." SWORD DtyCyc 1 100 -327.6800 327.6700 FORMAT "%8.4" ECU_ADDRESS 0x802C28 /end MEASUREMENT
/begin MEASUREMENT FanCtl_dcycFan1RampSwt_mp "Augenblickwert von Duty cycle für fan1" SWORD DtyCyc 1 100 -327.6800 327.6700 FORMAT "%8.4" ECU_ADDRESS 0x802C2A /end MEASUREMENT
/begin MEASUREMENT FanCtl_dcycFan1_mp "Duty Cycle für Fan1" SWORD DtyCyc 1 100 -327.6800 327.6700 FORMAT "%8.4" ECU_ADDRESS 0x802C2C /end MEASUREMENT
/begin MEASUREMENT FanCtl_dcycFan2Byp_mp "Messpunkt um den Wert von ASCET vor einem Bypass zu lesen" SWORD DtyCyc 1 100 -327.6800 327.6700 FORMAT "%8.4" ECU_ADDRESS 0x802C2E /end MEASUREMENT
/begin MEASUREMENT FanCtl_dcycFan2Preset3_mp "duty cycle für fan2 ramp switch" SWORD DtyCyc 1 100 -327.6800 327.6700 FORMAT "%8.4" ECU_ADDRESS 0x802C30 /end MEASUREMENT
/begin MEASUREMENT FanCtl_dcycFan2RampSwtAR_mp "Augenblickwert von Duty cycle für fan2 nach erste Rampe." SWORD DtyCyc 1 100 -327.6800 327.6700 FORMAT "%8.4" ECU_ADDRESS 0x802C32 /end MEASUREMENT
/begin MEASUREMENT FanCtl_dcycFan2RampSwt_mp "duty cycle nach fan 2 ramp switch" SWORD DtyCyc 1 100 -327.6800 327.6700 FORMAT "%8.4" ECU_ADDRESS 0x802C34 /end MEASUREMENT
/begin MEASUREMENT FanCtl_dcycFan2_mp "Messwert für Dutycycle von Fan2" SWORD DtyCyc 1 100 -327.6800 327.6700 FORMAT "%8.4" ECU_ADDRESS 0x802C36 /end MEASUREMENT
/begin MEASUREMENT FanCtl_dtClntDesDiffCorr_mp "Korrigierter Offset der Soll-Temperaturdifferenz" SWORD TempDiff_Kelv 1 100 -3276.800 3276.700 FORMAT "%8.3" ECU_ADDRESS 0x802C38 /end MEASUREMENT
/begin MEASUREMENT FanCtl_dtClntDesDiff_mp "Errechnete Soll-Temperaturdifferenz" SWORD TempDiff_Kelv 1 100 -3276.800 3276.700 FORMAT "%8.3" ECU_ADDRESS 0x802C3A /end MEASUREMENT
/begin MEASUREMENT FanCtl_dtClntDes_mp "Temperaturdifferenz für FanCtl_dtClntDesCorr_MAP" SWORD TempDiff_Kelv 1 100 -3276.800 3276.700 FORMAT "%8.3" ECU_ADDRESS 0x802C3C /end MEASUREMENT
/begin MEASUREMENT FanCtl_dtClntDiff_mp "Abweichung Soll-Temperatur am Kühleraustritt und tatsächliche Temperatur" SWORD TempDiff_Kelv 1 100 -3276.800 3276.700 FORMAT "%8.3" ECU_ADDRESS 0x802C3E /end MEASUREMENT
/begin MEASUREMENT FanCtl_dtCOTSCrit_mp "Differenz zwischen aktueller Temperatur am Kühleraustritt und einem Schwellwert" SWORD TempDiff_Kelv 1 100 -3276.800 3276.700 FORMAT "%8.3" ECU_ADDRESS 0x802C40 /end MEASUREMENT
/begin MEASUREMENT FanCtl_dvolFlConsumFltHold_mp "Meßpunkt des gefilterter Verbrauchs für den Nachlaufprozeß der Kühlerlüftersteuerung" SWORD FlConsum_l_h 1 100 -327.6800 327.6700 FORMAT "%8.4" ECU_ADDRESS 0x802C42 /end MEASUREMENT
/begin MEASUREMENT FanCtl_factCorr_mp "Korrrekturfaktor der Kühlmitteltemp.differenz über den Kühler" SWORD Fact 1 100 -4.000000 3.999878 FORMAT "%8.6" ECU_ADDRESS 0x802C44 /end MEASUREMENT
/begin MEASUREMENT FanCtl_nElBase3_mp "Basisdrehzahl für Elektrolüfter nach zusätzlicher Ausblendbedingung und minimaler Lüfterdrehzahl" SWORD EngN 1 100 -32768.00 32767.00 FORMAT "%8.2" ECU_ADDRESS 0x802C46 /end MEASUREMENT
/begin MEASUREMENT FanCtl_nFan1Base2_mp "Das Ergebnis für Drehzahlmaximum um Fan1 toggle zu verhindern." SWORD EngN 1 100 -32768.00 32767.00 FORMAT "%8.2" ECU_ADDRESS 0x802C48 /end MEASUREMENT
/begin MEASUREMENT FanCtl_nFan1Base_mp "Berechnete Wert von FanCtl_nFan1Base_MAP" SWORD EngN 1 100 -32768.00 32767.00 FORMAT "%8.2" ECU_ADDRESS 0x802C4A /end MEASUREMENT
/begin MEASUREMENT FanCtl_nFan2Base2_mp "Ergebnis von Maximumderahzahl um fan 2 toggle zu verhindern." SWORD EngN 1 100 -32768.00 32767.00 FORMAT "%8.2" ECU_ADDRESS 0x802C4C /end MEASUREMENT
/begin MEASUREMENT FanCtl_nFan2Base_mp "Berechnete Wert von FanCtl_nFan2Base_MAP" SWORD EngN 1 100 -32768.00 32767.00 FORMAT "%8.2" ECU_ADDRESS 0x802C4E /end MEASUREMENT
/begin MEASUREMENT FanCtl_nHydBase3_mp "Basisdrehzahl für Elektrolüfter nach zusätzlicher Ausblendbedingung und minimaler Lüfterdrehzahl" SWORD EngN 1 100 -32768.00 32767.00 FORMAT "%8.2" ECU_ADDRESS 0x802C50 /end MEASUREMENT
/begin MEASUREMENT FanCtl_pAcHold_mp "gespeicherter Klimadruck" SWORD PresAC_hPa 1 100 -65536.00 65534.00 FORMAT "%8.2" ECU_ADDRESS 0x802C52 /end MEASUREMENT
/begin MEASUREMENT FanCtl_pAc_mp "EIngangswert für die Tabelle prcQKakt and prcQKdeakt" SWORD PresAC_hPa 1 100 -65536.00 65534.00 FORMAT "%8.2" ECU_ADDRESS 0x802C54 /end MEASUREMENT
/begin MEASUREMENT FanCtl_prcACMnSw_mp "output value of the curve prcQKdeakt" SWORD Prc 1 100 -327.6800 327.6700 FORMAT "%8.4" ECU_ADDRESS 0x802C56 /end MEASUREMENT
/begin MEASUREMENT FanCtl_prcAcMul_mp "multiplied value of FanCtl_factACReqCorr_mp & prcAc" SWORD Prc 1 100 -327.6800 327.6700 FORMAT "%8.4" ECU_ADDRESS 0x802C58 /end MEASUREMENT
/begin MEASUREMENT FanCtl_prcCANByp_mp "Bypass message für FanCtl_prcCAN" SWORD Prc 1 100 -327.6800 327.6700 FORMAT "%8.4" ECU_ADDRESS 0x802C5A /end MEASUREMENT
/begin MEASUREMENT FanCtl_prcClntDesDiff_mp "relative Sollkühlleistung über den Kühler" SWORD Prc 1 100 -327.6800 327.6700 FORMAT "%8.4" ECU_ADDRESS 0x802C5C /end MEASUREMENT
/begin MEASUREMENT FanCtl_prcRelClntDes1_mp "Korrekturwert der Solltemperatur für den relativen dynamischen Kühlbedarf" SWORD Prc 1 100 -327.6800 327.6700 FORMAT "%8.4" ECU_ADDRESS 0x802C5E /end MEASUREMENT
/begin MEASUREMENT FanCtl_prcRelClntDes2_mp "relativer dynamischer Kühlbedarf" SWORD Prc 1 100 -327.6800 327.6700 FORMAT "%8.4" ECU_ADDRESS 0x802C60 /end MEASUREMENT
/begin MEASUREMENT FanCtl_prcRelClntDes_mp "Solltemperaturdifferenz des Kühlers für den relativen dynamische Kühlbedarf" SWORD Prc 1 100 -327.6800 327.6700 FORMAT "%8.4" ECU_ADDRESS 0x802C62 /end MEASUREMENT
/begin MEASUREMENT FanCtl_stCtl_mp "bitcodierte Stati der Lüftersteuerung" UWORD OneToOne 1 100 0.00 65535.00 FORMAT "%8.2" ECU_ADDRESS 0x802C64 /end MEASUREMENT
/begin MEASUREMENT FanCtl_tAirHold_mp "Umgebungstemperatur  für den Nachlaufprozeß" SWORD Temp_Cels 1 100 -3549.940 3003.560 FORMAT "%8.3" ECU_ADDRESS 0x802C66 /end MEASUREMENT
/begin MEASUREMENT FanCtl_tClntCrit_mp "berechnete kritische Kühlmitteltemperatur" SWORD Temp_Cels 1 100 -3549.940 3003.560 FORMAT "%8.3" ECU_ADDRESS 0x802C68 /end MEASUREMENT
/begin MEASUREMENT FanCtl_tClntDesCor1_mp "Kühlmittelsolltemperatur nach 1. Korrektur" SWORD Temp_Cels 1 100 -3549.940 3003.560 FORMAT "%8.3" ECU_ADDRESS 0x802C6A /end MEASUREMENT
/begin MEASUREMENT FanCtl_tClntDesFlt_mp "PT1-gefilterter Kühlmitteltemperatursollwert" SWORD Temp_Cels 1 100 -3549.940 3003.560 FORMAT "%8.3" ECU_ADDRESS 0x802C6C /end MEASUREMENT
/begin MEASUREMENT FanCtl_tClntDesMap_mp "Kühlmittelsolltemperatur vor Korrektur" SWORD Temp_Cels 1 100 -3549.940 3003.560 FORMAT "%8.3" ECU_ADDRESS 0x802C6E /end MEASUREMENT
/begin MEASUREMENT FanCtl_tClntDesRaw_mp "Kühlmitteltemperatursollwert" SWORD Temp_Cels 1 100 -3549.940 3003.560 FORMAT "%8.3" ECU_ADDRESS 0x802C70 /end MEASUREMENT
/begin MEASUREMENT FanCtl_tClntDes_mp "Kühlmitteltemp.sollwert am Kühleraustritt" SWORD Temp_Cels 1 100 -3549.940 3003.560 FORMAT "%8.3" ECU_ADDRESS 0x802C72 /end MEASUREMENT
/begin MEASUREMENT FanCtl_tCTSCurr_mp "aktuelle Eingangstemperatur des Kennfeld FanCtl_tClntDes_MAP" SWORD Temp_Cels 1 100 -3549.940 3003.560 FORMAT "%8.3" ECU_ADDRESS 0x802C74 /end MEASUREMENT
/begin MEASUREMENT FanCtl_tiAfterrun_mp "berechnete Lüfternachlaufdauer" ULONG Time_ms 1 100 0.00 42949672950.0 FORMAT "%13.1" ECU_ADDRESS 0x802C78 /end MEASUREMENT
/begin MEASUREMENT FanCtl_tiARprc_mp "prozentueller Anteil der 1. Lüfternachlaufzeit für die Ermittlung einer neuen Dauer" ULONG Time_ms 1 100 0.00 42949672950.0 FORMAT "%13.1" ECU_ADDRESS 0x802C7C /end MEASUREMENT
/begin MEASUREMENT FanCtl_tiARremain_mp "verbleibende Nachlaufzeit" ULONG Time_ms 1 100 0.00 42949672950.0 FORMAT "%13.1" ECU_ADDRESS 0x802C80 /end MEASUREMENT
/begin MEASUREMENT FanCtl_tiAR_mp "aktuelle Dauer des Lüfternachlaufs" ULONG Time_ms 1 100 0.00 42949672950.0 FORMAT "%13.1" ECU_ADDRESS 0x802C84 /end MEASUREMENT
/begin MEASUREMENT FanCtl_vCurr2_mp "zweite verwendete Fahrzeuggeschwindigkeit" SWORD Vel 1 100 -327.6800 327.6700 FORMAT "%8.4" ECU_ADDRESS 0x802C88 /end MEASUREMENT
/begin MEASUREMENT FanCtl_vCurr_mp "verwendete Fahrzeuggeschwindigkeit" SWORD Vel 1 100 -327.6800 327.6700 FORMAT "%8.4" ECU_ADDRESS 0x802C8A /end MEASUREMENT
/begin MEASUREMENT FBC_AALOut_mp "Ausgang des Antialiasingfiler" FLOAT32_IEEE OneToOne 1 100 -150000000. 150000000. FORMAT "%10.0" ECU_ADDRESS 0x802C98 /end MEASUREMENT
/begin MEASUREMENT FBC_Badpt "Adaptionsstatus" UBYTE OneToOne 1 100 0.00 255.0 FORMAT "%5.1" ECU_ADDRESS 0x7F93D4 /end MEASUREMENT
/begin MEASUREMENT FBC_BPAmpCaS_mp "aktueller Bandpass Zählerkoeffizient f=fNW (gangabhängig)" FLOAT32_IEEE OneToOne 1 100 -4.00000000 4.00000000 FORMAT "%10.8" ECU_ADDRESS 0x802C8C /end MEASUREMENT
/begin MEASUREMENT FBC_ctSegInt "interner Segmentzähler von FBC" UBYTE OneToOne 1 100 0.00 255.0 FORMAT "%5.1" ECU_ADDRESS 0x7F93D6 /end MEASUREMENT
/begin MEASUREMENT FBC_dBPCaS_mp "Array der Bandpassausgänge" SWORD EngN 1 100 -32768.00 32767.00 FORMAT "%8.2" ARRAY_SIZE 3 ECU_ADDRESS 0x802C90 /end MEASUREMENT
/begin MEASUREMENT FBC_dBPSum "FBC Mengenersatzsignal, Eingang PI-Regler" SWORD OneToOne 1 100 -32768.00 32767.00 FORMAT "%8.2" ECU_ADDRESS 0x7F981E /end MEASUREMENT
/begin MEASUREMENT FBC_DXadpt_mp "aktuelle Adaptionsgüte" SWORD Dxs 1 100 -0.8192000 0.8191750 FORMAT "%9.7" ECU_ADDRESS 0x802C9C /end MEASUREMENT
/begin MEASUREMENT FBC_DXSfn_mp "Ausgang des negativen Bewertungsfilter" SWORD Dxs 1 100 -0.8192000 0.8191750 FORMAT "%9.7" ARRAY_SIZE 12 ECU_ADDRESS 0x802C9E /end MEASUREMENT
/begin MEASUREMENT FBC_DXSfp_mp "Ausgang des positiven Bewertungsfilter" SWORD Dxs 1 100 -0.8192000 0.8191750 FORMAT "%9.7" ARRAY_SIZE 12 ECU_ADDRESS 0x802CB6 /end MEASUREMENT
/begin MEASUREMENT FBC_DXSf_mp "relative,aktuelle und gefilterte Zahnteilungsfehler (Adaptionsfilter)" SWORD Dxs 1 100 -0.8192000 0.8191750 FORMAT "%9.7" ARRAY_SIZE 12 ECU_ADDRESS 0x802CCE /end MEASUREMENT
/begin MEASUREMENT FBC_DXSl_mp "relative, gefilterte Zahnteilungsfehler (Adaptionsfilter, eingelernte Werte)" SWORD Dxs 1 100 -0.8192000 0.8191750 FORMAT "%9.7" ARRAY_SIZE 12 ECU_ADDRESS 0x802CE6 /end MEASUREMENT
/begin MEASUREMENT FBC_DXS_mp "relative Zahnteilungsfehler (ungefiltert)" SWORD Dxs 1 100 -0.8192000 0.8191750 FORMAT "%9.7" ARRAY_SIZE 12 ECU_ADDRESS 0x802CFE /end MEASUREMENT
/begin MEASUREMENT FBC_q "Ausgangsmenge der Mengenausgleichsregelung" SWORD InjMass 1 100 -327.6800 327.6700 FORMAT "%8.4" ECU_ADDRESS 0x7F9820 /end MEASUREMENT
/begin MEASUREMENT FBC_qDvtCyl "aktuelle zylinderindividuelle Korrekturmenge: I-Anteil" SWORD InjMass 1 100 -327.6800 327.6700 FORMAT "%8.4" ARRAY_SIZE 7 ECU_ADDRESS 0x7F9E82 /end MEASUREMENT
/begin MEASUREMENT FBC_qLimAct "Aktuelle Begrenzungsmenge für FBC_q" SWORD InjMass 1 100 -327.6800 327.6700 FORMAT "%8.4" ECU_ADDRESS 0x7F9822 /end MEASUREMENT
/begin MEASUREMENT FBC_RegionChng "signalisiert einen Wechsel der Lernregion in der FBC" UBYTE OneToOne 1 100 0.00 255.0 FORMAT "%5.1" ECU_ADDRESS 0x7F93D5 /end MEASUREMENT
/begin MEASUREMENT FBC_Region_mp "Drehzahl-/Mengenbereich für ""regeln - steuern - inaktiv""" UBYTE OneToOne 1 100 0.00 255.0 FORMAT "%5.1" ECU_ADDRESS 0x802D16 /end MEASUREMENT
/begin MEASUREMENT FBC_stActive "Status FBC-Regler -> '1': Regeln; '0': Steuern" UBYTE OneToOne 1 100 0.00 255.0 FORMAT "%5.1" ECU_ADDRESS 0x7F93D7 /end MEASUREMENT
/begin MEASUREMENT FBC_stEqualInit "Initialisierungsstatus für FBC-Regler" UBYTE OneToOne 1 100 0.00 255.0 FORMAT "%5.1" ECU_ADDRESS 0x7F93D8 /end MEASUREMENT
/begin MEASUREMENT FBC_stLearn "Bitfeld für Übergänge des Zustandsautomaten" UWORD OneToOne 1 100 0.00 65535.00 FORMAT "%8.2" ECU_ADDRESS 0x7F9824 /end MEASUREMENT
/begin MEASUREMENT FBC_stRegion_mp "Status  Regler in Abhängigkeit von Menge/Drehzahl ('regeln','steuern','inaktiv')" UBYTE OneToOne 1 100 0.00 255.0 FORMAT "%5.1" ECU_ADDRESS 0x802C96 /end MEASUREMENT
/begin MEASUREMENT FBC_stState_mp "Status des Zustandsautomates der Adaption" UBYTE FBC_LrnState 1 100 1.00000000000 5.00000000000 FORMAT "%13.11" ECU_ADDRESS 0x802D17 /end MEASUREMENT
/begin MEASUREMENT FBC_WheelLrnOut "Eingangsignal für FBC Bandpässe" FLOAT32_IEEE OneToOne 1 100 -1.00000000E+35 1.00000000E+35 FORMAT "%10.0" ECU_ADDRESS 0x7F9CA8 /end MEASUREMENT
/begin MEASUREMENT FlMng_AirTemp_mp "Lufttemperatur für PWG abhängige Rauchbegrenzung" SWORD Temp_Cels 1 100 -3549.940 3003.560 FORMAT "%8.3" ECU_ADDRESS 0x802D26 /end MEASUREMENT
/begin MEASUREMENT FlMng_facCor_mp "Lambda Grenzwert Korrektur Faktor für PWG abhängige Rauchbegrenzung" SWORD Fact 1 100 -4.000000 3.999878 FORMAT "%8.6" ECU_ADDRESS 0x802D28 /end MEASUREMENT
/begin MEASUREMENT FlMng_facLmbdSmkSOE_mp "Korrekturfaktor aufgrund Saugrohrdruck" SWORD Fact 1 100 -4.000000 3.999878 FORMAT "%8.6" ECU_ADDRESS 0x802D2A /end MEASUREMENT
/begin MEASUREMENT FlMng_mAirPerCylLim_mp "begrenzte Luftmasse" SWORD AirMassPerCyl 1 100 -3276.800 3276.700 FORMAT "%8.3" ECU_ADDRESS 0x802D2C /end MEASUREMENT
/begin MEASUREMENT FlMng_pBPAPCorr_mp "Ausgang des Druckwahlschalters FlMng_swtBPAP_C" SWORD Pres_hPa 1 100 -32768.00 32767.00 FORMAT "%8.2" ECU_ADDRESS 0x802D3C /end MEASUREMENT
/begin MEASUREMENT FlMng_pIATCorr_mp "Korrigierter Druck zur Rauchbegrenzung" SWORD Pres_hPa 1 100 -32768.00 32767.00 FORMAT "%8.2" ECU_ADDRESS 0x802D3E /end MEASUREMENT
/begin MEASUREMENT FlMng_pValSel_mp "Gewählter Druck für Korrekturfaktor" SWORD Pres_hPa 1 100 -32768.00 32767.00 FORMAT "%8.2" ECU_ADDRESS 0x802D2E /end MEASUREMENT
/begin MEASUREMENT FlMng_qFullLdRglI_mp "I-Anteil der Vollastregelung" SLONG InjMass 1 100 -21474836.4800 21474836.4700 FORMAT "%13.4" ECU_ADDRESS 0x802D18 /end MEASUREMENT
/begin MEASUREMENT FlMng_qFullLdRglP_mp "P-Anteil der Vollastregelung" SWORD InjMass 1 100 -327.6800 327.6700 FORMAT "%8.4" ECU_ADDRESS 0x802D1C /end MEASUREMENT
/begin MEASUREMENT FlMng_qFullLdRgl_mp "Stellgröße der Vollastregelung" SWORD InjMass 1 100 -327.6800 327.6700 FORMAT "%8.4" ECU_ADDRESS 0x802D1E /end MEASUREMENT
/begin MEASUREMENT FlMng_qLimSmk "Begrenzungsmenge zur Rauchbegrenzung" SWORD InjMass 1 100 -327.6800 327.6700 FORMAT "%8.4" ECU_ADDRESS 0x7F9868 /end MEASUREMENT
/begin MEASUREMENT FlMng_qLimSmkAir_mp "Begrenzungsmenge nach Rauchbegrenzungsauswahlschalter FlMng_swtSmokeVariant_C" SWORD InjMass 1 100 -327.6800 327.6700 FORMAT "%8.4" ECU_ADDRESS 0x802D40 /end MEASUREMENT
/begin MEASUREMENT FlMng_qLimSmkBas_mp "Basiswert der maximal zulässigen Kraftstoffmenge der Rauchbegrenzung" SWORD InjMass 1 100 -327.6800 327.6700 FORMAT "%8.4" ECU_ADDRESS 0x802D20 /end MEASUREMENT
/begin MEASUREMENT FlMng_qLimSmkByp_mp "Bypass message für FlMng_qLimSmk" SWORD InjMass 1 100 -327.6800 327.6700 FORMAT "%8.4" ECU_ADDRESS 0x802D30 /end MEASUREMENT
/begin MEASUREMENT FlMng_qLimSmkQ_mp "Begrenzungsmenge aus Rauchbegrenzung über Luftmasse/Luftdruck" SWORD InjMass 1 100 -327.6800 327.6700 FORMAT "%8.4" ECU_ADDRESS 0x802D42 /end MEASUREMENT
/begin MEASUREMENT FlMng_qTempFuelCorr_mp "Begrenzungsmenge gewichtet nach Kraftstofftemperatur" SWORD InjMass 1 100 -327.6800 327.6700 FORMAT "%8.4" ECU_ADDRESS 0x802D44 /end MEASUREMENT
/begin MEASUREMENT FlMng_qTempFuel_mp "Begrenzungsmenge aus Wunschmenge über KF FlMng_qTempFuel" SWORD dQnt_dT1 1 100 -655.3600 655.3400 FORMAT "%8.4" ECU_ADDRESS 0x802D46 /end MEASUREMENT
/begin MEASUREMENT FlMng_rLmbdPartLdCor_mp "PWG abhängige Rauchbegrenzung" SWORD lambda 1 100 -32.76800 32.76700 FORMAT "%8.5" ECU_ADDRESS 0x802D32 /end MEASUREMENT
/begin MEASUREMENT FlMng_rLmbdRecDvt_mp "Kehrwert der Lambdaabweichung bei Volllastregelung" SWORD lambdaRec 1 100 -3.276800 3.276700 FORMAT "%8.6" ECU_ADDRESS 0x802D22 /end MEASUREMENT
/begin MEASUREMENT FlMng_rLmbdSet_mp "minimal zulässiger Lambda Wert" SWORD lambda 1 100 -32.76800 32.76700 FORMAT "%8.5" ECU_ADDRESS 0x802D34 /end MEASUREMENT
/begin MEASUREMENT FlMng_rLmbdSmkSOECorr_mp "Lambdawert der Rauchbegrenzung aufgrund Ansteuerbeginn" SWORD lambda 1 100 -32.76800 32.76700 FORMAT "%8.5" ECU_ADDRESS 0x802D36 /end MEASUREMENT
/begin MEASUREMENT FlMng_rLmbdSmkSOE_mp "Lambdakorrekturwert durch Ansteuerbeginn - Frühverstellung" SWORD lambda 1 100 -32.76800 32.76700 FORMAT "%8.5" ECU_ADDRESS 0x802D38 /end MEASUREMENT
/begin MEASUREMENT FlMng_rLmbdSmk_mp "Lambda-Wert der Rauchbegrenzung" SWORD lambda 1 100 -32.76800 32.76700 FORMAT "%8.5" ECU_ADDRESS 0x802D3A /end MEASUREMENT
/begin MEASUREMENT FlMng_stMon_mp "Status der Einschaltlogik und Überwachung der VOllastregellung" UBYTE OneToOne 1 100 0.00 255.0 FORMAT "%5.1" ECU_ADDRESS 0x802D24 /end MEASUREMENT
/begin MEASUREMENT FlPpCD_stOutHWE_mp "Hardwareansteuerung Kraftstoffumwaelzpumpe" UBYTE OneToOne 1 100 0.00 255.0 FORMAT "%5.1" ECU_ADDRESS 0x802D48 /end MEASUREMENT
/begin MEASUREMENT FlPpCD_swtFlPpAct "Schalter fuer die Kraftstoffumwaelzpumpe ( 0 - deaktiviert / 1 - aktiviert )" UBYTE OneToOne 1 100 0.00 255.0 FORMAT "%5.1" ECU_ADDRESS 0x7F93E2 /end MEASUREMENT
/begin MEASUREMENT FlSCD_uLvlRawT1 "Spannungsrohwert des Kraftstofflevelsensors 1" SWORD Volt 1 100 -160156.4 160151.5 FORMAT "%8.1" ECU_ADDRESS 0x7F986A /end MEASUREMENT
/begin MEASUREMENT FlSCD_volTotal "gefiltertes Gesamtvolumen des Tanks" SWORD Fl_Half_L 1 100 -16384.00 16383.50 FORMAT "%8.2" ECU_ADDRESS 0x7F986C /end MEASUREMENT
/begin MEASUREMENT FlSCD_volTotalLin "Rohwert des Kraftstoffvolumens im Tank" SWORD Fl_Half_L 1 100 -16384.00 16383.50 FORMAT "%8.2" ECU_ADDRESS 0x7F986E /end MEASUREMENT
/begin MEASUREMENT FlSys_rhoFl "Koeffizient Kraftstoffdichte" SWORD RhoFuel 1 100 -3276.800 3276.700 FORMAT "%8.3" ECU_ADDRESS 0x7F9870 /end MEASUREMENT
/begin MEASUREMENT FlSys_stAftRunDelDem "Statusbit der Nachtankerkennung zur Verzögerung des Steuergeräte-Nachlaufs" UBYTE OneToOne 1 100 0.00 255.0 FORMAT "%5.1" ECU_ADDRESS 0x7F93E3 /end MEASUREMENT
/begin MEASUREMENT FlSys_stDeflate_mp "Aktivierung der Niederdruckentlueftung" UBYTE OneToOne 1 100 0.00 255.0 FORMAT "%5.1" ECU_ADDRESS 0x802D49 /end MEASUREMENT
/begin MEASUREMENT FlSys_stDetRefuel "Statusbyte der Nachtankerkennung" UBYTE OneToOne 1 100 0.00 255.0 FORMAT "%5.1" ECU_ADDRESS 0x7F93E4 /end MEASUREMENT
/begin MEASUREMENT FlSys_stDetRefuelEna_mp "Freigabestatus für den Zustandsautomaten" UBYTE OneToOne 1 100 0.00 255.0 FORMAT "%5.1" ECU_ADDRESS 0x802D4A /end MEASUREMENT
/begin MEASUREMENT FlSys_stFlPp "Statusmessage der Kraftstoffumwälzpumpenlogik" UBYTE OneToOne 1 100 0.00 255.0 FORMAT "%5.1" ECU_ADDRESS 0x7F93E5 /end MEASUREMENT
/begin MEASUREMENT FlSys_stLogicFlPp_mp "Meßpunkte für die Ansteuerungslogik der Kraftstoffumwälzpumpe" UBYTE OneToOne 1 100 0.00 255.0 FORMAT "%5.1" ECU_ADDRESS 0x802D5E /end MEASUREMENT
/begin MEASUREMENT FlSys_stSM_mp "Zustand des Zustandsautomaten" UBYTE OneToOne 1 100 0.00 255.0 FORMAT "%5.1" ECU_ADDRESS 0x802D4B /end MEASUREMENT
/begin MEASUREMENT FlSys_stTemp_mp "Statusbits zur Erfassung der Kraftstoffsystemtemperatur" UBYTE OneToOne 1 100 0.00 255.0 FORMAT "%5.1" ECU_ADDRESS 0x802D5F /end MEASUREMENT
/begin MEASUREMENT FlSys_swtTempSensCfg "Schalter, ob Kraftstofftemperaturfühler vorhanden" UBYTE OneToOne 1 100 0.00 255.0 FORMAT "%5.1" ECU_ADDRESS 0x7F93E6 /end MEASUREMENT
/begin MEASUREMENT FlSys_t "aktuelle Systemtemperatur" SWORD Temp_Cels 1 100 -3549.940 3003.560 FORMAT "%8.3" ECU_ADDRESS 0x7F9872 /end MEASUREMENT
/begin MEASUREMENT FlSys_volDetRefuel "Nachgetankte Kraftstoffmenge" SWORD Fl_Half_L 1 100 -16384.00 16383.50 FORMAT "%8.2" ECU_ADDRESS 0x7F9874 /end MEASUREMENT
/begin MEASUREMENT FlSys_volFuelConsCalc_mp "Integrierter Kraftstoffverbrauch für Tankfüllstandsersatzwertberechnung" SWORD Fl_Half_L 1 100 -16384.00 16383.50 FORMAT "%8.2" ECU_ADDRESS 0x802D4C /end MEASUREMENT
/begin MEASUREMENT FlSys_volFuelConsOld_mp "Integrierter Kraftstoffverbrauch alter Wert" SWORD Fl_Half_L 1 100 -16384.00 16383.50 FORMAT "%8.2" ECU_ADDRESS 0x802D4E /end MEASUREMENT
/begin MEASUREMENT FlSys_volFuelCons_mp "Integrierter Kraftstoffverbrauch für Überbetankung" SWORD Fl_Half_L 1 100 -16384.00 16383.50 FORMAT "%8.2" ECU_ADDRESS 0x802D50 /end MEASUREMENT
/begin MEASUREMENT FlSys_volTotalFlt "gefiltertes Tankfüllstandssignal" SWORD Fl_Half_L 1 100 -16384.00 16383.50 FORMAT "%8.2" ECU_ADDRESS 0x7F9876 /end MEASUREMENT
/begin MEASUREMENT FlSys_volTotalRef_mp "Referenzsignal des Tankfüllstands [l]" SWORD Fl_Half_L 1 100 -16384.00 16383.50 FORMAT "%8.2" ECU_ADDRESS 0x802D52 /end MEASUREMENT
/begin MEASUREMENT FlSys_volTotalReplVal_mp "Ersatzwert für den Tankfüllstand" SWORD Fl_Half_L 1 100 -16384.00 16383.50 FORMAT "%8.2" ECU_ADDRESS 0x802D54 /end MEASUREMENT
/begin MEASUREMENT FlSys_volTotalStrtVal_mp "Startwert für Tankfüllstandsersatzwertberechnung" SWORD Fl_Half_L 1 100 -16384.00 16383.50 FORMAT "%8.2" ECU_ADDRESS 0x802D56 /end MEASUREMENT
/begin MEASUREMENT FlSys_volTotal_mp "Tankfüllstandsausgangssignal der Signalüberwachung und Ersatzwertberechnung" SWORD Fl_Half_L 1 100 -16384.00 16383.50 FORMAT "%8.2" ECU_ADDRESS 0x802D58 /end MEASUREMENT
/begin MEASUREMENT FlSys_vVehReplVal_mp "Ersatzwert für die Fahrzeuggeschwindigkeit" SWORD Vel 1 100 -327.6800 327.6700 FORMAT "%8.4" ECU_ADDRESS 0x802D5A /end MEASUREMENT
/begin MEASUREMENT FlSys_vVeh_mp "Fahrzeuggeschwindigkeitsausgangssignal der Signalüberwachung und Ersatzwertberechnung" SWORD Vel 1 100 -327.6800 327.6700 FORMAT "%8.4" ECU_ADDRESS 0x802D5C /end MEASUREMENT
/begin MEASUREMENT FMA_dqAbs_mp "Absolutwert der Einspritzmengenänderung für FMA" SWORD InjMassSec 1 100 -327.6800 327.6700 FORMAT "%8.4" ECU_ADDRESS 0x802DF0 /end MEASUREMENT
/begin MEASUREMENT FMA_drLmbdAbs_mp "Absolutwert der Lambdaänderung für FMA" SWORD lambdaSec 1 100 -32.76800 32.76700 FORMAT "%8.5" ECU_ADDRESS 0x802DF2 /end MEASUREMENT
/begin MEASUREMENT FMA_facAirSwtOff_mp "Ansauglufttemperaturabhängiger Abschaltfaktor der FMA" SWORD Fact 1 100 -4.000000 3.999878 FORMAT "%8.6" ECU_ADDRESS 0x802DF4 /end MEASUREMENT
/begin MEASUREMENT FMA_facEngSwtOff_mp "Motortemperaturabhängiger Abschaltfaktor der FMA" SWORD Fact 1 100 -4.000000 3.999878 FORMAT "%8.6" ECU_ADDRESS 0x802DF6 /end MEASUREMENT
/begin MEASUREMENT FMA_facFaultSwtOff_mp "Faktor für langsame FMA-Abschaltung bei schweren Systemfehlern" SWORD Fact 1 100 -4.000000 3.999878 FORMAT "%8.6" ECU_ADDRESS 0x802DF8 /end MEASUREMENT
/begin MEASUREMENT FMA_facFlSwtOff_mp "Kraftstofftemperaturabhängiger Abschaltfaktor der FMA" SWORD Fact 1 100 -4.000000 3.999878 FORMAT "%8.6" ECU_ADDRESS 0x802DFA /end MEASUREMENT
/begin MEASUREMENT FMA_facRgnSwtOff_mp "Regenerations-/ Applikationsabhängiger Abschaltfaktor der FMA" SWORD Fact 1 100 -4.000000 3.999878 FORMAT "%8.6" ECU_ADDRESS 0x802DFC /end MEASUREMENT
/begin MEASUREMENT FMA_facSlpSwtOff_mp "Abschaltfaktor der FMA, gebildet aus den 4 oberen Abschaltfaktoren" SWORD Fact 1 100 -4.000000 3.999878 FORMAT "%8.6" ECU_ADDRESS 0x802DFE /end MEASUREMENT
/begin MEASUREMENT FMA_facSwtOff "Abschaltfaktor zum langsamen Aus- und Einschalten der FMA" SWORD Fact 1 100 -4.000000 3.999878 FORMAT "%8.6" ECU_ADDRESS 0x7F9826 /end MEASUREMENT
/begin MEASUREMENT FMA_qAct_mp "Aus Lambda- und Luftmassenmessung ermittelte Einspritzmenge. ""Wirkliche"" Einspritzmenge der FMA" SWORD InjMass 1 100 -327.6800 327.6700 FORMAT "%8.4" ECU_ADDRESS 0x802D60 /end MEASUREMENT
/begin MEASUREMENT FMA_qCtl_mp "Für Bestimmung des Mengenfehlers verwendetes Mengensignal" SWORD InjMass 1 100 -327.6800 327.6700 FORMAT "%8.4" ECU_ADDRESS 0x802D64 /end MEASUREMENT
/begin MEASUREMENT FMA_qDC "Von FMA ermittelter Einspritzmengenfehler bzw. -korrekturwert für Betriebsart Direct Control (Modellfehler)" SWORD InjMass 1 100 -327.6800 327.6700 FORMAT "%8.4" ECU_ADDRESS 0x7F9828 /end MEASUREMENT
/begin MEASUREMENT FMA_qDev_mp "Abweichung der ""wirklichen"" Einspritzmenge von der gewünschten Einspritzmenge in der FMA" SWORD InjMass 1 100 -327.6800 327.6700 FORMAT "%8.4" ECU_ADDRESS 0x802D62 /end MEASUREMENT
/begin MEASUREMENT FMA_qIC "Von FMA ermittelter Einspritzmengenfehler bzw. -korrekturwert für Betriebsart Indirect Control (Modellfehler)" SWORD InjMass 1 100 -327.6800 327.6700 FORMAT "%8.4" ECU_ADDRESS 0x7F982A /end MEASUREMENT
/begin MEASUREMENT FMA_qMapRow0_mp "Kennfeldwerte für erste Mengenstützstelle (erste zeile von adaptive Kennfeld)" SWORD InjMassCorr 1 100 -32.76800 32.76700 FORMAT "%8.5" ARRAY_SIZE 8 ECU_ADDRESS 0x802D68 /end MEASUREMENT
/begin MEASUREMENT FMA_qMapRow1_mp "Kennfeldwerte für zweite Mengenstützstelle (zweite zeile von adaptive Kennfeld)" SWORD InjMassCorr 1 100 -32.76800 32.76700 FORMAT "%8.5" ARRAY_SIZE 8 ECU_ADDRESS 0x802D78 /end MEASUREMENT
/begin MEASUREMENT FMA_qMapRow2_mp "Kennfeldwerte für dritte Mengenstützstelle (dritte zeile von adaptive Kennfeld)" SWORD InjMassCorr 1 100 -32.76800 32.76700 FORMAT "%8.5" ARRAY_SIZE 8 ECU_ADDRESS 0x802D88 /end MEASUREMENT
/begin MEASUREMENT FMA_qMapRow3_mp "Kennfeldwerte für vierte Mengenstützstelle (vierte zeile von adaptive Kennfeld)" SWORD InjMassCorr 1 100 -32.76800 32.76700 FORMAT "%8.5" ARRAY_SIZE 8 ECU_ADDRESS 0x802D98 /end MEASUREMENT
/begin MEASUREMENT FMA_qMapRow4_mp "Kennfeldwerte für fünfte Mengenstützstelle (fünfte zeile von adaptive Kennfeld)" SWORD InjMassCorr 1 100 -32.76800 32.76700 FORMAT "%8.5" ARRAY_SIZE 8 ECU_ADDRESS 0x802DA8 /end MEASUREMENT
/begin MEASUREMENT FMA_qMapRow5_mp "Kennfeldwerte für sechste Mengenstützstelle (sechste zeile von adaptive Kennfeld)" SWORD InjMassCorr 1 100 -32.76800 32.76700 FORMAT "%8.5" ARRAY_SIZE 8 ECU_ADDRESS 0x802DB8 /end MEASUREMENT
/begin MEASUREMENT FMA_qMapRow6_mp "Kennfeldwerte für siebte Mengenstützstelle (siebte zeile von adaptive Kennfeld)" SWORD InjMassCorr 1 100 -32.76800 32.76700 FORMAT "%8.5" ARRAY_SIZE 8 ECU_ADDRESS 0x802DC8 /end MEASUREMENT
/begin MEASUREMENT FMA_qMapRow7_mp "Kennfeldwerte für achte Mengenstützstelle (achte zeile von adaptive Kennfeld)" SWORD InjMassCorr 1 100 -32.76800 32.76700 FORMAT "%8.5" ARRAY_SIZE 8 ECU_ADDRESS 0x802DD8 /end MEASUREMENT
/begin MEASUREMENT FMA_qRaw_mp "Aus Fehlermodell ermittelter unbegrenzter Rohwert des Einspritzmengenfehlers der FMA" SWORD InjMass 1 100 -327.6800 327.6700 FORMAT "%8.4" ECU_ADDRESS 0x802DE8 /end MEASUREMENT
/begin MEASUREMENT FMA_qReg_mp "Einspritzmengenfehler im aktuellen Lernbereich" SWORD InjMass 1 100 -327.6800 327.6700 FORMAT "%8.4" ECU_ADDRESS 0x802DEA /end MEASUREMENT
/begin MEASUREMENT FMA_qSetFil_mp "Initialisierungswert für Integrierer bzw. PT1-Filter" SWORD InjMassCorr 1 100 -32.76800 32.76700 FORMAT "%8.5" ECU_ADDRESS 0x802DEC /end MEASUREMENT
/begin MEASUREMENT FMA_q_mp "Mit abshaltfactor multiplizierter Mengenfehler des Fehlermodells" SWORD InjMass 1 100 -327.6800 327.6700 FORMAT "%8.4" ECU_ADDRESS 0x802D66 /end MEASUREMENT
/begin MEASUREMENT FMA_stDynDlyd_mp "FMA-Status: Aktuell oder vor kurzem starke Änderung der Einspritzmenge (verzögerte Einspritzmengendynamik)" UBYTE OneToOne 1 100 0.00 255.0 FORMAT "%5.1" ECU_ADDRESS 0x802E00 /end MEASUREMENT
/begin MEASUREMENT FMA_stDynLmbd_mp "FMA- Status: Aktuell oder bis vor kurzem starke Lambdaänderung" UBYTE OneToOne 1 100 0.00 255.0 FORMAT "%5.1" ECU_ADDRESS 0x802E01 /end MEASUREMENT
/begin MEASUREMENT FMA_stNoAdapt_mp "Status: Adaption des FMA-Fehlermodells angehalten" UBYTE OneToOne 1 100 0.00 255.0 FORMAT "%5.1" ECU_ADDRESS 0x802E02 /end MEASUREMENT
/begin MEASUREMENT FMA_stOvrRunDlyd_mp "FMA-Status: Aktuell oder bis vor kurzem Schubbetrieb (verzögerter Schubbetrieb)" UBYTE OneToOne 1 100 0.00 255.0 FORMAT "%5.1" ECU_ADDRESS 0x802E03 /end MEASUREMENT
/begin MEASUREMENT FMA_stReset_mp "Status: FMA-Fehlermodell wird zurückgesetzt" UBYTE OneToOne 1 100 0.00 255.0 FORMAT "%5.1" ECU_ADDRESS 0x802E04 /end MEASUREMENT
/begin MEASUREMENT FMA_stRngLmbd_mp "FMA_ Status: Lambda aktuell oder bis vor kurzem außerhalb" UBYTE OneToOne 1 100 0.00 255.0 FORMAT "%5.1" ECU_ADDRESS 0x802E05 /end MEASUREMENT
/begin MEASUREMENT FMA_stSetMap_mp "Status: Setzen des aktuellen Kennfeldpunkts erlaubt" UBYTE OneToOne 1 100 0.00 255.0 FORMAT "%5.1" ECU_ADDRESS 0x802DEE /end MEASUREMENT
/begin MEASUREMENT FMA_stSwtOff "Abschaltzustand der FMA" UWORD OneToOne 1 100 0.00 65535.00 FORMAT "%8.2" ECU_ADDRESS 0x7F982C /end MEASUREMENT
/begin MEASUREMENT FMTC_etaCurr "aktueller Wirkunggsgrad (korrigiert)" SWORD Eta 1 100 -256.0000 255.9922 FORMAT "%8.4" ECU_ADDRESS 0x7F982E /end MEASUREMENT
/begin MEASUREMENT FMTC_etaCurrByp_mp "Meßpunkt für Bypass Freischnitt" SWORD Eta 1 100 -256.0000 255.9922 FORMAT "%8.4" ECU_ADDRESS 0x802E06 /end MEASUREMENT
/begin MEASUREMENT FMTC_etaCurrStd "aktueller Standard-Wirkungsgradfaktor (ohne Regenerationsmaßnahmen)" SWORD Eta 1 100 -256.0000 255.9922 FORMAT "%8.4" ECU_ADDRESS 0x7F9830 /end MEASUREMENT
/begin MEASUREMENT FMTC_facEtaCor "aktueller Wirkungsgradkorrekturwert" SWORD Fact 1 100 -4.000000 3.999878 FORMAT "%8.6" ECU_ADDRESS 0x7F9832 /end MEASUREMENT
/begin MEASUREMENT FMTC_qAct "Einspritzmenge Sollwert ohne Ruckeldämpfereingriff" SWORD InjMass 1 100 -327.6800 327.6700 FORMAT "%8.4" ECU_ADDRESS 0x7F9834 /end MEASUREMENT
/begin MEASUREMENT FMTC_qCurr "Einspritzmenge aktueller Wert" SWORD InjMass 1 100 -327.6800 327.6700 FORMAT "%8.4" ECU_ADDRESS 0x7F9836 /end MEASUREMENT
/begin MEASUREMENT FMTC_qDes "Einspritzmenge Wunschwert" SWORD InjMass 1 100 -327.6800 327.6700 FORMAT "%8.4" ECU_ADDRESS 0x7F9838 /end MEASUREMENT
/begin MEASUREMENT FMTC_qRaw "Einspritzmenge Rohwert (>Luftsystem)" SWORD InjMass 1 100 -327.6800 327.6700 FORMAT "%8.4" ECU_ADDRESS 0x7F983A /end MEASUREMENT
/begin MEASUREMENT FMTC_qSet "Einspritzmenge Sollwert (>Einspritzung)" SWORD InjMass 1 100 -327.6800 327.6700 FORMAT "%8.4" ECU_ADDRESS 0x7F983C /end MEASUREMENT
/begin MEASUREMENT FMTC_qSetOptStd_mp "optimale Standardsollmenge ohne Korrekturen" SWORD InjMass 1 100 -327.6800 327.6700 FORMAT "%8.4" ECU_ADDRESS 0x802E08 /end MEASUREMENT
/begin MEASUREMENT FMTC_qSetRgn1_mp "Regenerationseinspritzmenge Sollwert mit Berücksichtigung einer Regenerationsanforderung 1 der Abgasnachbehandlung" SWORD InjMass 1 100 -327.6800 327.6700 FORMAT "%8.4" ECU_ADDRESS 0x802E0A /end MEASUREMENT
/begin MEASUREMENT FMTC_qSetRgn2_mp "Regenerationseinspritzmenge Sollwert mit Berücksichtigung einer Regenerationsanforderung 2 der Abgasnachbehandlung" SWORD InjMass 1 100 -327.6800 327.6700 FORMAT "%8.4" ECU_ADDRESS 0x802E0C /end MEASUREMENT
/begin MEASUREMENT FMTC_qSetRgn3_mp "Regenerationseinspritzmenge Sollwert mit Berücksichtigung einer Regenerationsanforderung 3 der Abgasnachbehandlung" SWORD InjMass 1 100 -327.6800 327.6700 FORMAT "%8.4" ECU_ADDRESS 0x802E0E /end MEASUREMENT
/begin MEASUREMENT FMTC_qSetRgn4_mp "Regenerationseinspritzmenge Sollwert mit Berücksichtigung einer Regenerationsanforderung 4 der Abgasnachbehandlung" SWORD InjMass 1 100 -327.6800 327.6700 FORMAT "%8.4" ECU_ADDRESS 0x802E10 /end MEASUREMENT
/begin MEASUREMENT FMTC_qSetStd_mp "Standardeinspritzmenge Sollwert ohne Berücksichtigung der Regenerationsanforderung der Abgasnachbehandlung" SWORD InjMass 1 100 -327.6800 327.6700 FORMAT "%8.4" ECU_ADDRESS 0x802E12 /end MEASUREMENT
/begin MEASUREMENT FMTC_qStrt "Einspritzmenge Startwert" SWORD InjMass 1 100 -327.6800 327.6700 FORMAT "%8.4" ECU_ADDRESS 0x7F983E /end MEASUREMENT
/begin MEASUREMENT FMTC_qStrtByp_mp "Meßpunkt für Bypass Freischnitt" SWORD InjMass 1 100 -327.6800 327.6700 FORMAT "%8.4" ECU_ADDRESS 0x802E14 /end MEASUREMENT
/begin MEASUREMENT FMTC_stRgn_mp "Interner Regenerationsstatus des FMTC" UWORD OneToOne 1 100 0.00 65535.00 FORMAT "%8.2" ECU_ADDRESS 0x802E16 /end MEASUREMENT
/begin MEASUREMENT FMTC_trqInr "aktuelles rückgerechnetes inneres Motormoment" SWORD Trq 1 100 -3276.800 3276.700 FORMAT "%8.3" ECU_ADDRESS 0x7F9840 /end MEASUREMENT
/begin MEASUREMENT FMTC_trqInrLimSmk "Begrenzungsmoment Rauchgrenze" SWORD Trq 1 100 -3276.800 3276.700 FORMAT "%8.3" ECU_ADDRESS 0x7F9842 /end MEASUREMENT
/begin MEASUREMENT FMTC_trqInrLimSmkByp_mp "Meßpunkt für Bypass Freischnitt" SWORD Trq 1 100 -3276.800 3276.700 FORMAT "%8.3" ECU_ADDRESS 0x802E18 /end MEASUREMENT
/begin MEASUREMENT FQlSCD_rFlQl "Momentaner RME Gehalt in Kraftstoff" SWORD Prc 1 100 -327.6800 327.6700 FORMAT "%8.4" ECU_ADDRESS 0x7F9844 /end MEASUREMENT
/begin MEASUREMENT FQlSCD_rFlQlLin "Lineralisierte Gehalt RME im Kraftstoff" SWORD Prc 1 100 -327.6800 327.6700 FORMAT "%8.4" ECU_ADDRESS 0x7F9846 /end MEASUREMENT
/begin MEASUREMENT FQlSCD_stRpOil "Kraftstoffart (RME oder Diesel)" SWORD OneToOne 1 100 -32768.00 32767.00 FORMAT "%8.2" ECU_ADDRESS 0x7F9848 /end MEASUREMENT
/begin MEASUREMENT FQlSCD_swtSig "RME Signalquelle" SWORD OneToOne 1 100 -32768.00 32767.00 FORMAT "%8.2" ECU_ADDRESS 0x7F93D9 /end MEASUREMENT
/begin MEASUREMENT FQlSCD_uRaw "RME Sensor Rohwert" SWORD Volt 1 100 -160156.4 160151.5 FORMAT "%8.1" ECU_ADDRESS 0x7F984A /end MEASUREMENT
/begin MEASUREMENT FrmMng_pAir "Atmosphärendruck über CAN" SWORD OneToOne 1 100 -32768.00 32767.00 FORMAT "%8.2" ECU_ADDRESS 0x7F9884 /end MEASUREMENT
/begin MEASUREMENT FrmMng_pBoost "Ladedruck über CAN" SWORD OneToOne 1 100 -32768.00 32767.00 FORMAT "%8.2" ECU_ADDRESS 0x7F9886 /end MEASUREMENT
/begin MEASUREMENT FrmMng_pDiffPFlt "Differenzdruck über Partikelfilter" SWORD OneToOne 1 100 -32768.00 32767.00 FORMAT "%8.2" ECU_ADDRESS 0x7F9888 /end MEASUREMENT
/begin MEASUREMENT FrmMng_prcFan "Prozent Kühlleistunganforderung vom CAN für den Kühlerlüfter" SWORD Prc 1 100 -327.6800 327.6700 FORMAT "%8.4" ECU_ADDRESS 0x7F988A /end MEASUREMENT
/begin MEASUREMENT FrmMng_rFlQl "Kraftsstoffart für CAN" SWORD Prc 1 100 -327.6800 327.6700 FORMAT "%8.4" ECU_ADDRESS 0x7F9892 /end MEASUREMENT
/begin MEASUREMENT FrmMng_rRelPosBPAS "Positionsistwert des Ladedruckstellers  über CAN" SWORD OneToOne 1 100 -32768.00 32767.00 FORMAT "%8.2" ECU_ADDRESS 0x7F9894 /end MEASUREMENT
/begin MEASUREMENT FrmMng_stAC "Klimaanlagenzustand über CAN" UWORD OneToOne 1 100 0.00 65535.00 FORMAT "%8.2" ECU_ADDRESS 0x7F989E /end MEASUREMENT
/begin MEASUREMENT FrmMng_stACCInvalid "Status ob die CAN message ""ACC-System"" einmal korrekt empfangen wurde" UBYTE OneToOne 1 100 0.00 255.0 FORMAT "%5.1" ECU_ADDRESS 0x7F93EB /end MEASUREMENT
/begin MEASUREMENT FrmMng_stAWD1 "Zustand des  Allrad" UBYTE OneToOne 1 100 0.00 255.0 FORMAT "%5.1" ECU_ADDRESS 0x7F93EE /end MEASUREMENT
/begin MEASUREMENT FrmMng_stBrk "Bremsschalterinformation über CAN" UBYTE OneToOne 1 100 0.00 255.0 FORMAT "%5.1" ECU_ADDRESS 0x7F93F3 /end MEASUREMENT
/begin MEASUREMENT FrmMng_stBrkAct "Status BAB,- FDR- und EDS - Eingriff" UBYTE OneToOne 1 100 0.00 255.0 FORMAT "%5.1" ECU_ADDRESS 0x7F93F4 /end MEASUREMENT
/begin MEASUREMENT FrmMng_stClgGearbx "Gestufte Kühlleistungsanhebung" UBYTE OneToOne 1 100 0.00 255.0 FORMAT "%5.1" ECU_ADDRESS 0x7F93FD /end MEASUREMENT
/begin MEASUREMENT FrmMng_stConv "Kupplungszustand über CAN" UBYTE OneToOne 1 100 0.00 255.0 FORMAT "%5.1" ECU_ADDRESS 0x7F93FE /end MEASUREMENT
/begin MEASUREMENT FrmMng_stIgnLock "Status Klemme15 über CAN" UBYTE OneToOne 1 100 0.00 255.0 FORMAT "%5.1" ECU_ADDRESS 0x7F940E /end MEASUREMENT
/begin MEASUREMENT FrmMng_stKombiTst "Kombi im Stellgliedtest" UBYTE OneToOne 1 100 0.00 255.0 FORMAT "%5.1" ECU_ADDRESS 0x7F940F /end MEASUREMENT
/begin MEASUREMENT FrmMng_stLckCanRxMsg "Status welche Empfangsbotschaften gesperrt sind" ULONG OneToOne 1 100 0.00 4294967295.00 FORMAT "%13.2" ECU_ADDRESS 0x7F9CBC /end MEASUREMENT
/begin MEASUREMENT FrmMng_stLckCanTxMsg "Status welche Sendebotschaften gesperrt sind" UWORD OneToOne 1 100 0.00 65535.00 FORMAT "%8.2" ECU_ADDRESS 0x7F98AE /end MEASUREMENT
/begin MEASUREMENT FrmMng_stLckCanUsrMsg "Status welche User - Messages gesperrt sind" UWORD OneToOne 1 100 0.00 65535.00 FORMAT "%8.2" ECU_ADDRESS 0x7F98B0 /end MEASUREMENT
/begin MEASUREMENT FrmMng_stNoTORxMsg "Timeout Status von allen CAN Empfangs Botschaften; 1=Botschaft wird korrekt empfangen; 0=Botschaft wird nicht empfangen" ULONG OneToOne 1 100 0.00 4294967295.00 FORMAT "%13.2" ECU_ADDRESS 0x7F9CC0 /end MEASUREMENT
/begin MEASUREMENT FrmMng_stNoTOUsrMsg "Timeout Status von allen CAN User Botschaften; 1=Botschaft wird korrekt empfangen; 0=Botschaft wird nicht empfangen" UWORD OneToOne 1 100 0.00 65535.00 FORMAT "%8.2" ECU_ADDRESS 0x7F98B2 /end MEASUREMENT
/begin MEASUREMENT FrmMng_stNumTOOvrFlowECU "Message Array welches enthält, wieviele Timeout Überläufe pro Steuergerät aufgetreten sind" UBYTE OneToOne 1 100 0.00 255.0 FORMAT "%5.1" ARRAY_SIZE 32 ECU_ADDRESS 0x7F9EC0 /end MEASUREMENT
/begin MEASUREMENT FrmMng_stTClnt "Status der Wassertemperatur über CAN" UBYTE OneToOne 1 100 0.00 255.0 FORMAT "%5.1" ECU_ADDRESS 0x7F944F /end MEASUREMENT
/begin MEASUREMENT FrmMng_stTEnv "Status der Umgebungstemperatur über CAN" UBYTE OneToOne 1 100 0.00 255.0 FORMAT "%5.1" ECU_ADDRESS 0x7F9450 /end MEASUREMENT
/begin MEASUREMENT FrmMng_stTOil "Status der Öltemperatur über CAN" UBYTE OneToOne 1 100 0.00 255.0 FORMAT "%5.1" ECU_ADDRESS 0x7F9452 /end MEASUREMENT
/begin MEASUREMENT FrmMng_stUsrMsgRxOrTx "Status, welche Botschaften versendet bzw. empfangen werden" UWORD OneToOne 1 100 0.00 65535.00 FORMAT "%8.2" ECU_ADDRESS 0x7F98BA /end MEASUREMENT
/begin MEASUREMENT FrmMng_tAir "Ansauglufttemperatur über CAN" SWORD OneToOne 1 100 -32768.00 32767.00 FORMAT "%8.2" ECU_ADDRESS 0x7F98BC /end MEASUREMENT
/begin MEASUREMENT FrmMng_tClnt "Kühlmitteltemperatur" SWORD Temp_Cels 1 100 -3549.940 3003.560 FORMAT "%8.3" ECU_ADDRESS 0x7F98BE /end MEASUREMENT
/begin MEASUREMENT FrmMng_tEnv "Umgebungstemperatur" SWORD Temp_Cels 1 100 -3549.940 3003.560 FORMAT "%8.3" ECU_ADDRESS 0x7F98C0 /end MEASUREMENT
/begin MEASUREMENT FrmMng_tiTODet_mp "Zeit um ein Timeout fuer CAN Empfangsbotschaften" UBYTE TimeCAN_TO_ms 1 100 20.00 5120. FORMAT "%5.0" ARRAY_SIZE 23 ECU_ADDRESS 0x802E1A /end MEASUREMENT
/begin MEASUREMENT FrmMng_tOil "Öltemperatur" SWORD Temp_Cels 1 100 -3549.940 3003.560 FORMAT "%8.3" ECU_ADDRESS 0x7F98C2 /end MEASUREMENT
/begin MEASUREMENT FrmMng_trqLimAWD "Begrenzungsmoment durch Allradsteuergerät" SWORD TrqPrp 1 100 -32768.00 32767.00 FORMAT "%8.2" ECU_ADDRESS 0x7F98E6 /end MEASUREMENT
/begin MEASUREMENT FrmMng_vLimAWD "Höchstgeschwindigkeit durch Allradsteuergerät" SWORD Vel 1 100 -327.6800 327.6700 FORMAT "%8.4" ECU_ADDRESS 0x7F98F6 /end MEASUREMENT
/begin FUNCTION fanctl_co_uic ""
 /begin DEF_CHARACTERISTIC FanCtl_dcycFan1_Vector FanCtl_dcycFan1_Channel FanCtl_dcycFan2_Vector FanCtl_dcycFan2_Channel FanCtl_prcCAN_Vector FanCtl_prcCAN_Channel /end DEF_CHARACTERISTIC
 /begin OUT_MEASUREMENT FanCtl_dcycFan1Byp_mp FanCtl_dcycFan1Preset3_mp FanCtl_dcycFan1RampSwtAR_mp FanCtl_dcycFan1RampSwt_mp FanCtl_dcycFan1_mp FanCtl_dcycFan2Byp_mp FanCtl_dcycFan2Preset3_mp FanCtl_dcycFan2RampSwtAR_mp FanCtl_dcycFan2RampSwt_mp FanCtl_dcycFan2_mp FanCtl_dtClntDesDiffCorr_mp FanCtl_dtClntDesDiff_mp FanCtl_dtClntDes_mp FanCtl_dtClntDiff_mp FanCtl_dtCOTSCrit_mp FanCtl_dvolFlConsumFltHold_mp FanCtl_factCorr_mp FanCtl_nElBase3_mp FanCtl_nFan1Base2_mp FanCtl_nFan1Base_mp FanCtl_nFan2Base2_mp FanCtl_nFan2Base_mp FanCtl_nHydBase3_mp FanCtl_pAcHold_mp FanCtl_pAc_mp FanCtl_prcACMnSw_mp FanCtl_prcAcMul_mp FanCtl_prcCANByp_mp FanCtl_prcClntDesDiff_mp FanCtl_prcRelClntDes1_mp FanCtl_prcRelClntDes2_mp FanCtl_prcRelClntDes_mp FanCtl_stCtl_mp FanCtl_tAirHold_mp FanCtl_tClntCrit_mp FanCtl_tClntDesCor1_mp FanCtl_tClntDesFlt_mp FanCtl_tClntDesMap_mp FanCtl_tClntDesRaw_mp FanCtl_tClntDes_mp FanCtl_tCTSCurr_mp FanCtl_tiAfterrun_mp FanCtl_tiARprc_mp FanCtl_tiARremain_mp FanCtl_tiAR_mp FanCtl_vCurr2_mp FanCtl_vCurr_mp /end OUT_MEASUREMENT
/end FUNCTION
/begin FUNCTION fbc_equal "Laufruheregler"
 /begin DEF_CHARACTERISTIC FBC_BPFac1NumG_CUR FBC_dBPFacNumLo_CA FBC_dBPFacNumHi_CA FBC_dBPFacNumZFC_CA FBC_dBPFacDen1_CA FBC_dBPFacDen2_CA FBC_ctSegOffset_C FBC_dSegNhiCaS_C FBC_dSegNloCaS_C FBC_dSegZFCCaS_C FBC_dSyn_C FBC_fSurge_CUR FBC_GvrnIKi_C FBC_GvrnIKiPos_C FBC_GvrnIKiNeg_C FBC_GvrnIWinPos_C FBC_GvrnIWinNeg_C FBC_GvrnPKp_C FBC_GvrnPKpPos_C FBC_GvrnPKpNeg_C FBC_GvrnPWinPos_C FBC_GvrnPWinNeg_C FBC_nCtlOfsMin_C FBC_nCtlThresMax_C FBC_nGvrnOfsMin_C FBC_nGvrnThresMax_C FBC_nHyst_C FBC_nSurgeOffset_C FBC_nZFCThresMax_C FBC_qCtlOfsMax_C FBC_qCtlThresMin_C FBC_qGvrnThresMax_CUR FBC_qGvrnThresMin_C FBC_qLim_CUR FBC_stInitI_C FBC_stMskRgn_C /end DEF_CHARACTERISTIC
 /begin IN_MEASUREMENT DrvTrn_rTransDT Eng_nAvrg InjCtl_qSetUnBal /end IN_MEASUREMENT
 /begin OUT_MEASUREMENT FBC_BPAmpCaS_mp FBC_dBPCaS_mp /end OUT_MEASUREMENT
/end FUNCTION
/begin FUNCTION fbc_equal_uic "" /begin DEF_CHARACTERISTIC FBC_q_Vector FBC_q_Channel /end DEF_CHARACTERISTIC /begin OUT_MEASUREMENT FBC_stRegion_mp /end OUT_MEASUREMENT /end FUNCTION
/begin FUNCTION fbc_msg ""
 /begin OUT_MEASUREMENT FBC_Badpt FBC_ctSegInt FBC_dBPSum FBC_q FBC_qDvtCyl FBC_qLimAct FBC_RegionChng FBC_stActive FBC_stEqualInit FBC_stLearn FBC_WheelLrnOut /end OUT_MEASUREMENT
/end FUNCTION
/begin FUNCTION fbc_wheellrn "Drehzahlschwelle zum Radlernen"
 /begin DEF_CHARACTERISTIC FBC_AACoeff_C FBC_AAOrd_C FBC_Act_C FBC_DXadptl_C FBC_DXadptu_C FBC_DXalf0_C FBC_nLrnThres_C FBC_nThresFbc_C FBC_TFlrn_C FBC_TF_C FBC_ThresDyn_C FBC_TSm_C /end DEF_CHARACTERISTIC
 /begin OUT_MEASUREMENT FBC_AALOut_mp FBC_DXadpt_mp FBC_DXSfn_mp FBC_DXSfp_mp FBC_DXSf_mp FBC_DXSl_mp FBC_DXS_mp FBC_Region_mp FBC_stState_mp /end OUT_MEASUREMENT
/end FUNCTION
/begin FUNCTION fbc_wheellrn_uic "" /begin DEF_CHARACTERISTIC FBC_lrn_Vector FBC_lrn_Channel /end DEF_CHARACTERISTIC /end FUNCTION
/begin FUNCTION flmng "Gemischbildung"
 /begin DEF_CHARACTERISTIC FlMng_facCorAirTemp_CUR FlMng_facCorAP_CUR FlMng_facCorEngTemp_CUR FlMng_facLmbdSmkSOE_CUR FlMng_mAirPerCylMin_C FlMng_rLmbdPartLd_CUR FlMng_rLmbdSmkEGT_MAP FlMng_rLmbdSmkLim0_MAP FlMng_rLmbdSmkLim1_MAP FlMng_rLmbdSmkLim2_MAP FlMng_rLmbdSmkLimNr_CUR FlMng_rLmbdSmkSOE_MAP FlMng_stRgnMsk_C FlMng_swtAirTemp_C FlMng_swtMIAPSSrcSel_C FlMng_swtqLimSmkQ_C /end DEF_CHARACTERISTIC
 /begin IN_MEASUREMENT AccPed_rChkdVal AFSCD_mAirPerCylFlt APSCD_pVal Eng_nAvrg Eng_tEng FlMng_AirTemp_mp FlMng_pValSel_mp InjCrv_phiMIPCRCor /end IN_MEASUREMENT
/end FUNCTION
/begin FUNCTION flmng_fullldrgl_var ""
 /begin DEF_CHARACTERISTIC FlMng_FullLdRglIKi_CUR FlMng_qFullLdRglMax_C FlMng_qFullLdRglMin_C FlMng_FullLdRglPKp_CUR FlMng_rLmbdRecDvtMax_C FlMng_rLmbdRecDvtMin_C FlMng_dqSlpPos_C FlMng_dqSlpNeg_C FlMng_stEGTRglOff_C FlMng_swtFullLdRglVal_C FlMng_swtFullLdRglType_C FlMng_tiFullLdRglDel_CUR FlMng_trqEpsLim_C FlMng_trqEps_C /end DEF_CHARACTERISTIC
 /begin IN_MEASUREMENT Eng_nAvrg /end IN_MEASUREMENT
/end FUNCTION
/begin FUNCTION flmng_fullldrgl_var_uic ""
 /begin OUT_MEASUREMENT FlMng_qFullLdRglI_mp FlMng_qFullLdRglP_mp FlMng_qFullLdRgl_mp FlMng_qLimSmkBas_mp FlMng_rLmbdRecDvt_mp FlMng_stMon_mp /end OUT_MEASUREMENT
/end FUNCTION
/begin FUNCTION flmng_msg "" /begin OUT_MEASUREMENT FlMng_qLimSmk /end OUT_MEASUREMENT /end FUNCTION
/begin FUNCTION flmng_uic "" /begin DEF_CHARACTERISTIC FlMng_qLimSmk_Vector FlMng_qLimSmk_Channel /end DEF_CHARACTERISTIC
 /begin OUT_MEASUREMENT FlMng_AirTemp_mp FlMng_facCor_mp FlMng_facLmbdSmkSOE_mp FlMng_mAirPerCylLim_mp FlMng_pValSel_mp FlMng_qLimSmkByp_mp FlMng_rLmbdPartLdCor_mp FlMng_rLmbdSet_mp FlMng_rLmbdSmkSOECorr_mp FlMng_rLmbdSmkSOE_mp FlMng_rLmbdSmk_mp /end OUT_MEASUREMENT
/end FUNCTION
/begin FUNCTION flmng_var ""
 /begin DEF_CHARACTERISTIC FlMng_dSmokeMapNr_CUR FlMng_pIATCorr_MAP FlMng_qAFSCDSmoke_MAP FlMng_qAFSCDtEngSmoke0_MAP FlMng_qAFSCDtEngSmoke1_MAP FlMng_qAFSCDtEngSmoke2_MAP FlMng_qPresSmoke_MAP FlMng_qTempFuel_MAP FlMng_swtBPAP_C FlMng_swtSmokeSpace_C FlMng_swtSmokeVariant_C FlMng_tFueRef_C /end DEF_CHARACTERISTIC
 /begin IN_MEASUREMENT AFSCD_mAirPerCylFlt Eng_nAvrg Eng_tEng FlMng_pBPAPCorr_mp FlMng_pIATCorr_mp IATSCD_tAir InjCtl_qAct /end IN_MEASUREMENT
/end FUNCTION
/begin FUNCTION flmng_var_uic ""
 /begin OUT_MEASUREMENT FlMng_pBPAPCorr_mp FlMng_pIATCorr_mp FlMng_qLimSmkAir_mp FlMng_qLimSmkQ_mp FlMng_qTempFuelCorr_mp FlMng_qTempFuel_mp /end OUT_MEASUREMENT
/end FUNCTION
/begin FUNCTION flppcd "Komponententreiber Kraftstoffumwälzpumpe"
 /begin DEF_CHARACTERISTIC FlPpCD_DebExcTempDef_C FlPpCD_DebExcTempOk_C FlPpCD_DebNoLoadDef_C FlPpCD_DebNoLoadOk_C FlPpCD_DebShortCircBatDef_C FlPpCD_DebShortCircBatOk_C FlPpCD_DebShortCircGndDef_C FlPpCD_DebShortCircGndOk_C FlPpCD_stInvOut_C FlPpCD_swtFlPpAct_C FlPpCD_swtFlPpActVal_C FlPpCD_swtFlPpActType_C FlPpCD_tiFlPpcheckDfpTmr_C FlPpCD_tiFlPpOFFTmr_C /end DEF_CHARACTERISTIC
/end FUNCTION
/begin FUNCTION flppcd_msg "" /begin OUT_MEASUREMENT FlPpCD_swtFlPpAct /end OUT_MEASUREMENT /end FUNCTION
/begin FUNCTION flppcd_uic "" /begin OUT_MEASUREMENT FlPpCD_stOutHWE_mp /end OUT_MEASUREMENT /end FUNCTION
/begin FUNCTION flscd "Kraftstoffsensor Komponententreiber"
 /begin DEF_CHARACTERISTIC FlSCD_uSRCMin_C FlSCD_uSRCMax_C FlSCD_volTotalLin_CUR FlSCD_DebSigDef_C FlSCD_DebSigOK_C FlSCD_DebSRCMaxDef_C FlSCD_DebSRCMaxOk_C FlSCD_DebSRCMinDef_C FlSCD_DebSRCMinOk_C FlSCD_dvolRmpSlpUp_C FlSCD_dvolRmpSlpDwn_C FlSCD_swtFuelSens_C FlSCD_swtSig_C FlSCD_stSensIDWord_C FlSCD_volTotalDflVal_C FlSCD_volTotal_C /end DEF_CHARACTERISTIC
 /begin IN_MEASUREMENT FlSCD_uLvlRawT1 /end IN_MEASUREMENT
/end FUNCTION
/begin FUNCTION flscd_msg "" /begin OUT_MEASUREMENT FlSCD_uLvlRawT1 FlSCD_volTotal FlSCD_volTotalLin /end OUT_MEASUREMENT /end FUNCTION
/begin FUNCTION flscd_uic "" /end FUNCTION
/begin FUNCTION flsys_calccnvfac "Berechnung Umwandlungsfaktor von Einspritzmenge nach Einspritzvolumen" /begin DEF_CHARACTERISTIC FlSys_rhoFl_C FlSys_rhoFl_CUR /end DEF_CHARACTERISTIC /begin IN_MEASUREMENT FTSCD_tFuel /end IN_MEASUREMENT /end FUNCTION
/begin FUNCTION flsys_calccnvfac_msg "" /begin OUT_MEASUREMENT FlSys_rhoFl /end OUT_MEASUREMENT /end FUNCTION
/begin FUNCTION flsys_calccnvfac_uic "" /end FUNCTION
/begin FUNCTION flsys_deflate "Entlueftung des Niederdruckkreislaufs"
 /begin DEF_CHARACTERISTIC FlSys_nDeflateMax_C FlSys_nDeflateMin_C FlSys_pDeflate_C FlSys_tiDeflateDel_C /end DEF_CHARACTERISTIC
/end FUNCTION
/begin FUNCTION flsys_deflate_uic "" /begin OUT_MEASUREMENT FlSys_stDeflate_mp /end OUT_MEASUREMENT /end FUNCTION
/begin FUNCTION flsys_detrefuel "Nachtankerkennung"
 /begin DEF_CHARACTERISTIC FlSys_nAvrgUpLim_C FlSys_qCurrLoLim_C FlSys_qCurrUpLim_C FlSys_swtAutoMet_C FlSys_tiRefuelDebHiLo_C FlSys_tiRefuelDebLoHi_C FlSys_tiDetRefuelEna_C FlSys_tiFuelVolStrtValPT1_C FlSys_tiOvrRefuelDebHiLo_C FlSys_tiOvrRefuelDebLoHi_C FlSys_tiFuelVolPT1_C FlSys_volOvrRefuelMin_C FlSys_volRefuelMin_C FlSys_volTankMax_C FlSys_volTankMin_C FlSys_vVehMin_C /end DEF_CHARACTERISTIC
/end FUNCTION
/begin FUNCTION flsys_detrefuel_msg ""
 /begin OUT_MEASUREMENT FlSys_stAftRunDelDem FlSys_stDetRefuel FlSys_volDetRefuel FlSys_volTotalFlt /end OUT_MEASUREMENT
/end FUNCTION
/begin FUNCTION flsys_detrefuel_uic ""
 /begin OUT_MEASUREMENT FlSys_stDetRefuelEna_mp FlSys_stSM_mp FlSys_volFuelConsCalc_mp FlSys_volFuelConsOld_mp FlSys_volFuelCons_mp FlSys_volTotalRef_mp FlSys_volTotalReplVal_mp FlSys_volTotalStrtVal_mp FlSys_volTotal_mp FlSys_vVehReplVal_mp FlSys_vVeh_mp /end OUT_MEASUREMENT
/end FUNCTION
/begin FUNCTION flsys_logicflpp "Ansteuerungslogik der Krafstoffumwälzpumpe"
 /begin DEF_CHARACTERISTIC FlSys_nHysXLow_C FlSys_nHysXHigh_C FlSys_stnHysYLow_C FlSys_stnHysYHigh_C FlSys_tHysXLow_C FlSys_tHysXHigh_C FlSys_sttHysYLow_C FlSys_sttHysYHigh_C FlSys_tiAddFlPpActv_C FlSys_tiDelAddFlPpActv_C FlSys_tiMinFlPpActv_C /end DEF_CHARACTERISTIC
/end FUNCTION
/begin FUNCTION flsys_logicflpp_msg "" /begin OUT_MEASUREMENT FlSys_stFlPp /end OUT_MEASUREMENT /end FUNCTION
/begin FUNCTION flsys_logicflpp_uic "" /begin OUT_MEASUREMENT FlSys_stLogicFlPp_mp /end OUT_MEASUREMENT /end FUNCTION
/begin FUNCTION flsys_temp "Kraftstoffsystem-Temperatur"
 /begin DEF_CHARACTERISTIC FlSys_swtTempSel_C FlSys_swtTempSensCfgVal_C FlSys_swtTempSensCfgType_C FlSys_tDfl_C /end DEF_CHARACTERISTIC
/end FUNCTION
/begin FUNCTION flsys_temp_msg "" /begin OUT_MEASUREMENT FlSys_swtTempSensCfg FlSys_t /end OUT_MEASUREMENT /end FUNCTION
/begin FUNCTION flsys_temp_uic "" /begin OUT_MEASUREMENT FlSys_stTemp_mp /end OUT_MEASUREMENT /end FUNCTION
/begin FUNCTION fma_adapt "Mengenmittelwertadaption - Adaption des Einspritzmengen-Fehlermodells" /end FUNCTION
/begin FUNCTION fma_adapt_uic "" /begin OUT_MEASUREMENT FMA_qAct_mp FMA_qDev_mp /end OUT_MEASUREMENT /end FUNCTION
/begin FUNCTION fma_ctlcalc "Mengenmittelwertadaption - Berechnung des Einspritzmengenfehlers mittels adaptiver Steuerung" /begin DEF_CHARACTERISTIC FMA_swtIC_C /end DEF_CHARACTERISTIC /end FUNCTION
/begin FUNCTION fma_ctlcalc_msg "" /begin OUT_MEASUREMENT FMA_qDC FMA_qIC /end OUT_MEASUREMENT /end FUNCTION
/begin FUNCTION fma_ctlcalc_uic "" /begin OUT_MEASUREMENT FMA_qCtl_mp FMA_q_mp /end OUT_MEASUREMENT /end FUNCTION
/begin FUNCTION fma_errmod "Mengenmittelwertadaption - Algoithmen für Adaption und Auswertung des Fehlermodells für FMA_Adapt und FMA_CtlCalc"
 /begin DEF_CHARACTERISTIC FMA_IKi_C FMA_IKiPos_C FMA_IKiNeg_C FMA_qIWinPos_C FMA_qIWinNeg_C FMA_nGrid_C FMA_nHysMap_C FMA_numNGrid_C FMA_numQGrid_C FMA_tiPT1_C FMA_qGrid_C FMA_qHysMap_C FMA_qIncMap_C FMA_qIntMax_C FMA_qIntMin_C FMA_qSlpNMax_C FMA_qSlpQMax_C FMA_swtResetMap_C /end DEF_CHARACTERISTIC
 /begin OUT_MEASUREMENT FMA_qMapRow0_mp FMA_qMapRow1_mp FMA_qMapRow2_mp FMA_qMapRow3_mp FMA_qMapRow4_mp FMA_qMapRow5_mp FMA_qMapRow6_mp FMA_qMapRow7_mp /end OUT_MEASUREMENT
/end FUNCTION
/begin FUNCTION fma_errmod_uic "" /begin OUT_MEASUREMENT FMA_qRaw_mp FMA_qReg_mp FMA_qSetFil_mp FMA_stSetMap_mp /end OUT_MEASUREMENT /end FUNCTION
/begin FUNCTION fma_monitor "Mengenmittelwertadaption - Überwachung und Abschaltung"
 /begin DEF_CHARACTERISTIC FMA_dfacSwtOffMax_C FMA_dqThrs_C FMA_drLmbdThrs_C FMA_facAirSwtOff_CUR FMA_facEngSwtOff_CUR FMA_facFlSwtOff_CUR FMA_nThrs_C FMA_qThrs_C FMA_rLmbdThrsMax_C FMA_rLmbdThrsMin_C FMA_stRgnMsk_C FMA_swtOnFMA_C FMA_tiDLmbdThrs_C FMA_tiDynThrs_C FMA_tiFaultRmp_C FMA_tiLmbdDT1_C FMA_tiLmbdThrs_C FMA_tiOvrRun_C FMA_tiQDT1_C FMA_tiQLmbd_C /end DEF_CHARACTERISTIC
 /begin IN_MEASUREMENT Eng_tEng FTSCD_tFuel IATSCD_tAir /end IN_MEASUREMENT
/end FUNCTION
/begin FUNCTION fma_monitor_msg "" /begin OUT_MEASUREMENT FMA_facSwtOff FMA_stSwtOff /end OUT_MEASUREMENT /end FUNCTION
/begin FUNCTION fma_monitor_uic ""
 /begin OUT_MEASUREMENT FMA_dqAbs_mp FMA_drLmbdAbs_mp FMA_facAirSwtOff_mp FMA_facEngSwtOff_mp FMA_facFaultSwtOff_mp FMA_facFlSwtOff_mp FMA_facRgnSwtOff_mp FMA_facSlpSwtOff_mp FMA_stDynDlyd_mp FMA_stDynLmbd_mp FMA_stNoAdapt_mp FMA_stOvrRunDlyd_mp FMA_stReset_mp FMA_stRngLmbd_mp /end OUT_MEASUREMENT
/end FUNCTION
/begin FUNCTION fmtc "Masse/Momenten-Wandler"
 /begin DEF_CHARACTERISTIC FMTC_eta0_C FMTC_stRgnMsk1_C FMTC_stRgnMsk2_C FMTC_stRgnMsk3_C FMTC_stRgnMsk4_C FMTC_tiRmpSlp_C FMTC_trq2qBas_MAP FMTC_trq2qRgn1_MAP FMTC_trq2qRgn2_MAP FMTC_trq2qRgn3_MAP FMTC_trq2qRgn4_MAP /end DEF_CHARACTERISTIC
 /begin IN_MEASUREMENT CoEng_trqInrSet Eng_nAvrg /end IN_MEASUREMENT
/end FUNCTION
/begin FUNCTION fmtc_calccorr "Berchnung des Wirkungsgrad Korrekturfaktors" /end FUNCTION
/begin FUNCTION fmtc_calccorr_msg "" /begin OUT_MEASUREMENT FMTC_facEtaCor /end OUT_MEASUREMENT /end FUNCTION
/begin FUNCTION fmtc_calccorr_uic "" /end FUNCTION
/begin FUNCTION fmtc_msg ""
 /begin OUT_MEASUREMENT FMTC_etaCurr FMTC_etaCurrStd FMTC_qAct FMTC_qCurr FMTC_qDes FMTC_qRaw FMTC_qSet FMTC_qStrt FMTC_trqInr FMTC_trqInrLimSmk /end OUT_MEASUREMENT
/end FUNCTION
/begin FUNCTION fmtc_uic ""
 /begin DEF_CHARACTERISTIC FMTC_etaCurr_Vector FMTC_etaCurr_Channel FMTC_qStrt_Vector FMTC_qStrt_Channel FMTC_trqInrLimSmk_Vector FMTC_trqInrLimSmk_Channel /end DEF_CHARACTERISTIC
 /begin OUT_MEASUREMENT FMTC_etaCurrByp_mp FMTC_qSetOptStd_mp FMTC_qSetRgn1_mp FMTC_qSetRgn2_mp FMTC_qSetRgn3_mp FMTC_qSetRgn4_mp FMTC_qSetStd_mp FMTC_qStrtByp_mp FMTC_stRgn_mp FMTC_trqInrLimSmkByp_mp /end OUT_MEASUREMENT
/end FUNCTION
/begin FUNCTION fqlscd_co ""
 /begin DEF_CHARACTERISTIC FQlSCD_uSRCMin_C FQlSCD_uSRCMax_C FQlSCD_rLin_CUR FQlSCD_DebSigDef_C FQlSCD_DebSigOk_C FQlSCD_DebSRCHighDef_C FQlSCD_DebSRCHighOk_C FQlSCD_DebSRCLowDef_C FQlSCD_DebSRCLowOk_C FQlSCD_numSSp_C FQlSCD_dtRmpSlpUp_C FQlSCD_dtRmpSlpDwn_C FQlSCD_rRpOilHi_C FQlSCD_rRpOilLo_C FQlSCD_swtSig_C FQlSCD_stSensIDWord_C FQlSCD_rDfl_C /end DEF_CHARACTERISTIC
 /begin IN_MEASUREMENT FQlSCD_uRaw /end IN_MEASUREMENT
/end FUNCTION
/begin FUNCTION fqlscd_co_msg ""
 /begin OUT_MEASUREMENT FQlSCD_rFlQl FQlSCD_rFlQlLin FQlSCD_stRpOil FQlSCD_swtSig FQlSCD_uRaw /end OUT_MEASUREMENT
/end FUNCTION
/begin FUNCTION frmmng "CAN Message Frames für Übertragung und Empfang"
 /begin DEF_CHARACTERISTIC FrmMng_dACC1Byte1_C FrmMng_dACC1Byte2_C FrmMng_dACC1Byte3_C FrmMng_dACC1Byte4_C FrmMng_dACC1Byte5_C FrmMng_dACC1Byte6_C FrmMng_dACC1Byte7_C FrmMng_dACC1Byte8_C FrmMng_dCCtlByte1_C FrmMng_dCCtlByte2_C FrmMng_dCCtlByte3_C FrmMng_dCCtlByte4_C FrmMng_dCCtlByte5_C FrmMng_dCCtlByte6_C FrmMng_dCCtlByte7_C FrmMng_dCCtlByte8_C FrmMng_dEng1Byte1_C FrmMng_dEng1Byte2_C FrmMng_dEng1Byte3_C FrmMng_dEng1Byte4_C FrmMng_dEng1Byte5_C FrmMng_dEng1Byte6_C FrmMng_dEng1Byte7_C FrmMng_dEng1Byte8_C FrmMng_dEng2Byte1_C FrmMng_dEng2Byte2_C FrmMng_dEng2Byte3_C FrmMng_dEng2Byte4_C FrmMng_dEng2Byte5_C FrmMng_dEng2Byte6_C FrmMng_dEng2Byte7_C FrmMng_dEng2Byte8_C FrmMng_dEng3Byte1_C FrmMng_dEng3Byte2_C FrmMng_dEng3Byte3_C FrmMng_dEng3Byte4_C FrmMng_dEng3Byte5_C FrmMng_dEng3Byte6_C FrmMng_dEng3Byte7_C FrmMng_dEng3Byte8_C FrmMng_dEng5Byte1_C FrmMng_dEng5Byte2_C FrmMng_dEng5Byte3_C FrmMng_dEng5Byte4_C FrmMng_dEng5Byte5_C FrmMng_dEng5Byte6_C FrmMng_dEng5Byte7_C FrmMng_dEng5Byte8_C FrmMng_dEng6Byte1_C FrmMng_dEng6Byte2_C FrmMng_dEng6Byte3_C FrmMng_dEng6Byte4_C FrmMng_dEng6Byte5_C FrmMng_dEng6Byte6_C FrmMng_dEng6Byte7_C FrmMng_dEng6Byte8_C FrmMng_dEng7Byte1_C FrmMng_dEng7Byte2_C FrmMng_dEng7Byte3_C FrmMng_dEng7Byte4_C FrmMng_dEng7Byte5_C FrmMng_dEng7Byte6_C FrmMng_dEng7Byte7_C FrmMng_dEng7Byte8_C FrmMng_dENGACTR1Byte1_C FrmMng_dENGACTR1Byte2_C FrmMng_dENGACTR1Byte3_C FrmMng_dENGACTR1Byte4_C FrmMng_dENGACTR1Byte5_C FrmMng_dENGACTR1Byte6_C FrmMng_dENGACTR1Byte7_C FrmMng_dENGACTR1Byte8_C FrmMng_dEngflxByte1_C FrmMng_dEngflxByte2_C FrmMng_dEngflxByte3_C FrmMng_dEngflxByte4_C FrmMng_dEngflxByte5_C FrmMng_dEngflxByte6_C FrmMng_dEngflxByte7_C FrmMng_dEngflxByte8_C FrmMng_dEngTRQ1Byte1_C FrmMng_dEngTRQ1Byte2_C FrmMng_dEngTRQ1Byte3_C FrmMng_dEngTRQ1Byte4_C FrmMng_dEngTRQ1Byte5_C FrmMng_dEngTRQ1Byte6_C FrmMng_dEngTRQ1Byte7_C FrmMng_dEngTRQ1Byte8_C FrmMng_dEngTRQ2Byte1_C FrmMng_dEngTRQ2Byte2_C FrmMng_dEngTRQ2Byte3_C FrmMng_dEngTRQ2Byte4_C FrmMng_dEngTRQ2Byte5_C FrmMng_dEngTRQ2Byte6_C FrmMng_dEngTRQ2Byte7_C FrmMng_dEngTRQ2Byte8_C FrmMng_dEngTRQ3Byte1_C FrmMng_dEngTRQ3Byte2_C FrmMng_dEngTRQ3Byte3_C FrmMng_dEngTRQ3Byte4_C FrmMng_dEngTRQ3Byte5_C FrmMng_dEngTRQ3Byte6_C FrmMng_dEngTRQ3Byte7_C FrmMng_dEngTRQ3Byte8_C FrmMng_LimRawMax_C FrmMng_RawErr_C FrmMng_nDes_Offset_C FrmMng_facNDes_Slope_C FrmMng_nLI_Offset_C FrmMng_facNLI_Slope_C FrmMng_nmax_Offset_C FrmMng_facnmax_Slope_C FrmMng_nMulinfo5_1_C FrmMng_p_Offset_C FrmMng_facP_Slope_C FrmMng_rAPP_Offset_C FrmMng_facRAPP_Slope_C FrmMng_rFan_Offset_C FrmMng_facrFan_Slope_C FrmMng_rGearbx_Offset_C FrmMng_facRGearbx_Slope_C FrmMng_rInrTrq_Offset_C FrmMng_facRInrTrq_Slope_C FrmMng_stTORxMsgAlcECU_CA FrmMng_tOil_Offset_C FrmMng_facTOil_Slope_C FrmMng_trqAbs_Offset_C FrmMng_factrqAbs_Slope_C FrmMng_trqMulinfo2_3_C FrmMng_t_Offset_C FrmMng_facT_Slope_C FrmMng_v_Offset_C FrmMng_facV_Slope_C /end DEF_CHARACTERISTIC
 /begin OUT_MEASUREMENT FrmMng_tiTODet_mp /end OUT_MEASUREMENT
/end FUNCTION
/begin FUNCTION frmmng_cctl "Frame Manager Prozeß für die FGR-Sende- sowie Empfangsbotschaft über den CAN"
 /begin DEF_CHARACTERISTIC FrmMng_DebCCTLCNTDef_C FrmMng_DebCCTLCNTOk_C FrmMng_DebCCTLCSDef_C FrmMng_DebCCTLCSOk_C FrmMng_DebCCTLDLCDef_C FrmMng_DebCCTLDLCOk_C FrmMng_DebCCTLTODef_C FrmMng_DebCCTLTOOk_C FrmMng_MaxDiffCCTL_C FrmMng_MaxPerCCTL_C FrmMng_stGWTipUpDnInfo_C FrmMng_swtCCTLEna_C /end DEF_CHARACTERISTIC
/end FUNCTION
/begin FUNCTION frmmng_dummy_msg ""
 /begin OUT_MEASUREMENT FrmMng_pAir FrmMng_pBoost FrmMng_pDiffPFlt FrmMng_rFlQl FrmMng_rRelPosBPAS FrmMng_stIgnLock FrmMng_tAir /end OUT_MEASUREMENT
/end FUNCTION
/begin FUNCTION frmmng_msg ""
 /begin OUT_MEASUREMENT FrmMng_prcFan FrmMng_stAC FrmMng_stACCInvalid FrmMng_stAWD1 FrmMng_stBrk FrmMng_stBrkAct FrmMng_stClgGearbx FrmMng_stConv FrmMng_stKombiTst FrmMng_stLckCanRxMsg FrmMng_stLckCanTxMsg FrmMng_stLckCanUsrMsg FrmMng_stNoTORxMsg FrmMng_stNoTOUsrMsg FrmMng_stNumTOOvrFlowECU FrmMng_stTClnt FrmMng_stTEnv FrmMng_stTOil FrmMng_stUsrMsgRxOrTx FrmMng_tClnt FrmMng_tEnv FrmMng_tOil FrmMng_trqLimAWD FrmMng_vLimAWD /end OUT_MEASUREMENT
/end FUNCTION
/begin FUNCTION frmmng_recac "Frame Manager Prozeß für die Klima-Empfangsbotschaft vom CAN"
 /begin DEF_CHARACTERISTIC FrmMng_DebAC1DLCDef_C FrmMng_DebAC1DLCOk_C FrmMng_DebAC1TODef_C FrmMng_DebAC1TOOk_C FrmMng_pACPress_Offset_C FrmMng_facACPress_Slope_C FrmMng_swtAC1Ena_C FrmMng_trqACComprLoad_Offset_C FrmMng_facACComprLoad_Slope_C /end DEF_CHARACTERISTIC
/end FUNCTION
/begin FUNCTION frmmng_recacc "Frame Manager Prozeß für die ACC-Empfangsbotschaft vom CAN"
 /begin DEF_CHARACTERISTIC FrmMng_aACC_Offset_C FrmMng_facAACC_Slope_C FrmMng_DebACCCNTDef_C FrmMng_DebACCCNTOk_C FrmMng_DebACCCSDef_C FrmMng_DebACCCSOk_C FrmMng_DebACCDLCDef_C FrmMng_DebACCDLCOk_C FrmMng_DebACCTODef_C FrmMng_DebACCTOOk_C FrmMng_MaxDiffACC_C FrmMng_MaxPerACC_C FrmMng_stCCSelPlaus_C FrmMng_swtACC1Ena_C FrmMng_swtACCSysEna_C FrmMng_tiDebTO_C /end DEF_CHARACTERISTIC
/end FUNCTION
/begin FUNCTION frmmng_recairbg "Frame Manager Prozeß für die Airbag-Empfangsbotschaft vom CAN"
 /begin DEF_CHARACTERISTIC FrmMng_DebAIRBGCNTDef_C FrmMng_DebAIRBGCNTOk_C FrmMng_DebAIRBGCSDef_C FrmMng_DebAIRBGCSOk_C FrmMng_DebAIRBGDLCDef_C FrmMng_DebAIRBGDLCOk_C FrmMng_DebAIRBGTODef_C FrmMng_DebAIRBGTOOk_C FrmMng_MaxDiffAirbg_C FrmMng_MaxPerAirbg_C FrmMng_swtAIRBG1Ena_C FrmMng_tiAdpStrt_C /end DEF_CHARACTERISTIC
/end FUNCTION
/begin FUNCTION frmmng_recawd "Empfangsprozeß für die Allradbotschaften"
 /begin DEF_CHARACTERISTIC FrmMng_DebAWD1CNTDef_C FrmMng_DebAWD1CNTOk_C FrmMng_DebAWD1DLCDef_C FrmMng_DebAWD1DLCOk_C FrmMng_DebAWD1TODef_C FrmMng_DebAWD1TOOk_C FrmMng_MaxDiffAWD1_C FrmMng_MaxPerAWD1_C FrmMng_rTrqLim_Offset_C FrmMng_facRTrqLim_Slope_C FrmMng_swtAWD1Ena_C FrmMng_vLim_Offset_C FrmMng_facVLim_Slope_C /end DEF_CHARACTERISTIC
/end FUNCTION
/begin FUNCTION frmmng_recbem "Empfangsprozeß für Energiemanager CAN-Botschaft"
 /begin DEF_CHARACTERISTIC FrmMng_DebBEM1CNTDef_C FrmMng_DebBEM1CNTOk_C FrmMng_DebBEM1CSDef_C FrmMng_DebBEM1CSOk_C FrmMng_DebBEM1DLCDef_C FrmMng_DebBEM1DLCOk_C FrmMng_DebBEM1TODef_C FrmMng_DebBEM1TOOk_C FrmMng_MaxDiffBEM1_C FrmMng_MaxPerBEM1_C FrmMng_pwrBEMAltInit_C FrmMng_pwrInr_Offset_C FrmMng_facRpwr_Slope_C FrmMng_swtBEM1Ena_C /end DEF_CHARACTERISTIC
/end FUNCTION
/begin FUNCTION frmmng_recbrk "Frame Manager Prozeß für die Bremsen-Empfangsbotschaft vom CAN"
 /begin DEF_CHARACTERISTIC FrmMng_aTrnvrs_Offset_C FrmMng_facATrnvrs_Slope_C FrmMng_BRK_ENABLEMASK_C FrmMng_DebBRK1CNTDef_C FrmMng_DebBRK1CNTOk_C FrmMng_DebBRK1DLCDef_C FrmMng_DebBRK1DLCOk_C FrmMng_DebBRK1TODef_C FrmMng_DebBRK1TOOk_C FrmMng_DebBRK2DLCDef_C FrmMng_DebBRK2DLCOk_C FrmMng_DebBRK2TODef_C FrmMng_DebBRK2TOOk_C FrmMng_DebBRK8CNTDef_C FrmMng_DebBRK8CNTOk_C FrmMng_DebBRK8CSDef_C FrmMng_DebBRK8CSOk_C FrmMng_DebBRK8DLCDef_C FrmMng_DebBRK8DLCOk_C FrmMng_DebBRK8TODef_C FrmMng_DebBRK8TOOk_C FrmMng_MaxDiffBRK1_C FrmMng_MaxDiffBRK8_C FrmMng_MaxPerBRK1_C FrmMng_MaxPerBRK8_C FrmMng_swtBRK1Ena_C FrmMng_swtBRK2Ena_C FrmMng_swtBRK8Ena_C FrmMng_vGSInitVal_C /end DEF_CHARACTERISTIC
/end FUNCTION
/begin FUNCTION frmmng_recdsp "Frame Manager Prozeß für die Kombi-Empfangsbotschaft vom CAN"
 /begin DEF_CHARACTERISTIC FrmMng_DebDSP1CNTDef_C FrmMng_DebDSP1CNTOk_C FrmMng_DebDSP1DLCDef_C FrmMng_DebDSP1DLCOk_C FrmMng_DebDSP1TODef_C FrmMng_DebDSP1TOOk_C FrmMng_DebDSP2DLCDef_C FrmMng_DebDSP2DLCOk_C FrmMng_DebDSP2TODef_C FrmMng_DebDSP2TOOk_C FrmMng_MaxDiffDSP1_C FrmMng_MaxPerDSP1_C FrmMng_swtDSP1Ena_C FrmMng_swtDSP2Ena_C FrmMng_tEnv_Offset_C FrmMng_facTEnv_Slope_C FrmMng_volTnk_Offset_C FrmMng_facVolTnk_Slope_C /end DEF_CHARACTERISTIC
/end FUNCTION
/begin FUNCTION frmmng_recescu "Frame Manager Prozeß für die Bordnetz-Empfangsbotschaft vom CAN"
 /begin DEF_CHARACTERISTIC FrmMng_DebESCUDLCDef_C FrmMng_DebESCUDLCOk_C FrmMng_DebESCUTODef_C FrmMng_DebESCUTOOk_C FrmMng_swtESCUEna_C /end DEF_CHARACTERISTIC
/end FUNCTION
/begin FUNCTION frmmng_recgw ""
 /begin DEF_CHARACTERISTIC FrmMng_DebAAGCNTDef_C FrmMng_DebAAGCNTOk_C FrmMng_DebAAGTODef_C FrmMng_DebAAGTOOk_C FrmMng_DebDIA1DLCDef_C FrmMng_DebDIA1DLCOk_C FrmMng_DebDIA1TODef_C FrmMng_DebDIA1TOOk_C FrmMng_DebGW1DLCDef_C FrmMng_DebGW1DLCOk_C FrmMng_DebGW1TODef_C FrmMng_DebGW1TOOk_C FrmMng_DebILMCNTDef_C FrmMng_DebILMCNTOk_C FrmMng_DebILMTODef_C FrmMng_DebILMTOOk_C FrmMng_MaxDiffAAG_C FrmMng_MaxDiffILM_C FrmMng_MaxPerAAG_C FrmMng_MaxPerILM_C FrmMng_swtDIA1Ena_C FrmMng_swtGW1Ena_C /end DEF_CHARACTERISTIC
/end FUNCTION
/begin FUNCTION frmmng_recniveau "Empfangsprozeß für Niveau CAN-Botschaft"
 /begin DEF_CHARACTERISTIC FrmMng_tiDebNIV1WrngCodDef_C FrmMng_tiDebNIV1WrngCodOk_C FrmMng_DebNIVEAU1CNTDef_C FrmMng_DebNIVEAU1CNTOk_C FrmMng_DebNIVEAU1CSDef_C FrmMng_DebNIVEAU1CSOk_C FrmMng_DebNIVEAU1DLCDef_C FrmMng_DebNIVEAU1DLCOk_C FrmMng_DebNIVEAU1TODef_C FrmMng_DebNIVEAU1TOOk_C FrmMng_MaxDiffNIVEAU1_C FrmMng_MaxPerNIVEAU1_C FrmMng_tiPlausCANVerDebDef_C FrmMng_tiPlausCANVerDebOk_C FrmMng_swtNIVEAU1Ena_C /end DEF_CHARACTERISTIC
/end FUNCTION
/begin FUNCTION frmmng_recstign "Frame Manager Prozeß für die Zündanlaßschloß-Empfangsbotschaft vom CAN"
 /begin DEF_CHARACTERISTIC FrmMng_DebSTIGNDLCDef_C FrmMng_DebSTIGNDLCOk_C FrmMng_DebStIgnTODef_C FrmMng_DebStIgnTOOk_C FrmMng_swtSTIGNEna_C /end DEF_CHARACTERISTIC
/end FUNCTION
/begin COMPU_METHOD Acc "Fahrzeugbeschleunigung" RAT_FUNC "%6.5" "[m/s^2]" COEFFS 0 1000 0 0 0 1 /end COMPU_METHOD
/begin COMPU_METHOD AirMassPerCyl "Luftmasse pro Zylinder" RAT_FUNC "%6.3" "[mg/Hub Luft]" COEFFS 0 10 0 0 0 1 /end COMPU_METHOD
/begin COMPU_METHOD AngleCrS "Winkel Kurbelwelle" RAT_FUNC "%6.4" "[deg CrS]" COEFFS 0 42.6666666666667 0 0 0 1 /end COMPU_METHOD
/begin COMPU_METHOD dQnt_dT1 "Einspritzmengenabweichung per 100 Kelvin" RAT_FUNC "%6.4" "[(mg/hub)/100C]" COEFFS 0 50 0 0 0 1 /end COMPU_METHOD
/begin COMPU_METHOD DtyCyc "Tastverhaeltnis" RAT_FUNC "%6.4" "[%]" COEFFS 0 100 0 0 0 1 /end COMPU_METHOD
/begin COMPU_METHOD Dxs "Prozentsatz fuer DXs (-100% ... 100%)" RAT_FUNC "%7.6" "[%]" COEFFS 0 40000 0 0 0 1 /end COMPU_METHOD
/begin COMPU_METHOD EngN "Motordrehzahl" RAT_FUNC "%6.2" "[rpm]" COEFFS 0 1 0 0 0 1 /end COMPU_METHOD
/begin COMPU_METHOD EngN_float "Formel fuer die Drehzahl (Fließkomma)" RAT_FUNC "%6.2" "[rpm]" COEFFS 0 1 0 0 0 1 /end COMPU_METHOD
/begin COMPU_METHOD Eta "Umrechnugsformel für Wirkungsgradfaktor eta" RAT_FUNC "%6.4" "Nm/(mg/cyc)" COEFFS 0 128 0 0 0 1 /end COMPU_METHOD
/begin COMPU_METHOD Fact "Faktor mit Auflösung 1 / 8192, hauptsächlich für einen Faktorenbereich 0...1 verwendet" RAT_FUNC "%6.5" "[-]" COEFFS 0 8192 0 0 0 1 /end COMPU_METHOD
/begin COMPU_METHOD Fact1 "Faktor mit Auflösung 0,01 (100 mal höherer Bereich als Fact)" RAT_FUNC "%6.4" "[-]" COEFFS 0 128 0 0 0 1 /end COMPU_METHOD
/begin COMPU_METHOD FBC_BPfac "Umrechnungsformel für drehmomentübersetzungsabhängige Bandpassverstärkung" RAT_FUNC "%6.5" "-" COEFFS 0 1638.35 0 0 0 1 /end COMPU_METHOD
/begin COMPU_METHOD FBC_GvrnIKi_float "Integrationskonstante für FBC" RAT_FUNC "%6.2" "[mg/((1/min^2)*s)]" COEFFS 0 1 0 0 0 1 /end COMPU_METHOD
/begin COMPU_METHOD FBC_GvrnPKp_float "Proportinalitäts-Faktor für FBC" RAT_FUNC "%6.2" "[mg/(1/min^2)]" COEFFS 0 1 0 0 0 1 /end COMPU_METHOD
/begin COMPU_METHOD FBC_LrnState "Zustände des FBC Zustandsautomaten" TAB_VERB "%6.3" "[-]" COMPU_TAB_REF FBC_LrnState /end COMPU_METHOD
/begin COMPU_VTAB FBC_LrnState "Zustände des FBC Zustandsautomaten" TAB_VERB 5 1 "INIT   " 2 "DX_WAIT" 3 "LEARN  " 4 "APPLY  " 5 "DELAY  " /end COMPU_VTAB
/begin COMPU_METHOD FlConsum_l_h "Kraftstoffverbrauch" RAT_FUNC "%6.4" "[l/h]" COEFFS 0 100 0 0 0 1 /end COMPU_METHOD
/begin COMPU_METHOD Fl_Half_L "Kraftstoffverbrauchsintegral" RAT_FUNC "%6.3" "[l]" COEFFS 0 2 0 0 0 1 /end COMPU_METHOD
/begin COMPU_METHOD InjMass "Einspritzmenge" RAT_FUNC "%6.4" "[mg/hub]" COEFFS 0 100 0 0 0 1 /end COMPU_METHOD
/begin COMPU_METHOD InjMassCorr "Korrektureinspritzmenge" RAT_FUNC "%6.5" "[mg/hub]" COEFFS 0 1000 0 0 0 1 /end COMPU_METHOD
/begin COMPU_METHOD InjMassCyc "Einspritzmenge pro Zyklus (mg/Zyklus)" RAT_FUNC "%6.4" "[mg/cyc]" COEFFS 0 100 0 0 0 1 /end COMPU_METHOD
/begin COMPU_METHOD InjMassNSlp "Steigung der Korrektureinspritzmenge aufgrund der Drehzahlrichtung" RAT_FUNC "%7.6" "[(mg/hub)/rpm]" COEFFS 0 10000 0 0 0 1 /end COMPU_METHOD
/begin COMPU_METHOD InjMassQSlp "Steigung der Korrektureinspritzmenge aufgrund der Mengenrichtung" RAT_FUNC "%6.4" "[-]" COEFFS 0 100 0 0 0 1 /end COMPU_METHOD
/begin COMPU_METHOD InjMassSec "Einspritzmenge pro Sekunde" RAT_FUNC "%6.4" "[mg/hub/s]" COEFFS 0 100 0 0 0 1 /end COMPU_METHOD
/begin COMPU_METHOD Ki "Integrale Verstärkung Ki (gleiche Einheit/Umrechnungsregel an Ein- und Ausgang)" RAT_FUNC "%6.5" "[1/s]" COEFFS 0 4294.967296 0 0 0 1 /end COMPU_METHOD
/begin COMPU_METHOD Ki_LmbdRec2InjMass "Integrationsverstärkung (reziprokes Lambda zu Einspritzmenge)" RAT_FUNC "%6.4" "[mg/stroke/s]" COEFFS 0 42.94967296 0 0 0 1 /end COMPU_METHOD
/begin COMPU_METHOD Kp_LmbdRec2InjMass_1 "Proportionale Verstärkung Kp (reziprokes Lambda zu Einspritzmenge)" RAT_FUNC "%6.4" "[mg/stroke]" COEFFS 0 81.92 0 0 0 1 /end COMPU_METHOD
/begin COMPU_METHOD Kp_LmbdRec2InjMass_2 "Proportionale Verstärkung Kp (reziprokes Lambda zu Einspritzmenge)" RAT_FUNC "%6.4" "[mg/stroke]" COEFFS 0 81.92 0 0 0 1 /end COMPU_METHOD
/begin COMPU_METHOD lambda "Lambda" RAT_FUNC "%6.5" "[-]" COEFFS 0 1000 0 0 0 1 /end COMPU_METHOD
/begin COMPU_METHOD lambdaRec "Kehrwert von Lambda" RAT_FUNC "%7.6" "[-]" COEFFS 0 10000 0 0 0 1 /end COMPU_METHOD
/begin COMPU_METHOD lambdaSec "Lambda Aenderungsrate" RAT_FUNC "%6.5" "[-/s]" COEFFS 0 1000 0 0 0 1 /end COMPU_METHOD
/begin COMPU_METHOD Map_Select "Umsetzungsfaktor von Kennfeldern fuer vierdimensionale Raeume" RAT_FUNC "%6.4" "[-]" COEFFS 0 256 0 0 0 1 /end COMPU_METHOD
/begin COMPU_METHOD OneToOne "eins zu eins (physikalischer Wert ist gleich dem internen Wert)" RAT_FUNC "%6.2" "[-]" COEFFS 0 1 0 0 0 1 /end COMPU_METHOD
/begin COMPU_METHOD Per_Ratio "Umwandlung fuer Bereichsgewichtung" RAT_FUNC "%6.4" "[-]" COEFFS 0 256 0 0 0 1 /end COMPU_METHOD
/begin COMPU_METHOD Prc "Prozent, gleiche interne Auflösung wie Fact, aber Darstellung in Prozent (0...100%)" RAT_FUNC "%6.4" "[%]" COEFFS 0 100 0 0 0 1 /end COMPU_METHOD
/begin COMPU_METHOD Prc_float "Prozent Umrechnung für float" RAT_FUNC "%6.0" "%" COEFFS 0 0.01 0 0 0 1 /end COMPU_METHOD
/begin COMPU_METHOD PresAC_hPa "Druck (Klimatisierung) angezeigt in [hPa]" RAT_FUNC "%6.2" "[hPa]" COEFFS 0 0.5 0 0 0 1 /end COMPU_METHOD
/begin COMPU_METHOD Pres_hPa "Druck (angezeigt in [hPa])" RAT_FUNC "%6.2" "[hPa]" COEFFS 0 1 0 0 0 1 /end COMPU_METHOD
/begin COMPU_METHOD Pres_Rail "Raildruck in hPa" RAT_FUNC "%6.0" "[hPa]" COEFFS 0 0.01 0 0 0 1 /end COMPU_METHOD
/begin COMPU_METHOD Pwr "Leistung" RAT_FUNC "%6.2" "[W]" COEFFS 0 0.10610329539459 0 0 0 1 /end COMPU_METHOD
/begin COMPU_METHOD RhoFuel "Kraftstoffdichte" RAT_FUNC "%6.3" "[kg/m^3]" COEFFS 0 10 0 0 0 1 /end COMPU_METHOD
/begin COMPU_METHOD RmpFuel "fuel consumption ramp gradient" RAT_FUNC "%6.4" "[l/s]" COEFFS 0 131.072 0 0 0 1 /end COMPU_METHOD
/begin COMPU_METHOD RmpInjMass "Rampengradient für Einspritzmenge" RAT_FUNC "%6.5" "[(mg/stroke)/s]" COEFFS 0 6553.6 0 0 0 1 /end COMPU_METHOD
/begin COMPU_METHOD RmpPrc "Prozent Rampengradient" RAT_FUNC "%6.5" "[%/s]" COEFFS 0 6553.6 0 0 0 1 /end COMPU_METHOD
/begin COMPU_METHOD Rmp_Fact "Rampenfaktorgradient" RAT_FUNC "%8.7" "[1/s]" COEFFS 0 536870.912 0 0 0 1 /end COMPU_METHOD
/begin COMPU_METHOD rTrqCAN "Momentenverhältnis für CAN" RAT_FUNC "%6.3" "[%]" COEFFS 0 2.54999910750031 0 0 0 1 /end COMPU_METHOD
/begin COMPU_METHOD Surge_Frq "Umrechung der Ruckelfrequenz in kritische Drehzahl für fNW=fRuck" RAT_FUNC "%6.4" "[Hz]" COEFFS 0 120 0 0 0 1 /end COMPU_METHOD
/begin COMPU_METHOD TempDiff_Kelv "Offsettemperatur dargestellt in [K]" RAT_FUNC "%6.3" "[ deg C ]" COEFFS 0 10 0 0 0 1 /end COMPU_METHOD
/begin COMPU_METHOD Temp_Cels "Temperatur dargestellt in °C (gleiche interne Darstellung wie Temp_Kelv)" RAT_FUNC "%6.1" "[deg C]" COEFFS 0 10 2731.4 0 0 1 /end COMPU_METHOD
/begin COMPU_METHOD TimeCAN_TO_ms "Umrechnung von einer Inputzeit (ms) in eine Nummer" RAT_FUNC "%6.1" "[ms]" COEFFS 0 0.05 -1 0 0 1 /end COMPU_METHOD
/begin COMPU_METHOD TimeDeb "Entprellzeit in Millisekunden für Libraryfunktion Debounce" RAT_FUNC "%6.1" "[ms]" COEFFS 0 0.1 0 0 0 1 /end COMPU_METHOD
/begin COMPU_METHOD TimeDelay_s "Zeitkonstante T1 (in s) für PT1, DT1, etc." RAT_FUNC "%9.3" "[s]" COEFFS 0 0 1 0 0.00023283064365387 0 /end COMPU_METHOD
/begin COMPU_METHOD TimeEGTRmp "Umrechnung  Zeit in Rampensteigung,  Verwendet in EGT-Bibliothek" RAT_FUNC "%6.3" "[s]" COEFFS 0 0 1 0 0.0152587890625 0 /end COMPU_METHOD
/begin COMPU_METHOD Time_ms "Zeit in ms für Fehlerentprellung (DSM) und SW-Timer" RAT_FUNC "%6.1" "[ms]" COEFFS 0 0.1 0 0 0 1 /end COMPU_METHOD
/begin COMPU_METHOD Time_s "Zeit in s für Fehlerentprellung (DSM) und SW-Timer" RAT_FUNC "%6.4" "[s]" COEFFS 0 100 0 0 0 1 /end COMPU_METHOD
/begin COMPU_METHOD TransR "Übersetzungsverhältnis (Getriebe etc.)" RAT_FUNC "%6.4" "[-]" COEFFS 0 100 0 0 0 1 /end COMPU_METHOD
/begin COMPU_METHOD TrnvrsAcc "Umrechnung für Querbeschleunigung" RAT_FUNC "%6.4" "[g]" COEFFS 0 100 0 0 0 1 /end COMPU_METHOD
/begin COMPU_METHOD Trq "Motormoment" RAT_FUNC "%6.3" "[Nm]" COEFFS 0 10 0 0 0 1 /end COMPU_METHOD
/begin COMPU_METHOD TrqPrp "Vortriebsmoment" RAT_FUNC "%6.2" "[Nm]" COEFFS 0 1 0 0 0 1 /end COMPU_METHOD
/begin COMPU_METHOD Vel "Fahrzeuggeschwindigkeit, gleiche interne Auflösung wie Vel_SI" RAT_FUNC "%6.4" "[km/h]" COEFFS 0 100 0 0 0 1 /end COMPU_METHOD
/begin COMPU_METHOD Volt "Spannung in V (von ADC)" RAT_FUNC "%6.2" "[mV]" COEFFS 0 0.2046 0 0 0 1 /end COMPU_METHOD
/begin RECORD_LAYOUT Kf_Xs16_Ys16_Ws16 NO_AXIS_PTS_X 1 SWORD NO_AXIS_PTS_Y 2 SWORD AXIS_PTS_X 3 SWORD INDEX_INCR DIRECT AXIS_PTS_Y 4 SWORD INDEX_INCR DIRECT FNC_VALUES 5 SWORD COLUMN_DIR DIRECT /end RECORD_LAYOUT
/begin RECORD_LAYOUT Kl_Xs16_Ws16 NO_AXIS_PTS_X 1 SWORD AXIS_PTS_X 2 SWORD INDEX_INCR DIRECT FNC_VALUES 3 SWORD COLUMN_DIR DIRECT /end RECORD_LAYOUT
/begin RECORD_LAYOUT Kwb_Wr32 FNC_VALUES 1 FLOAT32_IEEE COLUMN_DIR DIRECT /end RECORD_LAYOUT
/begin RECORD_LAYOUT Kwb_Ws16 FNC_VALUES 1 SWORD COLUMN_DIR DIRECT /end RECORD_LAYOUT
/begin RECORD_LAYOUT Kwb_Wu16 FNC_VALUES 1 UWORD COLUMN_DIR DIRECT /end RECORD_LAYOUT
/begin RECORD_LAYOUT Kwb_Wu8 FNC_VALUES 1 UBYTE COLUMN_DIR DIRECT /end RECORD_LAYOUT
/begin RECORD_LAYOUT Kw_Wr32 FNC_VALUES 1 FLOAT32_IEEE COLUMN_DIR DIRECT /end RECORD_LAYOUT
/begin RECORD_LAYOUT Kw_Ws16 FNC_VALUES 1 SWORD COLUMN_DIR DIRECT /end RECORD_LAYOUT
/begin RECORD_LAYOUT Kw_Ws32 FNC_VALUES 1 SLONG COLUMN_DIR DIRECT /end RECORD_LAYOUT
/begin RECORD_LAYOUT Kw_Ws8 FNC_VALUES 1 SBYTE COLUMN_DIR DIRECT /end RECORD_LAYOUT
/begin RECORD_LAYOUT Kw_Wu16 FNC_VALUES 1 UWORD COLUMN_DIR DIRECT /end RECORD_LAYOUT
/begin RECORD_LAYOUT Kw_Wu32 FNC_VALUES 1 ULONG COLUMN_DIR DIRECT /end RECORD_LAYOUT
/begin RECORD_LAYOUT Kw_Wu8 FNC_VALUES 1 UBYTE COLUMN_DIR DIRECT /end RECORD_LAYOUT
/end MODULE
/end PROJECT
