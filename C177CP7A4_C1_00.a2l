ASAP2_VERSION 1 3
/begin PROJECT C177 "EDC16CP"
/begin HEADER "" VERSION "VCP7A3" PROJECT_NO C177 /end HEADER
/begin MODULE DIM ""
/begin MOD_COMMON "" BYTE_ORDER MSB_FIRST ALIGNMENT_BYTE 1 ALIGNMENT_WORD 2 ALIGNMENT_LONG 4 ALIGNMENT_FLOAT32_IEEE 4 /end MOD_COMMON
/begin CHARACTERISTIC DSM_CDCDfp_ACCCDWrongCoded_C "CARB spezifischer Fehlercode fuer Fehlerpfad Dfp_ACCCDWrongCoded" VAL_BLK 0x1CA000 Kwb_Wu16 65535.00 OneToOne 0.00 65535.00 FORMAT "%8.2" NUMBER 4 /end CHARACTERISTIC
/begin CHARACTERISTIC DSM_CDCDfp_ACCD_C "CARB spezifischer Fehlercode fuer Fehlerpfad Dfp_ACCD" VAL_BLK 0x1CA008 Kwb_Wu16 65535.00 OneToOne 0.00 65535.00 FORMAT "%8.2" NUMBER 4 /end CHARACTERISTIC
/begin CHARACTERISTIC DSM_CDCDfp_ACCD_PAC_C "CARB spezifischer Fehlercode fuer Fehlerpfad Dfp_ACCD_PAC" VAL_BLK 0x1CA010 Kwb_Wu16 65535.00 OneToOne 0.00 65535.00 FORMAT "%8.2" NUMBER 4 /end CHARACTERISTIC
/begin CHARACTERISTIC DSM_CDCDfp_ACCD_pCAN_C "CARB spezifischer Fehlercode fuer Fehlerpfad Dfp_ACCD_pCAN" VAL_BLK 0x1CA018 Kwb_Wu16 65535.00 OneToOne 0.00 65535.00 FORMAT "%8.2" NUMBER 4 /end CHARACTERISTIC
/begin CHARACTERISTIC DSM_CDCDfp_ACCD_trqCAN_C "CARB spezifischer Fehlercode fuer Fehlerpfad Dfp_ACCD_trqCAN" VAL_BLK 0x1CA020 Kwb_Wu16 65535.00 OneToOne 0.00 65535.00 FORMAT "%8.2" NUMBER 4 /end CHARACTERISTIC
/begin CHARACTERISTIC DSM_CDCDfp_ACCnotPlaus_C "CARB spezifischer Fehlercode fuer Fehlerpfad Dfp_ACCnotPlaus" VAL_BLK 0x1CA028 Kwb_Wu16 65535.00 OneToOne 0.00 65535.00 FORMAT "%8.2" NUMBER 4 /end CHARACTERISTIC
/begin CHARACTERISTIC DSM_CDCDfp_ADCMon_C "CARB spezifischer Fehlercode fuer Fehlerpfad Dfp_ADCMon" VAL_BLK 0x1CA030 Kwb_Wu16 65535.00 OneToOne 0.00 65535.00 FORMAT "%8.2" NUMBER 4 /end CHARACTERISTIC
/begin CHARACTERISTIC DSM_CDCDfp_AFSCD_AirTempDcyc_C "CARB spezifischer Fehlercode fuer Fehlerpfad Dfp_AFSCD_AirTempDcyc" VAL_BLK 0x1CA038 Kwb_Wu16 65535.00 OneToOne 0.00 65535.00 FORMAT "%8.2" NUMBER 4 /end CHARACTERISTIC
/begin CHARACTERISTIC DSM_CDCDfp_AFSCD_PlOffsDrft_C "CARB spezifischer Fehlercode fuer Fehlerpfad Dfp_AFSCD_PlOffsDrft" VAL_BLK 0x1CA040 Kwb_Wu16 65535.00 OneToOne 0.00 65535.00 FORMAT "%8.2" NUMBER 4 /end CHARACTERISTIC
/begin CHARACTERISTIC DSM_CDCDfp_AFSCD_PlSetyDrft_C "CARB spezifischer Fehlercode fuer Fehlerpfad Dfp_AFSCD_PlSetyDrft" VAL_BLK 0x1CA048 Kwb_Wu16 65535.00 OneToOne 0.00 65535.00 FORMAT "%8.2" NUMBER 4 /end CHARACTERISTIC
/begin CHARACTERISTIC DSM_CDCDfp_AFSCD_Plaus_C "CARB spezifischer Fehlercode fuer Fehlerpfad Dfp_AFSCD_Plaus" VAL_BLK 0x1CA050 Kwb_Wu16 65535.00 OneToOne 0.00 65535.00 FORMAT "%8.2" NUMBER 4 /end CHARACTERISTIC
/begin CHARACTERISTIC DSM_CDCDfp_AFSCD_SRCAirTemp_C "CARB spezifischer Fehlercode fuer Fehlerpfad Dfp_AFSCD_SRCAirTemp" VAL_BLK 0x1CA058 Kwb_Wu16 65535.00 OneToOne 0.00 65535.00 FORMAT "%8.2" NUMBER 4 /end CHARACTERISTIC
/begin CHARACTERISTIC DSM_CDCDfp_AFSCD_SRCAirm_C "CARB spezifischer Fehlercode fuer Fehlerpfad Dfp_AFSCD_SRCAirm" VAL_BLK 0x1CA060 Kwb_Wu16 65535.00 OneToOne 0.00 65535.00 FORMAT "%8.2" NUMBER 4 /end CHARACTERISTIC
/begin CHARACTERISTIC DSM_CDCDfp_AFSCD_SRCAirm2_C "CARB spezifischer Fehlercode fuer Fehlerpfad Dfp_AFSCD_SRCAirm2" VAL_BLK 0x1CA068 Kwb_Wu16 65535.00 OneToOne 0.00 65535.00 FORMAT "%8.2" NUMBER 4 /end CHARACTERISTIC
/begin CHARACTERISTIC DSM_CDCDfp_AFSCD_SRCBatt_C "CARB spezifischer Fehlercode fuer Fehlerpfad Dfp_AFSCD_SRCBatt" VAL_BLK 0x1CA070 Kwb_Wu16 65535.00 OneToOne 0.00 65535.00 FORMAT "%8.2" NUMBER 4 /end CHARACTERISTIC
/begin CHARACTERISTIC DSM_CDCDfp_AFSCD_SRCCorrAirm_C "CARB spezifischer Fehlercode fuer Fehlerpfad Dfp_AFSCD_SRCCorrAirm" VAL_BLK 0x1CA078 Kwb_Wu16 65535.00 OneToOne 0.00 65535.00 FORMAT "%8.2" NUMBER 4 /end CHARACTERISTIC
/begin CHARACTERISTIC DSM_CDCDfp_AFSCD_SRCRawAirm_C "CARB spezifischer Fehlercode fuer Fehlerpfad Dfp_AFSCD_SRCRawAirm" VAL_BLK 0x1CA080 Kwb_Wu16 65535.00 OneToOne 0.00 65535.00 FORMAT "%8.2" NUMBER 4 /end CHARACTERISTIC
/begin CHARACTERISTIC DSM_CDCDfp_AFSCD_SRCRefSigPer_C "CARB spezifischer Fehlercode fuer Fehlerpfad Dfp_AFSCD_SRCRefSigPer" VAL_BLK 0x1CA088 Kwb_Wu16 65535.00 OneToOne 0.00 65535.00 FORMAT "%8.2" NUMBER 4 /end CHARACTERISTIC
/begin CHARACTERISTIC DSM_CDCDfp_AFVCD_Actr_C "CARB spezifischer Fehlercode fuer Fehlerpfad Dfp_AFVCD_Actr" VAL_BLK 0x1CA090 Kwb_Wu16 65535.00 OneToOne 0.00 65535.00 FORMAT "%8.2" NUMBER 4 /end CHARACTERISTIC
/begin CHARACTERISTIC DSM_CDCDfp_AOHtCDHt1_C "CARB spezifischer Fehlercode fuer Fehlerpfad Dfp_AOHtCDHt1" VAL_BLK 0x1CA098 Kwb_Wu16 65535.00 OneToOne 0.00 65535.00 FORMAT "%8.2" NUMBER 4 /end CHARACTERISTIC
/begin CHARACTERISTIC DSM_CDCDfp_AOHtCDHt2_C "CARB spezifischer Fehlercode fuer Fehlerpfad Dfp_AOHtCDHt2" VAL_BLK 0x1CA0A0 Kwb_Wu16 65535.00 OneToOne 0.00 65535.00 FORMAT "%8.2" NUMBER 4 /end CHARACTERISTIC
/begin CHARACTERISTIC DSM_CDCDfp_AOHtCDHt3_C "CARB spezifischer Fehlercode fuer Fehlerpfad Dfp_AOHtCDHt3" VAL_BLK 0x1CA0A8 Kwb_Wu16 65535.00 OneToOne 0.00 65535.00 FORMAT "%8.2" NUMBER 4 /end CHARACTERISTIC
/begin CHARACTERISTIC DSM_CDCDfp_APP1_C "CARB spezifischer Fehlercode fuer Fehlerpfad Dfp_APP1" VAL_BLK 0x1CA0B0 Kwb_Wu16 65535.00 OneToOne 0.00 65535.00 FORMAT "%8.2" NUMBER 4 /end CHARACTERISTIC
/begin CHARACTERISTIC DSM_CDCDfp_APP2_C "CARB spezifischer Fehlercode fuer Fehlerpfad Dfp_APP2" VAL_BLK 0x1CA0B8 Kwb_Wu16 65535.00 OneToOne 0.00 65535.00 FORMAT "%8.2" NUMBER 4 /end CHARACTERISTIC
/begin CHARACTERISTIC DSM_CDCDfp_APPCD_KickDown_C "CARB spezifischer Fehlercode fuer Fehlerpfad Dfp_APPCD_KickDown" VAL_BLK 0x1CA0C0 Kwb_Wu16 65535.00 OneToOne 0.00 65535.00 FORMAT "%8.2" NUMBER 4 /end CHARACTERISTIC
/begin CHARACTERISTIC DSM_CDCDfp_APPSync_C "CARB spezifischer Fehlercode fuer Fehlerpfad Dfp_APPSync" VAL_BLK 0x1CA0C8 Kwb_Wu16 65535.00 OneToOne 0.00 65535.00 FORMAT "%8.2" NUMBER 4 /end CHARACTERISTIC
/begin CHARACTERISTIC DSM_CDCDfp_APP_Npl_C "CARB spezifischer Fehlercode fuer Fehlerpfad Dfp_APP_Npl" VAL_BLK 0x1CA0D0 Kwb_Wu16 65535.00 OneToOne 0.00 65535.00 FORMAT "%8.2" NUMBER 4 /end CHARACTERISTIC
/begin CHARACTERISTIC DSM_CDCDfp_APSCD_C "CARB spezifischer Fehlercode fuer Fehlerpfad Dfp_APSCD" VAL_BLK 0x1CA0D8 Kwb_Wu16 65535.00 OneToOne 0.00 65535.00 FORMAT "%8.2" NUMBER 4 /end CHARACTERISTIC
/begin CHARACTERISTIC DSM_CDCDfp_AccPedPlausBrk_C "CARB spezifischer Fehlercode fuer Fehlerpfad Dfp_AccPedPlausBrk" VAL_BLK 0x1CA0E0 Kwb_Wu16 65535.00 OneToOne 0.00 65535.00 FORMAT "%8.2" NUMBER 4 /end CHARACTERISTIC
/begin CHARACTERISTIC DSM_CDCDfp_AddPCD_C "CARB spezifischer Fehlercode fuer Fehlerpfad Dfp_ADDpcd" VAL_BLK 0x1CA0E8 Kwb_Wu16 65535.00 OneToOne 0.00 65535.00 FORMAT "%8.2" NUMBER 4 /end CHARACTERISTIC
/begin CHARACTERISTIC DSM_CDCDfp_AddPCDTnkLvl_C "CARB spezifischer Fehlercode fuer Fehlerpfad Dfp_AddPCDTnkLvl" VAL_BLK 0x1CA0F0 Kwb_Wu16 65535.00 OneToOne 0.00 65535.00 FORMAT "%8.2" NUMBER 4 /end CHARACTERISTIC
/begin CHARACTERISTIC DSM_CDCDfp_AddPCDTnkLvlDef_C "CARB spezifischer Fehlercode fuer Fehlerpfad Dfp_AddPCDTnkLvlDef" VAL_BLK 0x1CA0F8 Kwb_Wu16 65535.00 OneToOne 0.00 65535.00 FORMAT "%8.2" NUMBER 4 /end CHARACTERISTIC
/begin CHARACTERISTIC DSM_CDCDfp_AirCtl_GovDev_C "CARB spezifischer Fehlercode fuer Fehlerpfad Dfp_AirCtl_GovDev" VAL_BLK 0x1CA100 Kwb_Wu16 65535.00 OneToOne 0.00 65535.00 FORMAT "%8.2" NUMBER 4 /end CHARACTERISTIC
/begin CHARACTERISTIC DSM_CDCDfp_AirbCDCrash_C "CARB spezifischer Fehlercode fuer Fehlerpfad Dfp_AirbCDCrash" VAL_BLK 0x1CA108 Kwb_Wu16 65535.00 OneToOne 0.00 65535.00 FORMAT "%8.2" NUMBER 4 /end CHARACTERISTIC
/begin CHARACTERISTIC DSM_CDCDfp_AirbCDCrashCrCtl_C "CARB spezifischer Fehlercode fuer Fehlerpfad Dfp_AirbCDCrashCrCtl" VAL_BLK 0x1CA110 Kwb_Wu16 65535.00 OneToOne 0.00 65535.00 FORMAT "%8.2" NUMBER 4 /end CHARACTERISTIC
/begin CHARACTERISTIC DSM_CDCDfp_AirbCDCrashPSP_C "CARB spezifischer Fehlercode fuer Fehlerpfad Dfp_AirbCDCrashPSP" VAL_BLK 0x1CA118 Kwb_Wu16 65535.00 OneToOne 0.00 65535.00 FORMAT "%8.2" NUMBER 4 /end CHARACTERISTIC
/begin CHARACTERISTIC DSM_CDCDfp_AltCDExc_C "CARB spezifischer Fehlercode fuer Fehlerpfad Dfp_AltCDExc" VAL_BLK 0x1CA120 Kwb_Wu16 65535.00 OneToOne 0.00 65535.00 FORMAT "%8.2" NUMBER 4 /end CHARACTERISTIC
/begin CHARACTERISTIC DSM_CDCDfp_AltCD_Load_C "CARB spezifischer Fehlercode fuer Fehlerpfad Dfp_AltCD_Load" VAL_BLK 0x1CA128 Kwb_Wu16 65535.00 OneToOne 0.00 65535.00 FORMAT "%8.2" NUMBER 4 /end CHARACTERISTIC
/begin CHARACTERISTIC DSM_CDCDfp_AltPwrCan_C "CARB spezifischer Fehlercode fuer Fehlerpfad Dfp_AltPwrCan" VAL_BLK 0x1CA130 Kwb_Wu16 65535.00 OneToOne 0.00 65535.00 FORMAT "%8.2" NUMBER 4 /end CHARACTERISTIC
/begin CHARACTERISTIC DSM_CDCDfp_BPACD_Max_C "CARB spezifischer Fehlercode fuer Fehlerpfad Dfp_BPACD_Max" VAL_BLK 0x1CA138 Kwb_Wu16 65535.00 OneToOne 0.00 65535.00 FORMAT "%8.2" NUMBER 4 /end CHARACTERISTIC
/begin CHARACTERISTIC DSM_CDCDfp_BPACD_Min_C "CARB spezifischer Fehlercode fuer Fehlerpfad Dfp_BPACD_Min" VAL_BLK 0x1CA140 Kwb_Wu16 65535.00 OneToOne 0.00 65535.00 FORMAT "%8.2" NUMBER 4 /end CHARACTERISTIC
/begin CHARACTERISTIC DSM_CDCDfp_BPACD_SigNpl_C "CARB spezifischer Fehlercode fuer Fehlerpfad Dfp_BPACD_SigNpl" VAL_BLK 0x1CA148 Kwb_Wu16 65535.00 OneToOne 0.00 65535.00 FORMAT "%8.2" NUMBER 4 /end CHARACTERISTIC
/begin CHARACTERISTIC DSM_CDCDfp_BPAExcSensTemp_C "CARB spezifischer Fehlercode fuer Fehlerpfad Dfp_BPAExcSensTemp" VAL_BLK 0x1CA150 Kwb_Wu16 65535.00 OneToOne 0.00 65535.00 FORMAT "%8.2" NUMBER 4 /end CHARACTERISTIC
/begin CHARACTERISTIC DSM_CDCDfp_BPANotLrn_C "CARB spezifischer Fehlercode fuer Fehlerpfad Dfp_BPANotLrn" VAL_BLK 0x1CA158 Kwb_Wu16 65535.00 OneToOne 0.00 65535.00 FORMAT "%8.2" NUMBER 4 /end CHARACTERISTIC
/begin CHARACTERISTIC DSM_CDCDfp_BPASCDDcyc_C "CARB spezifischer Fehlercode fuer Fehlerpfad Dfp_BPASCDDcyc" VAL_BLK 0x1CA160 Kwb_Wu16 65535.00 OneToOne 0.00 65535.00 FORMAT "%8.2" NUMBER 4 /end CHARACTERISTIC
/begin CHARACTERISTIC DSM_CDCDfp_BPASCDPeriod_C "CARB spezifischer Fehlercode fuer Fehlerpfad Dfp_BPASCDPeriod" VAL_BLK 0x1CA168 Kwb_Wu16 65535.00 OneToOne 0.00 65535.00 FORMAT "%8.2" NUMBER 4 /end CHARACTERISTIC
/begin CHARACTERISTIC DSM_CDCDfp_BPSCD_C "CARB spezifischer Fehlercode fuer Fehlerpfad Dfp_BPSCD" VAL_BLK 0x1CA170 Kwb_Wu16 65535.00 OneToOne 0.00 65535.00 FORMAT "%8.2" NUMBER 4 /end CHARACTERISTIC
/begin CHARACTERISTIC DSM_CDCDfp_BPSCDPlaus_C "CARB spezifischer Fehlercode fuer Fehlerpfad Dfp_BPSCDPlaus" VAL_BLK 0x1CA178 Kwb_Wu16 65535.00 OneToOne 0.00 65535.00 FORMAT "%8.2" NUMBER 4 /end CHARACTERISTIC
/begin CHARACTERISTIC DSM_CDCDfp_BattCD_C "CARB spezifischer Fehlercode fuer Fehlerpfad Dfp_BattCD" VAL_BLK 0x1CA180 Kwb_Wu16 65535.00 OneToOne 0.00 65535.00 FORMAT "%8.2" NUMBER 4 /end CHARACTERISTIC
/begin CHARACTERISTIC DSM_CDCDfp_BrkCD_C "CARB spezifischer Fehlercode fuer Fehlerpfad Dfp_BrkCD" VAL_BLK 0x1CA188 Kwb_Wu16 65535.00 OneToOne 0.00 65535.00 FORMAT "%8.2" NUMBER 4 /end CHARACTERISTIC
/begin CHARACTERISTIC DSM_CDCDfp_BrkCDdynPl_C "CARB spezifischer Fehlercode fuer Fehlerpfad Dfp_BrkCDdynPl" VAL_BLK 0x1CA190 Kwb_Wu16 65535.00 OneToOne 0.00 65535.00 FORMAT "%8.2" NUMBER 4 /end CHARACTERISTIC
/begin CHARACTERISTIC DSM_CDCDfp_CANA_C "CARB spezifischer Fehlercode fuer Fehlerpfad Dfp_CANA" VAL_BLK 0x1CA198 Kwb_Wu16 65535.00 OneToOne 0.00 65535.00 FORMAT "%8.2" NUMBER 4 /end CHARACTERISTIC
/begin CHARACTERISTIC DSM_CDCDfp_CANB_C "CARB spezifischer Fehlercode fuer Fehlerpfad Dfp_CANB" VAL_BLK 0x1CA1A0 Kwb_Wu16 65535.00 OneToOne 0.00 65535.00 FORMAT "%8.2" NUMBER 4 /end CHARACTERISTIC
/begin CHARACTERISTIC DSM_CDCDfp_CANBus1_C "CARB spezifischer Fehlercode fuer Fehlerpfad Dfp_CANBus1" VAL_BLK 0x1CA1A8 Kwb_Wu16 65535.00 OneToOne 0.00 65535.00 FORMAT "%8.2" NUMBER 4 /end CHARACTERISTIC
/begin CHARACTERISTIC DSM_CDCDfp_CANBus2_C "CARB spezifischer Fehlercode fuer Fehlerpfad Dfp_CANBus2" VAL_BLK 0x1CA1B0 Kwb_Wu16 65535.00 OneToOne 0.00 65535.00 FORMAT "%8.2" NUMBER 4 /end CHARACTERISTIC
/begin CHARACTERISTIC DSM_CDCDfp_CANBus3_C "CARB spezifischer Fehlercode fuer Fehlerpfad Dfp_CANBus3" VAL_BLK 0x1CA1B8 Kwb_Wu16 65535.00 OneToOne 0.00 65535.00 FORMAT "%8.2" NUMBER 4 /end CHARACTERISTIC
/begin CHARACTERISTIC DSM_CDCDfp_CANC_C "CARB spezifischer Fehlercode fuer Fehlerpfad Dfp_CANC" VAL_BLK 0x1CA1C0 Kwb_Wu16 65535.00 OneToOne 0.00 65535.00 FORMAT "%8.2" NUMBER 4 /end CHARACTERISTIC
/begin CHARACTERISTIC DSM_CDCDfp_CANErrActA_C "CARB spezifischer Fehlercode fuer Fehlerpfad Dfp_CANErrActA" VAL_BLK 0x1CA1C8 Kwb_Wu16 65535.00 OneToOne 0.00 65535.00 FORMAT "%8.2" NUMBER 4 /end CHARACTERISTIC
/begin CHARACTERISTIC DSM_CDCDfp_CANErrActB_C "CARB spezifischer Fehlercode fuer Fehlerpfad Dfp_CANErrActB" VAL_BLK 0x1CA1D0 Kwb_Wu16 65535.00 OneToOne 0.00 65535.00 FORMAT "%8.2" NUMBER 4 /end CHARACTERISTIC
/begin CHARACTERISTIC DSM_CDCDfp_CANErrActC_C "CARB spezifischer Fehlercode fuer Fehlerpfad Dfp_CANErrActC" VAL_BLK 0x1CA1D8 Kwb_Wu16 65535.00 OneToOne 0.00 65535.00 FORMAT "%8.2" NUMBER 4 /end CHARACTERISTIC
/begin CHARACTERISTIC DSM_CDCDfp_COTSCD_C "CARB spezifischer Fehlercode fuer Fehlerpfad Dfp_COTSCD" VAL_BLK 0x1CA1E0 Kwb_Wu16 65535.00 OneToOne 0.00 65535.00 FORMAT "%8.2" NUMBER 4 /end CHARACTERISTIC
/begin CHARACTERISTIC DSM_CDCDfp_CTSCD_C "CARB spezifischer Fehlercode fuer Fehlerpfad Dfp_CTSCD" VAL_BLK 0x1CA1E8 Kwb_Wu16 65535.00 OneToOne 0.00 65535.00 FORMAT "%8.2" NUMBER 4 /end CHARACTERISTIC
/begin CHARACTERISTIC DSM_CDCDfp_CTSCDCanInac_C "CARB spezifischer Fehlercode fuer Fehlerpfad Dfp_CTSCDCanInac" VAL_BLK 0x1CA1F0 Kwb_Wu16 65535.00 OneToOne 0.00 65535.00 FORMAT "%8.2" NUMBER 4 /end CHARACTERISTIC
/begin CHARACTERISTIC DSM_CDCDfp_CTSCDCanSig_C "CARB spezifischer Fehlercode fuer Fehlerpfad Dfp_CTSCDCanSig" VAL_BLK 0x1CA1F8 Kwb_Wu16 65535.00 OneToOne 0.00 65535.00 FORMAT "%8.2" NUMBER 4 /end CHARACTERISTIC
/begin CHARACTERISTIC DSM_CDCDfp_Clg_DynTst_C "CARB spezifischer Fehlercode fuer Fehlerpfad Dfp_Clg_DynTst" VAL_BLK 0x1CA200 Kwb_Wu16 65535.00 OneToOne 0.00 65535.00 FORMAT "%8.2" NUMBER 4 /end CHARACTERISTIC
/begin CHARACTERISTIC DSM_CDCDfp_CmbChbMisfire1_C "CARB spezifischer Fehlercode fuer Fehlerpfad Dfp_CmbChbMisfire1" VAL_BLK 0x1CA208 Kwb_Wu16 65535.00 OneToOne 0.00 65535.00 FORMAT "%8.2" NUMBER 4 /end CHARACTERISTIC
/begin CHARACTERISTIC DSM_CDCDfp_CmbChbMisfire2_C "CARB spezifischer Fehlercode fuer Fehlerpfad Dfp_CmbChbMisfire2" VAL_BLK 0x1CA210 Kwb_Wu16 65535.00 OneToOne 0.00 65535.00 FORMAT "%8.2" NUMBER 4 /end CHARACTERISTIC
/begin CHARACTERISTIC DSM_CDCDfp_CmbChbMisfire3_C "CARB spezifischer Fehlercode fuer Fehlerpfad Dfp_CmbChbMisfire3" VAL_BLK 0x1CA218 Kwb_Wu16 65535.00 OneToOne 0.00 65535.00 FORMAT "%8.2" NUMBER 4 /end CHARACTERISTIC
/begin CHARACTERISTIC DSM_CDCDfp_CmbChbMisfire4_C "CARB spezifischer Fehlercode fuer Fehlerpfad Dfp_CmbChbMisfire4" VAL_BLK 0x1CA220 Kwb_Wu16 65535.00 OneToOne 0.00 65535.00 FORMAT "%8.2" NUMBER 4 /end CHARACTERISTIC
/begin CHARACTERISTIC DSM_CDCDfp_CmbChbMisfire5_C "CARB spezifischer Fehlercode fuer Fehlerpfad Dfp_CmbChbMisfire5" VAL_BLK 0x1CA228 Kwb_Wu16 65535.00 OneToOne 0.00 65535.00 FORMAT "%8.2" NUMBER 4 /end CHARACTERISTIC
/begin CHARACTERISTIC DSM_CDCDfp_CmbChbMisfire6_C "CARB spezifischer Fehlercode fuer Fehlerpfad Dfp_CmbChbMisfire6" VAL_BLK 0x1CA230 Kwb_Wu16 65535.00 OneToOne 0.00 65535.00 FORMAT "%8.2" NUMBER 4 /end CHARACTERISTIC
/begin CHARACTERISTIC DSM_CDCDfp_CmbChbMisfireMul_C "CARB spezifischer Fehlercode fuer Fehlerpfad Dfp_CmbChbMisfireMul" VAL_BLK 0x1CA238 Kwb_Wu16 65535.00 OneToOne 0.00 65535.00 FORMAT "%8.2" NUMBER 4 /end CHARACTERISTIC
/begin CHARACTERISTIC DSM_CDCDfp_CoVMDCSh_C "CARB spezifischer Fehlercode fuer Fehlerpfad Dfp_CoVMDCSh" VAL_BLK 0x1CA240 Kwb_Wu16 65535.00 OneToOne 0.00 65535.00 FORMAT "%8.2" NUMBER 4 /end CHARACTERISTIC
/begin CHARACTERISTIC DSM_CDCDfp_CoVMDCSp_C "CARB spezifischer Fehlercode fuer Fehlerpfad Dfp_CoVMDCSp" VAL_BLK 0x1CA248 Kwb_Wu16 65535.00 OneToOne 0.00 65535.00 FORMAT "%8.2" NUMBER 4 /end CHARACTERISTIC
/begin CHARACTERISTIC DSM_CDCDfp_CoVehEcoErr_C "CARB spezifischer Fehlercode fuer Fehlerpfad Dfp_CoVehEcoErr" VAL_BLK 0x1CA250 Kwb_Wu16 65535.00 OneToOne 0.00 65535.00 FORMAT "%8.2" NUMBER 4 /end CHARACTERISTIC
/begin CHARACTERISTIC DSM_CDCDfp_CoVehLvl2_C "CARB spezifischer Fehlercode fuer Fehlerpfad Dfp_CoVehLvl2" VAL_BLK 0x1CA258 Kwb_Wu16 65535.00 OneToOne 0.00 65535.00 FORMAT "%8.2" NUMBER 4 /end CHARACTERISTIC
/begin CHARACTERISTIC DSM_CDCDfp_ConvCD_C "CARB spezifischer Fehlercode fuer Fehlerpfad Dfp_ConvCD" VAL_BLK 0x1CA260 Kwb_Wu16 65535.00 OneToOne 0.00 65535.00 FORMAT "%8.2" NUMBER 4 /end CHARACTERISTIC
/begin CHARACTERISTIC DSM_CDCDfp_ConvCD_ConvErr_C "CARB spezifischer Fehlercode fuer Fehlerpfad Dfp_ConvCD_ConvErr" VAL_BLK 0x1CA268 Kwb_Wu16 65535.00 OneToOne 0.00 65535.00 FORMAT "%8.2" NUMBER 4 /end CHARACTERISTIC
/begin CHARACTERISTIC DSM_CDCDfp_CrCtlPLmpDef_C "CARB spezifischer Fehlercode fuer Fehlerpfad Dfp_CrCtlPLmpDef" VAL_BLK 0x1CA270 Kwb_Wu16 65535.00 OneToOne 0.00 65535.00 FORMAT "%8.2" NUMBER 4 /end CHARACTERISTIC
/begin CHARACTERISTIC DSM_CDCDfp_CrCtlPShutOff_C "CARB spezifischer Fehlercode fuer Fehlerpfad Dfp_CrCtlPShutOff" VAL_BLK 0x1CA278 Kwb_Wu16 65535.00 OneToOne 0.00 65535.00 FORMAT "%8.2" NUMBER 4 /end CHARACTERISTIC
/begin CHARACTERISTIC DSM_CDCDfp_CrCtlPTlrDef_C "CARB spezifischer Fehlercode fuer Fehlerpfad Dfp_CrCtlPTlrDef" VAL_BLK 0x1CA280 Kwb_Wu16 65535.00 OneToOne 0.00 65535.00 FORMAT "%8.2" NUMBER 4 /end CHARACTERISTIC
/begin CHARACTERISTIC DSM_CDCDfp_CrCtlPanErr_C "CARB spezifischer Fehlercode fuer Fehlerpfad Dfp_CrCtlPanErr" VAL_BLK 0x1CA288 Kwb_Wu16 65535.00 OneToOne 0.00 65535.00 FORMAT "%8.2" NUMBER 4 /end CHARACTERISTIC
/begin CHARACTERISTIC DSM_CDCDfp_CrCtlPanSwtErr_C "CARB spezifischer Fehlercode fuer Fehlerpfad Dfp_CrCtlPanSwtErr" VAL_BLK 0x1CA290 Kwb_Wu16 65535.00 OneToOne 0.00 65535.00 FORMAT "%8.2" NUMBER 4 /end CHARACTERISTIC
/begin CHARACTERISTIC DSM_CDCDfp_CtApCD_C "CARB spezifischer Fehlercode fuer Fehlerpfad Dfp_CtApCD" VAL_BLK 0x1CA298 Kwb_Wu16 65535.00 OneToOne 0.00 65535.00 FORMAT "%8.2" NUMBER 4 /end CHARACTERISTIC
/begin CHARACTERISTIC DSM_CDCDfp_CtTCD_C "CARB spezifischer Fehlercode fuer Fehlerpfad Dfp_CtTCD" VAL_BLK 0x1CA2A0 Kwb_Wu16 65535.00 OneToOne 0.00 65535.00 FORMAT "%8.2" NUMBER 4 /end CHARACTERISTIC
/begin CHARACTERISTIC DSM_CDCDfp_CtT_Mon_C "CARB spezifischer Fehlercode fuer Fehlerpfad Dfp_CtT_Mon" VAL_BLK 0x1CA2A8 Kwb_Wu16 65535.00 OneToOne 0.00 65535.00 FORMAT "%8.2" NUMBER 4 /end CHARACTERISTIC
/begin CHARACTERISTIC DSM_CDCDfp_DifftrqLimErrPat_C "CARB spezifischer Fehlercode fuer Fehlerpfad Dfp_DifftrqLimErrPat" VAL_BLK 0x1CA2B0 Kwb_Wu16 65535.00 OneToOne 0.00 65535.00 FORMAT "%8.2" NUMBER 4 /end CHARACTERISTIC
/begin CHARACTERISTIC DSM_CDCDfp_EATSCD_C "CARB spezifischer Fehlercode fuer Fehlerpfad Dfp_EATSCD" VAL_BLK 0x1CA2B8 Kwb_Wu16 65535.00 OneToOne 0.00 65535.00 FORMAT "%8.2" NUMBER 4 /end CHARACTERISTIC
/begin CHARACTERISTIC DSM_CDCDfp_EATSCDCanInac_C "CARB spezifischer Fehlercode fuer Fehlerpfad Dfp_EATSCDCanInac" VAL_BLK 0x1CA2C0 Kwb_Wu16 65535.00 OneToOne 0.00 65535.00 FORMAT "%8.2" NUMBER 4 /end CHARACTERISTIC
/begin CHARACTERISTIC DSM_CDCDfp_EATSCDCanSig_C "CARB spezifischer Fehlercode fuer Fehlerpfad Dfp_EATSCDCanSig" VAL_BLK 0x1CA2C8 Kwb_Wu16 65535.00 OneToOne 0.00 65535.00 FORMAT "%8.2" NUMBER 4 /end CHARACTERISTIC
/begin CHARACTERISTIC DSM_CDCDfp_EEPCDVarMng_C "CARB spezifischer Fehlercode fuer Fehlerpfad Dfp_EEPCDVarMng" VAL_BLK 0x1CA2D0 Kwb_Wu16 65535.00 OneToOne 0.00 65535.00 FORMAT "%8.2" NUMBER 4 /end CHARACTERISTIC
/begin CHARACTERISTIC DSM_CDCDfp_EGPpCDTPreTrbn_C "CARB spezifischer Fehlercode fuer Fehlerpfad Dfp_EgPpCDTPreTrbn" VAL_BLK 0x1CA2D8 Kwb_Wu16 65535.00 OneToOne 0.00 65535.00 FORMAT "%8.2" NUMBER 4 /end CHARACTERISTIC
/begin CHARACTERISTIC DSM_CDCDfp_EGPpCDTPreTrbn1_C "CARB spezifischer Fehlercode fuer Fehlerpfad Dfp_EGPpCDTPreTrbn1" VAL_BLK 0x1CA2E0 Kwb_Wu16 65535.00 OneToOne 0.00 65535.00 FORMAT "%8.2" NUMBER 4 /end CHARACTERISTIC
/begin CHARACTERISTIC DSM_CDCDfp_EGRCD_CBV_C "CARB spezifischer Fehlercode fuer Fehlerpfad Dfp_EGRCD_CBV" VAL_BLK 0x1CA2E8 Kwb_Wu16 65535.00 OneToOne 0.00 65535.00 FORMAT "%8.2" NUMBER 4 /end CHARACTERISTIC
/begin CHARACTERISTIC DSM_CDCDfp_EGRCD_Max_C "CARB spezifischer Fehlercode fuer Fehlerpfad Dfp_EGRCD_Max" VAL_BLK 0x1CA2F0 Kwb_Wu16 65535.00 OneToOne 0.00 65535.00 FORMAT "%8.2" NUMBER 4 /end CHARACTERISTIC
/begin CHARACTERISTIC DSM_CDCDfp_EGRCD_Min_C "CARB spezifischer Fehlercode fuer Fehlerpfad Dfp_EGRCD_Min" VAL_BLK 0x1CA2F8 Kwb_Wu16 65535.00 OneToOne 0.00 65535.00 FORMAT "%8.2" NUMBER 4 /end CHARACTERISTIC
/begin CHARACTERISTIC DSM_CDCDfp_EGRCD_SigNpl_C "CARB spezifischer Fehlercode fuer Fehlerpfad Dfp_EGRCD_SigNpl" VAL_BLK 0x1CA300 Kwb_Wu16 65535.00 OneToOne 0.00 65535.00 FORMAT "%8.2" NUMBER 4 /end CHARACTERISTIC
/begin CHARACTERISTIC DSM_CDCDfp_EMCCD_GTL1_C "CARB spezifischer Fehlercode fuer Fehlerpfad Dfp_EMCCD_GTL1" VAL_BLK 0x1CA308 Kwb_Wu16 65535.00 OneToOne 0.00 65535.00 FORMAT "%8.2" NUMBER 4 /end CHARACTERISTIC
/begin CHARACTERISTIC DSM_CDCDfp_EMCCD_GTL2_C "CARB spezifischer Fehlercode fuer Fehlerpfad Dfp_EMCCD_GTL2" VAL_BLK 0x1CA310 Kwb_Wu16 65535.00 OneToOne 0.00 65535.00 FORMAT "%8.2" NUMBER 4 /end CHARACTERISTIC
/begin CHARACTERISTIC DSM_CDCDfp_EMCCD_MLS1_C "CARB spezifischer Fehlercode fuer Fehlerpfad Dfp_EMCCD_MLS1" VAL_BLK 0x1CA318 Kwb_Wu16 65535.00 OneToOne 0.00 65535.00 FORMAT "%8.2" NUMBER 4 /end CHARACTERISTIC
/begin CHARACTERISTIC DSM_CDCDfp_EMCCD_MLS2_C "CARB spezifischer Fehlercode fuer Fehlerpfad Dfp_EMCCD_MLS2" VAL_BLK 0x1CA320 Kwb_Wu16 65535.00 OneToOne 0.00 65535.00 FORMAT "%8.2" NUMBER 4 /end CHARACTERISTIC
/begin CHARACTERISTIC DSM_CDCDfp_ETClbInj1_C "CARB spezifischer Fehlercode fuer Fehlerpfad Dfp_ETClbInj1" VAL_BLK 0x1CA328 Kwb_Wu16 65535.00 OneToOne 0.00 65535.00 FORMAT "%8.2" NUMBER 4 /end CHARACTERISTIC
/begin CHARACTERISTIC DSM_CDCDfp_ETClbInj2_C "CARB spezifischer Fehlercode fuer Fehlerpfad Dfp_ETClbInj2" VAL_BLK 0x1CA330 Kwb_Wu16 65535.00 OneToOne 0.00 65535.00 FORMAT "%8.2" NUMBER 4 /end CHARACTERISTIC
/begin CHARACTERISTIC DSM_CDCDfp_ETClbInj3_C "CARB spezifischer Fehlercode fuer Fehlerpfad Dfp_ETClbInj3" VAL_BLK 0x1CA338 Kwb_Wu16 65535.00 OneToOne 0.00 65535.00 FORMAT "%8.2" NUMBER 4 /end CHARACTERISTIC
/begin CHARACTERISTIC DSM_CDCDfp_ETClbInj4_C "CARB spezifischer Fehlercode fuer Fehlerpfad Dfp_ETClbInj4" VAL_BLK 0x1CA340 Kwb_Wu16 65535.00 OneToOne 0.00 65535.00 FORMAT "%8.2" NUMBER 4 /end CHARACTERISTIC
/begin CHARACTERISTIC DSM_CDCDfp_ETClbInj5_C "CARB spezifischer Fehlercode fuer Fehlerpfad Dfp_ETClbInj5" VAL_BLK 0x1CA348 Kwb_Wu16 65535.00 OneToOne 0.00 65535.00 FORMAT "%8.2" NUMBER 4 /end CHARACTERISTIC
/begin CHARACTERISTIC DSM_CDCDfp_ETClbInj6_C "CARB spezifischer Fehlercode fuer Fehlerpfad Dfp_ETClbInj6" VAL_BLK 0x1CA350 Kwb_Wu16 65535.00 OneToOne 0.00 65535.00 FORMAT "%8.2" NUMBER 4 /end CHARACTERISTIC
/begin CHARACTERISTIC DSM_CDCDfp_EngMCaS1_C "CARB spezifischer Fehlercode fuer Fehlerpfad Dfp_EngMCaS1" VAL_BLK 0x1CA358 Kwb_Wu16 65535.00 OneToOne 0.00 65535.00 FORMAT "%8.2" NUMBER 4 /end CHARACTERISTIC
/begin CHARACTERISTIC DSM_CDCDfp_EngMCrS1_C "CARB spezifischer Fehlercode fuer Fehlerpfad Dfp_EngMCrS1" VAL_BLK 0x1CA360 Kwb_Wu16 65535.00 OneToOne 0.00 65535.00 FORMAT "%8.2" NUMBER 4 /end CHARACTERISTIC
/begin CHARACTERISTIC DSM_CDCDfp_EngMOfsCaSCrS_C "CARB spezifischer Fehlercode fuer Fehlerpfad Dfp_EngMOfsCaSCrS" VAL_BLK 0x1CA368 Kwb_Wu16 65535.00 OneToOne 0.00 65535.00 FORMAT "%8.2" NUMBER 4 /end CHARACTERISTIC
/begin CHARACTERISTIC DSM_CDCDfp_EngMonIrrCmb_C "CARB spezifischer Fehlercode fuer Fehlerpfad Dfp_EngMonIrrCmb" VAL_BLK 0x1CA370 Kwb_Wu16 65535.00 OneToOne 0.00 65535.00 FORMAT "%8.2" NUMBER 4 /end CHARACTERISTIC
/begin CHARACTERISTIC DSM_CDCDfp_EngPrt_C "CARB spezifischer Fehlercode fuer Fehlerpfad Dfp_EngPrt" VAL_BLK 0x1CA378 Kwb_Wu16 65535.00 OneToOne 0.00 65535.00 FORMAT "%8.2" NUMBER 4 /end CHARACTERISTIC
/begin CHARACTERISTIC DSM_CDCDfp_ErLpCDMILReqON_C "CARB spezifischer Fehlercode fuer Fehlerpfad Dfp_ErLpCDMILReqON" VAL_BLK 0x1CA380 Kwb_Wu16 65535.00 OneToOne 0.00 65535.00 FORMAT "%8.2" NUMBER 4 /end CHARACTERISTIC
/begin CHARACTERISTIC DSM_CDCDfp_FMTC_NonMonotonMap_C "CARB spezifischer Fehlercode fuer Fehlerpfad Dfp_FMTC_NonMonotonMap" VAL_BLK 0x1CA388 Kwb_Wu16 65535.00 OneToOne 0.00 65535.00 FORMAT "%8.2" NUMBER 4 /end CHARACTERISTIC
/begin CHARACTERISTIC DSM_CDCDfp_FQlSCD_C "CARB spezifischer Fehlercode fuer Fehlerpfad Dfp_FQlSCD" VAL_BLK 0x1CA390 Kwb_Wu16 65535.00 OneToOne 0.00 65535.00 FORMAT "%8.2" NUMBER 4 /end CHARACTERISTIC
/begin CHARACTERISTIC DSM_CDCDfp_FTSCD_C "CARB spezifischer Fehlercode fuer Fehlerpfad Dfp_FTSCD" VAL_BLK 0x1CA398 Kwb_Wu16 65535.00 OneToOne 0.00 65535.00 FORMAT "%8.2" NUMBER 4 /end CHARACTERISTIC
/begin CHARACTERISTIC DSM_CDCDfp_FTSCDNpl_C "CARB spezifischer Fehlercode fuer Fehlerpfad Dfp_FTSCDNpl" VAL_BLK 0x1CA3A0 Kwb_Wu16 65535.00 OneToOne 0.00 65535.00 FORMAT "%8.2" NUMBER 4 /end CHARACTERISTIC
/begin CHARACTERISTIC DSM_CDCDfp_FanCD_Fan1Ctlr1_C "CARB spezifischer Fehlercode fuer Fehlerpfad Dfp_FanCD_Fan1Ctlr1" VAL_BLK 0x1CA3A8 Kwb_Wu16 65535.00 OneToOne 0.00 65535.00 FORMAT "%8.2" NUMBER 4 /end CHARACTERISTIC
/begin CHARACTERISTIC DSM_CDCDfp_FanCD_Fan1Ctlr2_C "CARB spezifischer Fehlercode fuer Fehlerpfad Dfp_FanCD_Fan1Ctlr2" VAL_BLK 0x1CA3B0 Kwb_Wu16 65535.00 OneToOne 0.00 65535.00 FORMAT "%8.2" NUMBER 4 /end CHARACTERISTIC
/begin CHARACTERISTIC DSM_CDCDfp_FanCD_Fan2Ctlr1_C "CARB spezifischer Fehlercode fuer Fehlerpfad Dfp_FanCD_Fan2Ctlr1" VAL_BLK 0x1CA3B8 Kwb_Wu16 65535.00 OneToOne 0.00 65535.00 FORMAT "%8.2" NUMBER 4 /end CHARACTERISTIC
/begin CHARACTERISTIC DSM_CDCDfp_FanCD_Fan2Ctlr2_C "CARB spezifischer Fehlercode fuer Fehlerpfad Dfp_FanCD_Fan2Ctlr2" VAL_BLK 0x1CA3C0 Kwb_Wu16 65535.00 OneToOne 0.00 65535.00 FORMAT "%8.2" NUMBER 4 /end CHARACTERISTIC
/begin CHARACTERISTIC DSM_CDCDfp_FanCD_FanCtlr1_C "CARB spezifischer Fehlercode fuer Fehlerpfad Dfp_FanCD_FanCtlr1" VAL_BLK 0x1CA3C8 Kwb_Wu16 65535.00 OneToOne 0.00 65535.00 FORMAT "%8.2" NUMBER 4 /end CHARACTERISTIC
/begin CHARACTERISTIC DSM_CDCDfp_FanCD_FanCtlr2_C "CARB spezifischer Fehlercode fuer Fehlerpfad Dfp_FanCD_FanCtlr2" VAL_BLK 0x1CA3D0 Kwb_Wu16 65535.00 OneToOne 0.00 65535.00 FORMAT "%8.2" NUMBER 4 /end CHARACTERISTIC
/begin CHARACTERISTIC DSM_CDCDfp_FanCD_OutFanCtlr1_C "CARB spezifischer Fehlercode fuer Fehlerpfad Dfp_FanCD_OutFanCtlr1" VAL_BLK 0x1CA3D8 Kwb_Wu16 65535.00 OneToOne 0.00 65535.00 FORMAT "%8.2" NUMBER 4 /end CHARACTERISTIC
/begin CHARACTERISTIC DSM_CDCDfp_FanCD_OutFanCtlr2_C "CARB spezifischer Fehlercode fuer Fehlerpfad Dfp_FanCD_OutFanCtlr2" VAL_BLK 0x1CA3E0 Kwb_Wu16 65535.00 OneToOne 0.00 65535.00 FORMAT "%8.2" NUMBER 4 /end CHARACTERISTIC
/begin CHARACTERISTIC DSM_CDCDfp_FlPpCD_C "CARB spezifischer Fehlercode fuer Fehlerpfad Dfp_FlPpCD" VAL_BLK 0x1CA3E8 Kwb_Wu16 65535.00 OneToOne 0.00 65535.00 FORMAT "%8.2" NUMBER 4 /end CHARACTERISTIC
/begin CHARACTERISTIC DSM_CDCDfp_FlSCDT1_C "CARB spezifischer Fehlercode fuer Fehlerpfad Dfp_FlSCDT1" VAL_BLK 0x1CA3F0 Kwb_Wu16 65535.00 OneToOne 0.00 65535.00 FORMAT "%8.2" NUMBER 4 /end CHARACTERISTIC
/begin CHARACTERISTIC DSM_CDCDfp_FrmMngAAGNpl_C "CARB spezifischer Fehlercode fuer Fehlerpfad Dfp_FrmMngAAGNpl" VAL_BLK 0x1CA3F8 Kwb_Wu16 65535.00 OneToOne 0.00 65535.00 FORMAT "%8.2" NUMBER 4 /end CHARACTERISTIC
/begin CHARACTERISTIC DSM_CDCDfp_FrmMngAAGTO_C "CARB spezifischer Fehlercode fuer Fehlerpfad Dfp_FrmMngAAGTO" VAL_BLK 0x1CA400 Kwb_Wu16 65535.00 OneToOne 0.00 65535.00 FORMAT "%8.2" NUMBER 4 /end CHARACTERISTIC
/begin CHARACTERISTIC DSM_CDCDfp_FrmMngAC1Npl_C "CARB spezifischer Fehlercode fuer Fehlerpfad Dfp_FrmMngAC1Npl" VAL_BLK 0x1CA408 Kwb_Wu16 65535.00 OneToOne 0.00 65535.00 FORMAT "%8.2" NUMBER 4 /end CHARACTERISTIC
/begin CHARACTERISTIC DSM_CDCDfp_FrmMngAC1TO_C "CARB spezifischer Fehlercode fuer Fehlerpfad Dfp_FrmMngAC1TO" VAL_BLK 0x1CA410 Kwb_Wu16 65535.00 OneToOne 0.00 65535.00 FORMAT "%8.2" NUMBER 4 /end CHARACTERISTIC
/begin CHARACTERISTIC DSM_CDCDfp_FrmMngACCNpl_C "CARB spezifischer Fehlercode fuer Fehlerpfad Dfp_FrmMngACCNpl" VAL_BLK 0x1CA418 Kwb_Wu16 65535.00 OneToOne 0.00 65535.00 FORMAT "%8.2" NUMBER 4 /end CHARACTERISTIC
/begin CHARACTERISTIC DSM_CDCDfp_FrmMngACCTO_C "CARB spezifischer Fehlercode fuer Fehlerpfad Dfp_FrmMngACCTO" VAL_BLK 0x1CA420 Kwb_Wu16 65535.00 OneToOne 0.00 65535.00 FORMAT "%8.2" NUMBER 4 /end CHARACTERISTIC
/begin CHARACTERISTIC DSM_CDCDfp_FrmMngAIRBGNpl_C "CARB spezifischer Fehlercode fuer Fehlerpfad Dfp_FrmMngAIRBGNpl" VAL_BLK 0x1CA428 Kwb_Wu16 65535.00 OneToOne 0.00 65535.00 FORMAT "%8.2" NUMBER 4 /end CHARACTERISTIC
/begin CHARACTERISTIC DSM_CDCDfp_FrmMngAIRBGTO_C "CARB spezifischer Fehlercode fuer Fehlerpfad Dfp_FrmMngAIRBGTO" VAL_BLK 0x1CA430 Kwb_Wu16 65535.00 OneToOne 0.00 65535.00 FORMAT "%8.2" NUMBER 4 /end CHARACTERISTIC
/begin CHARACTERISTIC DSM_CDCDfp_FrmMngAWD1Npl_C "CARB spezifischer Fehlercode fuer Fehlerpfad Dfp_FrmMngAWD1Npl" VAL_BLK 0x1CA438 Kwb_Wu16 65535.00 OneToOne 0.00 65535.00 FORMAT "%8.2" NUMBER 4 /end CHARACTERISTIC
/begin CHARACTERISTIC DSM_CDCDfp_FrmMngAWD1TO_C "CARB spezifischer Fehlercode fuer Fehlerpfad Dfp_FrmMngAWD1TO" VAL_BLK 0x1CA440 Kwb_Wu16 65535.00 OneToOne 0.00 65535.00 FORMAT "%8.2" NUMBER 4 /end CHARACTERISTIC
/begin CHARACTERISTIC DSM_CDCDfp_FrmMngBEM1Npl_C "CARB spezifischer Fehlercode für Fehlerpfad Dfp_FrmMngBEM1Npl" VAL_BLK 0x1CA448 Kwb_Wu16 65535.00 OneToOne 0.00 65535.00 FORMAT "%8.2" NUMBER 4 /end CHARACTERISTIC
/begin CHARACTERISTIC DSM_CDCDfp_FrmMngBEM1TO_C "CARB spezifischer Fehlercode fuer Fehlerpfad Dfp_FrmMngBEM1TO" VAL_BLK 0x1CA450 Kwb_Wu16 65535.00 OneToOne 0.00 65535.00 FORMAT "%8.2" NUMBER 4 /end CHARACTERISTIC
/begin CHARACTERISTIC DSM_CDCDfp_FrmMngBRK1Npl_C "CARB spezifischer Fehlercode fuer Fehlerpfad Dfp_FrmMngBRK1Npl" VAL_BLK 0x1CA458 Kwb_Wu16 65535.00 OneToOne 0.00 65535.00 FORMAT "%8.2" NUMBER 4 /end CHARACTERISTIC
/begin CHARACTERISTIC DSM_CDCDfp_FrmMngBRK1TO_C "CARB spezifischer Fehlercode fuer Fehlerpfad Dfp_FrmMngBRK1TO" VAL_BLK 0x1CA460 Kwb_Wu16 65535.00 OneToOne 0.00 65535.00 FORMAT "%8.2" NUMBER 4 /end CHARACTERISTIC
/begin CHARACTERISTIC DSM_CDCDfp_FrmMngBRK2Npl_C "CARB spezifischer Fehlercode fuer Fehlerpfad Dfp_FrmMngBRK2Npl" VAL_BLK 0x1CA468 Kwb_Wu16 65535.00 OneToOne 0.00 65535.00 FORMAT "%8.2" NUMBER 4 /end CHARACTERISTIC
/begin CHARACTERISTIC DSM_CDCDfp_FrmMngBRK2TO_C "CARB spezifischer Fehlercode fuer Fehlerpfad Dfp_FrmMngBRK2TO" VAL_BLK 0x1CA470 Kwb_Wu16 65535.00 OneToOne 0.00 65535.00 FORMAT "%8.2" NUMBER 4 /end CHARACTERISTIC
/begin CHARACTERISTIC DSM_CDCDfp_FrmMngBRK8Npl_C "CARB spezifischer Fehlercode fuer Fehlerpfad Dfp_FrmMngBRK8Npl" VAL_BLK 0x1CA478 Kwb_Wu16 65535.00 OneToOne 0.00 65535.00 FORMAT "%8.2" NUMBER 4 /end CHARACTERISTIC
/begin CHARACTERISTIC DSM_CDCDfp_FrmMngBRK8TO_C "CARB spezifischer Fehlercode fuer Fehlerpfad Dfp_FrmMngBRK8TO" VAL_BLK 0x1CA480 Kwb_Wu16 65535.00 OneToOne 0.00 65535.00 FORMAT "%8.2" NUMBER 4 /end CHARACTERISTIC
/begin CHARACTERISTIC DSM_CDCDfp_FrmMngCANVerErr_C "CARB spezifischer Fehlercode fuer Fehlerpfad Dfp_FrmMngCANVerErr" VAL_BLK 0x1CA488 Kwb_Wu16 65535.00 OneToOne 0.00 65535.00 FORMAT "%8.2" NUMBER 4 /end CHARACTERISTIC
/begin CHARACTERISTIC DSM_CDCDfp_FrmMngCCSel_C "CARB spezifischer Fehlercode fuer Fehlerpfad Dfp_FrmMngCCSel" VAL_BLK 0x1CA490 Kwb_Wu16 65535.00 OneToOne 0.00 65535.00 FORMAT "%8.2" NUMBER 4 /end CHARACTERISTIC
/begin CHARACTERISTIC DSM_CDCDfp_FrmMngCCTLNpl_C "CARB spezifischer Fehlercode fuer Fehlerpfad Dfp_FrmMngCCTLNpl" VAL_BLK 0x1CA498 Kwb_Wu16 65535.00 OneToOne 0.00 65535.00 FORMAT "%8.2" NUMBER 4 /end CHARACTERISTIC
/begin CHARACTERISTIC DSM_CDCDfp_FrmMngCCTLTO_C "CARB spezifischer Fehlercode fuer Fehlerpfad Dfp_FrmMngCCTLTO" VAL_BLK 0x1CA4A0 Kwb_Wu16 65535.00 OneToOne 0.00 65535.00 FORMAT "%8.2" NUMBER 4 /end CHARACTERISTIC
/begin CHARACTERISTIC DSM_CDCDfp_FrmMngCHRGR1Npl_C "CARB spezifischer Fehlercode fuer Fehlerpfad Dfp_FrmMngCHRGR1Npl" VAL_BLK 0x1CA4A8 Kwb_Wu16 65535.00 OneToOne 0.00 65535.00 FORMAT "%8.2" NUMBER 4 /end CHARACTERISTIC
/begin CHARACTERISTIC DSM_CDCDfp_FrmMngCHRGR1TO_C "CARB spezifischer Fehlercode fuer Fehlerpfad Dfp_FrmMngCHRGR1TO" VAL_BLK 0x1CA4B0 Kwb_Wu16 65535.00 OneToOne 0.00 65535.00 FORMAT "%8.2" NUMBER 4 /end CHARACTERISTIC
/begin CHARACTERISTIC DSM_CDCDfp_FrmMngCHRGR2Npl_C "CARB spezifischer Fehlercode fuer Fehlerpfad Dfp_FrmMngCHRGR2Npl" VAL_BLK 0x1CA4B8 Kwb_Wu16 65535.00 OneToOne 0.00 65535.00 FORMAT "%8.2" NUMBER 4 /end CHARACTERISTIC
/begin CHARACTERISTIC DSM_CDCDfp_FrmMngCHRGR2TO_C "CARB spezifischer Fehlercode fuer Fehlerpfad Dfp_FrmMngCHRGR2TO" VAL_BLK 0x1CA4C0 Kwb_Wu16 65535.00 OneToOne 0.00 65535.00 FORMAT "%8.2" NUMBER 4 /end CHARACTERISTIC
/begin CHARACTERISTIC DSM_CDCDfp_FrmMngChrgr1A_C "CARB spezifischer Fehlercode fuer Fehlerpfad Dfp_FrmMngChrgr1A" VAL_BLK 0x1CA4C8 Kwb_Wu16 65535.00 OneToOne 0.00 65535.00 FORMAT "%8.2" NUMBER 4 /end CHARACTERISTIC
/begin CHARACTERISTIC DSM_CDCDfp_FrmMngChrgr1C_C "CARB spezifischer Fehlercode fuer Fehlerpfad Dfp_FrmMngChrgr1C" VAL_BLK 0x1CA4D0 Kwb_Wu16 65535.00 OneToOne 0.00 65535.00 FORMAT "%8.2" NUMBER 4 /end CHARACTERISTIC
/begin CHARACTERISTIC DSM_CDCDfp_FrmMngChrgr1N_C "CARB spezifischer Fehlercode fuer Fehlerpfad Dfp_FrmMngChrgr1N" VAL_BLK 0x1CA4D8 Kwb_Wu16 65535.00 OneToOne 0.00 65535.00 FORMAT "%8.2" NUMBER 4 /end CHARACTERISTIC
/begin CHARACTERISTIC DSM_CDCDfp_FrmMngChrgr1T_C "CARB spezifischer Fehlercode fuer Fehlerpfad Dfp_FrmMngChrgr1T" VAL_BLK 0x1CA4E0 Kwb_Wu16 65535.00 OneToOne 0.00 65535.00 FORMAT "%8.2" NUMBER 4 /end CHARACTERISTIC
/begin CHARACTERISTIC DSM_CDCDfp_FrmMngChrgr1V_C "CARB spezifischer Fehlercode fuer Fehlerpfad Dfp_FrmMngChrgr1V" VAL_BLK 0x1CA4E8 Kwb_Wu16 65535.00 OneToOne 0.00 65535.00 FORMAT "%8.2" NUMBER 4 /end CHARACTERISTIC
/begin CHARACTERISTIC DSM_CDCDfp_FrmMngChrgr2A_C "CARB spezifischer Fehlercode fuer Fehlerpfad Dfp_FrmMngChrgr2A" VAL_BLK 0x1CA4F0 Kwb_Wu16 65535.00 OneToOne 0.00 65535.00 FORMAT "%8.2" NUMBER 4 /end CHARACTERISTIC
/begin CHARACTERISTIC DSM_CDCDfp_FrmMngChrgr2C_C "CARB spezifischer Fehlercode fuer Fehlerpfad Dfp_FrmMngChrgr2C" VAL_BLK 0x1CA4F8 Kwb_Wu16 65535.00 OneToOne 0.00 65535.00 FORMAT "%8.2" NUMBER 4 /end CHARACTERISTIC
/begin CHARACTERISTIC DSM_CDCDfp_FrmMngChrgr2N_C "CARB spezifischer Fehlercode fuer Fehlerpfad Dfp_FrmMngChrgr2N" VAL_BLK 0x1CA500 Kwb_Wu16 65535.00 OneToOne 0.00 65535.00 FORMAT "%8.2" NUMBER 4 /end CHARACTERISTIC
/begin CHARACTERISTIC DSM_CDCDfp_FrmMngChrgr2T_C "CARB spezifischer Fehlercode fuer Fehlerpfad Dfp_FrmMngChrgr2T" VAL_BLK 0x1CA508 Kwb_Wu16 65535.00 OneToOne 0.00 65535.00 FORMAT "%8.2" NUMBER 4 /end CHARACTERISTIC
/begin CHARACTERISTIC DSM_CDCDfp_FrmMngChrgr2V_C "CARB spezifischer Fehlercode fuer Fehlerpfad Dfp_FrmMngChrgr2V" VAL_BLK 0x1CA510 Kwb_Wu16 65535.00 OneToOne 0.00 65535.00 FORMAT "%8.2" NUMBER 4 /end CHARACTERISTIC
/begin CHARACTERISTIC DSM_CDCDfp_FrmMngDIA1Npl_C "CARB spezifischer Fehlercode fuer Fehlerpfad Dfp_FrmMngDIA1Npl" VAL_BLK 0x1CA518 Kwb_Wu16 65535.00 OneToOne 0.00 65535.00 FORMAT "%8.2" NUMBER 4 /end CHARACTERISTIC
/begin CHARACTERISTIC DSM_CDCDfp_FrmMngDIA1TO_C "CARB spezifischer Fehlercode fuer Fehlerpfad Dfp_FrmMngDIA1TO" VAL_BLK 0x1CA520 Kwb_Wu16 65535.00 OneToOne 0.00 65535.00 FORMAT "%8.2" NUMBER 4 /end CHARACTERISTIC
/begin CHARACTERISTIC DSM_CDCDfp_FrmMngDSP1Npl_C "CARB spezifischer Fehlercode fuer Fehlerpfad Dfp_FrmMngDSP1Npl" VAL_BLK 0x1CA528 Kwb_Wu16 65535.00 OneToOne 0.00 65535.00 FORMAT "%8.2" NUMBER 4 /end CHARACTERISTIC
/begin CHARACTERISTIC DSM_CDCDfp_FrmMngDSP1TO_C "CARB spezifischer Fehlercode fuer Fehlerpfad Dfp_FrmMngDSP1TO" VAL_BLK 0x1CA530 Kwb_Wu16 65535.00 OneToOne 0.00 65535.00 FORMAT "%8.2" NUMBER 4 /end CHARACTERISTIC
/begin CHARACTERISTIC DSM_CDCDfp_FrmMngDSP2Npl_C "CARB spezifischer Fehlercode fuer Fehlerpfad Dfp_FrmMngDSP2Npl" VAL_BLK 0x1CA538 Kwb_Wu16 65535.00 OneToOne 0.00 65535.00 FORMAT "%8.2" NUMBER 4 /end CHARACTERISTIC
/begin CHARACTERISTIC DSM_CDCDfp_FrmMngDSP2TO_C "CARB spezifischer Fehlercode fuer Fehlerpfad Dfp_FrmMngDSP2TO" VAL_BLK 0x1CA540 Kwb_Wu16 65535.00 OneToOne 0.00 65535.00 FORMAT "%8.2" NUMBER 4 /end CHARACTERISTIC
/begin CHARACTERISTIC DSM_CDCDfp_FrmMngESCUNpl_C "CARB spezifischer Fehlercode fuer Fehlerpfad Dfp_FrmMngESCUNpl" VAL_BLK 0x1CA548 Kwb_Wu16 65535.00 OneToOne 0.00 65535.00 FORMAT "%8.2" NUMBER 4 /end CHARACTERISTIC
/begin CHARACTERISTIC DSM_CDCDfp_FrmMngESCUTO_C "CARB spezifischer Fehlercode fuer Fehlerpfad Dfp_FrmMngESCUTO" VAL_BLK 0x1CA550 Kwb_Wu16 65535.00 OneToOne 0.00 65535.00 FORMAT "%8.2" NUMBER 4 /end CHARACTERISTIC
/begin CHARACTERISTIC DSM_CDCDfp_FrmMngGW1Npl_C "CARB spezifischer Fehlercode fuer Fehlerpfad Dfp_FrmMngGW1Npl" VAL_BLK 0x1CA558 Kwb_Wu16 65535.00 OneToOne 0.00 65535.00 FORMAT "%8.2" NUMBER 4 /end CHARACTERISTIC
/begin CHARACTERISTIC DSM_CDCDfp_FrmMngGW1TO_C "CARB spezifischer Fehlercode fuer Fehlerpfad Dfp_FrmMngGW1TO" VAL_BLK 0x1CA560 Kwb_Wu16 65535.00 OneToOne 0.00 65535.00 FORMAT "%8.2" NUMBER 4 /end CHARACTERISTIC
/begin CHARACTERISTIC DSM_CDCDfp_FrmMngILMNpl_C "CARB spezifischer Fehlercode fuer Fehlerpfad Dfp_FrmMngILMNpl" VAL_BLK 0x1CA568 Kwb_Wu16 65535.00 OneToOne 0.00 65535.00 FORMAT "%8.2" NUMBER 4 /end CHARACTERISTIC
/begin CHARACTERISTIC DSM_CDCDfp_FrmMngILMTO_C "CARB spezifischer Fehlercode fuer Fehlerpfad Dfp_FrmMngILMTO" VAL_BLK 0x1CA570 Kwb_Wu16 65535.00 OneToOne 0.00 65535.00 FORMAT "%8.2" NUMBER 4 /end CHARACTERISTIC
/begin CHARACTERISTIC DSM_CDCDfp_FrmMngNIV1WrngCod_C "CARB spezifischer Fehlercode fuer Fehlerpfad Dfp_FrmMngNIV1WrngCod" VAL_BLK 0x1CA578 Kwb_Wu16 65535.00 OneToOne 0.00 65535.00 FORMAT "%8.2" NUMBER 4 /end CHARACTERISTIC
/begin CHARACTERISTIC DSM_CDCDfp_FrmMngNIVEAU1Npl_C "CARB spezifischer Fehlercode fuer Fehlerpfad Dfp_FrmMngNIVEAU1Npl" VAL_BLK 0x1CA580 Kwb_Wu16 65535.00 OneToOne 0.00 65535.00 FORMAT "%8.2" NUMBER 4 /end CHARACTERISTIC
/begin CHARACTERISTIC DSM_CDCDfp_FrmMngNIVEAU1TO_C "CARB spezifischer Fehlercode fuer Fehlerpfad Dfp_FrmMngNIVEAU1TO" VAL_BLK 0x1CA588 Kwb_Wu16 65535.00 OneToOne 0.00 65535.00 FORMAT "%8.2" NUMBER 4 /end CHARACTERISTIC
/begin CHARACTERISTIC DSM_CDCDfp_FrmMngSTIGNNpl_C "CARB spezifischer Fehlercode fuer Fehlerpfad Dfp_FrmMngSTIGNNpl" VAL_BLK 0x1CA590 Kwb_Wu16 65535.00 OneToOne 0.00 65535.00 FORMAT "%8.2" NUMBER 4 /end CHARACTERISTIC
/begin CHARACTERISTIC DSM_CDCDfp_FrmMngStIgnTO_C "CARB spezifischer Fehlercode fuer Fehlerpfad Dfp_FrmMngStIgnTO" VAL_BLK 0x1CA598 Kwb_Wu16 65535.00 OneToOne 0.00 65535.00 FORMAT "%8.2" NUMBER 4 /end CHARACTERISTIC
/begin CHARACTERISTIC DSM_CDCDfp_FrmMngTOSNpl_C "CARB spezifischer Fehlercode fuer Fehlerpfad Dfp_FrmMngTOSNpl" VAL_BLK 0x1CA5A0 Kwb_Wu16 65535.00 OneToOne 0.00 65535.00 FORMAT "%8.2" NUMBER 4 /end CHARACTERISTIC
/begin CHARACTERISTIC DSM_CDCDfp_FrmMngTOSTO_C "CARB spezifischer Fehlercode fuer Fehlerpfad Dfp_FrmMngTOSTO" VAL_BLK 0x1CA5A8 Kwb_Wu16 65535.00 OneToOne 0.00 65535.00 FORMAT "%8.2" NUMBER 4 /end CHARACTERISTIC
/begin CHARACTERISTIC DSM_CDCDfp_FrmMngTSC1Npl_C "CARB spezifischer Fehlercode fuer Fehlerpfad Dfp_FrmMngTSC1Npl" VAL_BLK 0x1CA5B0 Kwb_Wu16 65535.00 OneToOne 0.00 65535.00 FORMAT "%8.2" NUMBER 4 /end CHARACTERISTIC
/begin CHARACTERISTIC DSM_CDCDfp_FrmMngTSC1TO_C "CARB spezifischer Fehlercode fuer Fehlerpfad Dfp_FrmMngTSC1TO" VAL_BLK 0x1CA5B8 Kwb_Wu16 65535.00 OneToOne 0.00 65535.00 FORMAT "%8.2" NUMBER 4 /end CHARACTERISTIC
/begin CHARACTERISTIC DSM_CDCDfp_FrmMngTSC2Npl_C "CARB spezifischer Fehlercode fuer Fehlerpfad Dfp_FrmMngTSC2Npl" VAL_BLK 0x1CA5C0 Kwb_Wu16 65535.00 OneToOne 0.00 65535.00 FORMAT "%8.2" NUMBER 4 /end CHARACTERISTIC
/begin CHARACTERISTIC DSM_CDCDfp_FrmMngTSC2TO_C "CARB spezifischer Fehlercode fuer Fehlerpfad Dfp_FrmMngTSC2TO" VAL_BLK 0x1CA5C8 Kwb_Wu16 65535.00 OneToOne 0.00 65535.00 FORMAT "%8.2" NUMBER 4 /end CHARACTERISTIC
/begin CHARACTERISTIC DSM_CDCDfp_FrmMngTSC3Npl_C "CARB spezifischer Fehlercode fuer Fehlerpfad Dfp_FrmMngTSC3Npl" VAL_BLK 0x1CA5D0 Kwb_Wu16 65535.00 OneToOne 0.00 65535.00 FORMAT "%8.2" NUMBER 4 /end CHARACTERISTIC
/begin CHARACTERISTIC DSM_CDCDfp_FrmMngTSC3TO_C "CARB spezifischer Fehlercode fuer Fehlerpfad Dfp_FrmMngTSC3TO" VAL_BLK 0x1CA5D8 Kwb_Wu16 65535.00 OneToOne 0.00 65535.00 FORMAT "%8.2" NUMBER 4 /end CHARACTERISTIC
/begin CHARACTERISTIC DSM_CDCDfp_GearbxASTh_C "CARB spezifischer Fehlercode fuer Fehlerpfad Dfp_GearbxASTh" VAL_BLK 0x1CA5E0 Kwb_Wu16 65535.00 OneToOne 0.00 65535.00 FORMAT "%8.2" NUMBER 4 /end CHARACTERISTIC
/begin CHARACTERISTIC DSM_CDCDfp_GearbxASTl_C "CARB spezifischer Fehlercode fuer Fehlerpfad Dfp_GearbxASTl" VAL_BLK 0x1CA5E8 Kwb_Wu16 65535.00 OneToOne 0.00 65535.00 FORMAT "%8.2" NUMBER 4 /end CHARACTERISTIC
/begin CHARACTERISTIC DSM_CDCDfp_GearbxTSC_C "CARB spezifischer Fehlercode fuer Fehlerpfad Dfp_GearbxTSC" VAL_BLK 0x1CA5F0 Kwb_Wu16 65535.00 OneToOne 0.00 65535.00 FORMAT "%8.2" NUMBER 4 /end CHARACTERISTIC
/begin CHARACTERISTIC DSM_CDCDfp_GearbxTypeMTErr_C "CARB spezifischer Fehlercode fuer Fehlerpfad Dfp_GearbxTypeMTErr" VAL_BLK 0x1CA5F8 Kwb_Wu16 65535.00 OneToOne 0.00 65535.00 FORMAT "%8.2" NUMBER 4 /end CHARACTERISTIC
/begin CHARACTERISTIC DSM_CDCDfp_GlwCD_Actr_C "CARB spezifischer Fehlercode fuer Fehlerpfad Dfp_GlwCD_Actr" VAL_BLK 0x1CA600 Kwb_Wu16 65535.00 OneToOne 0.00 65535.00 FORMAT "%8.2" NUMBER 4 /end CHARACTERISTIC
/begin CHARACTERISTIC DSM_CDCDfp_GlwCD_DIAG_C "CARB spezifischer Fehlercode fuer Fehlerpfad Dfp_GlwCD_DIAG" VAL_BLK 0x1CA608 Kwb_Wu16 65535.00 OneToOne 0.00 65535.00 FORMAT "%8.2" NUMBER 4 /end CHARACTERISTIC
/begin CHARACTERISTIC DSM_CDCDfp_GlwCD_Error1_C "CARB spezifischer Fehlercode fuer Fehlerpfad Dfp_GlwCD_Error1" VAL_BLK 0x1CA610 Kwb_Wu16 65535.00 OneToOne 0.00 65535.00 FORMAT "%8.2" NUMBER 4 /end CHARACTERISTIC
/begin CHARACTERISTIC DSM_CDCDfp_GlwCD_Error2_C "CARB spezifischer Fehlercode fuer Fehlerpfad Dfp_GlwCD_Error2" VAL_BLK 0x1CA618 Kwb_Wu16 65535.00 OneToOne 0.00 65535.00 FORMAT "%8.2" NUMBER 4 /end CHARACTERISTIC
/begin CHARACTERISTIC DSM_CDCDfp_GlwCD_EvalCod_C "CARB spezifischer Fehlercode fuer Fehlerpfad Dfp_GlwCD_EvalCod" VAL_BLK 0x1CA620 Kwb_Wu16 65535.00 OneToOne 0.00 65535.00 FORMAT "%8.2" NUMBER 4 /end CHARACTERISTIC
/begin CHARACTERISTIC DSM_CDCDfp_GlwCD_GSK_C "CARB spezifischer Fehlercode fuer Fehlerpfad Dfp_GlwCD_GSK" VAL_BLK 0x1CA628 Kwb_Wu16 65535.00 OneToOne 0.00 65535.00 FORMAT "%8.2" NUMBER 4 /end CHARACTERISTIC
/begin CHARACTERISTIC DSM_CDCDfp_GlwCD_Lamp_C "CARB spezifischer Fehlercode fuer Fehlerpfad Dfp_GlwCD_Lamp" VAL_BLK 0x1CA630 Kwb_Wu16 65535.00 OneToOne 0.00 65535.00 FORMAT "%8.2" NUMBER 4 /end CHARACTERISTIC
/begin CHARACTERISTIC DSM_CDCDfp_GlwCD_LampCan_C "CARB spezifischer Fehlercode fuer Fehlerpfad Dfp_GlwCD_LampCan" VAL_BLK 0x1CA638 Kwb_Wu16 65535.00 OneToOne 0.00 65535.00 FORMAT "%8.2" NUMBER 4 /end CHARACTERISTIC
/begin CHARACTERISTIC DSM_CDCDfp_GlwCD_PLUG0_C "CARB spezifischer Fehlercode fuer Fehlerpfad Dfp_GlwCD_PLUG0" VAL_BLK 0x1CA640 Kwb_Wu16 65535.00 OneToOne 0.00 65535.00 FORMAT "%8.2" NUMBER 4 /end CHARACTERISTIC
/begin CHARACTERISTIC DSM_CDCDfp_GlwCD_PLUG1_C "CARB spezifischer Fehlercode fuer Fehlerpfad Dfp_GlwCD_PLUG1" VAL_BLK 0x1CA648 Kwb_Wu16 65535.00 OneToOne 0.00 65535.00 FORMAT "%8.2" NUMBER 4 /end CHARACTERISTIC
/begin CHARACTERISTIC DSM_CDCDfp_GlwCD_PLUG2_C "CARB spezifischer Fehlercode fuer Fehlerpfad Dfp_GlwCD_PLUG2" VAL_BLK 0x1CA650 Kwb_Wu16 65535.00 OneToOne 0.00 65535.00 FORMAT "%8.2" NUMBER 4 /end CHARACTERISTIC
/begin CHARACTERISTIC DSM_CDCDfp_GlwCD_PLUG3_C "CARB spezifischer Fehlercode fuer Fehlerpfad Dfp_GlwCD_PLUG3" VAL_BLK 0x1CA658 Kwb_Wu16 65535.00 OneToOne 0.00 65535.00 FORMAT "%8.2" NUMBER 4 /end CHARACTERISTIC
/begin CHARACTERISTIC DSM_CDCDfp_GlwCD_PLUG4_C "CARB spezifischer Fehlercode fuer Fehlerpfad Dfp_GlwCD_PLUG4" VAL_BLK 0x1CA660 Kwb_Wu16 65535.00 OneToOne 0.00 65535.00 FORMAT "%8.2" NUMBER 4 /end CHARACTERISTIC
/begin CHARACTERISTIC DSM_CDCDfp_GlwCD_PLUG5_C "CARB spezifischer Fehlercode fuer Fehlerpfad Dfp_GlwCD_PLUG5" VAL_BLK 0x1CA668 Kwb_Wu16 65535.00 OneToOne 0.00 65535.00 FORMAT "%8.2" NUMBER 4 /end CHARACTERISTIC
/begin CHARACTERISTIC DSM_CDCDfp_GlwCD_SFD_C "CARB spezifischer Fehlercode fuer Fehlerpfad Dfp_GlwCD_SFD" VAL_BLK 0x1CA670 Kwb_Wu16 65535.00 OneToOne 0.00 65535.00 FORMAT "%8.2" NUMBER 4 /end CHARACTERISTIC
/begin CHARACTERISTIC DSM_CDCDfp_HDSCD_C "CARB spezifischer Fehlercode fuer Fehlerpfad Dfp_HDSCD" VAL_BLK 0x1CA678 Kwb_Wu16 65535.00 OneToOne 0.00 65535.00 FORMAT "%8.2" NUMBER 4 /end CHARACTERISTIC
/begin CHARACTERISTIC DSM_CDCDfp_HWEMonCom_C "CARB spezifischer Fehlercode fuer Fehlerpfad Dfp_HWEMonCom" VAL_BLK 0x1CA680 Kwb_Wu16 65535.00 OneToOne 0.00 65535.00 FORMAT "%8.2" NUMBER 4 /end CHARACTERISTIC
/begin CHARACTERISTIC DSM_CDCDfp_HWEMonEEPROM_C "CARB spezifischer Fehlercode fuer Fehlerpfad Dfp_HWEMonEEPROM" VAL_BLK 0x1CA688 Kwb_Wu16 65535.00 OneToOne 0.00 65535.00 FORMAT "%8.2" NUMBER 4 /end CHARACTERISTIC
/begin CHARACTERISTIC DSM_CDCDfp_HWEMonRcyLocked_C "CARB spezifischer Fehlercode fuer Fehlerpfad Dfp_HWEMonRcyLocked" VAL_BLK 0x1CA690 Kwb_Wu16 65535.00 OneToOne 0.00 65535.00 FORMAT "%8.2" NUMBER 4 /end CHARACTERISTIC
/begin CHARACTERISTIC DSM_CDCDfp_HWEMonRcySuppressed_C "CARB spezifischer Fehlercode fuer Fehlerpfad Dfp_HWEMonRcySuppressed" VAL_BLK 0x1CA698 Kwb_Wu16 65535.00 OneToOne 0.00 65535.00 FORMAT "%8.2" NUMBER 4 /end CHARACTERISTIC
/begin CHARACTERISTIC DSM_CDCDfp_HWEMonRcyVisible_C "CARB spezifischer Fehlercode fuer Fehlerpfad Dfp_HWEMonRcyVisible" VAL_BLK 0x1CA6A0 Kwb_Wu16 65535.00 OneToOne 0.00 65535.00 FORMAT "%8.2" NUMBER 4 /end CHARACTERISTIC
/begin CHARACTERISTIC DSM_CDCDfp_HWEMonUMaxSupply_C "CARB spezifischer Fehlercode fuer Fehlerpfad Dfp_HWEMonUMaxSupply" VAL_BLK 0x1CA6A8 Kwb_Wu16 65535.00 OneToOne 0.00 65535.00 FORMAT "%8.2" NUMBER 4 /end CHARACTERISTIC
/begin CHARACTERISTIC DSM_CDCDfp_HWEMonUMinSupply_C "CARB spezifischer Fehlercode fuer Fehlerpfad Dfp_HWEMonUMinSupply" VAL_BLK 0x1CA6B0 Kwb_Wu16 65535.00 OneToOne 0.00 65535.00 FORMAT "%8.2" NUMBER 4 /end CHARACTERISTIC
/begin CHARACTERISTIC DSM_CDCDfp_IATSCD_C "CARB spezifischer Fehlercode fuer Fehlerpfad Dfp_IATSCD" VAL_BLK 0x1CA6B8 Kwb_Wu16 65535.00 OneToOne 0.00 65535.00 FORMAT "%8.2" NUMBER 4 /end CHARACTERISTIC
/begin CHARACTERISTIC DSM_CDCDfp_IFCD_C "CARB spezifischer Fehlercode fuer Fehlerpfad Dfp_IFCD" VAL_BLK 0x1CA6C0 Kwb_Wu16 65535.00 OneToOne 0.00 65535.00 FORMAT "%8.2" NUMBER 4 /end CHARACTERISTIC
/begin CHARACTERISTIC DSM_CDCDfp_ImmCtl_C "CARB spezifischer Fehlercode fuer Fehlerpfad Dfp_ImmCtl" VAL_BLK 0x1CA6C8 Kwb_Wu16 65535.00 OneToOne 0.00 65535.00 FORMAT "%8.2" NUMBER 4 /end CHARACTERISTIC
/begin CHARACTERISTIC DSM_CDCDfp_InjCrv_InjLim_C "CARB spezifischer Fehlercode fuer Fehlerpfad Dfp_InjCrv_InjLim" VAL_BLK 0x1CA6D0 Kwb_Wu16 65535.00 OneToOne 0.00 65535.00 FORMAT "%8.2" NUMBER 4 /end CHARACTERISTIC
/begin CHARACTERISTIC DSM_CDCDfp_InjVCDActrChrg_C "CARB spezifischer Fehlercode fuer Fehlerpfad Dfp_InjVCDActrChrg" VAL_BLK 0x1CA6D8 Kwb_Wu16 65535.00 OneToOne 0.00 65535.00 FORMAT "%8.2" NUMBER 4 /end CHARACTERISTIC
/begin CHARACTERISTIC DSM_CDCDfp_InjVCDActrVolt_C "CARB spezifischer Fehlercode fuer Fehlerpfad Dfp_InjVCDActrVolt" VAL_BLK 0x1CA6E0 Kwb_Wu16 65535.00 OneToOne 0.00 65535.00 FORMAT "%8.2" NUMBER 4 /end CHARACTERISTIC
/begin CHARACTERISTIC DSM_CDCDfp_InjVCDClsBank1_C "CARB spezifischer Fehlercode fuer Fehlerpfad Dfp_InjVCDClsBank1" VAL_BLK 0x1CA6E8 Kwb_Wu16 65535.00 OneToOne 0.00 65535.00 FORMAT "%8.2" NUMBER 4 /end CHARACTERISTIC
/begin CHARACTERISTIC DSM_CDCDfp_InjVCDClsBank2_C "CARB spezifischer Fehlercode fuer Fehlerpfad Dfp_InjVCDClsBank2" VAL_BLK 0x1CA6F0 Kwb_Wu16 65535.00 OneToOne 0.00 65535.00 FORMAT "%8.2" NUMBER 4 /end CHARACTERISTIC
/begin CHARACTERISTIC DSM_CDCDfp_InjVCDMonCab_C "CARB spezifischer Fehlercode fuer Fehlerpfad Dfp_InjVCDMonCab" VAL_BLK 0x1CA6F8 Kwb_Wu16 65535.00 OneToOne 0.00 65535.00 FORMAT "%8.2" NUMBER 4 /end CHARACTERISTIC
/begin CHARACTERISTIC DSM_CDCDfp_InjVCDMonSwt_C "CARB spezifischer Fehlercode fuer Fehlerpfad Dfp_InjVCDMonSwt" VAL_BLK 0x1CA700 Kwb_Wu16 65535.00 OneToOne 0.00 65535.00 FORMAT "%8.2" NUMBER 4 /end CHARACTERISTIC
/begin CHARACTERISTIC DSM_CDCDfp_InjVCDShOffDCDC_C "CARB spezifischer Fehlercode fuer Fehlerpfad Dfp_InjVCDShOffDCDC" VAL_BLK 0x1CA708 Kwb_Wu16 65535.00 OneToOne 0.00 65535.00 FORMAT "%8.2" NUMBER 4 /end CHARACTERISTIC
/begin CHARACTERISTIC DSM_CDCDfp_InjVCDUBuf_C "CARB spezifischer Fehlercode fuer Fehlerpfad Dfp_InjVCDUBuf" VAL_BLK 0x1CA710 Kwb_Wu16 65535.00 OneToOne 0.00 65535.00 FORMAT "%8.2" NUMBER 4 /end CHARACTERISTIC
/begin CHARACTERISTIC DSM_CDCDfp_InjVCD_CY370Ampl_C "CARB spezifischer Fehlercode fuer Fehlerpfad Dfp_InjVCD_CY370Ampl" VAL_BLK 0x1CA718 Kwb_Wu16 65535.00 OneToOne 0.00 65535.00 FORMAT "%8.2" NUMBER 4 /end CHARACTERISTIC
/begin CHARACTERISTIC DSM_CDCDfp_InjVlvBnk1A_C "CARB spezifischer Fehlercode fuer Fehlerpfad Dfp_InjVlvBnk1A" VAL_BLK 0x1CA720 Kwb_Wu16 65535.00 OneToOne 0.00 65535.00 FORMAT "%8.2" NUMBER 4 /end CHARACTERISTIC
/begin CHARACTERISTIC DSM_CDCDfp_InjVlvBnk1B_C "CARB spezifischer Fehlercode fuer Fehlerpfad Dfp_InjVlvBnk1B" VAL_BLK 0x1CA728 Kwb_Wu16 65535.00 OneToOne 0.00 65535.00 FORMAT "%8.2" NUMBER 4 /end CHARACTERISTIC
/begin CHARACTERISTIC DSM_CDCDfp_InjVlvBnk2A_C "CARB spezifischer Fehlercode fuer Fehlerpfad Dfp_InjVlvBnk2A" VAL_BLK 0x1CA730 Kwb_Wu16 65535.00 OneToOne 0.00 65535.00 FORMAT "%8.2" NUMBER 4 /end CHARACTERISTIC
/begin CHARACTERISTIC DSM_CDCDfp_InjVlvBnk2B_C "CARB spezifischer Fehlercode fuer Fehlerpfad Dfp_InjVlvBnk2B" VAL_BLK 0x1CA738 Kwb_Wu16 65535.00 OneToOne 0.00 65535.00 FORMAT "%8.2" NUMBER 4 /end CHARACTERISTIC
/begin CHARACTERISTIC DSM_CDCDfp_InjVlvChipA_C "CARB spezifischer Fehlercode fuer Fehlerpfad Dfp_InjVlvChipA" VAL_BLK 0x1CA740 Kwb_Wu16 65535.00 OneToOne 0.00 65535.00 FORMAT "%8.2" NUMBER 4 /end CHARACTERISTIC
/begin CHARACTERISTIC DSM_CDCDfp_InjVlvChipB_C "CARB spezifischer Fehlercode fuer Fehlerpfad Dfp_InjVlvChipB" VAL_BLK 0x1CA748 Kwb_Wu16 65535.00 OneToOne 0.00 65535.00 FORMAT "%8.2" NUMBER 4 /end CHARACTERISTIC
/begin CHARACTERISTIC DSM_CDCDfp_InjVlvCyl1A_C "CARB spezifischer Fehlercode fuer Fehlerpfad Dfp_InjVlvCyl1A" VAL_BLK 0x1CA750 Kwb_Wu16 65535.00 OneToOne 0.00 65535.00 FORMAT "%8.2" NUMBER 4 /end CHARACTERISTIC
/begin CHARACTERISTIC DSM_CDCDfp_InjVlvCyl1B_C "CARB spezifischer Fehlercode fuer Fehlerpfad Dfp_InjVlvCyl1B" VAL_BLK 0x1CA758 Kwb_Wu16 65535.00 OneToOne 0.00 65535.00 FORMAT "%8.2" NUMBER 4 /end CHARACTERISTIC
/begin CHARACTERISTIC DSM_CDCDfp_InjVlvCyl1C_C "CARB spezifischer Fehlercode fuer Fehlerpfad Dfp_InjVlvCyl1C" VAL_BLK 0x1CA760 Kwb_Wu16 65535.00 OneToOne 0.00 65535.00 FORMAT "%8.2" NUMBER 4 /end CHARACTERISTIC
/begin CHARACTERISTIC DSM_CDCDfp_InjVlvCyl2A_C "CARB spezifischer Fehlercode fuer Fehlerpfad Dfp_InjVlvCyl2A" VAL_BLK 0x1CA768 Kwb_Wu16 65535.00 OneToOne 0.00 65535.00 FORMAT "%8.2" NUMBER 4 /end CHARACTERISTIC
/begin CHARACTERISTIC DSM_CDCDfp_InjVlvCyl2B_C "CARB spezifischer Fehlercode fuer Fehlerpfad Dfp_InjVlvCyl2B" VAL_BLK 0x1CA770 Kwb_Wu16 65535.00 OneToOne 0.00 65535.00 FORMAT "%8.2" NUMBER 4 /end CHARACTERISTIC
/begin CHARACTERISTIC DSM_CDCDfp_InjVlvCyl2C_C "CARB spezifischer Fehlercode fuer Fehlerpfad Dfp_InjVlvCyl2C" VAL_BLK 0x1CA778 Kwb_Wu16 65535.00 OneToOne 0.00 65535.00 FORMAT "%8.2" NUMBER 4 /end CHARACTERISTIC
/begin CHARACTERISTIC DSM_CDCDfp_InjVlvCyl3A_C "CARB spezifischer Fehlercode fuer Fehlerpfad Dfp_InjVlvCyl3A" VAL_BLK 0x1CA780 Kwb_Wu16 65535.00 OneToOne 0.00 65535.00 FORMAT "%8.2" NUMBER 4 /end CHARACTERISTIC
/begin CHARACTERISTIC DSM_CDCDfp_InjVlvCyl3B_C "CARB spezifischer Fehlercode fuer Fehlerpfad Dfp_InjVlvCyl3B" VAL_BLK 0x1CA788 Kwb_Wu16 65535.00 OneToOne 0.00 65535.00 FORMAT "%8.2" NUMBER 4 /end CHARACTERISTIC
/begin CHARACTERISTIC DSM_CDCDfp_InjVlvCyl3C_C "CARB spezifischer Fehlercode fuer Fehlerpfad Dfp_InjVlvCyl3C" VAL_BLK 0x1CA790 Kwb_Wu16 65535.00 OneToOne 0.00 65535.00 FORMAT "%8.2" NUMBER 4 /end CHARACTERISTIC
/begin CHARACTERISTIC DSM_CDCDfp_InjVlvCyl4A_C "CARB spezifischer Fehlercode fuer Fehlerpfad Dfp_InjVlvCyl4A" VAL_BLK 0x1CA798 Kwb_Wu16 65535.00 OneToOne 0.00 65535.00 FORMAT "%8.2" NUMBER 4 /end CHARACTERISTIC
/begin CHARACTERISTIC DSM_CDCDfp_InjVlvCyl4B_C "CARB spezifischer Fehlercode fuer Fehlerpfad Dfp_InjVlvCyl4B" VAL_BLK 0x1CA7A0 Kwb_Wu16 65535.00 OneToOne 0.00 65535.00 FORMAT "%8.2" NUMBER 4 /end CHARACTERISTIC
/begin CHARACTERISTIC DSM_CDCDfp_InjVlvCyl4C_C "CARB spezifischer Fehlercode fuer Fehlerpfad Dfp_InjVlvCyl4C" VAL_BLK 0x1CA7A8 Kwb_Wu16 65535.00 OneToOne 0.00 65535.00 FORMAT "%8.2" NUMBER 4 /end CHARACTERISTIC
/begin CHARACTERISTIC DSM_CDCDfp_InjVlvCyl5A_C "CARB spezifischer Fehlercode fuer Fehlerpfad Dfp_InjVlvCyl5A" VAL_BLK 0x1CA7B0 Kwb_Wu16 65535.00 OneToOne 0.00 65535.00 FORMAT "%8.2" NUMBER 4 /end CHARACTERISTIC
/begin CHARACTERISTIC DSM_CDCDfp_InjVlvCyl5B_C "CARB spezifischer Fehlercode fuer Fehlerpfad Dfp_InjVlvCyl5B" VAL_BLK 0x1CA7B8 Kwb_Wu16 65535.00 OneToOne 0.00 65535.00 FORMAT "%8.2" NUMBER 4 /end CHARACTERISTIC
/begin CHARACTERISTIC DSM_CDCDfp_InjVlvCyl5C_C "CARB spezifischer Fehlercode fuer Fehlerpfad Dfp_InjVlvCyl5C" VAL_BLK 0x1CA7C0 Kwb_Wu16 65535.00 OneToOne 0.00 65535.00 FORMAT "%8.2" NUMBER 4 /end CHARACTERISTIC
/begin CHARACTERISTIC DSM_CDCDfp_InjVlvCyl6A_C "CARB spezifischer Fehlercode fuer Fehlerpfad Dfp_InjVlvCyl6A" VAL_BLK 0x1CA7C8 Kwb_Wu16 65535.00 OneToOne 0.00 65535.00 FORMAT "%8.2" NUMBER 4 /end CHARACTERISTIC
/begin CHARACTERISTIC DSM_CDCDfp_InjVlvCyl6B_C "CARB spezifischer Fehlercode fuer Fehlerpfad Dfp_InjVlvCyl6B" VAL_BLK 0x1CA7D0 Kwb_Wu16 65535.00 OneToOne 0.00 65535.00 FORMAT "%8.2" NUMBER 4 /end CHARACTERISTIC
/begin CHARACTERISTIC DSM_CDCDfp_InjVlvCyl6C_C "CARB spezifischer Fehlercode fuer Fehlerpfad Dfp_InjVlvCyl6C" VAL_BLK 0x1CA7D8 Kwb_Wu16 65535.00 OneToOne 0.00 65535.00 FORMAT "%8.2" NUMBER 4 /end CHARACTERISTIC
/begin CHARACTERISTIC DSM_CDCDfp_InjVlvCyl7A_C "CARB spezifischer Fehlercode fuer Fehlerpfad Dfp_InjVlvCyl7A" VAL_BLK 0x1CA7E0 Kwb_Wu16 65535.00 OneToOne 0.00 65535.00 FORMAT "%8.2" NUMBER 4 /end CHARACTERISTIC
/begin CHARACTERISTIC DSM_CDCDfp_InjVlvCyl7B_C "CARB spezifischer Fehlercode fuer Fehlerpfad Dfp_InjVlvCyl7B" VAL_BLK 0x1CA7E8 Kwb_Wu16 65535.00 OneToOne 0.00 65535.00 FORMAT "%8.2" NUMBER 4 /end CHARACTERISTIC
/begin CHARACTERISTIC DSM_CDCDfp_InjVlvCyl7C_C "CARB spezifischer Fehlercode fuer Fehlerpfad Dfp_InjVlvCyl7C" VAL_BLK 0x1CA7F0 Kwb_Wu16 65535.00 OneToOne 0.00 65535.00 FORMAT "%8.2" NUMBER 4 /end CHARACTERISTIC
/begin CHARACTERISTIC DSM_CDCDfp_InjVlvCyl8A_C "CARB spezifischer Fehlercode fuer Fehlerpfad Dfp_InjVlvCyl8A" VAL_BLK 0x1CA7F8 Kwb_Wu16 65535.00 OneToOne 0.00 65535.00 FORMAT "%8.2" NUMBER 4 /end CHARACTERISTIC
/begin CHARACTERISTIC DSM_CDCDfp_InjVlvCyl8B_C "CARB spezifischer Fehlercode fuer Fehlerpfad Dfp_InjVlvCyl8B" VAL_BLK 0x1CA800 Kwb_Wu16 65535.00 OneToOne 0.00 65535.00 FORMAT "%8.2" NUMBER 4 /end CHARACTERISTIC
/begin CHARACTERISTIC DSM_CDCDfp_InjVlvCyl8C_C "CARB spezifischer Fehlercode fuer Fehlerpfad Dfp_InjVlvCyl8C" VAL_BLK 0x1CA808 Kwb_Wu16 65535.00 OneToOne 0.00 65535.00 FORMAT "%8.2" NUMBER 4 /end CHARACTERISTIC
/begin CHARACTERISTIC DSM_CDCDfp_LSUCDCircNernst0_C "CARB spezifischer Fehlercode fuer Fehlerpfad Dfp_LSUCDCircNernst0" VAL_BLK 0x1CA810 Kwb_Wu16 65535.00 OneToOne 0.00 65535.00 FORMAT "%8.2" NUMBER 4 /end CHARACTERISTIC
/begin CHARACTERISTIC DSM_CDCDfp_LSUCDCircPumpCur0_C "CARB spezifischer Fehlercode fuer Fehlerpfad Dfp_LSUCDCircPumpCur0" VAL_BLK 0x1CA818 Kwb_Wu16 65535.00 OneToOne 0.00 65535.00 FORMAT "%8.2" NUMBER 4 /end CHARACTERISTIC
/begin CHARACTERISTIC DSM_CDCDfp_LSUCDCircVirtGnd0_C "CARB spezifischer Fehlercode fuer Fehlerpfad Dfp_LSUCDCircVirtGnd0" VAL_BLK 0x1CA820 Kwb_Wu16 65535.00 OneToOne 0.00 65535.00 FORMAT "%8.2" NUMBER 4 /end CHARACTERISTIC
/begin CHARACTERISTIC DSM_CDCDfp_LSUCDHeater0_C "CARB spezifischer Fehlercode fuer Fehlerpfad Dfp_LSUCDHeater0" VAL_BLK 0x1CA828 Kwb_Wu16 65535.00 OneToOne 0.00 65535.00 FORMAT "%8.2" NUMBER 4 /end CHARACTERISTIC
/begin CHARACTERISTIC DSM_CDCDfp_LSUCDHtCoup0_C "CARB spezifischer Fehlercode fuer Fehlerpfad Dfp_LSUCDHtCoup0" VAL_BLK 0x1CA830 Kwb_Wu16 65535.00 OneToOne 0.00 65535.00 FORMAT "%8.2" NUMBER 4 /end CHARACTERISTIC
/begin CHARACTERISTIC DSM_CDCDfp_LSUCDO20_C "CARB spezifischer Fehlercode fuer Fehlerpfad Dfp_LSUCDO20" VAL_BLK 0x1CA838 Kwb_Wu16 65535.00 OneToOne 0.00 65535.00 FORMAT "%8.2" NUMBER 4 /end CHARACTERISTIC
/begin CHARACTERISTIC DSM_CDCDfp_LSUCDO2Clb0_C "CARB spezifischer Fehlercode fuer Fehlerpfad Dfp_LSUCDO2Clb0" VAL_BLK 0x1CA840 Kwb_Wu16 65535.00 OneToOne 0.00 65535.00 FORMAT "%8.2" NUMBER 4 /end CHARACTERISTIC
/begin CHARACTERISTIC DSM_CDCDfp_LSUCDRiClb0_C "CARB spezifischer Fehlercode fuer Fehlerpfad Dfp_LSUCDRiClb0" VAL_BLK 0x1CA848 Kwb_Wu16 65535.00 OneToOne 0.00 65535.00 FORMAT "%8.2" NUMBER 4 /end CHARACTERISTIC
/begin CHARACTERISTIC DSM_CDCDfp_LSUCDSPI0_C "CARB spezifischer Fehlercode fuer Fehlerpfad Dfp_LSUCDSPI0" VAL_BLK 0x1CA850 Kwb_Wu16 65535.00 OneToOne 0.00 65535.00 FORMAT "%8.2" NUMBER 4 /end CHARACTERISTIC
/begin CHARACTERISTIC DSM_CDCDfp_LSUCDSPIBattLow0_C "CARB spezifischer Fehlercode fuer Fehlerpfad Dfp_LSUCDSPIBattLow0" VAL_BLK 0x1CA858 Kwb_Wu16 65535.00 OneToOne 0.00 65535.00 FORMAT "%8.2" NUMBER 4 /end CHARACTERISTIC
/begin CHARACTERISTIC DSM_CDCDfp_LSUCDWireIP0_C "CARB spezifischer Fehlercode fuer Fehlerpfad Dfp_LSUCDWireIP0" VAL_BLK 0x1CA860 Kwb_Wu16 65535.00 OneToOne 0.00 65535.00 FORMAT "%8.2" NUMBER 4 /end CHARACTERISTIC
/begin CHARACTERISTIC DSM_CDCDfp_LSUCtlRiExc0_C "CARB spezifischer Fehlercode fuer Fehlerpfad Dfp_LSUCtlRiExc0" VAL_BLK 0x1CA868 Kwb_Wu16 65535.00 OneToOne 0.00 65535.00 FORMAT "%8.2" NUMBER 4 /end CHARACTERISTIC
/begin CHARACTERISTIC DSM_CDCDfp_LSUMon1Sens_C "CARB spezifischer Fehlercode fuer Fehlerpfad Dfp_LSUMon1Sens" VAL_BLK 0x1CA870 Kwb_Wu16 65535.00 OneToOne 0.00 65535.00 FORMAT "%8.2" NUMBER 4 /end CHARACTERISTIC
/begin CHARACTERISTIC DSM_CDCDfp_LSUMon2Sens_C "CARB spezifischer Fehlercode fuer Fehlerpfad Dfp_LSUMon2Sens" VAL_BLK 0x1CA878 Kwb_Wu16 65535.00 OneToOne 0.00 65535.00 FORMAT "%8.2" NUMBER 4 /end CHARACTERISTIC
/begin CHARACTERISTIC DSM_CDCDfp_MIL_C "CARB spezifischer Fehlercode fuer Fehlerpfad Dfp_MIL" VAL_BLK 0x1CA880 Kwb_Wu16 65535.00 OneToOne 0.00 65535.00 FORMAT "%8.2" NUMBER 4 /end CHARACTERISTIC
/begin CHARACTERISTIC DSM_CDCDfp_MRlyCD_C "CARB spezifischer Fehlercode fuer Fehlerpfad Dfp_MRlyCD" VAL_BLK 0x1CA888 Kwb_Wu16 65535.00 OneToOne 0.00 65535.00 FORMAT "%8.2" NUMBER 4 /end CHARACTERISTIC
/begin CHARACTERISTIC DSM_CDCDfp_MeUnCDNoLoad_C "CARB spezifischer Fehlercode fuer Fehlerpfad Dfp_MeUnCDNoLoad" VAL_BLK 0x1CA890 Kwb_Wu16 65535.00 OneToOne 0.00 65535.00 FORMAT "%8.2" NUMBER 4 /end CHARACTERISTIC
/begin CHARACTERISTIC DSM_CDCDfp_MeUnCDSCBat_C "CARB spezifischer Fehlercode fuer Fehlerpfad Dfp_MeUnCDSCBat" VAL_BLK 0x1CA898 Kwb_Wu16 65535.00 OneToOne 0.00 65535.00 FORMAT "%8.2" NUMBER 4 /end CHARACTERISTIC
/begin CHARACTERISTIC DSM_CDCDfp_MeUnCDSCGnd_C "CARB spezifischer Fehlercode fuer Fehlerpfad Dfp_MeUnCDSCGnd" VAL_BLK 0x1CA8A0 Kwb_Wu16 65535.00 OneToOne 0.00 65535.00 FORMAT "%8.2" NUMBER 4 /end CHARACTERISTIC
/begin CHARACTERISTIC DSM_CDCDfp_MeUnCD_ADC_C "CARB spezifischer Fehlercode fuer Fehlerpfad Dfp_MeUnCD_ADC" VAL_BLK 0x1CA8A8 Kwb_Wu16 65535.00 OneToOne 0.00 65535.00 FORMAT "%8.2" NUMBER 4 /end CHARACTERISTIC
/begin CHARACTERISTIC DSM_CDCDfp_Montr_C "CARB spezifischer Fehlercode fuer Fehlerpfad Dfp_Montr" VAL_BLK 0x1CA8B0 Kwb_Wu16 65535.00 OneToOne 0.00 65535.00 FORMAT "%8.2" NUMBER 4 /end CHARACTERISTIC
/begin CHARACTERISTIC DSM_CDCDfp_OTSCD_C "CARB spezifischer Fehlercode fuer Fehlerpfad Dfp_OTSCD" VAL_BLK 0x1CA8B8 Kwb_Wu16 65535.00 OneToOne 0.00 65535.00 FORMAT "%8.2" NUMBER 4 /end CHARACTERISTIC
/begin CHARACTERISTIC DSM_CDCDfp_OTSCDCanInac_C "CARB spezifischer Fehlercode fuer Fehlerpfad Dfp_OTSCDCanInac" VAL_BLK 0x1CA8C0 Kwb_Wu16 65535.00 OneToOne 0.00 65535.00 FORMAT "%8.2" NUMBER 4 /end CHARACTERISTIC
/begin CHARACTERISTIC DSM_CDCDfp_OTSCDCanSig_C "CARB spezifischer Fehlercode fuer Fehlerpfad Dfp_OTSCDCanSig" VAL_BLK 0x1CA8C8 Kwb_Wu16 65535.00 OneToOne 0.00 65535.00 FORMAT "%8.2" NUMBER 4 /end CHARACTERISTIC
/begin CHARACTERISTIC DSM_CDCDfp_OvRMon_C "CARB spezifischer Fehlercode fuer Fehlerpfad Dfp_OvRMon" VAL_BLK 0x1CA8D0 Kwb_Wu16 65535.00 OneToOne 0.00 65535.00 FORMAT "%8.2" NUMBER 4 /end CHARACTERISTIC
/begin CHARACTERISTIC DSM_CDCDfp_OvRMonCrCtlP_C "CARB spezifischer Fehlercode fuer Fehlerpfad Dfp_OvRMonCrCtlP" VAL_BLK 0x1CA8D8 Kwb_Wu16 65535.00 OneToOne 0.00 65535.00 FORMAT "%8.2" NUMBER 4 /end CHARACTERISTIC
/begin CHARACTERISTIC DSM_CDCDfp_OvRMonSigA_C "CARB spezifischer Fehlercode fuer Fehlerpfad Dfp_OvRMonSigA" VAL_BLK 0x1CA8E0 Kwb_Wu16 65535.00 OneToOne 0.00 65535.00 FORMAT "%8.2" NUMBER 4 /end CHARACTERISTIC
/begin CHARACTERISTIC DSM_CDCDfp_OxiCCDTPre_C "CARB spezifischer Fehlercode fuer Fehlerpfad Dfp_OxiCCDTPre" VAL_BLK 0x1CA8E8 Kwb_Wu16 65535.00 OneToOne 0.00 65535.00 FORMAT "%8.2" NUMBER 4 /end CHARACTERISTIC
/begin CHARACTERISTIC DSM_CDCDfp_OxiCCDTPre1_C "CARB spezifischer Fehlercode fuer Fehlerpfad Dfp_OxiCCDTPre1" VAL_BLK 0x1CA8F0 Kwb_Wu16 65535.00 OneToOne 0.00 65535.00 FORMAT "%8.2" NUMBER 4 /end CHARACTERISTIC
/begin CHARACTERISTIC DSM_CDCDfp_PCR_BalGovDev_C "CARB spezifischer Fehlercode fuer Fehlerpfad Dfp_PCR_BalGovDev" VAL_BLK 0x1CA8F8 Kwb_Wu16 65535.00 OneToOne 0.00 65535.00 FORMAT "%8.2" NUMBER 4 /end CHARACTERISTIC
/begin CHARACTERISTIC DSM_CDCDfp_PCR_GovDev_C "CARB spezifischer Fehlercode fuer Fehlerpfad Dfp_PCR_GovDev" VAL_BLK 0x1CA900 Kwb_Wu16 65535.00 OneToOne 0.00 65535.00 FORMAT "%8.2" NUMBER 4 /end CHARACTERISTIC
/begin CHARACTERISTIC DSM_CDCDfp_PCVCDNoLoad_C "CARB spezifischer Fehlercode fuer Fehlerpfad Dfp_PCVCDNoLoad" VAL_BLK 0x1CA908 Kwb_Wu16 65535.00 OneToOne 0.00 65535.00 FORMAT "%8.2" NUMBER 4 /end CHARACTERISTIC
/begin CHARACTERISTIC DSM_CDCDfp_PCVCDSCBat_C "CARB spezifischer Fehlercode fuer Fehlerpfad Dfp_PCVCDSCBat" VAL_BLK 0x1CA910 Kwb_Wu16 65535.00 OneToOne 0.00 65535.00 FORMAT "%8.2" NUMBER 4 /end CHARACTERISTIC
/begin CHARACTERISTIC DSM_CDCDfp_PCVCDSCGnd_C "CARB spezifischer Fehlercode fuer Fehlerpfad Dfp_PCVCDSCGnd" VAL_BLK 0x1CA918 Kwb_Wu16 65535.00 OneToOne 0.00 65535.00 FORMAT "%8.2" NUMBER 4 /end CHARACTERISTIC
/begin CHARACTERISTIC DSM_CDCDfp_PCVCD_ADC_C "CARB spezifischer Fehlercode fuer Fehlerpfad Dfp_PCVCD_ADC" VAL_BLK 0x1CA920 Kwb_Wu16 65535.00 OneToOne 0.00 65535.00 FORMAT "%8.2" NUMBER 4 /end CHARACTERISTIC
/begin CHARACTERISTIC DSM_CDCDfp_PFltCDHtg_C "CARB spezifischer Fehlercode fuer Fehlerpfad Dfp_PFltCDHtg" VAL_BLK 0x1CA928 Kwb_Wu16 65535.00 OneToOne 0.00 65535.00 FORMAT "%8.2" NUMBER 4 /end CHARACTERISTIC
/begin CHARACTERISTIC DSM_CDCDfp_PFltCDHtg1_C "CARB spezifischer Fehlercode fuer Fehlerpfad Dfp_PFltCDHtg1" VAL_BLK 0x1CA930 Kwb_Wu16 65535.00 OneToOne 0.00 65535.00 FORMAT "%8.2" NUMBER 4 /end CHARACTERISTIC
/begin CHARACTERISTIC DSM_CDCDfp_PFltCDPDiff_C "CARB spezifischer Fehlercode fuer Fehlerpfad Dfp_PFltCDPDiff" VAL_BLK 0x1CA938 Kwb_Wu16 65535.00 OneToOne 0.00 65535.00 FORMAT "%8.2" NUMBER 4 /end CHARACTERISTIC
/begin CHARACTERISTIC DSM_CDCDfp_PFltCDPDiff1_C "CARB spezifischer Fehlercode fuer Fehlerpfad Dfp_PFltCDPDiff1" VAL_BLK 0x1CA940 Kwb_Wu16 65535.00 OneToOne 0.00 65535.00 FORMAT "%8.2" NUMBER 4 /end CHARACTERISTIC
/begin CHARACTERISTIC DSM_CDCDfp_PFltCDTPre_C "CARB spezifischer Fehlercode fuer Fehlerpfad Dfp_PFltCDTPre" VAL_BLK 0x1CA948 Kwb_Wu16 65535.00 OneToOne 0.00 65535.00 FORMAT "%8.2" NUMBER 4 /end CHARACTERISTIC
/begin CHARACTERISTIC DSM_CDCDfp_PFltCDTPst_C "CARB spezifischer Fehlercode fuer Fehlerpfad Dfp_PFltCDTPst" VAL_BLK 0x1CA950 Kwb_Wu16 65535.00 OneToOne 0.00 65535.00 FORMAT "%8.2" NUMBER 4 /end CHARACTERISTIC
/begin CHARACTERISTIC DSM_CDCDfp_PFltCDTempPre_C "CARB spezifischer Fehlercode fuer Fehlerpfad Dfp_PFltCDTempPre" VAL_BLK 0x1CA958 Kwb_Wu16 65535.00 OneToOne 0.00 65535.00 FORMAT "%8.2" NUMBER 4 /end CHARACTERISTIC
/begin CHARACTERISTIC DSM_CDCDfp_PFltCDTempPre1_C "CARB spezifischer Fehlercode fuer Fehlerpfad Dfp_PFltCDTempPre1" VAL_BLK 0x1CA960 Kwb_Wu16 65535.00 OneToOne 0.00 65535.00 FORMAT "%8.2" NUMBER 4 /end CHARACTERISTIC
/begin CHARACTERISTIC DSM_CDCDfp_PFltChar_C "CARB spezifischer Fehlercode fuer Fehlerpfad Dfp_PFltChar" VAL_BLK 0x1CA968 Kwb_Wu16 65535.00 OneToOne 0.00 65535.00 FORMAT "%8.2" NUMBER 4 /end CHARACTERISTIC
/begin CHARACTERISTIC DSM_CDCDfp_PFltEngPrt_C "CARB spezifischer Fehlercode fuer Fehlerpfad Dfp_PFltEngPrt" VAL_BLK 0x1CA970 Kwb_Wu16 65535.00 OneToOne 0.00 65535.00 FORMAT "%8.2" NUMBER 4 /end CHARACTERISTIC
/begin CHARACTERISTIC DSM_CDCDfp_PFltPresDynPlaus_C "CARB spezifischer Fehlercode fuer Fehlerpfad Dfp_PFltPresDynPlaus" VAL_BLK 0x1CA978 Kwb_Wu16 65535.00 OneToOne 0.00 65535.00 FORMAT "%8.2" NUMBER 4 /end CHARACTERISTIC
/begin CHARACTERISTIC DSM_CDCDfp_PFltPresSens_C "CARB spezifischer Fehlercode fuer Fehlerpfad Dfp_PFltPresSens" VAL_BLK 0x1CA980 Kwb_Wu16 65535.00 OneToOne 0.00 65535.00 FORMAT "%8.2" NUMBER 4 /end CHARACTERISTIC
/begin CHARACTERISTIC DSM_CDCDfp_PFltPresSensHsLn_C "CARB spezifischer Fehlercode fuer Fehlerpfad Dfp_PFltPresSensHsLn" VAL_BLK 0x1CA988 Kwb_Wu16 65535.00 OneToOne 0.00 65535.00 FORMAT "%8.2" NUMBER 4 /end CHARACTERISTIC
/begin CHARACTERISTIC DSM_CDCDfp_PFltPresSensSot_C "CARB spezifischer Fehlercode fuer Fehlerpfad Dfp_PFltPresSensSot" VAL_BLK 0x1CA990 Kwb_Wu16 65535.00 OneToOne 0.00 65535.00 FORMAT "%8.2" NUMBER 4 /end CHARACTERISTIC
/begin CHARACTERISTIC DSM_CDCDfp_PFltRgnPerm_C "CARB spezifischer Fehlercode fuer Fehlerpfad Dfp_PFltRgnPerm" VAL_BLK 0x1CA998 Kwb_Wu16 65535.00 OneToOne 0.00 65535.00 FORMAT "%8.2" NUMBER 4 /end CHARACTERISTIC
/begin CHARACTERISTIC DSM_CDCDfp_PFltTempDwnStrm_C "CARB spezifischer Fehlercode fuer Fehlerpfad Dfp_PFltTempDwnStrm" VAL_BLK 0x1CA9A0 Kwb_Wu16 65535.00 OneToOne 0.00 65535.00 FORMAT "%8.2" NUMBER 4 /end CHARACTERISTIC
/begin CHARACTERISTIC DSM_CDCDfp_PFltTempSens_C "CARB spezifischer Fehlercode fuer Fehlerpfad Dfp_PFltTempSens" VAL_BLK 0x1CA9A8 Kwb_Wu16 65535.00 OneToOne 0.00 65535.00 FORMAT "%8.2" NUMBER 4 /end CHARACTERISTIC
/begin CHARACTERISTIC DSM_CDCDfp_PFltTempUpStrm_C "CARB spezifischer Fehlercode fuer Fehlerpfad Dfp_PFltTempUpStrm" VAL_BLK 0x1CA9B0 Kwb_Wu16 65535.00 OneToOne 0.00 65535.00 FORMAT "%8.2" NUMBER 4 /end CHARACTERISTIC
/begin CHARACTERISTIC DSM_CDCDfp_PSPCD_Actr_C "CARB spezifischer Fehlercode fuer Fehlerpfad Dfp_PSPCD_Actr" VAL_BLK 0x1CA9B8 Kwb_Wu16 65535.00 OneToOne 0.00 65535.00 FORMAT "%8.2" NUMBER 4 /end CHARACTERISTIC
/begin CHARACTERISTIC DSM_CDCDfp_PrpCtlvLimErrPat_C "CARB spezifischer Fehlercode fuer Fehlerpfad Dfp_PrpCtlvLimErrPat" VAL_BLK 0x1CA9C0 Kwb_Wu16 65535.00 OneToOne 0.00 65535.00 FORMAT "%8.2" NUMBER 4 /end CHARACTERISTIC
/begin CHARACTERISTIC DSM_CDCDfp_RailCD_C "CARB spezifischer Fehlercode fuer Fehlerpfad Dfp_RailCD" VAL_BLK 0x1CA9C8 Kwb_Wu16 65535.00 OneToOne 0.00 65535.00 FORMAT "%8.2" NUMBER 4 /end CHARACTERISTIC
/begin CHARACTERISTIC DSM_CDCDfp_RailCDOfsTst_C "CARB spezifischer Fehlercode fuer Fehlerpfad Dfp_RailCDOfsTst" VAL_BLK 0x1CA9D0 Kwb_Wu16 65535.00 OneToOne 0.00 65535.00 FORMAT "%8.2" NUMBER 4 /end CHARACTERISTIC
/begin CHARACTERISTIC DSM_CDCDfp_RailMeUn0_C "CARB spezifischer Fehlercode fuer Fehlerpfad Dfp_RailMeUn0" VAL_BLK 0x1CA9D8 Kwb_Wu16 65535.00 OneToOne 0.00 65535.00 FORMAT "%8.2" NUMBER 4 /end CHARACTERISTIC
/begin CHARACTERISTIC DSM_CDCDfp_RailMeUn1_C "CARB spezifischer Fehlercode fuer Fehlerpfad Dfp_RailMeUn1" VAL_BLK 0x1CA9E0 Kwb_Wu16 65535.00 OneToOne 0.00 65535.00 FORMAT "%8.2" NUMBER 4 /end CHARACTERISTIC
/begin CHARACTERISTIC DSM_CDCDfp_RailMeUn2_C "CARB spezifischer Fehlercode fuer Fehlerpfad Dfp_RailMeUn2" VAL_BLK 0x1CA9E8 Kwb_Wu16 65535.00 OneToOne 0.00 65535.00 FORMAT "%8.2" NUMBER 4 /end CHARACTERISTIC
/begin CHARACTERISTIC DSM_CDCDfp_RailMeUn3_C "CARB spezifischer Fehlercode fuer Fehlerpfad Dfp_RailMeUn3" VAL_BLK 0x1CA9F0 Kwb_Wu16 65535.00 OneToOne 0.00 65535.00 FORMAT "%8.2" NUMBER 4 /end CHARACTERISTIC
/begin CHARACTERISTIC DSM_CDCDfp_RailMeUn4_C "CARB spezifischer Fehlercode fuer Fehlerpfad Dfp_RailMeUn4" VAL_BLK 0x1CA9F8 Kwb_Wu16 65535.00 OneToOne 0.00 65535.00 FORMAT "%8.2" NUMBER 4 /end CHARACTERISTIC
/begin CHARACTERISTIC DSM_CDCDfp_RailPCV0_C "CARB spezifischer Fehlercode fuer Fehlerpfad Dfp_RailPCV0" VAL_BLK 0x1CAA00 Kwb_Wu16 65535.00 OneToOne 0.00 65535.00 FORMAT "%8.2" NUMBER 4 /end CHARACTERISTIC
/begin CHARACTERISTIC DSM_CDCDfp_RailPCV1_C "CARB spezifischer Fehlercode fuer Fehlerpfad Dfp_RailPCV1" VAL_BLK 0x1CAA08 Kwb_Wu16 65535.00 OneToOne 0.00 65535.00 FORMAT "%8.2" NUMBER 4 /end CHARACTERISTIC
/begin CHARACTERISTIC DSM_CDCDfp_RailPCV2_C "CARB spezifischer Fehlercode fuer Fehlerpfad Dfp_RailPCV2" VAL_BLK 0x1CAA10 Kwb_Wu16 65535.00 OneToOne 0.00 65535.00 FORMAT "%8.2" NUMBER 4 /end CHARACTERISTIC
/begin CHARACTERISTIC DSM_CDCDfp_RailPCV3_C "CARB spezifischer Fehlercode fuer Fehlerpfad Dfp_RailPCV3" VAL_BLK 0x1CAA18 Kwb_Wu16 65535.00 OneToOne 0.00 65535.00 FORMAT "%8.2" NUMBER 4 /end CHARACTERISTIC
/begin CHARACTERISTIC DSM_CDCDfp_RailPCV4_C "CARB spezifischer Fehlercode fuer Fehlerpfad Dfp_RailPCV4" VAL_BLK 0x1CAA20 Kwb_Wu16 65535.00 OneToOne 0.00 65535.00 FORMAT "%8.2" NUMBER 4 /end CHARACTERISTIC
/begin CHARACTERISTIC DSM_CDCDfp_RailPCV5_C "CARB spezifischer Fehlercode fuer Fehlerpfad Dfp_RailPCV5" VAL_BLK 0x1CAA28 Kwb_Wu16 65535.00 OneToOne 0.00 65535.00 FORMAT "%8.2" NUMBER 4 /end CHARACTERISTIC
/begin CHARACTERISTIC DSM_CDCDfp_SOPTst_C "CARB spezifischer Fehlercode fuer Fehlerpfad Dfp_SOPTst" VAL_BLK 0x1CAA30 Kwb_Wu16 65535.00 OneToOne 0.00 65535.00 FORMAT "%8.2" NUMBER 4 /end CHARACTERISTIC
/begin CHARACTERISTIC DSM_CDCDfp_SSpMon1_C "CARB spezifischer Fehlercode fuer Fehlerpfad Dfp_SSpMon1" VAL_BLK 0x1CAA38 Kwb_Wu16 65535.00 OneToOne 0.00 65535.00 FORMAT "%8.2" NUMBER 4 /end CHARACTERISTIC
/begin CHARACTERISTIC DSM_CDCDfp_SSpMon2_C "CARB spezifischer Fehlercode fuer Fehlerpfad Dfp_SSpMon2" VAL_BLK 0x1CAA40 Kwb_Wu16 65535.00 OneToOne 0.00 65535.00 FORMAT "%8.2" NUMBER 4 /end CHARACTERISTIC
/begin CHARACTERISTIC DSM_CDCDfp_SSpMon3_C "CARB spezifischer Fehlercode fuer Fehlerpfad Dfp_SSpMon3" VAL_BLK 0x1CAA48 Kwb_Wu16 65535.00 OneToOne 0.00 65535.00 FORMAT "%8.2" NUMBER 4 /end CHARACTERISTIC
/begin CHARACTERISTIC DSM_CDCDfp_StrtCDOffRly_C "CARB spezifischer Fehlercode für Fehlerpfad Dfp_StrtCDOffRly" VAL_BLK 0x1CAA50 Kwb_Wu16 65535.00 OneToOne 0.00 65535.00 FORMAT "%8.2" NUMBER 4 /end CHARACTERISTIC
/begin CHARACTERISTIC DSM_CDCDfp_StrtCDOnRly_C "CARB spezifischer Fehlercode für Fehlerpfad Dfp_StrtCDOnRly" VAL_BLK 0x1CAA58 Kwb_Wu16 65535.00 OneToOne 0.00 65535.00 FORMAT "%8.2" NUMBER 4 /end CHARACTERISTIC
/begin CHARACTERISTIC DSM_CDCDfp_StrtCtlIlsNotPlaus_C "CARB spezifischer Fehlercode für Fehlerpfad Dfp_StrtCtlIlsNotPlaus" VAL_BLK 0x1CAA60 Kwb_Wu16 65535.00 OneToOne 0.00 65535.00 FORMAT "%8.2" NUMBER 4 /end CHARACTERISTIC
/begin CHARACTERISTIC DSM_CDCDfp_StrtCtlT50ROneRly1_C "CARB spezifischer Fehlercode fuer Fehlerpfad Dfp_StrtCtlT50ROneRly1" VAL_BLK 0x1CAA68 Kwb_Wu16 65535.00 OneToOne 0.00 65535.00 FORMAT "%8.2" NUMBER 4 /end CHARACTERISTIC
/begin CHARACTERISTIC DSM_CDCDfp_StrtCtlT50ROneRly2_C "CARB spezifischer Fehlercode fuer Fehlerpfad Dfp_StrtCtlT50ROneRly2" VAL_BLK 0x1CAA70 Kwb_Wu16 65535.00 OneToOne 0.00 65535.00 FORMAT "%8.2" NUMBER 4 /end CHARACTERISTIC
/begin CHARACTERISTIC DSM_CDCDfp_StrtCtlT50RZero_C "CARB spezifischer Fehlercode fuer Fehlerpfad Dfp_StrtCtlT50RZero" VAL_BLK 0x1CAA78 Kwb_Wu16 65535.00 OneToOne 0.00 65535.00 FORMAT "%8.2" NUMBER 4 /end CHARACTERISTIC
/begin CHARACTERISTIC DSM_CDCDfp_SysLamp_C "CARB spezifischer Fehlercode fuer Fehlerpfad Dfp_SysLamp" VAL_BLK 0x1CAA80 Kwb_Wu16 65535.00 OneToOne 0.00 65535.00 FORMAT "%8.2" NUMBER 4 /end CHARACTERISTIC
/begin CHARACTERISTIC DSM_CDCDfp_T15CD_C "CARB spezifischer Fehlercode fuer Fehlerpfad Dfp_T15CD" VAL_BLK 0x1CAA88 Kwb_Wu16 65535.00 OneToOne 0.00 65535.00 FORMAT "%8.2" NUMBER 4 /end CHARACTERISTIC
/begin CHARACTERISTIC DSM_CDCDfp_TPUMon_C "CARB spezifischer Fehlercode fuer Fehlerpfad Dfp_TPUMon" VAL_BLK 0x1CAA90 Kwb_Wu16 65535.00 OneToOne 0.00 65535.00 FORMAT "%8.2" NUMBER 4 /end CHARACTERISTIC
/begin CHARACTERISTIC DSM_CDCDfp_TTSCD_C "CARB spezifischer Fehlercode fuer Fehlerpfad Dfp_TTSCD" VAL_BLK 0x1CAA98 Kwb_Wu16 65535.00 OneToOne 0.00 65535.00 FORMAT "%8.2" NUMBER 4 /end CHARACTERISTIC
/begin CHARACTERISTIC DSM_CDCDfp_TVACD_Max_C "CARB spezifischer Fehlercode fuer Fehlerpfad Dfp_TVACD_Max" VAL_BLK 0x1CAAA0 Kwb_Wu16 65535.00 OneToOne 0.00 65535.00 FORMAT "%8.2" NUMBER 4 /end CHARACTERISTIC
/begin CHARACTERISTIC DSM_CDCDfp_TVACD_Min_C "CARB spezifischer Fehlercode fuer Fehlerpfad Dfp_TVACD_Min" VAL_BLK 0x1CAAA8 Kwb_Wu16 65535.00 OneToOne 0.00 65535.00 FORMAT "%8.2" NUMBER 4 /end CHARACTERISTIC
/begin CHARACTERISTIC DSM_CDCDfp_TVACD_SigNpl_C "CARB spezifischer Fehlercode fuer Fehlerpfad Dfp_TVACD_SigNpl" VAL_BLK 0x1CAAB0 Kwb_Wu16 65535.00 OneToOne 0.00 65535.00 FORMAT "%8.2" NUMBER 4 /end CHARACTERISTIC
/begin CHARACTERISTIC DSM_CDCDfp_TVACD_stLineDef_C "CARB spezifischer Fehlercode fuer Fehlerpfad Dfp_TVACD_stLineDef" VAL_BLK 0x1CAAB8 Kwb_Wu16 65535.00 OneToOne 0.00 65535.00 FORMAT "%8.2" NUMBER 4 /end CHARACTERISTIC
/begin CHARACTERISTIC DSM_CDCDfp_UAcc_CodeBitErr_C "CARB spezifischer Fehlercode fuer Fehlerpfad Dfp_UAcc_CodeBitErr" VAL_BLK 0x1CAAC0 Kwb_Wu16 65535.00 OneToOne 0.00 65535.00 FORMAT "%8.2" NUMBER 4 /end CHARACTERISTIC
/begin CHARACTERISTIC DSM_CDCDfp_USAp_DataVariant_C "CARB spezifischer Fehlercode fuer Fehlerpfad Dfp_USAp_DataVariant" VAL_BLK 0x1CAAC8 Kwb_Wu16 65535.00 OneToOne 0.00 65535.00 FORMAT "%8.2" NUMBER 4 /end CHARACTERISTIC
/begin CHARACTERISTIC DSM_CDCDfp_USAp_FuncCodeRead_C "CARB spezifischer Fehlercode fuer Fehlerpfad Dfp_USAp_FuncCodeRead" VAL_BLK 0x1CAAD0 Kwb_Wu16 65535.00 OneToOne 0.00 65535.00 FORMAT "%8.2" NUMBER 4 /end CHARACTERISTIC
/begin CHARACTERISTIC DSM_CDCDfp_VSACD1_Max_C "CARB spezifischer Fehlercode fuer Fehlerpfad Dfp_VSACD1_Max" VAL_BLK 0x1CAAD8 Kwb_Wu16 65535.00 OneToOne 0.00 65535.00 FORMAT "%8.2" NUMBER 4 /end CHARACTERISTIC
/begin CHARACTERISTIC DSM_CDCDfp_VSACD1_Min_C "CARB spezifischer Fehlercode fuer Fehlerpfad Dfp_VSACD1_Min" VAL_BLK 0x1CAAE0 Kwb_Wu16 65535.00 OneToOne 0.00 65535.00 FORMAT "%8.2" NUMBER 4 /end CHARACTERISTIC
/begin CHARACTERISTIC DSM_CDCDfp_VSACD1_SigNpl_C "CARB spezifischer Fehlercode fuer Fehlerpfad Dfp_VSACD1_SigNpl" VAL_BLK 0x1CAAE8 Kwb_Wu16 65535.00 OneToOne 0.00 65535.00 FORMAT "%8.2" NUMBER 4 /end CHARACTERISTIC
/begin CHARACTERISTIC DSM_CDCDfp_VSACD2_Max_C "CARB spezifischer Fehlercode fuer Fehlerpfad Dfp_VSACD2_Max" VAL_BLK 0x1CAAF0 Kwb_Wu16 65535.00 OneToOne 0.00 65535.00 FORMAT "%8.2" NUMBER 4 /end CHARACTERISTIC
/begin CHARACTERISTIC DSM_CDCDfp_VSACD2_Min_C "CARB spezifischer Fehlercode fuer Fehlerpfad Dfp_VSACD2_Min" VAL_BLK 0x1CAAF8 Kwb_Wu16 65535.00 OneToOne 0.00 65535.00 FORMAT "%8.2" NUMBER 4 /end CHARACTERISTIC
/begin CHARACTERISTIC DSM_CDCDfp_VSACD2_SigNpl_C "CARB spezifischer Fehlercode fuer Fehlerpfad Dfp_VSACD2_SigNpl" VAL_BLK 0x1CAB00 Kwb_Wu16 65535.00 OneToOne 0.00 65535.00 FORMAT "%8.2" NUMBER 4 /end CHARACTERISTIC
/begin CHARACTERISTIC DSM_CDCDfp_VSAExcSensTemp1_C "CARB spezifischer Fehlercode fuer Fehlerpfad Dfp_VSAExcSensTemp1" VAL_BLK 0x1CAB08 Kwb_Wu16 65535.00 OneToOne 0.00 65535.00 FORMAT "%8.2" NUMBER 4 /end CHARACTERISTIC
/begin CHARACTERISTIC DSM_CDCDfp_VSAExcSensTemp2_C "CARB spezifischer Fehlercode fuer Fehlerpfad Dfp_VSAExcSensTemp2" VAL_BLK 0x1CAB10 Kwb_Wu16 65535.00 OneToOne 0.00 65535.00 FORMAT "%8.2" NUMBER 4 /end CHARACTERISTIC
/begin CHARACTERISTIC DSM_CDCDfp_VSANotLrn1_C "CARB spezifischer Fehlercode fuer Fehlerpfad Dfp_VSANotLrn1" VAL_BLK 0x1CAB18 Kwb_Wu16 65535.00 OneToOne 0.00 65535.00 FORMAT "%8.2" NUMBER 4 /end CHARACTERISTIC
/begin CHARACTERISTIC DSM_CDCDfp_VSANotLrn2_C "CARB spezifischer Fehlercode fuer Fehlerpfad Dfp_VSANotLrn2" VAL_BLK 0x1CAB20 Kwb_Wu16 65535.00 OneToOne 0.00 65535.00 FORMAT "%8.2" NUMBER 4 /end CHARACTERISTIC
/begin CHARACTERISTIC DSM_CDCDfp_VSASCDDcyc1_C "CARB spezifischer Fehlercode fuer Fehlerpfad Dfp_VSASCDDcyc1" VAL_BLK 0x1CAB28 Kwb_Wu16 65535.00 OneToOne 0.00 65535.00 FORMAT "%8.2" NUMBER 4 /end CHARACTERISTIC
/begin CHARACTERISTIC DSM_CDCDfp_VSASCDDcyc2_C "CARB spezifischer Fehlercode fuer Fehlerpfad Dfp_VSASCDDcyc2" VAL_BLK 0x1CAB30 Kwb_Wu16 65535.00 OneToOne 0.00 65535.00 FORMAT "%8.2" NUMBER 4 /end CHARACTERISTIC
/begin CHARACTERISTIC DSM_CDCDfp_VSASCDPeriod1_C "CARB spezifischer Fehlercode fuer Fehlerpfad Dfp_VSASCDPeriod1" VAL_BLK 0x1CAB38 Kwb_Wu16 65535.00 OneToOne 0.00 65535.00 FORMAT "%8.2" NUMBER 4 /end CHARACTERISTIC
/begin CHARACTERISTIC DSM_CDCDfp_VSASCDPeriod2_C "CARB spezifischer Fehlercode fuer Fehlerpfad Dfp_VSASCDPeriod2" VAL_BLK 0x1CAB40 Kwb_Wu16 65535.00 OneToOne 0.00 65535.00 FORMAT "%8.2" NUMBER 4 /end CHARACTERISTIC
/begin CHARACTERISTIC DSM_CDCDfp_VSSCD1_C "CARB spezifischer Fehlercode fuer Fehlerpfad Dfp_VSSCD1" VAL_BLK 0x1CAB48 Kwb_Wu16 65535.00 OneToOne 0.00 65535.00 FORMAT "%8.2" NUMBER 4 /end CHARACTERISTIC
/begin CHARACTERISTIC DSM_CDCDfp_VSSCD2_C "CARB spezifischer Fehlercode fuer Fehlerpfad Dfp_VSSCD2" VAL_BLK 0x1CAB50 Kwb_Wu16 65535.00 OneToOne 0.00 65535.00 FORMAT "%8.2" NUMBER 4 /end CHARACTERISTIC
/begin CHARACTERISTIC DSM_CDCDfp_VSSCD4_C "CARB spezifischer Fehlercode fuer Fehlerpfad Dfp_VSSCD4" VAL_BLK 0x1CAB58 Kwb_Wu16 65535.00 OneToOne 0.00 65535.00 FORMAT "%8.2" NUMBER 4 /end CHARACTERISTIC
/begin CHARACTERISTIC DSM_CDCDfp_VSSCDBrkLowVltg_C "CARB spezifischer Fehlercode fuer Fehlerpfad Dfp_VSSCDBrkLowVltg" VAL_BLK 0x1CAB60 Kwb_Wu16 65535.00 OneToOne 0.00 65535.00 FORMAT "%8.2" NUMBER 4 /end CHARACTERISTIC
/begin CHARACTERISTIC DSM_CDCDfp_VSSCDCAN_C "CARB spezifischer Fehlercode fuer Fehlerpfad Dfp_VSSCDCAN" VAL_BLK 0x1CAB68 Kwb_Wu16 65535.00 OneToOne 0.00 65535.00 FORMAT "%8.2" NUMBER 4 /end CHARACTERISTIC
/begin CHARACTERISTIC DSM_CDCDfp_VSSCDNpl_C "CARB spezifischer Fehlercode fuer Fehlerpfad Dfp_VSSCDNpl" VAL_BLK 0x1CAB70 Kwb_Wu16 65535.00 OneToOne 0.00 65535.00 FORMAT "%8.2" NUMBER 4 /end CHARACTERISTIC
/begin CHARACTERISTIC DSM_CDCDfp_WdCom_C "CARB spezifischer Fehlercode fuer Fehlerpfad Dfp_WdCom" VAL_BLK 0x1CAB78 Kwb_Wu16 65535.00 OneToOne 0.00 65535.00 FORMAT "%8.2" NUMBER 4 /end CHARACTERISTIC
/begin CHARACTERISTIC DSM_FMKDfp_ACCCDWrongCoded_C "Ausblendbedingungen fuer Fehlerpfad Dfp_ACCCDWrongCoded" VALUE 0x1C9E90 Kw_Wu8 255.0 OneToOne 0.00 255.0 FORMAT "%5.1" /end CHARACTERISTIC
/begin CHARACTERISTIC DSM_FMKDfp_ACCD_C "Ausblendbedingungen fuer Fehlerpfad Dfp_ACCD" VALUE 0x1C9E91 Kw_Wu8 255.0 OneToOne 0.00 255.0 FORMAT "%5.1" /end CHARACTERISTIC
/begin CHARACTERISTIC DSM_FMKDfp_ACCD_PAC_C "Ausblendbedingungen fuer Fehlerpfad Dfp_ACCD_PAC" VALUE 0x1C9E92 Kw_Wu8 255.0 OneToOne 0.00 255.0 FORMAT "%5.1" /end CHARACTERISTIC
/begin CHARACTERISTIC DSM_FMKDfp_ACCD_pCAN_C "Ausblendbedingungen fuer Fehlerpfad Dfp_ACCD_pCAN" VALUE 0x1C9E93 Kw_Wu8 255.0 OneToOne 0.00 255.0 FORMAT "%5.1" /end CHARACTERISTIC
/begin CHARACTERISTIC DSM_FMKDfp_ACCD_trqCAN_C "Ausblendbedingungen fuer Fehlerpfad Dfp_ACCD_trqCAN" VALUE 0x1C9E94 Kw_Wu8 255.0 OneToOne 0.00 255.0 FORMAT "%5.1" /end CHARACTERISTIC
/begin CHARACTERISTIC DSM_FMKDfp_ACCnotPlaus_C "Ausblendbedingungen fuer Fehlerpfad Dfp_ACCnotPlaus" VALUE 0x1C9E95 Kw_Wu8 255.0 OneToOne 0.00 255.0 FORMAT "%5.1" /end CHARACTERISTIC
/begin CHARACTERISTIC DSM_FMKDfp_ADCMon_C "Ausblendbedingungen fuer Fehlerpfad Dfp_ADCMon" VALUE 0x1C9E96 Kw_Wu8 255.0 OneToOne 0.00 255.0 FORMAT "%5.1" /end CHARACTERISTIC
/begin CHARACTERISTIC DSM_FMKDfp_AFSCD_AirTempDcyc_C "Ausblendbedingungen fuer Fehlerpfad Dfp_AFSCD_AirTempDcyc" VALUE 0x1C9E97 Kw_Wu8 255.0 OneToOne 0.00 255.0 FORMAT "%5.1" /end CHARACTERISTIC
/begin CHARACTERISTIC DSM_FMKDfp_AFSCD_PlOffsDrft_C "Ausblendbedingungen fuer Fehlerpfad Dfp_AFSCD_PlOffsDrft" VALUE 0x1C9E98 Kw_Wu8 255.0 OneToOne 0.00 255.0 FORMAT "%5.1" /end CHARACTERISTIC
/begin CHARACTERISTIC DSM_FMKDfp_AFSCD_PlSetyDrft_C "Ausblendbedingungen fuer Fehlerpfad Dfp_AFSCD_PlSetyDrft" VALUE 0x1C9E99 Kw_Wu8 255.0 OneToOne 0.00 255.0 FORMAT "%5.1" /end CHARACTERISTIC
/begin CHARACTERISTIC DSM_FMKDfp_AFSCD_Plaus_C "Ausblendbedingungen fuer Fehlerpfad Dfp_AFSCD_Plaus" VALUE 0x1C9E9A Kw_Wu8 255.0 OneToOne 0.00 255.0 FORMAT "%5.1" /end CHARACTERISTIC
/begin CHARACTERISTIC DSM_FMKDfp_AFSCD_SRCAirTemp_C "Ausblendbedingungen fuer Fehlerpfad Dfp_AFSCD_SRCAirTemp" VALUE 0x1C9E9B Kw_Wu8 255.0 OneToOne 0.00 255.0 FORMAT "%5.1" /end CHARACTERISTIC
/begin CHARACTERISTIC DSM_FMKDfp_AFSCD_SRCAirm_C "Ausblendbedingungen fuer Fehlerpfad Dfp_AFSCD_SRCAirm" VALUE 0x1C9E9C Kw_Wu8 255.0 OneToOne 0.00 255.0 FORMAT "%5.1" /end CHARACTERISTIC
/begin CHARACTERISTIC DSM_FMKDfp_AFSCD_SRCAirm2_C "Ausblendbedingungen fuer Fehlerpfad Dfp_AFSCD_SRCAirm2" VALUE 0x1C9E9D Kw_Wu8 255.0 OneToOne 0.00 255.0 FORMAT "%5.1" /end CHARACTERISTIC
/begin CHARACTERISTIC DSM_FMKDfp_AFSCD_SRCBatt_C "Ausblendbedingungen fuer Fehlerpfad Dfp_AFSCD_SRCBatt" VALUE 0x1C9E9E Kw_Wu8 255.0 OneToOne 0.00 255.0 FORMAT "%5.1" /end CHARACTERISTIC
/begin CHARACTERISTIC DSM_FMKDfp_AFSCD_SRCCorrAirm_C "Ausblendbedingungen fuer Fehlerpfad Dfp_AFSCD_SRCCorrAirm" VALUE 0x1C9E9F Kw_Wu8 255.0 OneToOne 0.00 255.0 FORMAT "%5.1" /end CHARACTERISTIC
/begin CHARACTERISTIC DSM_FMKDfp_AFSCD_SRCRawAirm_C "Ausblendbedingungen fuer Fehlerpfad Dfp_AFSCD_SRCRawAirm" VALUE 0x1C9EA0 Kw_Wu8 255.0 OneToOne 0.00 255.0 FORMAT "%5.1" /end CHARACTERISTIC
/begin CHARACTERISTIC DSM_FMKDfp_AFSCD_SRCRefSigPer_C "Ausblendbedingungen fuer Fehlerpfad Dfp_AFSCD_SRCRefSigPer" VALUE 0x1C9EA1 Kw_Wu8 255.0 OneToOne 0.00 255.0 FORMAT "%5.1" /end CHARACTERISTIC
/begin CHARACTERISTIC DSM_FMKDfp_AFVCD_Actr_C "Ausblendbedingungen fuer Fehlerpfad Dfp_AFVCD_Actr" VALUE 0x1C9EA2 Kw_Wu8 255.0 OneToOne 0.00 255.0 FORMAT "%5.1" /end CHARACTERISTIC
/begin CHARACTERISTIC DSM_FMKDfp_AOHtCDHt1_C "Ausblendbedingungen fuer Fehlerpfad Dfp_AOHtCDHt1" VALUE 0x1C9EA3 Kw_Wu8 255.0 OneToOne 0.00 255.0 FORMAT "%5.1" /end CHARACTERISTIC
/begin CHARACTERISTIC DSM_FMKDfp_AOHtCDHt2_C "Ausblendbedingungen fuer Fehlerpfad Dfp_AOHtCDHt2" VALUE 0x1C9EA4 Kw_Wu8 255.0 OneToOne 0.00 255.0 FORMAT "%5.1" /end CHARACTERISTIC
/begin CHARACTERISTIC DSM_FMKDfp_AOHtCDHt3_C "Ausblendbedingungen fuer Fehlerpfad Dfp_AOHtCDHt3" VALUE 0x1C9EA5 Kw_Wu8 255.0 OneToOne 0.00 255.0 FORMAT "%5.1" /end CHARACTERISTIC
/begin CHARACTERISTIC DSM_FMKDfp_APP1_C "Ausblendbedingungen fuer Fehlerpfad Dfp_APP1" VALUE 0x1C9EA6 Kw_Wu8 255.0 OneToOne 0.00 255.0 FORMAT "%5.1" /end CHARACTERISTIC
/begin CHARACTERISTIC DSM_FMKDfp_APP2_C "Ausblendbedingungen fuer Fehlerpfad Dfp_APP2" VALUE 0x1C9EA7 Kw_Wu8 255.0 OneToOne 0.00 255.0 FORMAT "%5.1" /end CHARACTERISTIC
/begin CHARACTERISTIC DSM_FMKDfp_APPCD_KickDown_C "Ausblendbedingungen fuer Fehlerpfad Dfp_APPCD_KickDown" VALUE 0x1C9EA8 Kw_Wu8 255.0 OneToOne 0.00 255.0 FORMAT "%5.1" /end CHARACTERISTIC
/begin CHARACTERISTIC DSM_FMKDfp_APPSync_C "Ausblendbedingungen fuer Fehlerpfad Dfp_APPSync" VALUE 0x1C9EA9 Kw_Wu8 255.0 OneToOne 0.00 255.0 FORMAT "%5.1" /end CHARACTERISTIC
/begin CHARACTERISTIC DSM_FMKDfp_APP_Npl_C "Ausblendbedingungen fuer Fehlerpfad Dfp_APP_Npl" VALUE 0x1C9EAA Kw_Wu8 255.0 OneToOne 0.00 255.0 FORMAT "%5.1" /end CHARACTERISTIC
/begin CHARACTERISTIC DSM_FMKDfp_APSCD_C "Ausblendbedingungen fuer Fehlerpfad Dfp_APSCD" VALUE 0x1C9EAB Kw_Wu8 255.0 OneToOne 0.00 255.0 FORMAT "%5.1" /end CHARACTERISTIC
/begin CHARACTERISTIC DSM_FMKDfp_AccPedPlausBrk_C "Ausblendbedingungen fuer Fehlerpfad Dfp_AccPedPlausBrk" VALUE 0x1C9EAC Kw_Wu8 255.0 OneToOne 0.00 255.0 FORMAT "%5.1" /end CHARACTERISTIC
/begin CHARACTERISTIC DSM_FMKDfp_AddPCD_C "Ausblendbedingungen fuer Fehlerpfad Dfp_AddPCD" VALUE 0x1C9EAD Kw_Wu8 255.0 OneToOne 0.00 255.0 FORMAT "%5.1" /end CHARACTERISTIC
/begin CHARACTERISTIC DSM_FMKDfp_AddPCDTnkLvl_C "Ausblendbedingungen fuer Fehlerpfad Dfp_AddPCDTnkLvl" VALUE 0x1C9EAE Kw_Wu8 255.0 OneToOne 0.00 255.0 FORMAT "%5.1" /end CHARACTERISTIC
/begin CHARACTERISTIC DSM_FMKDfp_AddPCDTnkLvlDef_C "Ausblendbedingungen fuer Fehlerpfad Dfp_AddPCDTnkLvlDef" VALUE 0x1C9EAF Kw_Wu8 255.0 OneToOne 0.00 255.0 FORMAT "%5.1" /end CHARACTERISTIC
/begin CHARACTERISTIC DSM_FMKDfp_AirCtl_GovDev_C "Ausblendbedingungen fuer Fehlerpfad Dfp_AirCtl_GovDev" VALUE 0x1C9EB0 Kw_Wu8 255.0 OneToOne 0.00 255.0 FORMAT "%5.1" /end CHARACTERISTIC
/begin CHARACTERISTIC DSM_FMKDfp_AirbCDCrash_C "Ausblendbedingungen fuer Fehlerpfad Dfp_AirbCDCrash" VALUE 0x1C9EB1 Kw_Wu8 255.0 OneToOne 0.00 255.0 FORMAT "%5.1" /end CHARACTERISTIC
/begin CHARACTERISTIC DSM_FMKDfp_AirbCDCrashCrCtl_C "Ausblendbedingungen fuer Fehlerpfad Dfp_AirbCDCrashCrCtl" VALUE 0x1C9EB2 Kw_Wu8 255.0 OneToOne 0.00 255.0 FORMAT "%5.1" /end CHARACTERISTIC
/begin CHARACTERISTIC DSM_FMKDfp_AirbCDCrashPSP_C "Ausblendbedingungen fuer Fehlerpfad Dfp_AirbCDCrashPSP" VALUE 0x1C9EB3 Kw_Wu8 255.0 OneToOne 0.00 255.0 FORMAT "%5.1" /end CHARACTERISTIC
/begin CHARACTERISTIC DSM_FMKDfp_AltCDExc_C "Ausblendbedingungen fuer Fehlerpfad Dfp_AltCDExc" VALUE 0x1C9EB4 Kw_Wu8 255.0 OneToOne 0.00 255.0 FORMAT "%5.1" /end CHARACTERISTIC
/begin CHARACTERISTIC DSM_FMKDfp_AltCD_Load_C "Ausblendbedingungen fuer Fehlerpfad Dfp_AltCD_Load" VALUE 0x1C9EB5 Kw_Wu8 255.0 OneToOne 0.00 255.0 FORMAT "%5.1" /end CHARACTERISTIC
/begin CHARACTERISTIC DSM_FMKDfp_AltPwrCan_C "Ausblendbedingungen fuer Fehlerpfad Dfp_AltPwrCan" VALUE 0x1C9EB6 Kw_Wu8 255.0 OneToOne 0.00 255.0 FORMAT "%5.1" /end CHARACTERISTIC
/begin CHARACTERISTIC DSM_FMKDfp_BPACD_Max_C "Ausblendbedingungen fuer Fehlerpfad Dfp_BPACD_Max" VALUE 0x1C9EB7 Kw_Wu8 255.0 OneToOne 0.00 255.0 FORMAT "%5.1" /end CHARACTERISTIC
/begin CHARACTERISTIC DSM_FMKDfp_BPACD_Min_C "Ausblendbedingungen fuer Fehlerpfad Dfp_BPACD_Min" VALUE 0x1C9EB8 Kw_Wu8 255.0 OneToOne 0.00 255.0 FORMAT "%5.1" /end CHARACTERISTIC
/begin CHARACTERISTIC DSM_FMKDfp_BPACD_SigNpl_C "Ausblendbedingungen fuer Fehlerpfad Dfp_BPACD_SigNpl" VALUE 0x1C9EB9 Kw_Wu8 255.0 OneToOne 0.00 255.0 FORMAT "%5.1" /end CHARACTERISTIC
/begin CHARACTERISTIC DSM_FMKDfp_BPAExcSensTemp_C "Ausblendbedingungen fuer Fehlerpfad Dfp_BPAExcSensTemp" VALUE 0x1C9EBA Kw_Wu8 255.0 OneToOne 0.00 255.0 FORMAT "%5.1" /end CHARACTERISTIC
/begin CHARACTERISTIC DSM_FMKDfp_BPANotLrn_C "Ausblendbedingungen fuer Fehlerpfad Dfp_BPANotLrn" VALUE 0x1C9EBB Kw_Wu8 255.0 OneToOne 0.00 255.0 FORMAT "%5.1" /end CHARACTERISTIC
/begin CHARACTERISTIC DSM_FMKDfp_BPASCDDcyc_C "Ausblendbedingungen fuer Fehlerpfad Dfp_BPASCDDcyc" VALUE 0x1C9EBC Kw_Wu8 255.0 OneToOne 0.00 255.0 FORMAT "%5.1" /end CHARACTERISTIC
/begin CHARACTERISTIC DSM_FMKDfp_BPASCDPeriod_C "Ausblendbedingungen fuer Fehlerpfad Dfp_BPASCDPeriod" VALUE 0x1C9EBD Kw_Wu8 255.0 OneToOne 0.00 255.0 FORMAT "%5.1" /end CHARACTERISTIC
/begin CHARACTERISTIC DSM_FMKDfp_BPSCD_C "Ausblendbedingungen fuer Fehlerpfad Dfp_BPSCD" VALUE 0x1C9EBE Kw_Wu8 255.0 OneToOne 0.00 255.0 FORMAT "%5.1" /end CHARACTERISTIC
/begin CHARACTERISTIC DSM_FMKDfp_BPSCDPlaus_C "Ausblendbedingungen fuer Fehlerpfad Dfp_BPSCDPlaus" VALUE 0x1C9EBF Kw_Wu8 255.0 OneToOne 0.00 255.0 FORMAT "%5.1" /end CHARACTERISTIC
/begin CHARACTERISTIC DSM_FMKDfp_BattCD_C "Ausblendbedingungen fuer Fehlerpfad Dfp_BattCD" VALUE 0x1C9EC0 Kw_Wu8 255.0 OneToOne 0.00 255.0 FORMAT "%5.1" /end CHARACTERISTIC
/begin CHARACTERISTIC DSM_FMKDfp_BrkCD_C "Ausblendbedingungen fuer Fehlerpfad Dfp_BrkCD" VALUE 0x1C9EC1 Kw_Wu8 255.0 OneToOne 0.00 255.0 FORMAT "%5.1" /end CHARACTERISTIC
/begin CHARACTERISTIC DSM_FMKDfp_BrkCDdynPl_C "Ausblendbedingungen fuer Fehlerpfad Dfp_BrkCDdynPl" VALUE 0x1C9EC2 Kw_Wu8 255.0 OneToOne 0.00 255.0 FORMAT "%5.1" /end CHARACTERISTIC
/begin CHARACTERISTIC DSM_FMKDfp_CANA_C "Ausblendbedingungen fuer Fehlerpfad Dfp_CANA" VALUE 0x1C9EC3 Kw_Wu8 255.0 OneToOne 0.00 255.0 FORMAT "%5.1" /end CHARACTERISTIC
/begin CHARACTERISTIC DSM_FMKDfp_CANB_C "Ausblendbedingungen fuer Fehlerpfad Dfp_CANB" VALUE 0x1C9EC4 Kw_Wu8 255.0 OneToOne 0.00 255.0 FORMAT "%5.1" /end CHARACTERISTIC
/begin CHARACTERISTIC DSM_FMKDfp_CANBus1_C "Ausblendbedingungen fuer Fehlerpfad Dfp_CANBus1" VALUE 0x1C9EC5 Kw_Wu8 255.0 OneToOne 0.00 255.0 FORMAT "%5.1" /end CHARACTERISTIC
/begin CHARACTERISTIC DSM_FMKDfp_CANBus2_C "Ausblendbedingungen fuer Fehlerpfad Dfp_CANBus2" VALUE 0x1C9EC6 Kw_Wu8 255.0 OneToOne 0.00 255.0 FORMAT "%5.1" /end CHARACTERISTIC
/begin CHARACTERISTIC DSM_FMKDfp_CANBus3_C "Ausblendbedingungen fuer Fehlerpfad Dfp_CANBus3" VALUE 0x1C9EC7 Kw_Wu8 255.0 OneToOne 0.00 255.0 FORMAT "%5.1" /end CHARACTERISTIC
/begin CHARACTERISTIC DSM_FMKDfp_CANC_C "Ausblendbedingungen fuer Fehlerpfad Dfp_CANC" VALUE 0x1C9EC8 Kw_Wu8 255.0 OneToOne 0.00 255.0 FORMAT "%5.1" /end CHARACTERISTIC
/begin CHARACTERISTIC DSM_FMKDfp_CANErrActA_C "Ausblendbedingungen fuer Fehlerpfad Dfp_CANErrActA" VALUE 0x1C9EC9 Kw_Wu8 255.0 OneToOne 0.00 255.0 FORMAT "%5.1" /end CHARACTERISTIC
/begin CHARACTERISTIC DSM_FMKDfp_CANErrActB_C "Ausblendbedingungen fuer Fehlerpfad Dfp_CANErrActB" VALUE 0x1C9ECA Kw_Wu8 255.0 OneToOne 0.00 255.0 FORMAT "%5.1" /end CHARACTERISTIC
/begin CHARACTERISTIC DSM_FMKDfp_CANErrActC_C "Ausblendbedingungen fuer Fehlerpfad Dfp_CANErrActC" VALUE 0x1C9ECB Kw_Wu8 255.0 OneToOne 0.00 255.0 FORMAT "%5.1" /end CHARACTERISTIC
/begin CHARACTERISTIC DSM_FMKDfp_COTSCD_C "Ausblendbedingungen fuer Fehlerpfad Dfp_COTSCD" VALUE 0x1C9ECC Kw_Wu8 255.0 OneToOne 0.00 255.0 FORMAT "%5.1" /end CHARACTERISTIC
/begin CHARACTERISTIC DSM_FMKDfp_CTSCD_C "Ausblendbedingungen fuer Fehlerpfad Dfp_CTSCD" VALUE 0x1C9ECD Kw_Wu8 255.0 OneToOne 0.00 255.0 FORMAT "%5.1" /end CHARACTERISTIC
/begin CHARACTERISTIC DSM_FMKDfp_CTSCDCanInac_C "Ausblendbedingungen fuer Fehlerpfad Dfp_CTSCDCanInac" VALUE 0x1C9ECE Kw_Wu8 255.0 OneToOne 0.00 255.0 FORMAT "%5.1" /end CHARACTERISTIC
/begin CHARACTERISTIC DSM_FMKDfp_CTSCDCanSig_C "Ausblendbedingungen fuer Fehlerpfad Dfp_CTSCDCanSig" VALUE 0x1C9ECF Kw_Wu8 255.0 OneToOne 0.00 255.0 FORMAT "%5.1" /end CHARACTERISTIC
/begin CHARACTERISTIC DSM_FMKDfp_Clg_DynTst_C "Ausblendbedingungen fuer Fehlerpfad Dfp_Clg_DynTst" VALUE 0x1C9ED0 Kw_Wu8 255.0 OneToOne 0.00 255.0 FORMAT "%5.1" /end CHARACTERISTIC
/begin CHARACTERISTIC DSM_FMKDfp_CmbChbMisfire1_C "Ausblendbedingungen fuer Fehlerpfad Dfp_CmbChbMisfire1" VALUE 0x1C9ED1 Kw_Wu8 255.0 OneToOne 0.00 255.0 FORMAT "%5.1" /end CHARACTERISTIC
/begin CHARACTERISTIC DSM_FMKDfp_CmbChbMisfire2_C "Ausblendbedingungen fuer Fehlerpfad Dfp_CmbChbMisfire2" VALUE 0x1C9ED2 Kw_Wu8 255.0 OneToOne 0.00 255.0 FORMAT "%5.1" /end CHARACTERISTIC
/begin CHARACTERISTIC DSM_FMKDfp_CmbChbMisfire3_C "Ausblendbedingungen fuer Fehlerpfad Dfp_CmbChbMisfire3" VALUE 0x1C9ED3 Kw_Wu8 255.0 OneToOne 0.00 255.0 FORMAT "%5.1" /end CHARACTERISTIC
/begin CHARACTERISTIC DSM_FMKDfp_CmbChbMisfire4_C "Ausblendbedingungen fuer Fehlerpfad Dfp_CmbChbMisfire4" VALUE 0x1C9ED4 Kw_Wu8 255.0 OneToOne 0.00 255.0 FORMAT "%5.1" /end CHARACTERISTIC
/begin CHARACTERISTIC DSM_FMKDfp_CmbChbMisfire5_C "Ausblendbedingungen fuer Fehlerpfad Dfp_CmbChbMisfire5" VALUE 0x1C9ED5 Kw_Wu8 255.0 OneToOne 0.00 255.0 FORMAT "%5.1" /end CHARACTERISTIC
/begin CHARACTERISTIC DSM_FMKDfp_CmbChbMisfire6_C "Ausblendbedingungen fuer Fehlerpfad Dfp_CmbChbMisfire6" VALUE 0x1C9ED6 Kw_Wu8 255.0 OneToOne 0.00 255.0 FORMAT "%5.1" /end CHARACTERISTIC
/begin CHARACTERISTIC DSM_FMKDfp_CmbChbMisfireMul_C "Ausblendbedingungen fuer Fehlerpfad Dfp_CmbChbMisfireMul" VALUE 0x1C9ED7 Kw_Wu8 255.0 OneToOne 0.00 255.0 FORMAT "%5.1" /end CHARACTERISTIC
/begin CHARACTERISTIC DSM_FMKDfp_CoVMDCSh_C "Ausblendbedingungen fuer Fehlerpfad Dfp_CoVMDCSh" VALUE 0x1C9ED8 Kw_Wu8 255.0 OneToOne 0.00 255.0 FORMAT "%5.1" /end CHARACTERISTIC
/begin CHARACTERISTIC DSM_FMKDfp_CoVMDCSp_C "Ausblendbedingungen fuer Fehlerpfad Dfp_CoVMDCSp" VALUE 0x1C9ED9 Kw_Wu8 255.0 OneToOne 0.00 255.0 FORMAT "%5.1" /end CHARACTERISTIC
/begin CHARACTERISTIC DSM_FMKDfp_CoVehEcoErr_C "Ausblendbedingungen fuer Fehlerpfad Dfp_CoVehEcoErr" VALUE 0x1C9EDA Kw_Wu8 255.0 OneToOne 0.00 255.0 FORMAT "%5.1" /end CHARACTERISTIC
/begin CHARACTERISTIC DSM_FMKDfp_CoVehLvl2_C "Ausblendbedingungen fuer Fehlerpfad Dfp_CoVehLvl2" VALUE 0x1C9EDB Kw_Wu8 255.0 OneToOne 0.00 255.0 FORMAT "%5.1" /end CHARACTERISTIC
/begin CHARACTERISTIC DSM_FMKDfp_ConvCD_C "Ausblendbedingungen fuer Fehlerpfad Dfp_ConvCD" VALUE 0x1C9EDC Kw_Wu8 255.0 OneToOne 0.00 255.0 FORMAT "%5.1" /end CHARACTERISTIC
/begin CHARACTERISTIC DSM_FMKDfp_ConvCD_ConvErr_C "Ausblendbedingungen fuer Fehlerpfad Dfp_ConvCD_ConvErr" VALUE 0x1C9EDD Kw_Wu8 255.0 OneToOne 0.00 255.0 FORMAT "%5.1" /end CHARACTERISTIC
/begin CHARACTERISTIC DSM_FMKDfp_CrCtlPLmpDef_C "Ausblendbedingungen fuer Fehlerpfad Dfp_CrCtlPLmpDef" VALUE 0x1C9EDE Kw_Wu8 255.0 OneToOne 0.00 255.0 FORMAT "%5.1" /end CHARACTERISTIC
/begin CHARACTERISTIC DSM_FMKDfp_CrCtlPShutOff_C "Ausblendbedingungen fuer Fehlerpfad Dfp_CrCtlPShutOff" VALUE 0x1C9EDF Kw_Wu8 255.0 OneToOne 0.00 255.0 FORMAT "%5.1" /end CHARACTERISTIC
/begin CHARACTERISTIC DSM_FMKDfp_CrCtlPTlrDef_C "Ausblendbedingungen fuer Fehlerpfad Dfp_CrCtlPTlrDef" VALUE 0x1C9EE0 Kw_Wu8 255.0 OneToOne 0.00 255.0 FORMAT "%5.1" /end CHARACTERISTIC
/begin CHARACTERISTIC DSM_FMKDfp_CrCtlPanErr_C "Ausblendbedingungen fuer Fehlerpfad Dfp_CrCtlPanErr" VALUE 0x1C9EE1 Kw_Wu8 255.0 OneToOne 0.00 255.0 FORMAT "%5.1" /end CHARACTERISTIC
/begin CHARACTERISTIC DSM_FMKDfp_CrCtlPanSwtErr_C "Ausblendbedingungen fuer Fehlerpfad Dfp_CrCtlPanSwtErr" VALUE 0x1C9EE2 Kw_Wu8 255.0 OneToOne 0.00 255.0 FORMAT "%5.1" /end CHARACTERISTIC
/begin CHARACTERISTIC DSM_FMKDfp_CtApCD_C "Ausblendbedingungen fuer Fehlerpfad Dfp_CtApCD" VALUE 0x1C9EE3 Kw_Wu8 255.0 OneToOne 0.00 255.0 FORMAT "%5.1" /end CHARACTERISTIC
/begin CHARACTERISTIC DSM_FMKDfp_CtTCD_C "Ausblendbedingungen fuer Fehlerpfad Dfp_CtTCD" VALUE 0x1C9EE4 Kw_Wu8 255.0 OneToOne 0.00 255.0 FORMAT "%5.1" /end CHARACTERISTIC
/begin CHARACTERISTIC DSM_FMKDfp_CtT_Mon_C "Ausblendbedingungen fuer Fehlerpfad Dfp_CtT_Mon" VALUE 0x1C9EE5 Kw_Wu8 255.0 OneToOne 0.00 255.0 FORMAT "%5.1" /end CHARACTERISTIC
/begin CHARACTERISTIC DSM_FMKDfp_DifftrqLimErrPat_C "Ausblendbedingungen fuer Fehlerpfad Dfp_DifftrqLimErrPat" VALUE 0x1C9EE6 Kw_Wu8 255.0 OneToOne 0.00 255.0 FORMAT "%5.1" /end CHARACTERISTIC
/begin CHARACTERISTIC DSM_FMKDfp_EATSCD_C "Ausblendbedingungen fuer Fehlerpfad Dfp_EATSCD" VALUE 0x1C9EE7 Kw_Wu8 255.0 OneToOne 0.00 255.0 FORMAT "%5.1" /end CHARACTERISTIC
/begin CHARACTERISTIC DSM_FMKDfp_EATSCDCanInac_C "Ausblendbedingungen fuer Fehlerpfad Dfp_EATSCDCanInac" VALUE 0x1C9EE8 Kw_Wu8 255.0 OneToOne 0.00 255.0 FORMAT "%5.1" /end CHARACTERISTIC
/begin CHARACTERISTIC DSM_FMKDfp_EATSCDCanSig_C "Ausblendbedingungen fuer Fehlerpfad Dfp_EATSCDCanSig" VALUE 0x1C9EE9 Kw_Wu8 255.0 OneToOne 0.00 255.0 FORMAT "%5.1" /end CHARACTERISTIC
/begin CHARACTERISTIC DSM_FMKDfp_EEPCDVarMng_C "Ausblendbedingungen fuer Fehlerpfad Dfp_EEPCDVarMng" VALUE 0x1C9EEA Kw_Wu8 255.0 OneToOne 0.00 255.0 FORMAT "%5.1" /end CHARACTERISTIC
/begin CHARACTERISTIC DSM_FMKDfp_EGPpCDTPreTrbn_C "Ausblendbedingungen fuer Fehlerpfad Dfp_EgPpCDTPreTrbn" VALUE 0x1C9EEB Kw_Wu8 255.0 OneToOne 0.00 255.0 FORMAT "%5.1" /end CHARACTERISTIC
/begin CHARACTERISTIC DSM_FMKDfp_EGPpCDTPreTrbn1_C "Ausblendbedingungen fuer Fehlerpfad Dfp_EGPpCDTPreTrbn1" VALUE 0x1C9EEC Kw_Wu8 255.0 OneToOne 0.00 255.0 FORMAT "%5.1" /end CHARACTERISTIC
/begin CHARACTERISTIC DSM_FMKDfp_EGRCD_CBV_C "Ausblendbedingungen fuer Fehlerpfad Dfp_EGRCD_CBV" VALUE 0x1C9EED Kw_Wu8 255.0 OneToOne 0.00 255.0 FORMAT "%5.1" /end CHARACTERISTIC
/begin CHARACTERISTIC DSM_FMKDfp_EGRCD_Max_C "Ausblendbedingungen fuer Fehlerpfad Dfp_EGRCD_Max" VALUE 0x1C9EEE Kw_Wu8 255.0 OneToOne 0.00 255.0 FORMAT "%5.1" /end CHARACTERISTIC
/begin CHARACTERISTIC DSM_FMKDfp_EGRCD_Min_C "Ausblendbedingungen fuer Fehlerpfad Dfp_EGRCD_Min" VALUE 0x1C9EEF Kw_Wu8 255.0 OneToOne 0.00 255.0 FORMAT "%5.1" /end CHARACTERISTIC
/begin CHARACTERISTIC DSM_FMKDfp_EGRCD_SigNpl_C "Ausblendbedingungen fuer Fehlerpfad Dfp_EGRCD_SigNpl" VALUE 0x1C9EF0 Kw_Wu8 255.0 OneToOne 0.00 255.0 FORMAT "%5.1" /end CHARACTERISTIC
/begin CHARACTERISTIC DSM_FMKDfp_EMCCD_GTL1_C "Ausblendbedingungen fuer Fehlerpfad Dfp_EMCCD_GTL1" VALUE 0x1C9EF1 Kw_Wu8 255.0 OneToOne 0.00 255.0 FORMAT "%5.1" /end CHARACTERISTIC
/begin CHARACTERISTIC DSM_FMKDfp_EMCCD_GTL2_C "Ausblendbedingungen fuer Fehlerpfad Dfp_EMCCD_GTL2" VALUE 0x1C9EF2 Kw_Wu8 255.0 OneToOne 0.00 255.0 FORMAT "%5.1" /end CHARACTERISTIC
/begin CHARACTERISTIC DSM_FMKDfp_EMCCD_MLS1_C "Ausblendbedingungen fuer Fehlerpfad Dfp_EMCCD_MLS1" VALUE 0x1C9EF3 Kw_Wu8 255.0 OneToOne 0.00 255.0 FORMAT "%5.1" /end CHARACTERISTIC
/begin CHARACTERISTIC DSM_FMKDfp_EMCCD_MLS2_C "Ausblendbedingungen fuer Fehlerpfad Dfp_EMCCD_MLS2" VALUE 0x1C9EF4 Kw_Wu8 255.0 OneToOne 0.00 255.0 FORMAT "%5.1" /end CHARACTERISTIC
/begin CHARACTERISTIC DSM_FMKDfp_ETClbInj1_C "Ausblendbedingungen fuer Fehlerpfad Dfp_ETClbInj1" VALUE 0x1C9EF5 Kw_Wu8 255.0 OneToOne 0.00 255.0 FORMAT "%5.1" /end CHARACTERISTIC
/begin CHARACTERISTIC DSM_FMKDfp_ETClbInj2_C "Ausblendbedingungen fuer Fehlerpfad Dfp_ETClbInj2" VALUE 0x1C9EF6 Kw_Wu8 255.0 OneToOne 0.00 255.0 FORMAT "%5.1" /end CHARACTERISTIC
/begin CHARACTERISTIC DSM_FMKDfp_ETClbInj3_C "Ausblendbedingungen fuer Fehlerpfad Dfp_ETClbInj3" VALUE 0x1C9EF7 Kw_Wu8 255.0 OneToOne 0.00 255.0 FORMAT "%5.1" /end CHARACTERISTIC
/begin CHARACTERISTIC DSM_FMKDfp_ETClbInj4_C "Ausblendbedingungen fuer Fehlerpfad Dfp_ETClbInj4" VALUE 0x1C9EF8 Kw_Wu8 255.0 OneToOne 0.00 255.0 FORMAT "%5.1" /end CHARACTERISTIC
/begin CHARACTERISTIC DSM_FMKDfp_ETClbInj5_C "Ausblendbedingungen fuer Fehlerpfad Dfp_ETClbInj5" VALUE 0x1C9EF9 Kw_Wu8 255.0 OneToOne 0.00 255.0 FORMAT "%5.1" /end CHARACTERISTIC
/begin CHARACTERISTIC DSM_FMKDfp_ETClbInj6_C "Ausblendbedingungen fuer Fehlerpfad Dfp_ETClbInj6" VALUE 0x1C9EFA Kw_Wu8 255.0 OneToOne 0.00 255.0 FORMAT "%5.1" /end CHARACTERISTIC
/begin CHARACTERISTIC DSM_FMKDfp_EngMCaS1_C "Ausblendbedingungen fuer Fehlerpfad Dfp_EngMCaS1" VALUE 0x1C9EFB Kw_Wu8 255.0 OneToOne 0.00 255.0 FORMAT "%5.1" /end CHARACTERISTIC
/begin CHARACTERISTIC DSM_FMKDfp_EngMCrS1_C "Ausblendbedingungen fuer Fehlerpfad Dfp_EngMCrS1" VALUE 0x1C9EFC Kw_Wu8 255.0 OneToOne 0.00 255.0 FORMAT "%5.1" /end CHARACTERISTIC
/begin CHARACTERISTIC DSM_FMKDfp_EngMOfsCaSCrS_C "Ausblendbedingungen fuer Fehlerpfad Dfp_EngMOfsCaSCrS" VALUE 0x1C9EFD Kw_Wu8 255.0 OneToOne 0.00 255.0 FORMAT "%5.1" /end CHARACTERISTIC
/begin CHARACTERISTIC DSM_FMKDfp_EngMonIrrCmb_C "Ausblendbedingungen fuer Fehlerpfad Dfp_EngMonIrrCmb" VALUE 0x1C9EFE Kw_Wu8 255.0 OneToOne 0.00 255.0 FORMAT "%5.1" /end CHARACTERISTIC
/begin CHARACTERISTIC DSM_FMKDfp_EngPrt_C "Ausblendbedingungen fuer Fehlerpfad Dfp_EngPrt" VALUE 0x1C9EFF Kw_Wu8 255.0 OneToOne 0.00 255.0 FORMAT "%5.1" /end CHARACTERISTIC
/begin CHARACTERISTIC DSM_FMKDfp_ErLpCDMILReqON_C "Ausblendbedingungen fuer Fehlerpfad Dfp_ErLpCDMILReqON" VALUE 0x1C9F00 Kw_Wu8 255.0 OneToOne 0.00 255.0 FORMAT "%5.1" /end CHARACTERISTIC
/begin CHARACTERISTIC DSM_FMKDfp_FMTC_NonMonotonMap_C "Ausblendbedingungen fuer Fehlerpfad Dfp_FMTC_NonMonotonMap" VALUE 0x1C9F01 Kw_Wu8 255.0 OneToOne 0.00 255.0 FORMAT "%5.1" /end CHARACTERISTIC
/begin CHARACTERISTIC DSM_FMKDfp_FQlSCD_C "Ausblendbedingungen fuer Fehlerpfad Dfp_FQlSCD" VALUE 0x1C9F02 Kw_Wu8 255.0 OneToOne 0.00 255.0 FORMAT "%5.1" /end CHARACTERISTIC
/begin CHARACTERISTIC DSM_FMKDfp_FTSCD_C "Ausblendbedingungen fuer Fehlerpfad Dfp_FTSCD" VALUE 0x1C9F03 Kw_Wu8 255.0 OneToOne 0.00 255.0 FORMAT "%5.1" /end CHARACTERISTIC
/begin CHARACTERISTIC DSM_FMKDfp_FTSCDNpl_C "Ausblendbedingungen fuer Fehlerpfad Dfp_FTSCDNpl" VALUE 0x1C9F04 Kw_Wu8 255.0 OneToOne 0.00 255.0 FORMAT "%5.1" /end CHARACTERISTIC
/begin CHARACTERISTIC DSM_FMKDfp_FanCD_Fan1Ctlr1_C "Ausblendbedingungen fuer Fehlerpfad Dfp_FanCD_Fan1Ctlr1" VALUE 0x1C9F05 Kw_Wu8 255.0 OneToOne 0.00 255.0 FORMAT "%5.1" /end CHARACTERISTIC
/begin CHARACTERISTIC DSM_FMKDfp_FanCD_Fan1Ctlr2_C "Ausblendbedingungen fuer Fehlerpfad Dfp_FanCD_Fan1Ctlr2" VALUE 0x1C9F06 Kw_Wu8 255.0 OneToOne 0.00 255.0 FORMAT "%5.1" /end CHARACTERISTIC
/begin CHARACTERISTIC DSM_FMKDfp_FanCD_Fan2Ctlr1_C "Ausblendbedingungen fuer Fehlerpfad Dfp_FanCD_Fan2Ctlr1" VALUE 0x1C9F07 Kw_Wu8 255.0 OneToOne 0.00 255.0 FORMAT "%5.1" /end CHARACTERISTIC
/begin CHARACTERISTIC DSM_FMKDfp_FanCD_Fan2Ctlr2_C "Ausblendbedingungen fuer Fehlerpfad Dfp_FanCD_Fan2Ctlr2" VALUE 0x1C9F08 Kw_Wu8 255.0 OneToOne 0.00 255.0 FORMAT "%5.1" /end CHARACTERISTIC
/begin CHARACTERISTIC DSM_FMKDfp_FanCD_FanCtlr1_C "Ausblendbedingungen fuer Fehlerpfad Dfp_FanCD_FanCtlr1" VALUE 0x1C9F09 Kw_Wu8 255.0 OneToOne 0.00 255.0 FORMAT "%5.1" /end CHARACTERISTIC
/begin CHARACTERISTIC DSM_FMKDfp_FanCD_FanCtlr2_C "Ausblendbedingungen fuer Fehlerpfad Dfp_FanCD_FanCtlr2" VALUE 0x1C9F0A Kw_Wu8 255.0 OneToOne 0.00 255.0 FORMAT "%5.1" /end CHARACTERISTIC
/begin CHARACTERISTIC DSM_FMKDfp_FanCD_OutFanCtlr1_C "Ausblendbedingungen fuer Fehlerpfad Dfp_FanCD_OutFanCtlr1" VALUE 0x1C9F0B Kw_Wu8 255.0 OneToOne 0.00 255.0 FORMAT "%5.1" /end CHARACTERISTIC
/begin CHARACTERISTIC DSM_FMKDfp_FanCD_OutFanCtlr2_C "Ausblendbedingungen fuer Fehlerpfad Dfp_FanCD_OutFanCtlr2" VALUE 0x1C9F0C Kw_Wu8 255.0 OneToOne 0.00 255.0 FORMAT "%5.1" /end CHARACTERISTIC
/begin CHARACTERISTIC DSM_FMKDfp_FlPpCD_C "Ausblendbedingungen fuer Fehlerpfad Dfp_FlPpCD" VALUE 0x1C9F0D Kw_Wu8 255.0 OneToOne 0.00 255.0 FORMAT "%5.1" /end CHARACTERISTIC
/begin CHARACTERISTIC DSM_FMKDfp_FlSCDT1_C "Ausblendbedingungen fuer Fehlerpfad Dfp_FlSCDT1" VALUE 0x1C9F0E Kw_Wu8 255.0 OneToOne 0.00 255.0 FORMAT "%5.1" /end CHARACTERISTIC
/begin CHARACTERISTIC DSM_FMKDfp_FrmMngAAGNpl_C "Ausblendbedingungen fuer Fehlerpfad Dfp_FrmMngAAGNpl" VALUE 0x1C9F0F Kw_Wu8 255.0 OneToOne 0.00 255.0 FORMAT "%5.1" /end CHARACTERISTIC
/begin CHARACTERISTIC DSM_FMKDfp_FrmMngAAGTO_C "Ausblendbedingungen fuer Fehlerpfad Dfp_FrmMngAAGTO" VALUE 0x1C9F10 Kw_Wu8 255.0 OneToOne 0.00 255.0 FORMAT "%5.1" /end CHARACTERISTIC
/begin CHARACTERISTIC DSM_FMKDfp_FrmMngAC1Npl_C "Ausblendbedingungen fuer Fehlerpfad Dfp_FrmMngAC1Npl" VALUE 0x1C9F11 Kw_Wu8 255.0 OneToOne 0.00 255.0 FORMAT "%5.1" /end CHARACTERISTIC
/begin CHARACTERISTIC DSM_FMKDfp_FrmMngAC1TO_C "Ausblendbedingungen fuer Fehlerpfad Dfp_FrmMngAC1TO" VALUE 0x1C9F12 Kw_Wu8 255.0 OneToOne 0.00 255.0 FORMAT "%5.1" /end CHARACTERISTIC
/begin CHARACTERISTIC DSM_FMKDfp_FrmMngACCNpl_C "Ausblendbedingungen fuer Fehlerpfad Dfp_FrmMngACCNpl" VALUE 0x1C9F13 Kw_Wu8 255.0 OneToOne 0.00 255.0 FORMAT "%5.1" /end CHARACTERISTIC
/begin CHARACTERISTIC DSM_FMKDfp_FrmMngACCTO_C "Ausblendbedingungen fuer Fehlerpfad Dfp_FrmMngACCTO" VALUE 0x1C9F14 Kw_Wu8 255.0 OneToOne 0.00 255.0 FORMAT "%5.1" /end CHARACTERISTIC
/begin CHARACTERISTIC DSM_FMKDfp_FrmMngAIRBGNpl_C "Ausblendbedingungen fuer Fehlerpfad Dfp_FrmMngAIRBGNpl" VALUE 0x1C9F15 Kw_Wu8 255.0 OneToOne 0.00 255.0 FORMAT "%5.1" /end CHARACTERISTIC
/begin CHARACTERISTIC DSM_FMKDfp_FrmMngAIRBGTO_C "Ausblendbedingungen fuer Fehlerpfad Dfp_FrmMngAIRBGTO" VALUE 0x1C9F16 Kw_Wu8 255.0 OneToOne 0.00 255.0 FORMAT "%5.1" /end CHARACTERISTIC
/begin CHARACTERISTIC DSM_FMKDfp_FrmMngAWD1Npl_C "Ausblendbedingungen fuer Fehlerpfad Dfp_FrmMngAWD1Npl" VALUE 0x1C9F17 Kw_Wu8 255.0 OneToOne 0.00 255.0 FORMAT "%5.1" /end CHARACTERISTIC
/begin CHARACTERISTIC DSM_FMKDfp_FrmMngAWD1TO_C "Ausblendbedingungen fuer Fehlerpfad Dfp_FrmMngAWD1TO" VALUE 0x1C9F18 Kw_Wu8 255.0 OneToOne 0.00 255.0 FORMAT "%5.1" /end CHARACTERISTIC
/begin CHARACTERISTIC DSM_FMKDfp_FrmMngBEM1Npl_C "Ausblendbedingungen für Fehlerpfad Dfp_FrmMngBEM1Npl" VALUE 0x1C9F19 Kw_Wu8 255.0 OneToOne 0.00 255.0 FORMAT "%5.1" /end CHARACTERISTIC
/begin CHARACTERISTIC DSM_FMKDfp_FrmMngBEM1TO_C "Ausblendbedingungen fuer Fehlerpfad Dfp_FrmMngBEM1TO" VALUE 0x1C9F1A Kw_Wu8 255.0 OneToOne 0.00 255.0 FORMAT "%5.1" /end CHARACTERISTIC
/begin CHARACTERISTIC DSM_FMKDfp_FrmMngBRK1Npl_C "Ausblendbedingungen fuer Fehlerpfad Dfp_FrmMngBRK1Npl" VALUE 0x1C9F1B Kw_Wu8 255.0 OneToOne 0.00 255.0 FORMAT "%5.1" /end CHARACTERISTIC
/begin CHARACTERISTIC DSM_FMKDfp_FrmMngBRK1TO_C "Ausblendbedingungen fuer Fehlerpfad Dfp_FrmMngBRK1TO" VALUE 0x1C9F1C Kw_Wu8 255.0 OneToOne 0.00 255.0 FORMAT "%5.1" /end CHARACTERISTIC
/begin CHARACTERISTIC DSM_FMKDfp_FrmMngBRK2Npl_C "Ausblendbedingungen fuer Fehlerpfad Dfp_FrmMngBRK2Npl" VALUE 0x1C9F1D Kw_Wu8 255.0 OneToOne 0.00 255.0 FORMAT "%5.1" /end CHARACTERISTIC
/begin CHARACTERISTIC DSM_FMKDfp_FrmMngBRK2TO_C "Ausblendbedingungen fuer Fehlerpfad Dfp_FrmMngBRK2TO" VALUE 0x1C9F1E Kw_Wu8 255.0 OneToOne 0.00 255.0 FORMAT "%5.1" /end CHARACTERISTIC
/begin CHARACTERISTIC DSM_FMKDfp_FrmMngBRK8Npl_C "Ausblendbedingungen fuer Fehlerpfad Dfp_FrmMngBRK8Npl" VALUE 0x1C9F1F Kw_Wu8 255.0 OneToOne 0.00 255.0 FORMAT "%5.1" /end CHARACTERISTIC
/begin CHARACTERISTIC DSM_FMKDfp_FrmMngBRK8TO_C "Ausblendbedingungen fuer Fehlerpfad Dfp_FrmMngBRK8TO" VALUE 0x1C9F20 Kw_Wu8 255.0 OneToOne 0.00 255.0 FORMAT "%5.1" /end CHARACTERISTIC
/begin CHARACTERISTIC DSM_FMKDfp_FrmMngCANVerErr_C "Ausblendbedingungen fuer Fehlerpfad Dfp_FrmMngCANVerErr" VALUE 0x1C9F21 Kw_Wu8 255.0 OneToOne 0.00 255.0 FORMAT "%5.1" /end CHARACTERISTIC
/begin CHARACTERISTIC DSM_FMKDfp_FrmMngCCSel_C "Ausblendbedingungen fuer Fehlerpfad Dfp_FrmMngCCSel_C" VALUE 0x1C9F22 Kw_Wu8 255.0 OneToOne 0.00 255.0 FORMAT "%5.1" /end CHARACTERISTIC
/begin CHARACTERISTIC DSM_FMKDfp_FrmMngCCTLNpl_C "Ausblendbedingungen fuer Fehlerpfad Dfp_FrmMngCCTLNpl" VALUE 0x1C9F23 Kw_Wu8 255.0 OneToOne 0.00 255.0 FORMAT "%5.1" /end CHARACTERISTIC
/begin CHARACTERISTIC DSM_FMKDfp_FrmMngCCTLTO_C "Ausblendbedingungen fuer Fehlerpfad Dfp_FrmMngCCTLTO" VALUE 0x1C9F24 Kw_Wu8 255.0 OneToOne 0.00 255.0 FORMAT "%5.1" /end CHARACTERISTIC
/begin CHARACTERISTIC DSM_FMKDfp_FrmMngCHRGR1Npl_C "Ausblendbedingungen fuer Fehlerpfad Dfp_FrmMngCHRGR1Npl" VALUE 0x1C9F25 Kw_Wu8 255.0 OneToOne 0.00 255.0 FORMAT "%5.1" /end CHARACTERISTIC
/begin CHARACTERISTIC DSM_FMKDfp_FrmMngCHRGR1TO_C "Ausblendbedingungen fuer Fehlerpfad Dfp_FrmMngCHRGR1TO" VALUE 0x1C9F26 Kw_Wu8 255.0 OneToOne 0.00 255.0 FORMAT "%5.1" /end CHARACTERISTIC
/begin CHARACTERISTIC DSM_FMKDfp_FrmMngCHRGR2Npl_C "Ausblendbedingungen fuer Fehlerpfad Dfp_FrmMngCHRGR2Npl" VALUE 0x1C9F27 Kw_Wu8 255.0 OneToOne 0.00 255.0 FORMAT "%5.1" /end CHARACTERISTIC
/begin CHARACTERISTIC DSM_FMKDfp_FrmMngCHRGR2TO_C "Ausblendbedingungen fuer Fehlerpfad Dfp_FrmMngCHRGR2TO" VALUE 0x1C9F28 Kw_Wu8 255.0 OneToOne 0.00 255.0 FORMAT "%5.1" /end CHARACTERISTIC
/begin CHARACTERISTIC DSM_FMKDfp_FrmMngChrgr1A_C "Ausblendbedingungen fuer Fehlerpfad Dfp_FrmMngChrgr1A" VALUE 0x1C9F29 Kw_Wu8 255.0 OneToOne 0.00 255.0 FORMAT "%5.1" /end CHARACTERISTIC
/begin CHARACTERISTIC DSM_FMKDfp_FrmMngChrgr1C_C "Ausblendbedingungen fuer Fehlerpfad Dfp_FrmMngChrgr1C" VALUE 0x1C9F2A Kw_Wu8 255.0 OneToOne 0.00 255.0 FORMAT "%5.1" /end CHARACTERISTIC
/begin CHARACTERISTIC DSM_FMKDfp_FrmMngChrgr1N_C "Ausblendbedingungen fuer Fehlerpfad Dfp_FrmMngChrgr1N" VALUE 0x1C9F2B Kw_Wu8 255.0 OneToOne 0.00 255.0 FORMAT "%5.1" /end CHARACTERISTIC
/begin CHARACTERISTIC DSM_FMKDfp_FrmMngChrgr1T_C "Ausblendbedingungen fuer Fehlerpfad Dfp_FrmMngChrgr1T" VALUE 0x1C9F2C Kw_Wu8 255.0 OneToOne 0.00 255.0 FORMAT "%5.1" /end CHARACTERISTIC
/begin CHARACTERISTIC DSM_FMKDfp_FrmMngChrgr1V_C "Ausblendbedingungen fuer Fehlerpfad Dfp_FrmMngChrgr1V" VALUE 0x1C9F2D Kw_Wu8 255.0 OneToOne 0.00 255.0 FORMAT "%5.1" /end CHARACTERISTIC
/begin CHARACTERISTIC DSM_FMKDfp_FrmMngChrgr2A_C "Ausblendbedingungen fuer Fehlerpfad Dfp_FrmMngChrgr2A" VALUE 0x1C9F2E Kw_Wu8 255.0 OneToOne 0.00 255.0 FORMAT "%5.1" /end CHARACTERISTIC
/begin CHARACTERISTIC DSM_FMKDfp_FrmMngChrgr2C_C "Ausblendbedingungen fuer Fehlerpfad Dfp_FrmMngChrgr2C" VALUE 0x1C9F2F Kw_Wu8 255.0 OneToOne 0.00 255.0 FORMAT "%5.1" /end CHARACTERISTIC
/begin CHARACTERISTIC DSM_FMKDfp_FrmMngChrgr2N_C "Ausblendbedingungen fuer Fehlerpfad Dfp_FrmMngChrgr2N" VALUE 0x1C9F30 Kw_Wu8 255.0 OneToOne 0.00 255.0 FORMAT "%5.1" /end CHARACTERISTIC
/begin CHARACTERISTIC DSM_FMKDfp_FrmMngChrgr2T_C "Ausblendbedingungen fuer Fehlerpfad Dfp_FrmMngChrgr2T" VALUE 0x1C9F31 Kw_Wu8 255.0 OneToOne 0.00 255.0 FORMAT "%5.1" /end CHARACTERISTIC
/begin CHARACTERISTIC DSM_FMKDfp_FrmMngChrgr2V_C "Ausblendbedingungen fuer Fehlerpfad Dfp_FrmMngChrgr2V" VALUE 0x1C9F32 Kw_Wu8 255.0 OneToOne 0.00 255.0 FORMAT "%5.1" /end CHARACTERISTIC
/begin CHARACTERISTIC DSM_FMKDfp_FrmMngDIA1Npl_C "Ausblendbedingungen fuer Fehlerpfad Dfp_FrmMngDIA1Npl" VALUE 0x1C9F33 Kw_Wu8 255.0 OneToOne 0.00 255.0 FORMAT "%5.1" /end CHARACTERISTIC
/begin CHARACTERISTIC DSM_FMKDfp_FrmMngDIA1TO_C "Durch Fehlerpfad Dfp_FrmMngDIA1TO verriegelte Funktionsidentifier" VALUE 0x1C9F34 Kw_Wu8 255.0 OneToOne 0.00 255.0 FORMAT "%5.1" /end CHARACTERISTIC
/begin CHARACTERISTIC DSM_FMKDfp_FrmMngDSP1Npl_C "Ausblendbedingungen fuer Fehlerpfad Dfp_FrmMngDSP1Npl" VALUE 0x1C9F35 Kw_Wu8 255.0 OneToOne 0.00 255.0 FORMAT "%5.1" /end CHARACTERISTIC
/begin CHARACTERISTIC DSM_FMKDfp_FrmMngDSP1TO_C "Ausblendbedingungen fuer Fehlerpfad Dfp_FrmMngDSP1TO" VALUE 0x1C9F36 Kw_Wu8 255.0 OneToOne 0.00 255.0 FORMAT "%5.1" /end CHARACTERISTIC
/begin CHARACTERISTIC DSM_FMKDfp_FrmMngDSP2Npl_C "Ausblendbedingungen fuer Fehlerpfad Dfp_FrmMngDSP2Npl" VALUE 0x1C9F37 Kw_Wu8 255.0 OneToOne 0.00 255.0 FORMAT "%5.1" /end CHARACTERISTIC
/begin CHARACTERISTIC DSM_FMKDfp_FrmMngDSP2TO_C "Ausblendbedingungen fuer Fehlerpfad Dfp_FrmMngDSP2TO" VALUE 0x1C9F38 Kw_Wu8 255.0 OneToOne 0.00 255.0 FORMAT "%5.1" /end CHARACTERISTIC
/begin CHARACTERISTIC DSM_FMKDfp_FrmMngESCUNpl_C "Ausblendbedingungen fuer Fehlerpfad Dfp_FrmMngESCUNpl" VALUE 0x1C9F39 Kw_Wu8 255.0 OneToOne 0.00 255.0 FORMAT "%5.1" /end CHARACTERISTIC
/begin CHARACTERISTIC DSM_FMKDfp_FrmMngESCUTO_C "Ausblendbedingungen fuer Fehlerpfad Dfp_FrmMngESCUTO" VALUE 0x1C9F3A Kw_Wu8 255.0 OneToOne 0.00 255.0 FORMAT "%5.1" /end CHARACTERISTIC
/begin CHARACTERISTIC DSM_FMKDfp_FrmMngGW1Npl_C "Ausblendbedingungen fuer Fehlerpfad Dfp_FrmMngGW1Npl" VALUE 0x1C9F3B Kw_Wu8 255.0 OneToOne 0.00 255.0 FORMAT "%5.1" /end CHARACTERISTIC
/begin CHARACTERISTIC DSM_FMKDfp_FrmMngGW1TO_C "Ausblendbedingungen fuer Fehlerpfad Dfp_FrmMngGW1TO" VALUE 0x1C9F3C Kw_Wu8 255.0 OneToOne 0.00 255.0 FORMAT "%5.1" /end CHARACTERISTIC
/begin CHARACTERISTIC DSM_FMKDfp_FrmMngILMNpl_C "Ausblendbedingungen fuer Fehlerpfad Dfp_FrmMngILMNpl" VALUE 0x1C9F3D Kw_Wu8 255.0 OneToOne 0.00 255.0 FORMAT "%5.1" /end CHARACTERISTIC
/begin CHARACTERISTIC DSM_FMKDfp_FrmMngILMTO_C "Ausblendbedingungen fuer Fehlerpfad Dfp_FrmMngILMTO" VALUE 0x1C9F3E Kw_Wu8 255.0 OneToOne 0.00 255.0 FORMAT "%5.1" /end CHARACTERISTIC
/begin CHARACTERISTIC DSM_FMKDfp_FrmMngNIV1WrngCod_C "Ausblendbedingungen fuer Fehlerpfad Dfp_FrmMngNIV1WrngCod" VALUE 0x1C9F3F Kw_Wu8 255.0 OneToOne 0.00 255.0 FORMAT "%5.1" /end CHARACTERISTIC
/begin CHARACTERISTIC DSM_FMKDfp_FrmMngNIVEAU1Npl_C "Ausblendbedingungen fuer Fehlerpfad Dfp_FrmMngNIVEAU1Npl" VALUE 0x1C9F40 Kw_Wu8 255.0 OneToOne 0.00 255.0 FORMAT "%5.1" /end CHARACTERISTIC
/begin CHARACTERISTIC DSM_FMKDfp_FrmMngNIVEAU1TO_C "Ausblendbedingungen fuer Fehlerpfad Dfp_FrmMngNIVEAU1TO" VALUE 0x1C9F41 Kw_Wu8 255.0 OneToOne 0.00 255.0 FORMAT "%5.1" /end CHARACTERISTIC
/begin CHARACTERISTIC DSM_FMKDfp_FrmMngSTIGNNpl_C "Ausblendbedingungen fuer Fehlerpfad Dfp_FrmMngSTIGNNpl" VALUE 0x1C9F42 Kw_Wu8 255.0 OneToOne 0.00 255.0 FORMAT "%5.1" /end CHARACTERISTIC
/begin CHARACTERISTIC DSM_FMKDfp_FrmMngStIgnTO_C "Ausblendbedingungen fuer Fehlerpfad Dfp_FrmMngStIgnTO" VALUE 0x1C9F43 Kw_Wu8 255.0 OneToOne 0.00 255.0 FORMAT "%5.1" /end CHARACTERISTIC
/begin CHARACTERISTIC DSM_FMKDfp_FrmMngTOSNpl_C "Ausblendbedingungen fuer Fehlerpfad Dfp_FrmMngTOSNpl" VALUE 0x1C9F44 Kw_Wu8 255.0 OneToOne 0.00 255.0 FORMAT "%5.1" /end CHARACTERISTIC
/begin CHARACTERISTIC DSM_FMKDfp_FrmMngTOSTO_C "Ausblendbedingungen fuer Fehlerpfad Dfp_FrmMngTOSTO" VALUE 0x1C9F45 Kw_Wu8 255.0 OneToOne 0.00 255.0 FORMAT "%5.1" /end CHARACTERISTIC
/begin CHARACTERISTIC DSM_FMKDfp_FrmMngTSC1Npl_C "Ausblendbedingungen fuer Fehlerpfad Dfp_FrmMngTSC1Npl" VALUE 0x1C9F46 Kw_Wu8 255.0 OneToOne 0.00 255.0 FORMAT "%5.1" /end CHARACTERISTIC
/begin CHARACTERISTIC DSM_FMKDfp_FrmMngTSC1TO_C "Ausblendbedingungen fuer Fehlerpfad Dfp_FrmMngTSC1TO" VALUE 0x1C9F47 Kw_Wu8 255.0 OneToOne 0.00 255.0 FORMAT "%5.1" /end CHARACTERISTIC
/begin CHARACTERISTIC DSM_FMKDfp_FrmMngTSC2Npl_C "Ausblendbedingungen fuer Fehlerpfad Dfp_FrmMngTSC2Npl" VALUE 0x1C9F48 Kw_Wu8 255.0 OneToOne 0.00 255.0 FORMAT "%5.1" /end CHARACTERISTIC
/begin CHARACTERISTIC DSM_FMKDfp_FrmMngTSC2TO_C "Ausblendbedingungen fuer Fehlerpfad Dfp_FrmMngTSC2TO" VALUE 0x1C9F49 Kw_Wu8 255.0 OneToOne 0.00 255.0 FORMAT "%5.1" /end CHARACTERISTIC
/begin CHARACTERISTIC DSM_FMKDfp_FrmMngTSC3Npl_C "Ausblendbedingungen fuer Fehlerpfad Dfp_FrmMngTSC3Npl" VALUE 0x1C9F4A Kw_Wu8 255.0 OneToOne 0.00 255.0 FORMAT "%5.1" /end CHARACTERISTIC
/begin CHARACTERISTIC DSM_FMKDfp_FrmMngTSC3TO_C "Ausblendbedingungen fuer Fehlerpfad Dfp_FrmMngTSC3TO" VALUE 0x1C9F4B Kw_Wu8 255.0 OneToOne 0.00 255.0 FORMAT "%5.1" /end CHARACTERISTIC
/begin CHARACTERISTIC DSM_FMKDfp_GearbxASTh_C "Ausblendbedingungen fuer Fehlerpfad Dfp_GearbxASTh" VALUE 0x1C9F4C Kw_Wu8 255.0 OneToOne 0.00 255.0 FORMAT "%5.1" /end CHARACTERISTIC
/begin CHARACTERISTIC DSM_FMKDfp_GearbxASTl_C "Ausblendbedingungen fuer Fehlerpfad Dfp_GearbxASTl" VALUE 0x1C9F4D Kw_Wu8 255.0 OneToOne 0.00 255.0 FORMAT "%5.1" /end CHARACTERISTIC
/begin CHARACTERISTIC DSM_FMKDfp_GearbxTSC_C "Ausblendbedingungen fuer Fehlerpfad Dfp_GearbxTSC" VALUE 0x1C9F4E Kw_Wu8 255.0 OneToOne 0.00 255.0 FORMAT "%5.1" /end CHARACTERISTIC
/begin CHARACTERISTIC DSM_FMKDfp_GearbxTypeMTErr_C "Ausblendbedingungen fuer Fehlerpfad Dfp_GearbxTypeMTErr" VALUE 0x1C9F4F Kw_Wu8 255.0 OneToOne 0.00 255.0 FORMAT "%5.1" /end CHARACTERISTIC
/begin CHARACTERISTIC DSM_FMKDfp_GlwCD_Actr_C "Ausblendbedingungen fuer Fehlerpfad Dfp_GlwCD_Actr" VALUE 0x1C9F50 Kw_Wu8 255.0 OneToOne 0.00 255.0 FORMAT "%5.1" /end CHARACTERISTIC
/begin CHARACTERISTIC DSM_FMKDfp_GlwCD_DIAG_C "Ausblendbedingungen fuer Fehlerpfad Dfp_GlwCD_DIAG" VALUE 0x1C9F51 Kw_Wu8 255.0 OneToOne 0.00 255.0 FORMAT "%5.1" /end CHARACTERISTIC
/begin CHARACTERISTIC DSM_FMKDfp_GlwCD_Error1_C "Ausblendbedingungen fuer Fehlerpfad Dfp_GlwCD_Error1" VALUE 0x1C9F52 Kw_Wu8 255.0 OneToOne 0.00 255.0 FORMAT "%5.1" /end CHARACTERISTIC
/begin CHARACTERISTIC DSM_FMKDfp_GlwCD_Error2_C "Ausblendbedingungen fuer Fehlerpfad Dfp_GlwCD_Error2" VALUE 0x1C9F53 Kw_Wu8 255.0 OneToOne 0.00 255.0 FORMAT "%5.1" /end CHARACTERISTIC
/begin CHARACTERISTIC DSM_FMKDfp_GlwCD_EvalCod_C "Durch Fehlerpfad Dfp_GlwCD_EvalCod verriegelte Funktionsidentifier" VALUE 0x1C9F54 Kw_Wu8 255.0 OneToOne 0.00 255.0 FORMAT "%5.1" /end CHARACTERISTIC
/begin CHARACTERISTIC DSM_FMKDfp_GlwCD_GSK_C "Ausblendbedingungen fuer Fehlerpfad Dfp_GlwCD_GSK" VALUE 0x1C9F55 Kw_Wu8 255.0 OneToOne 0.00 255.0 FORMAT "%5.1" /end CHARACTERISTIC
/begin CHARACTERISTIC DSM_FMKDfp_GlwCD_Lamp_C "Ausblendbedingungen fuer Fehlerpfad Dfp_GlwCD_Lamp" VALUE 0x1C9F56 Kw_Wu8 255.0 OneToOne 0.00 255.0 FORMAT "%5.1" /end CHARACTERISTIC
/begin CHARACTERISTIC DSM_FMKDfp_GlwCD_LampCan_C "Ausblendbedingungen fuer Fehlerpfad Dfp_GlwCD_LampCan" VALUE 0x1C9F57 Kw_Wu8 255.0 OneToOne 0.00 255.0 FORMAT "%5.1" /end CHARACTERISTIC
/begin CHARACTERISTIC DSM_FMKDfp_GlwCD_PLUG0_C "Ausblendbedingungen fuer Fehlerpfad Dfp_GlwCD_PLUG0" VALUE 0x1C9F58 Kw_Wu8 255.0 OneToOne 0.00 255.0 FORMAT "%5.1" /end CHARACTERISTIC
/begin CHARACTERISTIC DSM_FMKDfp_GlwCD_PLUG1_C "Ausblendbedingungen fuer Fehlerpfad Dfp_GlwCD_PLUG1" VALUE 0x1C9F59 Kw_Wu8 255.0 OneToOne 0.00 255.0 FORMAT "%5.1" /end CHARACTERISTIC
/begin CHARACTERISTIC DSM_FMKDfp_GlwCD_PLUG2_C "Ausblendbedingungen fuer Fehlerpfad Dfp_GlwCD_PLUG2" VALUE 0x1C9F5A Kw_Wu8 255.0 OneToOne 0.00 255.0 FORMAT "%5.1" /end CHARACTERISTIC
/begin CHARACTERISTIC DSM_FMKDfp_GlwCD_PLUG3_C "Ausblendbedingungen fuer Fehlerpfad Dfp_GlwCD_PLUG3" VALUE 0x1C9F5B Kw_Wu8 255.0 OneToOne 0.00 255.0 FORMAT "%5.1" /end CHARACTERISTIC
/begin CHARACTERISTIC DSM_FMKDfp_GlwCD_PLUG4_C "Ausblendbedingungen fuer Fehlerpfad Dfp_GlwCD_PLUG4" VALUE 0x1C9F5C Kw_Wu8 255.0 OneToOne 0.00 255.0 FORMAT "%5.1" /end CHARACTERISTIC
/begin CHARACTERISTIC DSM_FMKDfp_GlwCD_PLUG5_C "Ausblendbedingungen fuer Fehlerpfad Dfp_GlwCD_PLUG5" VALUE 0x1C9F5D Kw_Wu8 255.0 OneToOne 0.00 255.0 FORMAT "%5.1" /end CHARACTERISTIC
/begin CHARACTERISTIC DSM_FMKDfp_GlwCD_SFD_C "Ausblendbedingungen fuer Fehlerpfad Dfp_GlwCD_SFD" VALUE 0x1C9F5E Kw_Wu8 255.0 OneToOne 0.00 255.0 FORMAT "%5.1" /end CHARACTERISTIC
/begin CHARACTERISTIC DSM_FMKDfp_HDSCD_C "Ausblendbedingungen fuer Fehlerpfad Dfp_HDSCD" VALUE 0x1C9F5F Kw_Wu8 255.0 OneToOne 0.00 255.0 FORMAT "%5.1" /end CHARACTERISTIC
/begin CHARACTERISTIC DSM_FMKDfp_HWEMonCom_C "Ausblendbedingungen fuer Fehlerpfad Dfp_HWEMonCom" VALUE 0x1C9F60 Kw_Wu8 255.0 OneToOne 0.00 255.0 FORMAT "%5.1" /end CHARACTERISTIC
/begin CHARACTERISTIC DSM_FMKDfp_HWEMonEEPROM_C "Ausblendbedingungen fuer Fehlerpfad Dfp_HWEMonEEPROM" VALUE 0x1C9F61 Kw_Wu8 255.0 OneToOne 0.00 255.0 FORMAT "%5.1" /end CHARACTERISTIC
/begin CHARACTERISTIC DSM_FMKDfp_HWEMonRcyLocked_C "Ausblendbedingungen fuer Fehlerpfad Dfp_HWEMonRcyLocked" VALUE 0x1C9F62 Kw_Wu8 255.0 OneToOne 0.00 255.0 FORMAT "%5.1" /end CHARACTERISTIC
/begin CHARACTERISTIC DSM_FMKDfp_HWEMonRcySuppressed_C "Ausblendbedingungen fuer Fehlerpfad Dfp_HWEMonRcySuppressed" VALUE 0x1C9F63 Kw_Wu8 255.0 OneToOne 0.00 255.0 FORMAT "%5.1" /end CHARACTERISTIC
/begin CHARACTERISTIC DSM_FMKDfp_HWEMonRcyVisible_C "Ausblendbedingungen fuer Fehlerpfad Dfp_HWEMonRcyVisible" VALUE 0x1C9F64 Kw_Wu8 255.0 OneToOne 0.00 255.0 FORMAT "%5.1" /end CHARACTERISTIC
/begin CHARACTERISTIC DSM_FMKDfp_HWEMonUMaxSupply_C "Ausblendbedingungen fuer Fehlerpfad Dfp_HWEMonUMaxSupply" VALUE 0x1C9F65 Kw_Wu8 255.0 OneToOne 0.00 255.0 FORMAT "%5.1" /end CHARACTERISTIC
/begin CHARACTERISTIC DSM_FMKDfp_HWEMonUMinSupply_C "Ausblendbedingungen fuer Fehlerpfad Dfp_HWEMonUMinSupply" VALUE 0x1C9F66 Kw_Wu8 255.0 OneToOne 0.00 255.0 FORMAT "%5.1" /end CHARACTERISTIC
/begin CHARACTERISTIC DSM_FMKDfp_IATSCD_C "Ausblendbedingungen fuer Fehlerpfad Dfp_IATSCD" VALUE 0x1C9F67 Kw_Wu8 255.0 OneToOne 0.00 255.0 FORMAT "%5.1" /end CHARACTERISTIC
/begin CHARACTERISTIC DSM_FMKDfp_IFCD_C "Ausblendbedingungen fuer Fehlerpfad Dfp_IFCD" VALUE 0x1C9F68 Kw_Wu8 255.0 OneToOne 0.00 255.0 FORMAT "%5.1" /end CHARACTERISTIC
/begin CHARACTERISTIC DSM_FMKDfp_ImmCtl_C "Ausblendbedingungen fuer Fehlerpfad Dfp_ImmCtl" VALUE 0x1C9F69 Kw_Wu8 255.0 OneToOne 0.00 255.0 FORMAT "%5.1" /end CHARACTERISTIC
/begin CHARACTERISTIC DSM_FMKDfp_InjCrv_InjLim_C "Ausblendbedingungen fuer Fehlerpfad Dfp_InjCrv_InjLim" VALUE 0x1C9F6A Kw_Wu8 255.0 OneToOne 0.00 255.0 FORMAT "%5.1" /end CHARACTERISTIC
/begin CHARACTERISTIC DSM_FMKDfp_InjVCDActrChrg_C "Ausblendbedingungen fuer Fehlerpfad Dfp_InjVCDActrChrg" VALUE 0x1C9F6B Kw_Wu8 255.0 OneToOne 0.00 255.0 FORMAT "%5.1" /end CHARACTERISTIC
/begin CHARACTERISTIC DSM_FMKDfp_InjVCDActrVolt_C "Ausblendbedingungen fuer Fehlerpfad Dfp_InjVCDActrVolt" VALUE 0x1C9F6C Kw_Wu8 255.0 OneToOne 0.00 255.0 FORMAT "%5.1" /end CHARACTERISTIC
/begin CHARACTERISTIC DSM_FMKDfp_InjVCDClsBank1_C "Ausblendbedingungen fuer Fehlerpfad Dfp_InjVCDClsBank1" VALUE 0x1C9F6D Kw_Wu8 255.0 OneToOne 0.00 255.0 FORMAT "%5.1" /end CHARACTERISTIC
/begin CHARACTERISTIC DSM_FMKDfp_InjVCDClsBank2_C "Ausblendbedingungen fuer Fehlerpfad Dfp_InjVCDClsBank2" VALUE 0x1C9F6E Kw_Wu8 255.0 OneToOne 0.00 255.0 FORMAT "%5.1" /end CHARACTERISTIC
/begin CHARACTERISTIC DSM_FMKDfp_InjVCDMonCab_C "Ausblendbedingungen fuer Fehlerpfad Dfp_InjVCDMonCab" VALUE 0x1C9F6F Kw_Wu8 255.0 OneToOne 0.00 255.0 FORMAT "%5.1" /end CHARACTERISTIC
/begin CHARACTERISTIC DSM_FMKDfp_InjVCDMonSwt_C "Ausblendbedingungen fuer Fehlerpfad Dfp_InjVCDMonSwt" VALUE 0x1C9F70 Kw_Wu8 255.0 OneToOne 0.00 255.0 FORMAT "%5.1" /end CHARACTERISTIC
/begin CHARACTERISTIC DSM_FMKDfp_InjVCDShOffDCDC_C "Ausblendbedingungen fuer Fehlerpfad Dfp_InjVCDShOffDCDC" VALUE 0x1C9F71 Kw_Wu8 255.0 OneToOne 0.00 255.0 FORMAT "%5.1" /end CHARACTERISTIC
/begin CHARACTERISTIC DSM_FMKDfp_InjVCDUBuf_C "Ausblendbedingungen fuer Fehlerpfad Dfp_InjVCDUBuf" VALUE 0x1C9F72 Kw_Wu8 255.0 OneToOne 0.00 255.0 FORMAT "%5.1" /end CHARACTERISTIC
/begin CHARACTERISTIC DSM_FMKDfp_InjVCD_CY370Ampl_C "Ausblendbedingungen fuer Fehlerpfad Dfp_InjVCD_CY370Ampl" VALUE 0x1C9F73 Kw_Wu8 255.0 OneToOne 0.00 255.0 FORMAT "%5.1" /end CHARACTERISTIC
/begin CHARACTERISTIC DSM_FMKDfp_InjVlvBnk1A_C "Ausblendbedingungen fuer Fehlerpfad Dfp_InjVlvBnk1A" VALUE 0x1C9F74 Kw_Wu8 255.0 OneToOne 0.00 255.0 FORMAT "%5.1" /end CHARACTERISTIC
/begin CHARACTERISTIC DSM_FMKDfp_InjVlvBnk1B_C "Ausblendbedingungen fuer Fehlerpfad Dfp_InjVlvBnk1B" VALUE 0x1C9F75 Kw_Wu8 255.0 OneToOne 0.00 255.0 FORMAT "%5.1" /end CHARACTERISTIC
/begin CHARACTERISTIC DSM_FMKDfp_InjVlvBnk2A_C "Ausblendbedingungen fuer Fehlerpfad Dfp_InjVlvBnk2A" VALUE 0x1C9F76 Kw_Wu8 255.0 OneToOne 0.00 255.0 FORMAT "%5.1" /end CHARACTERISTIC
/begin CHARACTERISTIC DSM_FMKDfp_InjVlvBnk2B_C "Ausblendbedingungen fuer Fehlerpfad Dfp_InjVlvBnk2B" VALUE 0x1C9F77 Kw_Wu8 255.0 OneToOne 0.00 255.0 FORMAT "%5.1" /end CHARACTERISTIC
/begin CHARACTERISTIC DSM_FMKDfp_InjVlvChipA_C "Ausblendbedingungen fuer Fehlerpfad Dfp_InjVlvChipA" VALUE 0x1C9F78 Kw_Wu8 255.0 OneToOne 0.00 255.0 FORMAT "%5.1" /end CHARACTERISTIC
/begin CHARACTERISTIC DSM_FMKDfp_InjVlvChipB_C "Ausblendbedingungen fuer Fehlerpfad Dfp_InjVlvChipB" VALUE 0x1C9F79 Kw_Wu8 255.0 OneToOne 0.00 255.0 FORMAT "%5.1" /end CHARACTERISTIC
/begin CHARACTERISTIC DSM_FMKDfp_InjVlvCyl1A_C "Ausblendbedingungen fuer Fehlerpfad Dfp_InjVlvCyl1A" VALUE 0x1C9F7A Kw_Wu8 255.0 OneToOne 0.00 255.0 FORMAT "%5.1" /end CHARACTERISTIC
/begin CHARACTERISTIC DSM_FMKDfp_InjVlvCyl1B_C "Ausblendbedingungen fuer Fehlerpfad Dfp_InjVlvCyl1B" VALUE 0x1C9F7B Kw_Wu8 255.0 OneToOne 0.00 255.0 FORMAT "%5.1" /end CHARACTERISTIC
/begin CHARACTERISTIC DSM_FMKDfp_InjVlvCyl1C_C "Ausblendbedingungen fuer Fehlerpfad Dfp_InjVlvCyl1C" VALUE 0x1C9F7C Kw_Wu8 255.0 OneToOne 0.00 255.0 FORMAT "%5.1" /end CHARACTERISTIC
/begin CHARACTERISTIC DSM_FMKDfp_InjVlvCyl2A_C "Ausblendbedingungen fuer Fehlerpfad Dfp_InjVlvCyl2A" VALUE 0x1C9F7D Kw_Wu8 255.0 OneToOne 0.00 255.0 FORMAT "%5.1" /end CHARACTERISTIC
/begin CHARACTERISTIC DSM_FMKDfp_InjVlvCyl2B_C "Ausblendbedingungen fuer Fehlerpfad Dfp_InjVlvCyl2B" VALUE 0x1C9F7E Kw_Wu8 255.0 OneToOne 0.00 255.0 FORMAT "%5.1" /end CHARACTERISTIC
/begin CHARACTERISTIC DSM_FMKDfp_InjVlvCyl2C_C "Ausblendbedingungen fuer Fehlerpfad Dfp_InjVlvCyl2C" VALUE 0x1C9F7F Kw_Wu8 255.0 OneToOne 0.00 255.0 FORMAT "%5.1" /end CHARACTERISTIC
/begin CHARACTERISTIC DSM_FMKDfp_InjVlvCyl3A_C "Ausblendbedingungen fuer Fehlerpfad Dfp_InjVlvCyl3A" VALUE 0x1C9F80 Kw_Wu8 255.0 OneToOne 0.00 255.0 FORMAT "%5.1" /end CHARACTERISTIC
/begin CHARACTERISTIC DSM_FMKDfp_InjVlvCyl3B_C "Ausblendbedingungen fuer Fehlerpfad Dfp_InjVlvCyl3B" VALUE 0x1C9F81 Kw_Wu8 255.0 OneToOne 0.00 255.0 FORMAT "%5.1" /end CHARACTERISTIC
/begin CHARACTERISTIC DSM_FMKDfp_InjVlvCyl3C_C "Ausblendbedingungen fuer Fehlerpfad Dfp_InjVlvCyl3C" VALUE 0x1C9F82 Kw_Wu8 255.0 OneToOne 0.00 255.0 FORMAT "%5.1" /end CHARACTERISTIC
/begin CHARACTERISTIC DSM_FMKDfp_InjVlvCyl4A_C "Ausblendbedingungen fuer Fehlerpfad Dfp_InjVlvCyl4A" VALUE 0x1C9F83 Kw_Wu8 255.0 OneToOne 0.00 255.0 FORMAT "%5.1" /end CHARACTERISTIC
/begin CHARACTERISTIC DSM_FMKDfp_InjVlvCyl4B_C "Ausblendbedingungen fuer Fehlerpfad Dfp_InjVlvCyl4B" VALUE 0x1C9F84 Kw_Wu8 255.0 OneToOne 0.00 255.0 FORMAT "%5.1" /end CHARACTERISTIC
/begin CHARACTERISTIC DSM_FMKDfp_InjVlvCyl4C_C "Ausblendbedingungen fuer Fehlerpfad Dfp_InjVlvCyl4C" VALUE 0x1C9F85 Kw_Wu8 255.0 OneToOne 0.00 255.0 FORMAT "%5.1" /end CHARACTERISTIC
/begin CHARACTERISTIC DSM_FMKDfp_InjVlvCyl5A_C "Ausblendbedingungen fuer Fehlerpfad Dfp_InjVlvCyl5A" VALUE 0x1C9F86 Kw_Wu8 255.0 OneToOne 0.00 255.0 FORMAT "%5.1" /end CHARACTERISTIC
/begin CHARACTERISTIC DSM_FMKDfp_InjVlvCyl5B_C "Ausblendbedingungen fuer Fehlerpfad Dfp_InjVlvCyl5B" VALUE 0x1C9F87 Kw_Wu8 255.0 OneToOne 0.00 255.0 FORMAT "%5.1" /end CHARACTERISTIC
/begin CHARACTERISTIC DSM_FMKDfp_InjVlvCyl5C_C "Ausblendbedingungen fuer Fehlerpfad Dfp_InjVlvCyl5C" VALUE 0x1C9F88 Kw_Wu8 255.0 OneToOne 0.00 255.0 FORMAT "%5.1" /end CHARACTERISTIC
/begin CHARACTERISTIC DSM_FMKDfp_InjVlvCyl6A_C "Ausblendbedingungen fuer Fehlerpfad Dfp_InjVlvCyl6A" VALUE 0x1C9F89 Kw_Wu8 255.0 OneToOne 0.00 255.0 FORMAT "%5.1" /end CHARACTERISTIC
/begin CHARACTERISTIC DSM_FMKDfp_InjVlvCyl6B_C "Ausblendbedingungen fuer Fehlerpfad Dfp_InjVlvCyl6B" VALUE 0x1C9F8A Kw_Wu8 255.0 OneToOne 0.00 255.0 FORMAT "%5.1" /end CHARACTERISTIC
/begin CHARACTERISTIC DSM_FMKDfp_InjVlvCyl6C_C "Ausblendbedingungen fuer Fehlerpfad Dfp_InjVlvCyl6C" VALUE 0x1C9F8B Kw_Wu8 255.0 OneToOne 0.00 255.0 FORMAT "%5.1" /end CHARACTERISTIC
/begin CHARACTERISTIC DSM_FMKDfp_InjVlvCyl7A_C "Ausblendbedingungen fuer Fehlerpfad Dfp_InjVlvCyl7A" VALUE 0x1C9F8C Kw_Wu8 255.0 OneToOne 0.00 255.0 FORMAT "%5.1" /end CHARACTERISTIC
/begin CHARACTERISTIC DSM_FMKDfp_InjVlvCyl7B_C "Ausblendbedingungen fuer Fehlerpfad Dfp_InjVlvCyl7B" VALUE 0x1C9F8D Kw_Wu8 255.0 OneToOne 0.00 255.0 FORMAT "%5.1" /end CHARACTERISTIC
/begin CHARACTERISTIC DSM_FMKDfp_InjVlvCyl7C_C "Ausblendbedingungen fuer Fehlerpfad Dfp_InjVlvCyl7C" VALUE 0x1C9F8E Kw_Wu8 255.0 OneToOne 0.00 255.0 FORMAT "%5.1" /end CHARACTERISTIC
/begin CHARACTERISTIC DSM_FMKDfp_InjVlvCyl8A_C "Ausblendbedingungen fuer Fehlerpfad Dfp_InjVlvCyl8A" VALUE 0x1C9F8F Kw_Wu8 255.0 OneToOne 0.00 255.0 FORMAT "%5.1" /end CHARACTERISTIC
/begin CHARACTERISTIC DSM_FMKDfp_InjVlvCyl8B_C "Ausblendbedingungen fuer Fehlerpfad Dfp_InjVlvCyl8B" VALUE 0x1C9F90 Kw_Wu8 255.0 OneToOne 0.00 255.0 FORMAT "%5.1" /end CHARACTERISTIC
/begin CHARACTERISTIC DSM_FMKDfp_InjVlvCyl8C_C "Ausblendbedingungen fuer Fehlerpfad Dfp_InjVlvCyl8C" VALUE 0x1C9F91 Kw_Wu8 255.0 OneToOne 0.00 255.0 FORMAT "%5.1" /end CHARACTERISTIC
/begin CHARACTERISTIC DSM_FMKDfp_LSUCDCircNernst0_C "Ausblendbedingungen fuer Fehlerpfad Dfp_LSUCDCircNernst0" VALUE 0x1C9F92 Kw_Wu8 255.0 OneToOne 0.00 255.0 FORMAT "%5.1" /end CHARACTERISTIC
/begin CHARACTERISTIC DSM_FMKDfp_LSUCDCircPumpCur0_C "Ausblendbedingungen fuer Fehlerpfad Dfp_LSUCDCircPumpCur0" VALUE 0x1C9F93 Kw_Wu8 255.0 OneToOne 0.00 255.0 FORMAT "%5.1" /end CHARACTERISTIC
/begin CHARACTERISTIC DSM_FMKDfp_LSUCDCircVirtGnd0_C "Ausblendbedingungen fuer Fehlerpfad Dfp_LSUCDCircVirtGnd0" VALUE 0x1C9F94 Kw_Wu8 255.0 OneToOne 0.00 255.0 FORMAT "%5.1" /end CHARACTERISTIC
/begin CHARACTERISTIC DSM_FMKDfp_LSUCDHeater0_C "Ausblendbedingungen fuer Fehlerpfad Dfp_LSUCDHeater0" VALUE 0x1C9F95 Kw_Wu8 255.0 OneToOne 0.00 255.0 FORMAT "%5.1" /end CHARACTERISTIC
/begin CHARACTERISTIC DSM_FMKDfp_LSUCDHtCoup0_C "Ausblendbedingungen fuer Fehlerpfad Dfp_LSUCDHtCoup0" VALUE 0x1C9F96 Kw_Wu8 255.0 OneToOne 0.00 255.0 FORMAT "%5.1" /end CHARACTERISTIC
/begin CHARACTERISTIC DSM_FMKDfp_LSUCDO20_C "Ausblendbedingungen fuer Fehlerpfad Dfp_LSUCDO20" VALUE 0x1C9F97 Kw_Wu8 255.0 OneToOne 0.00 255.0 FORMAT "%5.1" /end CHARACTERISTIC
/begin CHARACTERISTIC DSM_FMKDfp_LSUCDO2Clb0_C "Ausblendbedingungen fuer Fehlerpfad Dfp_LSUCDO2Clb0" VALUE 0x1C9F98 Kw_Wu8 255.0 OneToOne 0.00 255.0 FORMAT "%5.1" /end CHARACTERISTIC
/begin CHARACTERISTIC DSM_FMKDfp_LSUCDRiClb0_C "Ausblendbedingungen fuer Fehlerpfad Dfp_LSUCDRiClb0" VALUE 0x1C9F99 Kw_Wu8 255.0 OneToOne 0.00 255.0 FORMAT "%5.1" /end CHARACTERISTIC
/begin CHARACTERISTIC DSM_FMKDfp_LSUCDSPI0_C "Ausblendbedingungen fuer Fehlerpfad Dfp_LSUCDSPI0" VALUE 0x1C9F9A Kw_Wu8 255.0 OneToOne 0.00 255.0 FORMAT "%5.1" /end CHARACTERISTIC
/begin CHARACTERISTIC DSM_FMKDfp_LSUCDSPIBattLow0_C "Ausblendbedingungen fuer Fehlerpfad Dfp_LSUCDSPIBattLow0" VALUE 0x1C9F9B Kw_Wu8 255.0 OneToOne 0.00 255.0 FORMAT "%5.1" /end CHARACTERISTIC
/begin CHARACTERISTIC DSM_FMKDfp_LSUCDWireIP0_C "Ausblendbedingungen fuer Fehlerpfad Dfp_LSUCDWireIP0" VALUE 0x1C9F9C Kw_Wu8 255.0 OneToOne 0.00 255.0 FORMAT "%5.1" /end CHARACTERISTIC
/begin CHARACTERISTIC DSM_FMKDfp_LSUCtlRiExc0_C "Ausblendbedingungen fuer Fehlerpfad Dfp_LSUCtlRiExc0" VALUE 0x1C9F9D Kw_Wu8 255.0 OneToOne 0.00 255.0 FORMAT "%5.1" /end CHARACTERISTIC
/begin CHARACTERISTIC DSM_FMKDfp_LSUMon1Sens_C "Ausblendbedingungen fuer Fehlerpfad Dfp_LSUMon1Sens" VALUE 0x1C9F9E Kw_Wu8 255.0 OneToOne 0.00 255.0 FORMAT "%5.1" /end CHARACTERISTIC
/begin CHARACTERISTIC DSM_FMKDfp_LSUMon2Sens_C "Ausblendbedingungen fuer Fehlerpfad Dfp_LSUMon2Sens" VALUE 0x1C9F9F Kw_Wu8 255.0 OneToOne 0.00 255.0 FORMAT "%5.1" /end CHARACTERISTIC
/begin CHARACTERISTIC DSM_FMKDfp_MIL_C "Ausblendbedingungen fuer Fehlerpfad Dfp_MIL" VALUE 0x1C9FA0 Kw_Wu8 255.0 OneToOne 0.00 255.0 FORMAT "%5.1" /end CHARACTERISTIC
/begin CHARACTERISTIC DSM_FMKDfp_MRlyCD_C "Ausblendbedingungen fuer Fehlerpfad Dfp_MRlyCD" VALUE 0x1C9FA1 Kw_Wu8 255.0 OneToOne 0.00 255.0 FORMAT "%5.1" /end CHARACTERISTIC
/begin CHARACTERISTIC DSM_FMKDfp_MeUnCDNoLoad_C "Ausblendbedingungen fuer Fehlerpfad Dfp_MeUnCDNoLoad" VALUE 0x1C9FA2 Kw_Wu8 255.0 OneToOne 0.00 255.0 FORMAT "%5.1" /end CHARACTERISTIC
/begin CHARACTERISTIC DSM_FMKDfp_MeUnCDSCBat_C "Ausblendbedingungen fuer Fehlerpfad Dfp_MeUnCDSCBat" VALUE 0x1C9FA3 Kw_Wu8 255.0 OneToOne 0.00 255.0 FORMAT "%5.1" /end CHARACTERISTIC
/begin CHARACTERISTIC DSM_FMKDfp_MeUnCDSCGnd_C "Ausblendbedingungen fuer Fehlerpfad Dfp_MeUnCDSCGnd" VALUE 0x1C9FA4 Kw_Wu8 255.0 OneToOne 0.00 255.0 FORMAT "%5.1" /end CHARACTERISTIC
/begin CHARACTERISTIC DSM_FMKDfp_MeUnCD_ADC_C "Ausblendbedingungen fuer Fehlerpfad Dfp_MeUnCD_ADC" VALUE 0x1C9FA5 Kw_Wu8 255.0 OneToOne 0.00 255.0 FORMAT "%5.1" /end CHARACTERISTIC
/begin CHARACTERISTIC DSM_FMKDfp_Montr_C "Ausblendbedingungen fuer Fehlerpfad Dfp_Montr" VALUE 0x1C9FA6 Kw_Wu8 255.0 OneToOne 0.00 255.0 FORMAT "%5.1" /end CHARACTERISTIC
/begin CHARACTERISTIC DSM_FMKDfp_OTSCD_C "Ausblendbedingungen fuer Fehlerpfad Dfp_OTSCD" VALUE 0x1C9FA7 Kw_Wu8 255.0 OneToOne 0.00 255.0 FORMAT "%5.1" /end CHARACTERISTIC
/begin CHARACTERISTIC DSM_FMKDfp_OTSCDCanInac_C "Ausblendbedingungen fuer Fehlerpfad Dfp_OTSCDCanInac" VALUE 0x1C9FA8 Kw_Wu8 255.0 OneToOne 0.00 255.0 FORMAT "%5.1" /end CHARACTERISTIC
/begin CHARACTERISTIC DSM_FMKDfp_OTSCDCanSig_C "Ausblendbedingungen fuer Fehlerpfad Dfp_OTSCDCanSig" VALUE 0x1C9FA9 Kw_Wu8 255.0 OneToOne 0.00 255.0 FORMAT "%5.1" /end CHARACTERISTIC
/begin CHARACTERISTIC DSM_FMKDfp_OvRMon_C "Ausblendbedingungen fuer Fehlerpfad Dfp_OvRMon" VALUE 0x1C9FAA Kw_Wu8 255.0 OneToOne 0.00 255.0 FORMAT "%5.1" /end CHARACTERISTIC
/begin CHARACTERISTIC DSM_FMKDfp_OvRMonCrCtlP_C "Ausblendbedingungen fuer Fehlerpfad Dfp_OvRMonCrCtlP" VALUE 0x1C9FAB Kw_Wu8 255.0 OneToOne 0.00 255.0 FORMAT "%5.1" /end CHARACTERISTIC
/begin CHARACTERISTIC DSM_FMKDfp_OvRMonSigA_C "Ausblendbedingungen fuer Fehlerpfad Dfp_OvRMonSigA" VALUE 0x1C9FAC Kw_Wu8 255.0 OneToOne 0.00 255.0 FORMAT "%5.1" /end CHARACTERISTIC
/begin CHARACTERISTIC DSM_FMKDfp_OxiCCDTPre_C "Ausblendbedingungen fuer Fehlerpfad Dfp_OxiCCDTPre" VALUE 0x1C9FAD Kw_Wu8 255.0 OneToOne 0.00 255.0 FORMAT "%5.1" /end CHARACTERISTIC
/begin CHARACTERISTIC DSM_FMKDfp_OxiCCDTPre1_C "Ausblendbedingungen fuer Fehlerpfad Dfp_OxiCCDTPre1" VALUE 0x1C9FAE Kw_Wu8 255.0 OneToOne 0.00 255.0 FORMAT "%5.1" /end CHARACTERISTIC
/begin CHARACTERISTIC DSM_FMKDfp_PCR_BalGovDev_C "Ausblendbedingungen fuer Fehlerpfad Dfp_PCR_BalGovDev" VALUE 0x1C9FAF Kw_Wu8 255.0 OneToOne 0.00 255.0 FORMAT "%5.1" /end CHARACTERISTIC
/begin CHARACTERISTIC DSM_FMKDfp_PCR_GovDev_C "Ausblendbedingungen fuer Fehlerpfad Dfp_PCR_GovDev" VALUE 0x1C9FB0 Kw_Wu8 255.0 OneToOne 0.00 255.0 FORMAT "%5.1" /end CHARACTERISTIC
/begin CHARACTERISTIC DSM_FMKDfp_PCVCDNoLoad_C "Ausblendbedingungen fuer Fehlerpfad Dfp_PCVCDNoLoad" VALUE 0x1C9FB1 Kw_Wu8 255.0 OneToOne 0.00 255.0 FORMAT "%5.1" /end CHARACTERISTIC
/begin CHARACTERISTIC DSM_FMKDfp_PCVCDSCBat_C "Ausblendbedingungen fuer Fehlerpfad Dfp_PCVCDSCBat" VALUE 0x1C9FB2 Kw_Wu8 255.0 OneToOne 0.00 255.0 FORMAT "%5.1" /end CHARACTERISTIC
/begin CHARACTERISTIC DSM_FMKDfp_PCVCDSCGnd_C "Ausblendbedingungen fuer Fehlerpfad Dfp_PCVCDSCGnd" VALUE 0x1C9FB3 Kw_Wu8 255.0 OneToOne 0.00 255.0 FORMAT "%5.1" /end CHARACTERISTIC
/begin CHARACTERISTIC DSM_FMKDfp_PCVCD_ADC_C "Ausblendbedingungen fuer Fehlerpfad Dfp_PCVCD_ADC" VALUE 0x1C9FB4 Kw_Wu8 255.0 OneToOne 0.00 255.0 FORMAT "%5.1" /end CHARACTERISTIC
/begin CHARACTERISTIC DSM_FMKDfp_PFltCDHtg_C "Ausblendbedingungen fuer Fehlerpfad Dfp_PFltCDHtg" VALUE 0x1C9FB5 Kw_Wu8 255.0 OneToOne 0.00 255.0 FORMAT "%5.1" /end CHARACTERISTIC
/begin CHARACTERISTIC DSM_FMKDfp_PFltCDHtg1_C "Ausblendbedingungen fuer Fehlerpfad Dfp_PFltCDHtg1" VALUE 0x1C9FB6 Kw_Wu8 255.0 OneToOne 0.00 255.0 FORMAT "%5.1" /end CHARACTERISTIC
/begin CHARACTERISTIC DSM_FMKDfp_PFltCDPDiff_C "Ausblendbedingungen fuer Fehlerpfad Dfp_PFltCDPDiff" VALUE 0x1C9FB7 Kw_Wu8 255.0 OneToOne 0.00 255.0 FORMAT "%5.1" /end CHARACTERISTIC
/begin CHARACTERISTIC DSM_FMKDfp_PFltCDPDiff1_C "Ausblendbedingungen fuer Fehlerpfad Dfp_PFltCDPDiff1" VALUE 0x1C9FB8 Kw_Wu8 255.0 OneToOne 0.00 255.0 FORMAT "%5.1" /end CHARACTERISTIC
/begin CHARACTERISTIC DSM_FMKDfp_PFltCDTPre_C "Ausblendbedingungen fuer Fehlerpfad Dfp_PFltCDTPre" VALUE 0x1C9FB9 Kw_Wu8 255.0 OneToOne 0.00 255.0 FORMAT "%5.1" /end CHARACTERISTIC
/begin CHARACTERISTIC DSM_FMKDfp_PFltCDTPst_C "Ausblendbedingungen fuer Fehlerpfad Dfp_PFltCDTPst" VALUE 0x1C9FBA Kw_Wu8 255.0 OneToOne 0.00 255.0 FORMAT "%5.1" /end CHARACTERISTIC
/begin CHARACTERISTIC DSM_FMKDfp_PFltCDTempPre_C "Ausblendbedingungen fuer Fehlerpfad Dfp_PFltCDTempPre" VALUE 0x1C9FBB Kw_Wu8 255.0 OneToOne 0.00 255.0 FORMAT "%5.1" /end CHARACTERISTIC
/begin CHARACTERISTIC DSM_FMKDfp_PFltCDTempPre1_C "Ausblendbedingungen fuer Fehlerpfad Dfp_PFltCDTempPre1" VALUE 0x1C9FBC Kw_Wu8 255.0 OneToOne 0.00 255.0 FORMAT "%5.1" /end CHARACTERISTIC
/begin CHARACTERISTIC DSM_FMKDfp_PFltChar_C "Ausblendbedingungen fuer Fehlerpfad Dfp_PFltChar" VALUE 0x1C9FBD Kw_Wu8 255.0 OneToOne 0.00 255.0 FORMAT "%5.1" /end CHARACTERISTIC
/begin CHARACTERISTIC DSM_FMKDfp_PFltEngPrt_C "Ausblendbedingungen fuer Fehlerpfad Dfp_PFltEngPrt" VALUE 0x1C9FBE Kw_Wu8 255.0 OneToOne 0.00 255.0 FORMAT "%5.1" /end CHARACTERISTIC
/begin CHARACTERISTIC DSM_FMKDfp_PFltPresDynPlaus_C "Ausblendbedingungen fuer Fehlerpfad Dfp_PFltPresDynPlaus" VALUE 0x1C9FBF Kw_Wu8 255.0 OneToOne 0.00 255.0 FORMAT "%5.1" /end CHARACTERISTIC
/begin CHARACTERISTIC DSM_FMKDfp_PFltPresSens_C "Ausblendbedingungen fuer Fehlerpfad Dfp_PFltPresSens" VALUE 0x1C9FC0 Kw_Wu8 255.0 OneToOne 0.00 255.0 FORMAT "%5.1" /end CHARACTERISTIC
/begin CHARACTERISTIC DSM_FMKDfp_PFltPresSensHsLn_C "Ausblendbedingungen fuer Fehlerpfad Dfp_PFltPresSensHsLn" VALUE 0x1C9FC1 Kw_Wu8 255.0 OneToOne 0.00 255.0 FORMAT "%5.1" /end CHARACTERISTIC
/begin CHARACTERISTIC DSM_FMKDfp_PFltPresSensSot_C "Ausblendbedingungen fuer Fehlerpfad Dfp_PFltPresSensSot" VALUE 0x1C9FC2 Kw_Wu8 255.0 OneToOne 0.00 255.0 FORMAT "%5.1" /end CHARACTERISTIC
/begin CHARACTERISTIC DSM_FMKDfp_PFltRgnPerm_C "Ausblendbedingungen fuer Fehlerpfad Dfp_PFltRgnPerm" VALUE 0x1C9FC3 Kw_Wu8 255.0 OneToOne 0.00 255.0 FORMAT "%5.1" /end CHARACTERISTIC
/begin CHARACTERISTIC DSM_FMKDfp_PFltTempDwnStrm_C "Ausblendbedingungen fuer Fehlerpfad Dfp_PFltTempDwnStrm" VALUE 0x1C9FC4 Kw_Wu8 255.0 OneToOne 0.00 255.0 FORMAT "%5.1" /end CHARACTERISTIC
/begin CHARACTERISTIC DSM_FMKDfp_PFltTempSens_C "Ausblendbedingungen fuer Fehlerpfad Dfp_PFltTempSens" VALUE 0x1C9FC5 Kw_Wu8 255.0 OneToOne 0.00 255.0 FORMAT "%5.1" /end CHARACTERISTIC
/begin CHARACTERISTIC DSM_FMKDfp_PFltTempUpStrm_C "Ausblendbedingungen fuer Fehlerpfad Dfp_PFltTempUpStrm" VALUE 0x1C9FC6 Kw_Wu8 255.0 OneToOne 0.00 255.0 FORMAT "%5.1" /end CHARACTERISTIC
/begin CHARACTERISTIC DSM_FMKDfp_PSPCD_Actr_C "Ausblendbedingungen fuer Fehlerpfad Dfp_PSPCD_Actr" VALUE 0x1C9FC7 Kw_Wu8 255.0 OneToOne 0.00 255.0 FORMAT "%5.1" /end CHARACTERISTIC
/begin CHARACTERISTIC DSM_FMKDfp_PrpCtlvLimErrPat_C "Ausblendbedingungen fuer Fehlerpfad Dfp_PrpCtlvLimErrPat" VALUE 0x1C9FC8 Kw_Wu8 255.0 OneToOne 0.00 255.0 FORMAT "%5.1" /end CHARACTERISTIC
/begin CHARACTERISTIC DSM_FMKDfp_RailCD_C "Ausblendbedingungen fuer Fehlerpfad Dfp_RailCD" VALUE 0x1C9FC9 Kw_Wu8 255.0 OneToOne 0.00 255.0 FORMAT "%5.1" /end CHARACTERISTIC
/begin CHARACTERISTIC DSM_FMKDfp_RailCDOfsTst_C "Ausblendbedingungen fuer Fehlerpfad Dfp_RailCDOfsTst" VALUE 0x1C9FCA Kw_Wu8 255.0 OneToOne 0.00 255.0 FORMAT "%5.1" /end CHARACTERISTIC
/begin CHARACTERISTIC DSM_FMKDfp_RailMeUn0_C "Ausblendbedingungen fuer Fehlerpfad Dfp_RailMeUn0" VALUE 0x1C9FCB Kw_Wu8 255.0 OneToOne 0.00 255.0 FORMAT "%5.1" /end CHARACTERISTIC
/begin CHARACTERISTIC DSM_FMKDfp_RailMeUn1_C "Ausblendbedingungen fuer Fehlerpfad Dfp_RailMeUn1" VALUE 0x1C9FCC Kw_Wu8 255.0 OneToOne 0.00 255.0 FORMAT "%5.1" /end CHARACTERISTIC
/begin CHARACTERISTIC DSM_FMKDfp_RailMeUn2_C "Ausblendbedingungen fuer Fehlerpfad Dfp_RailMeUn2" VALUE 0x1C9FCD Kw_Wu8 255.0 OneToOne 0.00 255.0 FORMAT "%5.1" /end CHARACTERISTIC
/begin CHARACTERISTIC DSM_FMKDfp_RailMeUn3_C "Ausblendbedingungen fuer Fehlerpfad Dfp_RailMeUn3" VALUE 0x1C9FCE Kw_Wu8 255.0 OneToOne 0.00 255.0 FORMAT "%5.1" /end CHARACTERISTIC
/begin CHARACTERISTIC DSM_FMKDfp_RailMeUn4_C "Ausblendbedingungen fuer Fehlerpfad Dfp_RailMeUn4" VALUE 0x1C9FCF Kw_Wu8 255.0 OneToOne 0.00 255.0 FORMAT "%5.1" /end CHARACTERISTIC
/begin CHARACTERISTIC DSM_FMKDfp_RailPCV0_C "Ausblendbedingungen fuer Fehlerpfad Dfp_RailPCV0" VALUE 0x1C9FD0 Kw_Wu8 255.0 OneToOne 0.00 255.0 FORMAT "%5.1" /end CHARACTERISTIC
/begin CHARACTERISTIC DSM_FMKDfp_RailPCV1_C "Ausblendbedingungen fuer Fehlerpfad Dfp_RailPCV1" VALUE 0x1C9FD1 Kw_Wu8 255.0 OneToOne 0.00 255.0 FORMAT "%5.1" /end CHARACTERISTIC
/begin CHARACTERISTIC DSM_FMKDfp_RailPCV2_C "Ausblendbedingungen fuer Fehlerpfad Dfp_RailPCV2" VALUE 0x1C9FD2 Kw_Wu8 255.0 OneToOne 0.00 255.0 FORMAT "%5.1" /end CHARACTERISTIC
/begin CHARACTERISTIC DSM_FMKDfp_RailPCV3_C "Ausblendbedingungen fuer Fehlerpfad Dfp_RailPCV3" VALUE 0x1C9FD3 Kw_Wu8 255.0 OneToOne 0.00 255.0 FORMAT "%5.1" /end CHARACTERISTIC
/begin CHARACTERISTIC DSM_FMKDfp_RailPCV4_C "Ausblendbedingungen fuer Fehlerpfad Dfp_RailPCV4" VALUE 0x1C9FD4 Kw_Wu8 255.0 OneToOne 0.00 255.0 FORMAT "%5.1" /end CHARACTERISTIC
/begin CHARACTERISTIC DSM_FMKDfp_RailPCV5_C "Ausblendbedingungen fuer Fehlerpfad Dfp_RailPCV5" VALUE 0x1C9FD5 Kw_Wu8 255.0 OneToOne 0.00 255.0 FORMAT "%5.1" /end CHARACTERISTIC
/begin CHARACTERISTIC DSM_FMKDfp_SOPTst_C "Ausblendbedingungen fuer Fehlerpfad Dfp_SOPTst" VALUE 0x1C9FD6 Kw_Wu8 255.0 OneToOne 0.00 255.0 FORMAT "%5.1" /end CHARACTERISTIC
/begin CHARACTERISTIC DSM_FMKDfp_SSpMon1_C "Ausblendbedingungen fuer Fehlerpfad Dfp_SSpMon1" VALUE 0x1C9FD7 Kw_Wu8 255.0 OneToOne 0.00 255.0 FORMAT "%5.1" /end CHARACTERISTIC
/begin CHARACTERISTIC DSM_FMKDfp_SSpMon2_C "Ausblendbedingungen fuer Fehlerpfad Dfp_SSpMon2" VALUE 0x1C9FD8 Kw_Wu8 255.0 OneToOne 0.00 255.0 FORMAT "%5.1" /end CHARACTERISTIC
/begin CHARACTERISTIC DSM_FMKDfp_SSpMon3_C "Ausblendbedingungen fuer Fehlerpfad Dfp_SSpMon3" VALUE 0x1C9FD9 Kw_Wu8 255.0 OneToOne 0.00 255.0 FORMAT "%5.1" /end CHARACTERISTIC
/begin CHARACTERISTIC DSM_FMKDfp_StrtCDOffRly_C "Ausblendbedingungen fuer Fehlerpfad Dfp_StrtCDOffRly" VALUE 0x1C9FDA Kw_Wu8 255.0 OneToOne 0.00 255.0 FORMAT "%5.1" /end CHARACTERISTIC
/begin CHARACTERISTIC DSM_FMKDfp_StrtCDOnRly_C "Ausblendbedingungen fuer Fehlerpfad Dfp_StrtCDOnRly" VALUE 0x1C9FDB Kw_Wu8 255.0 OneToOne 0.00 255.0 FORMAT "%5.1" /end CHARACTERISTIC
/begin CHARACTERISTIC DSM_FMKDfp_StrtCtlIlsNotPlaus_C "Ausblendbedingungen für Fehlerpfad Dfp_StrtCtlIlsNotPlaus" VALUE 0x1C9FDC Kw_Wu8 255.0 OneToOne 0.00 255.0 FORMAT "%5.1" /end CHARACTERISTIC
/begin CHARACTERISTIC DSM_FMKDfp_StrtCtlT50ROneRly1_C "Ausblendbedingungen fuer Fehlerpfad Dfp_StrtCtlT50ROneRly1" VALUE 0x1C9FDD Kw_Wu8 255.0 OneToOne 0.00 255.0 FORMAT "%5.1" /end CHARACTERISTIC
/begin CHARACTERISTIC DSM_FMKDfp_StrtCtlT50ROneRly2_C "Ausblendbedingungen fuer Fehlerpfad Dfp_StrtCtlT50ROneRly2" VALUE 0x1C9FDE Kw_Wu8 255.0 OneToOne 0.00 255.0 FORMAT "%5.1" /end CHARACTERISTIC
/begin CHARACTERISTIC DSM_FMKDfp_StrtCtlT50RZero_C "Ausblendbedingungen fuer Fehlerpfad Dfp_StrtCtlT50RZero" VALUE 0x1C9FDF Kw_Wu8 255.0 OneToOne 0.00 255.0 FORMAT "%5.1" /end CHARACTERISTIC
/begin CHARACTERISTIC DSM_FMKDfp_SysLamp_C "Ausblendbedingungen fuer Fehlerpfad Dfp_SysLamp" VALUE 0x1C9FE0 Kw_Wu8 255.0 OneToOne 0.00 255.0 FORMAT "%5.1" /end CHARACTERISTIC
/begin CHARACTERISTIC DSM_FMKDfp_T15CD_C "Ausblendbedingungen fuer Fehlerpfad Dfp_T15CD" VALUE 0x1C9FE1 Kw_Wu8 255.0 OneToOne 0.00 255.0 FORMAT "%5.1" /end CHARACTERISTIC
/begin CHARACTERISTIC DSM_FMKDfp_TPUMon_C "Ausblendbedingungen fuer Fehlerpfad Dfp_TPUMon" VALUE 0x1C9FE2 Kw_Wu8 255.0 OneToOne 0.00 255.0 FORMAT "%5.1" /end CHARACTERISTIC
/begin CHARACTERISTIC DSM_FMKDfp_TTSCD_C "Ausblendbedingungen fuer Fehlerpfad Dfp_TTSCD" VALUE 0x1C9FE3 Kw_Wu8 255.0 OneToOne 0.00 255.0 FORMAT "%5.1" /end CHARACTERISTIC
/begin CHARACTERISTIC DSM_FMKDfp_TVACD_Max_C "Ausblendbedingungen fuer Fehlerpfad Dfp_TVACD_Max" VALUE 0x1C9FE4 Kw_Wu8 255.0 OneToOne 0.00 255.0 FORMAT "%5.1" /end CHARACTERISTIC
/begin CHARACTERISTIC DSM_FMKDfp_TVACD_Min_C "Ausblendbedingungen fuer Fehlerpfad Dfp_TVACD_Min" VALUE 0x1C9FE5 Kw_Wu8 255.0 OneToOne 0.00 255.0 FORMAT "%5.1" /end CHARACTERISTIC
/begin CHARACTERISTIC DSM_FMKDfp_TVACD_SigNpl_C "Ausblendbedingungen fuer Fehlerpfad Dfp_TVACD_SigNpl" VALUE 0x1C9FE6 Kw_Wu8 255.0 OneToOne 0.00 255.0 FORMAT "%5.1" /end CHARACTERISTIC
/begin CHARACTERISTIC DSM_FMKDfp_TVACD_stLineDef_C "Ausblendbedingungen fuer Fehlerpfad Dfp_TVACD_stLineDef" VALUE 0x1C9FE7 Kw_Wu8 255.0 OneToOne 0.00 255.0 FORMAT "%5.1" /end CHARACTERISTIC
/begin CHARACTERISTIC DSM_FMKDfp_UAcc_CodeBitErr_C "Ausblendbedingungen fuer Fehlerpfad Dfp_UAcc_CodeBitErr" VALUE 0x1C9FE8 Kw_Wu8 255.0 OneToOne 0.00 255.0 FORMAT "%5.1" /end CHARACTERISTIC
/begin CHARACTERISTIC DSM_FMKDfp_USAp_DataVariant_C "Ausblendbedingungen fuer Fehlerpfad Dfp_USAp_DataVariant" VALUE 0x1C9FE9 Kw_Wu8 255.0 OneToOne 0.00 255.0 FORMAT "%5.1" /end CHARACTERISTIC
/begin CHARACTERISTIC DSM_FMKDfp_USAp_FuncCodeRead_C "Ausblendbedingungen fuer Fehlerpfad Dfp_USAp_FuncCodeRead" VALUE 0x1C9FEA Kw_Wu8 255.0 OneToOne 0.00 255.0 FORMAT "%5.1" /end CHARACTERISTIC
/begin CHARACTERISTIC DSM_FMKDfp_VSACD1_Max_C "Ausblendbedingungen fuer Fehlerpfad Dfp_VSACD1_Max" VALUE 0x1C9FEB Kw_Wu8 255.0 OneToOne 0.00 255.0 FORMAT "%5.1" /end CHARACTERISTIC
/begin CHARACTERISTIC DSM_FMKDfp_VSACD1_Min_C "Ausblendbedingungen fuer Fehlerpfad Dfp_VSACD1_Min" VALUE 0x1C9FEC Kw_Wu8 255.0 OneToOne 0.00 255.0 FORMAT "%5.1" /end CHARACTERISTIC
/begin CHARACTERISTIC DSM_FMKDfp_VSACD1_SigNpl_C "Ausblendbedingungen fuer Fehlerpfad Dfp_VSACD1_SigNpl" VALUE 0x1C9FED Kw_Wu8 255.0 OneToOne 0.00 255.0 FORMAT "%5.1" /end CHARACTERISTIC
/begin CHARACTERISTIC DSM_FMKDfp_VSACD2_Max_C "Ausblendbedingungen fuer Fehlerpfad Dfp_VSACD2_Max" VALUE 0x1C9FEE Kw_Wu8 255.0 OneToOne 0.00 255.0 FORMAT "%5.1" /end CHARACTERISTIC
/begin CHARACTERISTIC DSM_FMKDfp_VSACD2_Min_C "Ausblendbedingungen fuer Fehlerpfad Dfp_VSACD2_Min" VALUE 0x1C9FEF Kw_Wu8 255.0 OneToOne 0.00 255.0 FORMAT "%5.1" /end CHARACTERISTIC
/begin CHARACTERISTIC DSM_FMKDfp_VSACD2_SigNpl_C "Ausblendbedingungen fuer Fehlerpfad Dfp_VSACD2_SigNpl" VALUE 0x1C9FF0 Kw_Wu8 255.0 OneToOne 0.00 255.0 FORMAT "%5.1" /end CHARACTERISTIC
/begin CHARACTERISTIC DSM_FMKDfp_VSAExcSensTemp1_C "Ausblendbedingungen fuer Fehlerpfad Dfp_VSAExcSensTemp1" VALUE 0x1C9FF1 Kw_Wu8 255.0 OneToOne 0.00 255.0 FORMAT "%5.1" /end CHARACTERISTIC
/begin CHARACTERISTIC DSM_FMKDfp_VSAExcSensTemp2_C "Ausblendbedingungen fuer Fehlerpfad Dfp_VSAExcSensTemp2" VALUE 0x1C9FF2 Kw_Wu8 255.0 OneToOne 0.00 255.0 FORMAT "%5.1" /end CHARACTERISTIC
/begin CHARACTERISTIC DSM_FMKDfp_VSANotLrn1_C "Ausblendbedingungen fuer Fehlerpfad Dfp_VSANotLrn1" VALUE 0x1C9FF3 Kw_Wu8 255.0 OneToOne 0.00 255.0 FORMAT "%5.1" /end CHARACTERISTIC
/begin CHARACTERISTIC DSM_FMKDfp_VSANotLrn2_C "Ausblendbedingungen fuer Fehlerpfad Dfp_VSANotLrn2" VALUE 0x1C9FF4 Kw_Wu8 255.0 OneToOne 0.00 255.0 FORMAT "%5.1" /end CHARACTERISTIC
/begin CHARACTERISTIC DSM_FMKDfp_VSASCDDcyc1_C "Ausblendbedingungen fuer Fehlerpfad Dfp_VSASCDDcyc1" VALUE 0x1C9FF5 Kw_Wu8 255.0 OneToOne 0.00 255.0 FORMAT "%5.1" /end CHARACTERISTIC
/begin CHARACTERISTIC DSM_FMKDfp_VSASCDDcyc2_C "Ausblendbedingungen fuer Fehlerpfad Dfp_VSASCDDcyc2" VALUE 0x1C9FF6 Kw_Wu8 255.0 OneToOne 0.00 255.0 FORMAT "%5.1" /end CHARACTERISTIC
/begin CHARACTERISTIC DSM_FMKDfp_VSASCDPeriod1_C "Ausblendbedingungen fuer Fehlerpfad Dfp_VSASCDPeriod1" VALUE 0x1C9FF7 Kw_Wu8 255.0 OneToOne 0.00 255.0 FORMAT "%5.1" /end CHARACTERISTIC
/begin CHARACTERISTIC DSM_FMKDfp_VSASCDPeriod2_C "Ausblendbedingungen fuer Fehlerpfad Dfp_VSASCDPeriod2" VALUE 0x1C9FF8 Kw_Wu8 255.0 OneToOne 0.00 255.0 FORMAT "%5.1" /end CHARACTERISTIC
/begin CHARACTERISTIC DSM_FMKDfp_VSSCD1_C "Ausblendbedingungen fuer Fehlerpfad Dfp_VSSCD1" VALUE 0x1C9FF9 Kw_Wu8 255.0 OneToOne 0.00 255.0 FORMAT "%5.1" /end CHARACTERISTIC
/begin CHARACTERISTIC DSM_FMKDfp_VSSCD2_C "Ausblendbedingungen fuer Fehlerpfad Dfp_VSSCD2" VALUE 0x1C9FFA Kw_Wu8 255.0 OneToOne 0.00 255.0 FORMAT "%5.1" /end CHARACTERISTIC
/begin CHARACTERISTIC DSM_FMKDfp_VSSCD4_C "Ausblendbedingungen fuer Fehlerpfad Dfp_VSSCD4" VALUE 0x1C9FFB Kw_Wu8 255.0 OneToOne 0.00 255.0 FORMAT "%5.1" /end CHARACTERISTIC
/begin CHARACTERISTIC DSM_FMKDfp_VSSCDBrkLowVltg_C "Ausblendbedingungen fuer Fehlerpfad Dfp_VSSCDBrkLowVltg" VALUE 0x1C9FFC Kw_Wu8 255.0 OneToOne 0.00 255.0 FORMAT "%5.1" /end CHARACTERISTIC
/begin CHARACTERISTIC DSM_FMKDfp_VSSCDCAN_C "Ausblendbedingungen fuer Fehlerpfad Dfp_VSSCDCAN" VALUE 0x1C9FFD Kw_Wu8 255.0 OneToOne 0.00 255.0 FORMAT "%5.1" /end CHARACTERISTIC
/begin CHARACTERISTIC DSM_FMKDfp_VSSCDNpl_C "Ausblendbedingungen fuer Fehlerpfad Dfp_VSSCDNpl" VALUE 0x1C9FFE Kw_Wu8 255.0 OneToOne 0.00 255.0 FORMAT "%5.1" /end CHARACTERISTIC
/begin CHARACTERISTIC DSM_FMKDfp_WdCom_C "Ausblendbedingungen fuer Fehlerpfad Dfp_WdCom" VALUE 0x1C9FFF Kw_Wu8 255.0 OneToOne 0.00 255.0 FORMAT "%5.1" /end CHARACTERISTIC
/begin FUNCTION dsm_auto_blk ""
 /begin DEF_CHARACTERISTIC DSM_FMKDfp_ACCCDWrongCoded_C DSM_FMKDfp_ACCD_C DSM_FMKDfp_ACCD_PAC_C DSM_FMKDfp_ACCD_pCAN_C DSM_FMKDfp_ACCD_trqCAN_C DSM_FMKDfp_ACCnotPlaus_C DSM_FMKDfp_ADCMon_C DSM_FMKDfp_AFSCD_AirTempDcyc_C DSM_FMKDfp_AFSCD_PlOffsDrft_C DSM_FMKDfp_AFSCD_PlSetyDrft_C DSM_FMKDfp_AFSCD_Plaus_C DSM_FMKDfp_AFSCD_SRCAirTemp_C DSM_FMKDfp_AFSCD_SRCAirm_C DSM_FMKDfp_AFSCD_SRCAirm2_C DSM_FMKDfp_AFSCD_SRCBatt_C DSM_FMKDfp_AFSCD_SRCCorrAirm_C DSM_FMKDfp_AFSCD_SRCRawAirm_C DSM_FMKDfp_AFSCD_SRCRefSigPer_C DSM_FMKDfp_AFVCD_Actr_C DSM_FMKDfp_AOHtCDHt1_C DSM_FMKDfp_AOHtCDHt2_C DSM_FMKDfp_AOHtCDHt3_C DSM_FMKDfp_APP1_C DSM_FMKDfp_APP2_C DSM_FMKDfp_APPCD_KickDown_C DSM_FMKDfp_APPSync_C DSM_FMKDfp_APP_Npl_C DSM_FMKDfp_APSCD_C DSM_FMKDfp_AccPedPlausBrk_C DSM_FMKDfp_AddPCD_C DSM_FMKDfp_AddPCDTnkLvl_C DSM_FMKDfp_AddPCDTnkLvlDef_C DSM_FMKDfp_AirCtl_GovDev_C DSM_FMKDfp_AirbCDCrash_C DSM_FMKDfp_AirbCDCrashCrCtl_C DSM_FMKDfp_AirbCDCrashPSP_C DSM_FMKDfp_AltCDExc_C DSM_FMKDfp_AltCD_Load_C DSM_FMKDfp_AltPwrCan_C DSM_FMKDfp_BPACD_Max_C DSM_FMKDfp_BPACD_Min_C DSM_FMKDfp_BPACD_SigNpl_C DSM_FMKDfp_BPAExcSensTemp_C DSM_FMKDfp_BPANotLrn_C DSM_FMKDfp_BPASCDDcyc_C DSM_FMKDfp_BPASCDPeriod_C DSM_FMKDfp_BPSCD_C DSM_FMKDfp_BPSCDPlaus_C DSM_FMKDfp_BattCD_C DSM_FMKDfp_BrkCD_C DSM_FMKDfp_BrkCDdynPl_C DSM_FMKDfp_CANA_C DSM_FMKDfp_CANB_C DSM_FMKDfp_CANBus1_C DSM_FMKDfp_CANBus2_C DSM_FMKDfp_CANBus3_C DSM_FMKDfp_CANC_C DSM_FMKDfp_CANErrActA_C DSM_FMKDfp_CANErrActB_C DSM_FMKDfp_CANErrActC_C DSM_FMKDfp_COTSCD_C DSM_FMKDfp_CTSCD_C DSM_FMKDfp_CTSCDCanInac_C DSM_FMKDfp_CTSCDCanSig_C DSM_FMKDfp_Clg_DynTst_C DSM_FMKDfp_CmbChbMisfire1_C DSM_FMKDfp_CmbChbMisfire2_C DSM_FMKDfp_CmbChbMisfire3_C DSM_FMKDfp_CmbChbMisfire4_C DSM_FMKDfp_CmbChbMisfire5_C DSM_FMKDfp_CmbChbMisfire6_C DSM_FMKDfp_CmbChbMisfireMul_C DSM_FMKDfp_CoVMDCSh_C DSM_FMKDfp_CoVMDCSp_C DSM_FMKDfp_CoVehEcoErr_C DSM_FMKDfp_CoVehLvl2_C DSM_FMKDfp_ConvCD_C DSM_FMKDfp_ConvCD_ConvErr_C DSM_FMKDfp_CrCtlPLmpDef_C DSM_FMKDfp_CrCtlPShutOff_C DSM_FMKDfp_CrCtlPTlrDef_C DSM_FMKDfp_CrCtlPanErr_C DSM_FMKDfp_CrCtlPanSwtErr_C DSM_FMKDfp_CtApCD_C DSM_FMKDfp_CtTCD_C DSM_FMKDfp_CtT_Mon_C DSM_FMKDfp_DifftrqLimErrPat_C DSM_FMKDfp_EATSCD_C DSM_FMKDfp_EATSCDCanInac_C DSM_FMKDfp_EATSCDCanSig_C DSM_FMKDfp_EEPCDVarMng_C DSM_FMKDfp_EGPpCDTPreTrbn_C DSM_FMKDfp_EGPpCDTPreTrbn1_C DSM_FMKDfp_EGRCD_CBV_C DSM_FMKDfp_EGRCD_Max_C DSM_FMKDfp_EGRCD_Min_C DSM_FMKDfp_EGRCD_SigNpl_C DSM_FMKDfp_EMCCD_GTL1_C DSM_FMKDfp_EMCCD_GTL2_C DSM_FMKDfp_EMCCD_MLS1_C DSM_FMKDfp_EMCCD_MLS2_C DSM_FMKDfp_ETClbInj1_C DSM_FMKDfp_ETClbInj2_C DSM_FMKDfp_ETClbInj3_C DSM_FMKDfp_ETClbInj4_C DSM_FMKDfp_ETClbInj5_C DSM_FMKDfp_ETClbInj6_C DSM_FMKDfp_EngMCaS1_C DSM_FMKDfp_EngMCrS1_C DSM_FMKDfp_EngMOfsCaSCrS_C DSM_FMKDfp_EngMonIrrCmb_C DSM_FMKDfp_EngPrt_C DSM_FMKDfp_ErLpCDMILReqON_C DSM_FMKDfp_FMTC_NonMonotonMap_C DSM_FMKDfp_FQlSCD_C DSM_FMKDfp_FTSCD_C DSM_FMKDfp_FTSCDNpl_C DSM_FMKDfp_FanCD_Fan1Ctlr1_C DSM_FMKDfp_FanCD_Fan1Ctlr2_C DSM_FMKDfp_FanCD_Fan2Ctlr1_C DSM_FMKDfp_FanCD_Fan2Ctlr2_C DSM_FMKDfp_FanCD_FanCtlr1_C DSM_FMKDfp_FanCD_FanCtlr2_C DSM_FMKDfp_FanCD_OutFanCtlr1_C DSM_FMKDfp_FanCD_OutFanCtlr2_C DSM_FMKDfp_FlPpCD_C DSM_FMKDfp_FlSCDT1_C DSM_FMKDfp_FrmMngAAGNpl_C DSM_FMKDfp_FrmMngAAGTO_C DSM_FMKDfp_FrmMngAC1Npl_C DSM_FMKDfp_FrmMngAC1TO_C DSM_FMKDfp_FrmMngACCNpl_C DSM_FMKDfp_FrmMngACCTO_C DSM_FMKDfp_FrmMngAIRBGNpl_C DSM_FMKDfp_FrmMngAIRBGTO_C DSM_FMKDfp_FrmMngAWD1Npl_C DSM_FMKDfp_FrmMngAWD1TO_C DSM_FMKDfp_FrmMngBEM1Npl_C DSM_FMKDfp_FrmMngBEM1TO_C DSM_FMKDfp_FrmMngBRK1Npl_C DSM_FMKDfp_FrmMngBRK1TO_C DSM_FMKDfp_FrmMngBRK2Npl_C DSM_FMKDfp_FrmMngBRK2TO_C DSM_FMKDfp_FrmMngBRK8Npl_C DSM_FMKDfp_FrmMngBRK8TO_C DSM_FMKDfp_FrmMngCANVerErr_C DSM_FMKDfp_FrmMngCCSel_C DSM_FMKDfp_FrmMngCCTLNpl_C DSM_FMKDfp_FrmMngCCTLTO_C DSM_FMKDfp_FrmMngCHRGR1Npl_C DSM_FMKDfp_FrmMngCHRGR1TO_C DSM_FMKDfp_FrmMngCHRGR2Npl_C DSM_FMKDfp_FrmMngCHRGR2TO_C DSM_FMKDfp_FrmMngChrgr1A_C DSM_FMKDfp_FrmMngChrgr1C_C DSM_FMKDfp_FrmMngChrgr1N_C DSM_FMKDfp_FrmMngChrgr1T_C DSM_FMKDfp_FrmMngChrgr1V_C DSM_FMKDfp_FrmMngChrgr2A_C DSM_FMKDfp_FrmMngChrgr2C_C DSM_FMKDfp_FrmMngChrgr2N_C DSM_FMKDfp_FrmMngChrgr2T_C DSM_FMKDfp_FrmMngChrgr2V_C DSM_FMKDfp_FrmMngDIA1Npl_C DSM_FMKDfp_FrmMngDIA1TO_C DSM_FMKDfp_FrmMngDSP1Npl_C DSM_FMKDfp_FrmMngDSP1TO_C DSM_FMKDfp_FrmMngDSP2Npl_C DSM_FMKDfp_FrmMngDSP2TO_C DSM_FMKDfp_FrmMngESCUNpl_C DSM_FMKDfp_FrmMngESCUTO_C DSM_FMKDfp_FrmMngGW1Npl_C DSM_FMKDfp_FrmMngGW1TO_C DSM_FMKDfp_FrmMngILMNpl_C DSM_FMKDfp_FrmMngILMTO_C DSM_FMKDfp_FrmMngNIV1WrngCod_C DSM_FMKDfp_FrmMngNIVEAU1Npl_C DSM_FMKDfp_FrmMngNIVEAU1TO_C DSM_FMKDfp_FrmMngSTIGNNpl_C DSM_FMKDfp_FrmMngStIgnTO_C DSM_FMKDfp_FrmMngTOSNpl_C DSM_FMKDfp_FrmMngTOSTO_C DSM_FMKDfp_FrmMngTSC1Npl_C DSM_FMKDfp_FrmMngTSC1TO_C DSM_FMKDfp_FrmMngTSC2Npl_C DSM_FMKDfp_FrmMngTSC2TO_C DSM_FMKDfp_FrmMngTSC3Npl_C DSM_FMKDfp_FrmMngTSC3TO_C DSM_FMKDfp_GearbxASTh_C DSM_FMKDfp_GearbxASTl_C DSM_FMKDfp_GearbxTSC_C DSM_FMKDfp_GearbxTypeMTErr_C DSM_FMKDfp_GlwCD_Actr_C DSM_FMKDfp_GlwCD_DIAG_C DSM_FMKDfp_GlwCD_Error1_C DSM_FMKDfp_GlwCD_Error2_C DSM_FMKDfp_GlwCD_EvalCod_C DSM_FMKDfp_GlwCD_GSK_C DSM_FMKDfp_GlwCD_Lamp_C DSM_FMKDfp_GlwCD_LampCan_C DSM_FMKDfp_GlwCD_PLUG0_C DSM_FMKDfp_GlwCD_PLUG1_C DSM_FMKDfp_GlwCD_PLUG2_C DSM_FMKDfp_GlwCD_PLUG3_C DSM_FMKDfp_GlwCD_PLUG4_C DSM_FMKDfp_GlwCD_PLUG5_C DSM_FMKDfp_GlwCD_SFD_C DSM_FMKDfp_HDSCD_C DSM_FMKDfp_HWEMonCom_C DSM_FMKDfp_HWEMonEEPROM_C DSM_FMKDfp_HWEMonRcyLocked_C DSM_FMKDfp_HWEMonRcySuppressed_C DSM_FMKDfp_HWEMonRcyVisible_C DSM_FMKDfp_HWEMonUMaxSupply_C DSM_FMKDfp_HWEMonUMinSupply_C DSM_FMKDfp_IATSCD_C DSM_FMKDfp_IFCD_C DSM_FMKDfp_ImmCtl_C DSM_FMKDfp_InjCrv_InjLim_C DSM_FMKDfp_InjVCDActrChrg_C DSM_FMKDfp_InjVCDActrVolt_C DSM_FMKDfp_InjVCDClsBank1_C DSM_FMKDfp_InjVCDClsBank2_C DSM_FMKDfp_InjVCDMonCab_C DSM_FMKDfp_InjVCDMonSwt_C DSM_FMKDfp_InjVCDShOffDCDC_C DSM_FMKDfp_InjVCDUBuf_C DSM_FMKDfp_InjVCD_CY370Ampl_C DSM_FMKDfp_InjVlvBnk1A_C DSM_FMKDfp_InjVlvBnk1B_C DSM_FMKDfp_InjVlvBnk2A_C DSM_FMKDfp_InjVlvBnk2B_C DSM_FMKDfp_InjVlvChipA_C DSM_FMKDfp_InjVlvChipB_C DSM_FMKDfp_InjVlvCyl1A_C DSM_FMKDfp_InjVlvCyl1B_C DSM_FMKDfp_InjVlvCyl1C_C DSM_FMKDfp_InjVlvCyl2A_C DSM_FMKDfp_InjVlvCyl2B_C DSM_FMKDfp_InjVlvCyl2C_C DSM_FMKDfp_InjVlvCyl3A_C DSM_FMKDfp_InjVlvCyl3B_C DSM_FMKDfp_InjVlvCyl3C_C DSM_FMKDfp_InjVlvCyl4A_C DSM_FMKDfp_InjVlvCyl4B_C DSM_FMKDfp_InjVlvCyl4C_C DSM_FMKDfp_InjVlvCyl5A_C DSM_FMKDfp_InjVlvCyl5B_C DSM_FMKDfp_InjVlvCyl5C_C DSM_FMKDfp_InjVlvCyl6A_C DSM_FMKDfp_InjVlvCyl6B_C DSM_FMKDfp_InjVlvCyl6C_C DSM_FMKDfp_InjVlvCyl7A_C DSM_FMKDfp_InjVlvCyl7B_C DSM_FMKDfp_InjVlvCyl7C_C DSM_FMKDfp_InjVlvCyl8A_C DSM_FMKDfp_InjVlvCyl8B_C DSM_FMKDfp_InjVlvCyl8C_C DSM_FMKDfp_LSUCDCircNernst0_C DSM_FMKDfp_LSUCDCircPumpCur0_C DSM_FMKDfp_LSUCDCircVirtGnd0_C DSM_FMKDfp_LSUCDHeater0_C DSM_FMKDfp_LSUCDHtCoup0_C DSM_FMKDfp_LSUCDO20_C DSM_FMKDfp_LSUCDO2Clb0_C DSM_FMKDfp_LSUCDRiClb0_C DSM_FMKDfp_LSUCDSPI0_C DSM_FMKDfp_LSUCDSPIBattLow0_C DSM_FMKDfp_LSUCDWireIP0_C DSM_FMKDfp_LSUCtlRiExc0_C DSM_FMKDfp_LSUMon1Sens_C DSM_FMKDfp_LSUMon2Sens_C DSM_FMKDfp_MIL_C DSM_FMKDfp_MRlyCD_C DSM_FMKDfp_MeUnCDNoLoad_C DSM_FMKDfp_MeUnCDSCBat_C DSM_FMKDfp_MeUnCDSCGnd_C DSM_FMKDfp_MeUnCD_ADC_C DSM_FMKDfp_Montr_C DSM_FMKDfp_OTSCD_C DSM_FMKDfp_OTSCDCanInac_C DSM_FMKDfp_OTSCDCanSig_C DSM_FMKDfp_OvRMon_C DSM_FMKDfp_OvRMonCrCtlP_C DSM_FMKDfp_OvRMonSigA_C DSM_FMKDfp_OxiCCDTPre_C DSM_FMKDfp_OxiCCDTPre1_C DSM_FMKDfp_PCR_BalGovDev_C DSM_FMKDfp_PCR_GovDev_C DSM_FMKDfp_PCVCDNoLoad_C DSM_FMKDfp_PCVCDSCBat_C DSM_FMKDfp_PCVCDSCGnd_C DSM_FMKDfp_PCVCD_ADC_C DSM_FMKDfp_PFltCDHtg_C DSM_FMKDfp_PFltCDHtg1_C DSM_FMKDfp_PFltCDPDiff_C DSM_FMKDfp_PFltCDPDiff1_C DSM_FMKDfp_PFltCDTPre_C DSM_FMKDfp_PFltCDTPst_C DSM_FMKDfp_PFltCDTempPre_C DSM_FMKDfp_PFltCDTempPre1_C DSM_FMKDfp_PFltChar_C DSM_FMKDfp_PFltEngPrt_C DSM_FMKDfp_PFltPresDynPlaus_C DSM_FMKDfp_PFltPresSens_C DSM_FMKDfp_PFltPresSensHsLn_C DSM_FMKDfp_PFltPresSensSot_C DSM_FMKDfp_PFltRgnPerm_C DSM_FMKDfp_PFltTempDwnStrm_C DSM_FMKDfp_PFltTempSens_C DSM_FMKDfp_PFltTempUpStrm_C DSM_FMKDfp_PSPCD_Actr_C DSM_FMKDfp_PrpCtlvLimErrPat_C DSM_FMKDfp_RailCD_C DSM_FMKDfp_RailCDOfsTst_C DSM_FMKDfp_RailMeUn0_C DSM_FMKDfp_RailMeUn1_C DSM_FMKDfp_RailMeUn2_C DSM_FMKDfp_RailMeUn3_C DSM_FMKDfp_RailMeUn4_C DSM_FMKDfp_RailPCV0_C DSM_FMKDfp_RailPCV1_C DSM_FMKDfp_RailPCV2_C DSM_FMKDfp_RailPCV3_C DSM_FMKDfp_RailPCV4_C DSM_FMKDfp_RailPCV5_C DSM_FMKDfp_SOPTst_C DSM_FMKDfp_SSpMon1_C DSM_FMKDfp_SSpMon2_C DSM_FMKDfp_SSpMon3_C DSM_FMKDfp_StrtCDOffRly_C DSM_FMKDfp_StrtCDOnRly_C DSM_FMKDfp_StrtCtlIlsNotPlaus_C DSM_FMKDfp_StrtCtlT50ROneRly1_C DSM_FMKDfp_StrtCtlT50ROneRly2_C DSM_FMKDfp_StrtCtlT50RZero_C DSM_FMKDfp_SysLamp_C DSM_FMKDfp_T15CD_C DSM_FMKDfp_TPUMon_C DSM_FMKDfp_TTSCD_C DSM_FMKDfp_TVACD_Max_C DSM_FMKDfp_TVACD_Min_C DSM_FMKDfp_TVACD_SigNpl_C DSM_FMKDfp_TVACD_stLineDef_C DSM_FMKDfp_UAcc_CodeBitErr_C DSM_FMKDfp_USAp_DataVariant_C DSM_FMKDfp_USAp_FuncCodeRead_C DSM_FMKDfp_VSACD1_Max_C DSM_FMKDfp_VSACD1_Min_C DSM_FMKDfp_VSACD1_SigNpl_C DSM_FMKDfp_VSACD2_Max_C DSM_FMKDfp_VSACD2_Min_C DSM_FMKDfp_VSACD2_SigNpl_C DSM_FMKDfp_VSAExcSensTemp1_C DSM_FMKDfp_VSAExcSensTemp2_C DSM_FMKDfp_VSANotLrn1_C DSM_FMKDfp_VSANotLrn2_C DSM_FMKDfp_VSASCDDcyc1_C DSM_FMKDfp_VSASCDDcyc2_C DSM_FMKDfp_VSASCDPeriod1_C DSM_FMKDfp_VSASCDPeriod2_C DSM_FMKDfp_VSSCD1_C DSM_FMKDfp_VSSCD2_C DSM_FMKDfp_VSSCD4_C DSM_FMKDfp_VSSCDBrkLowVltg_C DSM_FMKDfp_VSSCDCAN_C DSM_FMKDfp_VSSCDNpl_C DSM_FMKDfp_WdCom_C /end DEF_CHARACTERISTIC
/end FUNCTION
/begin FUNCTION dsm_auto_cdc ""
 /begin DEF_CHARACTERISTIC DSM_CDCDfp_ACCCDWrongCoded_C DSM_CDCDfp_ACCD_C DSM_CDCDfp_ACCD_PAC_C DSM_CDCDfp_ACCD_pCAN_C DSM_CDCDfp_ACCD_trqCAN_C DSM_CDCDfp_ACCnotPlaus_C DSM_CDCDfp_ADCMon_C DSM_CDCDfp_AFSCD_AirTempDcyc_C DSM_CDCDfp_AFSCD_PlOffsDrft_C DSM_CDCDfp_AFSCD_PlSetyDrft_C DSM_CDCDfp_AFSCD_Plaus_C DSM_CDCDfp_AFSCD_SRCAirTemp_C DSM_CDCDfp_AFSCD_SRCAirm_C DSM_CDCDfp_AFSCD_SRCAirm2_C DSM_CDCDfp_AFSCD_SRCBatt_C DSM_CDCDfp_AFSCD_SRCCorrAirm_C DSM_CDCDfp_AFSCD_SRCRawAirm_C DSM_CDCDfp_AFSCD_SRCRefSigPer_C DSM_CDCDfp_AFVCD_Actr_C DSM_CDCDfp_AOHtCDHt1_C DSM_CDCDfp_AOHtCDHt2_C DSM_CDCDfp_AOHtCDHt3_C DSM_CDCDfp_APP1_C DSM_CDCDfp_APP2_C DSM_CDCDfp_APPCD_KickDown_C DSM_CDCDfp_APPSync_C DSM_CDCDfp_APP_Npl_C DSM_CDCDfp_APSCD_C DSM_CDCDfp_AccPedPlausBrk_C DSM_CDCDfp_AddPCD_C DSM_CDCDfp_AddPCDTnkLvl_C DSM_CDCDfp_AddPCDTnkLvlDef_C DSM_CDCDfp_AirCtl_GovDev_C DSM_CDCDfp_AirbCDCrash_C DSM_CDCDfp_AirbCDCrashCrCtl_C DSM_CDCDfp_AirbCDCrashPSP_C DSM_CDCDfp_AltCDExc_C DSM_CDCDfp_AltCD_Load_C DSM_CDCDfp_AltPwrCan_C DSM_CDCDfp_BPACD_Max_C DSM_CDCDfp_BPACD_Min_C DSM_CDCDfp_BPACD_SigNpl_C DSM_CDCDfp_BPAExcSensTemp_C DSM_CDCDfp_BPANotLrn_C DSM_CDCDfp_BPASCDDcyc_C DSM_CDCDfp_BPASCDPeriod_C DSM_CDCDfp_BPSCD_C DSM_CDCDfp_BPSCDPlaus_C DSM_CDCDfp_BattCD_C DSM_CDCDfp_BrkCD_C DSM_CDCDfp_BrkCDdynPl_C DSM_CDCDfp_CANA_C DSM_CDCDfp_CANB_C DSM_CDCDfp_CANBus1_C DSM_CDCDfp_CANBus2_C DSM_CDCDfp_CANBus3_C DSM_CDCDfp_CANC_C DSM_CDCDfp_CANErrActA_C DSM_CDCDfp_CANErrActB_C DSM_CDCDfp_CANErrActC_C DSM_CDCDfp_COTSCD_C DSM_CDCDfp_CTSCD_C DSM_CDCDfp_CTSCDCanInac_C DSM_CDCDfp_CTSCDCanSig_C DSM_CDCDfp_Clg_DynTst_C DSM_CDCDfp_CmbChbMisfire1_C DSM_CDCDfp_CmbChbMisfire2_C DSM_CDCDfp_CmbChbMisfire3_C DSM_CDCDfp_CmbChbMisfire4_C DSM_CDCDfp_CmbChbMisfire5_C DSM_CDCDfp_CmbChbMisfire6_C DSM_CDCDfp_CmbChbMisfireMul_C DSM_CDCDfp_CoVMDCSh_C DSM_CDCDfp_CoVMDCSp_C DSM_CDCDfp_CoVehEcoErr_C DSM_CDCDfp_CoVehLvl2_C DSM_CDCDfp_ConvCD_C DSM_CDCDfp_ConvCD_ConvErr_C DSM_CDCDfp_CrCtlPLmpDef_C DSM_CDCDfp_CrCtlPShutOff_C DSM_CDCDfp_CrCtlPTlrDef_C DSM_CDCDfp_CrCtlPanErr_C DSM_CDCDfp_CrCtlPanSwtErr_C DSM_CDCDfp_CtApCD_C DSM_CDCDfp_CtTCD_C DSM_CDCDfp_CtT_Mon_C DSM_CDCDfp_DifftrqLimErrPat_C DSM_CDCDfp_EATSCD_C DSM_CDCDfp_EATSCDCanInac_C DSM_CDCDfp_EATSCDCanSig_C DSM_CDCDfp_EEPCDVarMng_C DSM_CDCDfp_EGPpCDTPreTrbn_C DSM_CDCDfp_EGPpCDTPreTrbn1_C DSM_CDCDfp_EGRCD_CBV_C DSM_CDCDfp_EGRCD_Max_C DSM_CDCDfp_EGRCD_Min_C DSM_CDCDfp_EGRCD_SigNpl_C DSM_CDCDfp_EMCCD_GTL1_C DSM_CDCDfp_EMCCD_GTL2_C DSM_CDCDfp_EMCCD_MLS1_C DSM_CDCDfp_EMCCD_MLS2_C DSM_CDCDfp_ETClbInj1_C DSM_CDCDfp_ETClbInj2_C DSM_CDCDfp_ETClbInj3_C DSM_CDCDfp_ETClbInj4_C DSM_CDCDfp_ETClbInj5_C DSM_CDCDfp_ETClbInj6_C DSM_CDCDfp_EngMCaS1_C DSM_CDCDfp_EngMCrS1_C DSM_CDCDfp_EngMOfsCaSCrS_C DSM_CDCDfp_EngMonIrrCmb_C DSM_CDCDfp_EngPrt_C DSM_CDCDfp_ErLpCDMILReqON_C DSM_CDCDfp_FMTC_NonMonotonMap_C DSM_CDCDfp_FQlSCD_C DSM_CDCDfp_FTSCD_C DSM_CDCDfp_FTSCDNpl_C DSM_CDCDfp_FanCD_Fan1Ctlr1_C DSM_CDCDfp_FanCD_Fan1Ctlr2_C DSM_CDCDfp_FanCD_Fan2Ctlr1_C DSM_CDCDfp_FanCD_Fan2Ctlr2_C DSM_CDCDfp_FanCD_FanCtlr1_C DSM_CDCDfp_FanCD_FanCtlr2_C DSM_CDCDfp_FanCD_OutFanCtlr1_C DSM_CDCDfp_FanCD_OutFanCtlr2_C DSM_CDCDfp_FlPpCD_C DSM_CDCDfp_FlSCDT1_C DSM_CDCDfp_FrmMngAAGNpl_C DSM_CDCDfp_FrmMngAAGTO_C DSM_CDCDfp_FrmMngAC1Npl_C DSM_CDCDfp_FrmMngAC1TO_C DSM_CDCDfp_FrmMngACCNpl_C DSM_CDCDfp_FrmMngACCTO_C DSM_CDCDfp_FrmMngAIRBGNpl_C DSM_CDCDfp_FrmMngAIRBGTO_C DSM_CDCDfp_FrmMngAWD1Npl_C DSM_CDCDfp_FrmMngAWD1TO_C DSM_CDCDfp_FrmMngBEM1Npl_C DSM_CDCDfp_FrmMngBEM1TO_C DSM_CDCDfp_FrmMngBRK1Npl_C DSM_CDCDfp_FrmMngBRK1TO_C DSM_CDCDfp_FrmMngBRK2Npl_C DSM_CDCDfp_FrmMngBRK2TO_C DSM_CDCDfp_FrmMngBRK8Npl_C DSM_CDCDfp_FrmMngBRK8TO_C DSM_CDCDfp_FrmMngCANVerErr_C DSM_CDCDfp_FrmMngCCSel_C DSM_CDCDfp_FrmMngCCTLNpl_C DSM_CDCDfp_FrmMngCCTLTO_C DSM_CDCDfp_FrmMngCHRGR1Npl_C DSM_CDCDfp_FrmMngCHRGR1TO_C DSM_CDCDfp_FrmMngCHRGR2Npl_C DSM_CDCDfp_FrmMngCHRGR2TO_C DSM_CDCDfp_FrmMngChrgr1A_C DSM_CDCDfp_FrmMngChrgr1C_C DSM_CDCDfp_FrmMngChrgr1N_C DSM_CDCDfp_FrmMngChrgr1T_C DSM_CDCDfp_FrmMngChrgr1V_C DSM_CDCDfp_FrmMngChrgr2A_C DSM_CDCDfp_FrmMngChrgr2C_C DSM_CDCDfp_FrmMngChrgr2N_C DSM_CDCDfp_FrmMngChrgr2T_C DSM_CDCDfp_FrmMngChrgr2V_C DSM_CDCDfp_FrmMngDIA1Npl_C DSM_CDCDfp_FrmMngDIA1TO_C DSM_CDCDfp_FrmMngDSP1Npl_C DSM_CDCDfp_FrmMngDSP1TO_C DSM_CDCDfp_FrmMngDSP2Npl_C DSM_CDCDfp_FrmMngDSP2TO_C DSM_CDCDfp_FrmMngESCUNpl_C DSM_CDCDfp_FrmMngESCUTO_C DSM_CDCDfp_FrmMngGW1Npl_C DSM_CDCDfp_FrmMngGW1TO_C DSM_CDCDfp_FrmMngILMNpl_C DSM_CDCDfp_FrmMngILMTO_C DSM_CDCDfp_FrmMngNIV1WrngCod_C DSM_CDCDfp_FrmMngNIVEAU1Npl_C DSM_CDCDfp_FrmMngNIVEAU1TO_C DSM_CDCDfp_FrmMngSTIGNNpl_C DSM_CDCDfp_FrmMngStIgnTO_C DSM_CDCDfp_FrmMngTOSNpl_C DSM_CDCDfp_FrmMngTOSTO_C DSM_CDCDfp_FrmMngTSC1Npl_C DSM_CDCDfp_FrmMngTSC1TO_C DSM_CDCDfp_FrmMngTSC2Npl_C DSM_CDCDfp_FrmMngTSC2TO_C DSM_CDCDfp_FrmMngTSC3Npl_C DSM_CDCDfp_FrmMngTSC3TO_C DSM_CDCDfp_GearbxASTh_C DSM_CDCDfp_GearbxASTl_C DSM_CDCDfp_GearbxTSC_C DSM_CDCDfp_GearbxTypeMTErr_C DSM_CDCDfp_GlwCD_Actr_C DSM_CDCDfp_GlwCD_DIAG_C DSM_CDCDfp_GlwCD_Error1_C DSM_CDCDfp_GlwCD_Error2_C DSM_CDCDfp_GlwCD_EvalCod_C DSM_CDCDfp_GlwCD_GSK_C DSM_CDCDfp_GlwCD_Lamp_C DSM_CDCDfp_GlwCD_LampCan_C DSM_CDCDfp_GlwCD_PLUG0_C DSM_CDCDfp_GlwCD_PLUG1_C DSM_CDCDfp_GlwCD_PLUG2_C DSM_CDCDfp_GlwCD_PLUG3_C DSM_CDCDfp_GlwCD_PLUG4_C DSM_CDCDfp_GlwCD_PLUG5_C DSM_CDCDfp_GlwCD_SFD_C DSM_CDCDfp_HDSCD_C DSM_CDCDfp_HWEMonCom_C DSM_CDCDfp_HWEMonEEPROM_C DSM_CDCDfp_HWEMonRcyLocked_C DSM_CDCDfp_HWEMonRcySuppressed_C DSM_CDCDfp_HWEMonRcyVisible_C DSM_CDCDfp_HWEMonUMaxSupply_C DSM_CDCDfp_HWEMonUMinSupply_C DSM_CDCDfp_IATSCD_C DSM_CDCDfp_IFCD_C DSM_CDCDfp_ImmCtl_C DSM_CDCDfp_InjCrv_InjLim_C DSM_CDCDfp_InjVCDActrChrg_C DSM_CDCDfp_InjVCDActrVolt_C DSM_CDCDfp_InjVCDClsBank1_C DSM_CDCDfp_InjVCDClsBank2_C DSM_CDCDfp_InjVCDMonCab_C DSM_CDCDfp_InjVCDMonSwt_C DSM_CDCDfp_InjVCDShOffDCDC_C DSM_CDCDfp_InjVCDUBuf_C DSM_CDCDfp_InjVCD_CY370Ampl_C DSM_CDCDfp_InjVlvBnk1A_C DSM_CDCDfp_InjVlvBnk1B_C DSM_CDCDfp_InjVlvBnk2A_C DSM_CDCDfp_InjVlvBnk2B_C DSM_CDCDfp_InjVlvChipA_C DSM_CDCDfp_InjVlvChipB_C DSM_CDCDfp_InjVlvCyl1A_C DSM_CDCDfp_InjVlvCyl1B_C DSM_CDCDfp_InjVlvCyl1C_C DSM_CDCDfp_InjVlvCyl2A_C DSM_CDCDfp_InjVlvCyl2B_C DSM_CDCDfp_InjVlvCyl2C_C DSM_CDCDfp_InjVlvCyl3A_C DSM_CDCDfp_InjVlvCyl3B_C DSM_CDCDfp_InjVlvCyl3C_C DSM_CDCDfp_InjVlvCyl4A_C DSM_CDCDfp_InjVlvCyl4B_C DSM_CDCDfp_InjVlvCyl4C_C DSM_CDCDfp_InjVlvCyl5A_C DSM_CDCDfp_InjVlvCyl5B_C DSM_CDCDfp_InjVlvCyl5C_C DSM_CDCDfp_InjVlvCyl6A_C DSM_CDCDfp_InjVlvCyl6B_C DSM_CDCDfp_InjVlvCyl6C_C DSM_CDCDfp_InjVlvCyl7A_C DSM_CDCDfp_InjVlvCyl7B_C DSM_CDCDfp_InjVlvCyl7C_C DSM_CDCDfp_InjVlvCyl8A_C DSM_CDCDfp_InjVlvCyl8B_C DSM_CDCDfp_InjVlvCyl8C_C DSM_CDCDfp_LSUCDCircNernst0_C DSM_CDCDfp_LSUCDCircPumpCur0_C DSM_CDCDfp_LSUCDCircVirtGnd0_C DSM_CDCDfp_LSUCDHeater0_C DSM_CDCDfp_LSUCDHtCoup0_C DSM_CDCDfp_LSUCDO20_C DSM_CDCDfp_LSUCDO2Clb0_C DSM_CDCDfp_LSUCDRiClb0_C DSM_CDCDfp_LSUCDSPI0_C DSM_CDCDfp_LSUCDSPIBattLow0_C DSM_CDCDfp_LSUCDWireIP0_C DSM_CDCDfp_LSUCtlRiExc0_C DSM_CDCDfp_LSUMon1Sens_C DSM_CDCDfp_LSUMon2Sens_C DSM_CDCDfp_MIL_C DSM_CDCDfp_MRlyCD_C DSM_CDCDfp_MeUnCDNoLoad_C DSM_CDCDfp_MeUnCDSCBat_C DSM_CDCDfp_MeUnCDSCGnd_C DSM_CDCDfp_MeUnCD_ADC_C DSM_CDCDfp_Montr_C DSM_CDCDfp_OTSCD_C DSM_CDCDfp_OTSCDCanInac_C DSM_CDCDfp_OTSCDCanSig_C DSM_CDCDfp_OvRMon_C DSM_CDCDfp_OvRMonCrCtlP_C DSM_CDCDfp_OvRMonSigA_C DSM_CDCDfp_OxiCCDTPre_C DSM_CDCDfp_OxiCCDTPre1_C DSM_CDCDfp_PCR_BalGovDev_C DSM_CDCDfp_PCR_GovDev_C DSM_CDCDfp_PCVCDNoLoad_C DSM_CDCDfp_PCVCDSCBat_C DSM_CDCDfp_PCVCDSCGnd_C DSM_CDCDfp_PCVCD_ADC_C DSM_CDCDfp_PFltCDHtg_C DSM_CDCDfp_PFltCDHtg1_C DSM_CDCDfp_PFltCDPDiff_C DSM_CDCDfp_PFltCDPDiff1_C DSM_CDCDfp_PFltCDTPre_C DSM_CDCDfp_PFltCDTPst_C DSM_CDCDfp_PFltCDTempPre_C DSM_CDCDfp_PFltCDTempPre1_C DSM_CDCDfp_PFltChar_C DSM_CDCDfp_PFltEngPrt_C DSM_CDCDfp_PFltPresDynPlaus_C DSM_CDCDfp_PFltPresSens_C DSM_CDCDfp_PFltPresSensHsLn_C DSM_CDCDfp_PFltPresSensSot_C DSM_CDCDfp_PFltRgnPerm_C DSM_CDCDfp_PFltTempDwnStrm_C DSM_CDCDfp_PFltTempSens_C DSM_CDCDfp_PFltTempUpStrm_C DSM_CDCDfp_PSPCD_Actr_C DSM_CDCDfp_PrpCtlvLimErrPat_C DSM_CDCDfp_RailCD_C DSM_CDCDfp_RailCDOfsTst_C DSM_CDCDfp_RailMeUn0_C DSM_CDCDfp_RailMeUn1_C DSM_CDCDfp_RailMeUn2_C DSM_CDCDfp_RailMeUn3_C DSM_CDCDfp_RailMeUn4_C DSM_CDCDfp_RailPCV0_C DSM_CDCDfp_RailPCV1_C DSM_CDCDfp_RailPCV2_C DSM_CDCDfp_RailPCV3_C DSM_CDCDfp_RailPCV4_C DSM_CDCDfp_RailPCV5_C DSM_CDCDfp_SOPTst_C DSM_CDCDfp_SSpMon1_C DSM_CDCDfp_SSpMon2_C DSM_CDCDfp_SSpMon3_C DSM_CDCDfp_StrtCDOffRly_C DSM_CDCDfp_StrtCDOnRly_C DSM_CDCDfp_StrtCtlIlsNotPlaus_C DSM_CDCDfp_StrtCtlT50ROneRly1_C DSM_CDCDfp_StrtCtlT50ROneRly2_C DSM_CDCDfp_StrtCtlT50RZero_C DSM_CDCDfp_SysLamp_C DSM_CDCDfp_T15CD_C DSM_CDCDfp_TPUMon_C DSM_CDCDfp_TTSCD_C DSM_CDCDfp_TVACD_Max_C DSM_CDCDfp_TVACD_Min_C DSM_CDCDfp_TVACD_SigNpl_C DSM_CDCDfp_TVACD_stLineDef_C DSM_CDCDfp_UAcc_CodeBitErr_C DSM_CDCDfp_USAp_DataVariant_C DSM_CDCDfp_USAp_FuncCodeRead_C DSM_CDCDfp_VSACD1_Max_C DSM_CDCDfp_VSACD1_Min_C DSM_CDCDfp_VSACD1_SigNpl_C DSM_CDCDfp_VSACD2_Max_C DSM_CDCDfp_VSACD2_Min_C DSM_CDCDfp_VSACD2_SigNpl_C DSM_CDCDfp_VSAExcSensTemp1_C DSM_CDCDfp_VSAExcSensTemp2_C DSM_CDCDfp_VSANotLrn1_C DSM_CDCDfp_VSANotLrn2_C DSM_CDCDfp_VSASCDDcyc1_C DSM_CDCDfp_VSASCDDcyc2_C DSM_CDCDfp_VSASCDPeriod1_C DSM_CDCDfp_VSASCDPeriod2_C DSM_CDCDfp_VSSCD1_C DSM_CDCDfp_VSSCD2_C DSM_CDCDfp_VSSCD4_C DSM_CDCDfp_VSSCDBrkLowVltg_C DSM_CDCDfp_VSSCDCAN_C DSM_CDCDfp_VSSCDNpl_C DSM_CDCDfp_WdCom_C /end DEF_CHARACTERISTIC
/end FUNCTION
/begin COMPU_METHOD OneToOne "eins zu eins (physikalischer Wert ist gleich dem internen Wert)" RAT_FUNC "%6.2" "[-]" COEFFS 0 1 0 0 0 1 /end COMPU_METHOD
/begin RECORD_LAYOUT Kwb_Wu16 FNC_VALUES 1 UWORD COLUMN_DIR DIRECT /end RECORD_LAYOUT
/begin RECORD_LAYOUT Kw_Wu8 FNC_VALUES 1 UBYTE COLUMN_DIR DIRECT /end RECORD_LAYOUT
/end MODULE
/end PROJECT
