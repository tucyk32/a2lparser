ASAP2_VERSION 1 3
/begin PROJECT C177 "EDC16CP"
/begin HEADER "" VERSION "VCP7A3" PROJECT_NO C177 /end HEADER
/begin MODULE DIM ""
/begin MOD_COMMON "" BYTE_ORDER MSB_FIRST ALIGNMENT_BYTE 1 ALIGNMENT_WORD 2 ALIGNMENT_LONG 4 ALIGNMENT_FLOAT32_IEEE 4 /end MOD_COMMON
/begin CHARACTERISTIC InjCrv_dMI1BasMapNr_CUR "Temperaturabhängige Auswahlkennlinie für MI-Ansteuerbeginnkennraum" CURVE 0x1D5BA0 Kl_Xs16_Ws16 5.000000 Map_Select 0.00 5.000000 FORMAT "%8.6" EXTENDED_LIMITS -128.0000 127.9961
 /begin AXIS_DESCR STD_AXIS InjCrv_tBasMap_mp Temp_Cels 6 -50.14000 199.8600 FORMAT "%8.4" EXTENDED_LIMITS -3549.940 3003.560 DEPOSIT ABSOLUTE /end AXIS_DESCR
/end CHARACTERISTIC
/begin CHARACTERISTIC InjCrv_dtiMI1RgnRmpUp_C "positive Rampensteigung bei Umschaltung auf Regenerationswert MI1" VALUE 0x1D87D0 Kw_Wu32 65535999.9847 Rmp 0.00 65535999.9847 FORMAT "%13.4" /end CHARACTERISTIC
/begin CHARACTERISTIC InjCrv_dtiMI1RgnRmpDwn_C "negative Rampensteigung bei Umschaltung auf Regenerationswert MI1" VALUE 0x1D87D4 Kw_Wu32 65535999.9847 Rmp 0.00 65535999.9847 FORMAT "%13.4" /end CHARACTERISTIC
/begin CHARACTERISTIC InjCrv_dtiPiI1RgnRmpUp_C "positive Rampensteigung bei Umschaltung auf Regenerationswert PiI1" VALUE 0x1DB1B8 Kw_Wu32 65535999.9847 Rmp 0.00 65535999.9847 FORMAT "%13.4" /end CHARACTERISTIC
/begin CHARACTERISTIC InjCrv_dtiPiI1RgnRmpDwn_C "negative Rampensteigung bei Umschaltung auf Regenerationswert PiI1" VALUE 0x1DB1BC Kw_Wu32 65535999.9847 Rmp 0.00 65535999.9847 FORMAT "%13.4" /end CHARACTERISTIC
/begin CHARACTERISTIC InjCrv_dtiPiI2RgnRmpUp_C "positive Rampensteigung bei Umschaltung auf Regenerationswert PiI2" VALUE 0x1D9BE4 Kw_Wu32 65535999.9847 Rmp 0.00 65535999.9847 FORMAT "%13.4" /end CHARACTERISTIC
/begin CHARACTERISTIC InjCrv_dtiPiI2RgnRmpDwn_C "negative Rampensteigung bei Umschaltung auf Regenerationswert PiI2" VALUE 0x1D9BE8 Kw_Wu32 65535999.9847 Rmp 0.00 65535999.9847 FORMAT "%13.4" /end CHARACTERISTIC
/begin CHARACTERISTIC InjCrv_dtiPoI1RgnRmpUp_C "positive Rampensteigung bei Umschaltung auf Regenerationswerte PoI1" VALUE 0x1DBD30 Kw_Wu32 65535999.9847 Rmp 0.00 65535999.9847 FORMAT "%13.4" /end CHARACTERISTIC
/begin CHARACTERISTIC InjCrv_dtiPoI1RgnRmpDwn_C "negative Rampensteigung bei Umschaltung auf Regenerationswerte PoI1" VALUE 0x1DBD34 Kw_Wu32 65535999.9847 Rmp 0.00 65535999.9847 FORMAT "%13.4" /end CHARACTERISTIC
/begin CHARACTERISTIC InjCrv_dtiPoI2RgnRmpUp_C "positive Rampensteigung bei Umschaltung auf Regenerationswerte PoI2" VALUE 0x1DC31C Kw_Wu32 65535999.9847 Rmp 0.00 65535999.9847 FORMAT "%13.4" /end CHARACTERISTIC
/begin CHARACTERISTIC InjCrv_dtiPoI2RgnRmpDwn_C "negative Rampensteigung bei Umschaltung auf Regenerationswerte PoI2" VALUE 0x1DC320 Kw_Wu32 65535999.9847 Rmp 0.00 65535999.9847 FORMAT "%13.4" /end CHARACTERISTIC
/begin CHARACTERISTIC InjCrv_facMI1ETSSOERgnCor1_CUR "motortemperaturabhängige Ansteuerbeginnkorrekturkennlinie 1 für MI1 im Regenerationsfall" CURVE 0x1D81B0 Kl_Xs16_Ws16 1.000000 Fact 0.00 1.000000 FORMAT "%8.6" EXTENDED_LIMITS -4.000000 3.999878
 /begin AXIS_DESCR STD_AXIS Eng_tEng Temp_Cels 8 -50.14000 199.8600 FORMAT "%8.4" EXTENDED_LIMITS -3549.940 3003.560 DEPOSIT ABSOLUTE /end AXIS_DESCR
/end CHARACTERISTIC
/begin CHARACTERISTIC InjCrv_facMI1ETSSOERgnCor2_CUR "motortemperaturabhängige Ansteuerbeginnkorrekturkennlinie 2 für MI1 im Regenerationsfall" CURVE 0x1D81D2 Kl_Xs16_Ws16 1.000000 Fact 0.00 1.000000 FORMAT "%8.6" EXTENDED_LIMITS -4.000000 3.999878
 /begin AXIS_DESCR STD_AXIS Eng_tEng Temp_Cels 8 -50.14000 199.8600 FORMAT "%8.4" EXTENDED_LIMITS -3549.940 3003.560 DEPOSIT ABSOLUTE /end AXIS_DESCR
/end CHARACTERISTIC
/begin CHARACTERISTIC InjCrv_facMI1ETSSOERgnCor3_CUR "motortemperaturabhängige Ansteuerbeginnkorrekturkennlinie 3 für MI1 im Regenerationsfall" CURVE 0x1D81F4 Kl_Xs16_Ws16 1.000000 Fact 0.00 1.000000 FORMAT "%8.6" EXTENDED_LIMITS -4.000000 3.999878
 /begin AXIS_DESCR STD_AXIS Eng_tEng Temp_Cels 8 -50.14000 199.8600 FORMAT "%8.4" EXTENDED_LIMITS -3549.940 3003.560 DEPOSIT ABSOLUTE /end AXIS_DESCR
/end CHARACTERISTIC
/begin CHARACTERISTIC InjCrv_facMIAPSPhiCor_CUR "atmosphärendruckabhängige Ansteuerbeginnkorrekturkennlinie für MI1" CURVE 0x1D8216 Kl_Xs16_Ws16 1.000000 Fact 0.00 1.000000 FORMAT "%8.6" EXTENDED_LIMITS -4.000000 3.999878
 /begin AXIS_DESCR STD_AXIS InjCrv_pAPSSrcSel_mp Pres_hPa 8 0.00 4000.000 FORMAT "%8.3" EXTENDED_LIMITS -32768.00 32767.00 DEPOSIT ABSOLUTE /end AXIS_DESCR
/end CHARACTERISTIC
/begin CHARACTERISTIC InjCrv_facMIAPStCor_MAP "Druckkorrektur-faktorkennlinie über Menge, Temperatur" MAP 0x1D7434 Kf_Xs16_Ys16_Ws16 1.000000 Fact 0.00 1.000000 FORMAT "%8.6" EXTENDED_LIMITS -4.000000 3.999878
 /begin AXIS_DESCR STD_AXIS InjCtl_qSetUnBal InjMass 6 0.00 327.6700 FORMAT "%8.4" EXTENDED_LIMITS -327.6800 327.6700 DEPOSIT ABSOLUTE /end AXIS_DESCR
 /begin AXIS_DESCR STD_AXIS Eng_tEng Temp_Cels 6 -50.14000 199.8600 FORMAT "%8.4" EXTENDED_LIMITS -3549.940 3003.560 DEPOSIT ABSOLUTE /end AXIS_DESCR
/end CHARACTERISTIC
/begin CHARACTERISTIC InjCrv_facMIATSPhiCor_CUR "ansauglufttemperaturabhängige Ansteuerbeginnkorrekturkennlinie für MI1" CURVE 0x1D8238 Kl_Xs16_Ws16 1.000000 Fact 0.00 1.000000 FORMAT "%8.6" EXTENDED_LIMITS -4.000000 3.999878
 /begin AXIS_DESCR STD_AXIS IATSCD_tAir Temp_Cels 8 -50.14000 199.8600 FORMAT "%8.4" EXTENDED_LIMITS -3549.940 3003.560 DEPOSIT ABSOLUTE /end AXIS_DESCR
/end CHARACTERISTIC
/begin CHARACTERISTIC InjCrv_facMIFTSRailCor_CUR "Korrekturfaktorkennlinie für die MI1, abhängig von der kraftstofftemperaturabhängigen Raildruckkorrektur" CURVE 0x1D825A Kl_Xs16_Ws16 1.000000 Fact 0.00 1.000000 FORMAT "%8.6" EXTENDED_LIMITS -4.000000 3.999878
 /begin AXIS_DESCR STD_AXIS Rail_pSetPointFlTempCor Pres_Rail 8 -1800000. 1800000. FORMAT "%8.0" EXTENDED_LIMITS -3276800. 3276700. DEPOSIT ABSOLUTE /end AXIS_DESCR
/end CHARACTERISTIC
/begin CHARACTERISTIC InjCrv_facMIPCRPhiCor_MAP "Differenz-Raildruck Gewichtungsfaktorkennfeld für MI-Ansteuerbeginn" MAP 0x1D7498 Kf_Xs16_Ys16_Ws16 1.000000 Fact 0.00 1.000000 FORMAT "%8.6" EXTENDED_LIMITS -4.000000 3.999878
 /begin AXIS_DESCR STD_AXIS Eng_tEng Temp_Cels 8 -50.14000 199.8600 FORMAT "%8.4" EXTENDED_LIMITS -3549.940 3003.560 DEPOSIT ABSOLUTE /end AXIS_DESCR
 /begin AXIS_DESCR STD_AXIS InjCtl_qSetUnBal InjMass 6 0.00 327.6700 FORMAT "%8.4" EXTENDED_LIMITS -327.6800 327.6700 DEPOSIT ABSOLUTE /end AXIS_DESCR
/end CHARACTERISTIC
/begin CHARACTERISTIC InjCrv_facMIpRailDiffPhiCor_CUR "Korrekturfaktor für SOE-Winkelkorrektur abh. von Raildruck" CURVE 0x1D7518 Kl_Xs16_Ws16 1.000000 Fact 0.00 1.000000 FORMAT "%8.6" EXTENDED_LIMITS -4.000000 3.999878
 /begin AXIS_DESCR STD_AXIS InjCrv_pRailDiffLim Pres_Rail 8 0.00 1800000. FORMAT "%8.0" EXTENDED_LIMITS -3276800. 3276700. DEPOSIT ABSOLUTE /end AXIS_DESCR
/end CHARACTERISTIC
/begin CHARACTERISTIC InjCrv_facPiI1APSQCor2_CUR "atmosphärendruckabhängige Mengenkorrekturkennlinie für Voreinspritzung 1 wenn PiI2 oder PiI3 aktiv ist" CURVE 0x1DA444 Kl_Xs16_Ws16 1.000000 Fact 0.00 1.000000 FORMAT "%8.6" EXTENDED_LIMITS -4.000000 3.999878
 /begin AXIS_DESCR STD_AXIS APSCD_pVal Pres_hPa 8 0.00 3500.000 FORMAT "%8.3" EXTENDED_LIMITS -32768.00 32767.00 DEPOSIT ABSOLUTE /end AXIS_DESCR
/end CHARACTERISTIC
/begin CHARACTERISTIC InjCrv_facPiI1APSQCor_CUR "atmosphärendruckabhängige Mengenkorrekturkennlinie für Voreinspritzung 1" CURVE 0x1DA466 Kl_Xs16_Ws16 1.000000 Fact 0.00 1.000000 FORMAT "%8.6" EXTENDED_LIMITS -4.000000 3.999878
 /begin AXIS_DESCR STD_AXIS APSCD_pVal Pres_hPa 8 0.00 3500.000 FORMAT "%8.3" EXTENDED_LIMITS -32768.00 32767.00 DEPOSIT ABSOLUTE /end AXIS_DESCR
/end CHARACTERISTIC
/begin CHARACTERISTIC InjCrv_facPiI1APSSOECor_CUR "kundenspezifische atmosphärendruckabhängige Gewichtungskennlinie der Spritzbeginnkorrektur der PiI1" CURVE 0x1D9DB6 Kl_Xs16_Ws16 1.000000 Fact 0.00 1.000000 FORMAT "%8.6" EXTENDED_LIMITS -4.000000 3.999878
 /begin AXIS_DESCR STD_AXIS InjCrv_pSrcSel_mp Pres_hPa 8 0.00 3500.000 FORMAT "%8.3" EXTENDED_LIMITS -32768.00 32767.00 DEPOSIT ABSOLUTE /end AXIS_DESCR
/end CHARACTERISTIC
/begin CHARACTERISTIC InjCrv_facPiI1ATSQCor2_CUR "ansauglufttemperaturabhängige Mengenkorrekturkennlinie für Voreinspritzung 1 wenn PiI2 oder PiI3 aktiv ist" CURVE 0x1DA488 Kl_Xs16_Ws16 1.000000 Fact 0.00 1.000000 FORMAT "%8.6" EXTENDED_LIMITS -4.000000 3.999878
 /begin AXIS_DESCR STD_AXIS IATSCD_tAir Temp_Cels 8 -50.14000 199.8600 FORMAT "%8.4" EXTENDED_LIMITS -3549.940 3003.560 DEPOSIT ABSOLUTE /end AXIS_DESCR
/end CHARACTERISTIC
/begin CHARACTERISTIC InjCrv_facPiI1ATSQCor_CUR "ansauglufttemperaturabhängige Mengenkorrekturkennlinie für Voreinspritzung 1" CURVE 0x1DA4AA Kl_Xs16_Ws16 1.000000 Fact 0.00 1.000000 FORMAT "%8.6" EXTENDED_LIMITS -4.000000 3.999878
 /begin AXIS_DESCR STD_AXIS IATSCD_tAir Temp_Cels 8 -50.14000 199.8600 FORMAT "%8.4" EXTENDED_LIMITS -3549.940 3003.560 DEPOSIT ABSOLUTE /end AXIS_DESCR
/end CHARACTERISTIC
/begin CHARACTERISTIC InjCrv_facPiI1ETSQCor2_CUR "motortemperaturabhängige Mengenkorrekturkennlinie für Voreinspritzung 1 wenn PiI2 oder PiI3 aktiv ist" CURVE 0x1DA4CC Kl_Xs16_Ws16 1.000000 Fact 0.00 1.000000 FORMAT "%8.6" EXTENDED_LIMITS -4.000000 3.999878
 /begin AXIS_DESCR STD_AXIS Eng_tEng Temp_Cels 8 -50.14000 199.8600 FORMAT "%8.4" EXTENDED_LIMITS -3549.940 3003.560 DEPOSIT ABSOLUTE /end AXIS_DESCR
/end CHARACTERISTIC
/begin CHARACTERISTIC InjCrv_facPiI1ETSQCor_CUR "motortemperaturabhängige Mengenkorrekturkennlinie für Voreinspritzung 1" CURVE 0x1DA4EE Kl_Xs16_Ws16 1.000000 Fact 0.00 1.000000 FORMAT "%8.6" EXTENDED_LIMITS -4.000000 3.999878
 /begin AXIS_DESCR STD_AXIS Eng_tEng Temp_Cels 8 -50.14000 199.8600 FORMAT "%8.4" EXTENDED_LIMITS -3549.940 3003.560 DEPOSIT ABSOLUTE /end AXIS_DESCR
/end CHARACTERISTIC
/begin CHARACTERISTIC InjCrv_facPiI1ETSSOECor_CUR "motortemperaturabhängige Ansteuerbeginnkorrekturkennlinie für Voreinspritzung 1" CURVE 0x1DA510 Kl_Xs16_Ws16 1.000000 Fact 0.00 1.000000 FORMAT "%8.6" EXTENDED_LIMITS -4.000000 3.999878
 /begin AXIS_DESCR STD_AXIS Eng_tEng Temp_Cels 8 -50.14000 199.8600 FORMAT "%8.4" EXTENDED_LIMITS -3549.940 3003.560 DEPOSIT ABSOLUTE /end AXIS_DESCR
/end CHARACTERISTIC
/begin CHARACTERISTIC InjCrv_facPiI1ETSSOERgnCor1_CUR "motortemperaturabhängige Ansteuerbeginnkorrekturlinie 1 im Regenerationsfall" CURVE 0x1DA532 Kl_Xs16_Ws16 1.000000 Fact 0.00 1.000000 FORMAT "%8.6" EXTENDED_LIMITS -4.000000 3.999878
 /begin AXIS_DESCR STD_AXIS Eng_tEng Temp_Cels 8 -50.14000 199.8600 FORMAT "%8.4" EXTENDED_LIMITS -3549.940 3003.560 DEPOSIT ABSOLUTE /end AXIS_DESCR
/end CHARACTERISTIC
/begin CHARACTERISTIC InjCrv_facPiI1ETSSOERgnCor2_CUR "motortemperaturabhängige Ansteuerbeginnkorrekturlinie 2 im Regenerationsfall" CURVE 0x1DA554 Kl_Xs16_Ws16 1.000000 Fact 0.00 1.000000 FORMAT "%8.6" EXTENDED_LIMITS -4.000000 3.999878
 /begin AXIS_DESCR STD_AXIS Eng_tEng Temp_Cels 8 -50.14000 199.8600 FORMAT "%8.4" EXTENDED_LIMITS -3549.940 3003.560 DEPOSIT ABSOLUTE /end AXIS_DESCR
/end CHARACTERISTIC
/begin CHARACTERISTIC InjCrv_facPiI1ETSSOERgnCor3_CUR "motortemperaturabhängige Ansteuerbeginnkorrekturlinie 3 im Regenerationsfall" CURVE 0x1DA576 Kl_Xs16_Ws16 1.000000 Fact 0.00 1.000000 FORMAT "%8.6" EXTENDED_LIMITS -4.000000 3.999878
 /begin AXIS_DESCR STD_AXIS Eng_tEng Temp_Cels 8 -50.14000 199.8600 FORMAT "%8.4" EXTENDED_LIMITS -3549.940 3003.560 DEPOSIT ABSOLUTE /end AXIS_DESCR
/end CHARACTERISTIC
/begin CHARACTERISTIC InjCrv_facPiI1QntMax_C "Wichtungsfaktor für die berechnete Sollmenge der Voreinspritzung 1" VALUE 0x1D9104 Kw_Ws16 1.000000 Fact1 0.00 1.000000 FORMAT "%8.6" EXTENDED_LIMITS -256.0000 255.9922 /end CHARACTERISTIC
/begin CHARACTERISTIC InjCrv_facPiI1QntMin_CUR "raildruckabhängige Kennlinie zur Ermittlung des Faktor fuer die Berechnung der Mindestmenge um die PiI1 abzuschalten" CURVE 0x1D87E4 Kl_Xs16_Ws16 1.000000 Fact1 0.00 1.000000 FORMAT "%8.6" EXTENDED_LIMITS -256.0000 255.9922
 /begin AXIS_DESCR STD_AXIS RailCD_pPeak Pres_Rail 8 0.00 1800000. FORMAT "%8.0" EXTENDED_LIMITS -3276800. 3276700. DEPOSIT ABSOLUTE /end AXIS_DESCR
/end CHARACTERISTIC
/begin CHARACTERISTIC InjCrv_facPiI2APSQCor_CUR "atmosphärendruckabhängige Mengenkorrekturkennlinie für Voreinspritzung 2" CURVE 0x1D9A28 Kl_Xs16_Ws16 1.000000 Fact 0.00 1.000000 FORMAT "%8.6" EXTENDED_LIMITS -4.000000 3.999878
 /begin AXIS_DESCR STD_AXIS APSCD_pVal Pres_hPa 8 0.00 3500.000 FORMAT "%8.3" EXTENDED_LIMITS -32768.00 32767.00 DEPOSIT ABSOLUTE /end AXIS_DESCR
/end CHARACTERISTIC
/begin CHARACTERISTIC InjCrv_facPiI2ATSQCor_CUR "ansauglufttemperaturabhängige Mengenkorrekturkennlinie für Voreinspritzung 2" CURVE 0x1D9A4A Kl_Xs16_Ws16 1.000000 Fact 0.00 1.000000 FORMAT "%8.6" EXTENDED_LIMITS -4.000000 3.999878
 /begin AXIS_DESCR STD_AXIS IATSCD_tAir Temp_Cels 8 -50.14000 199.8600 FORMAT "%8.4" EXTENDED_LIMITS -3549.940 3003.560 DEPOSIT ABSOLUTE /end AXIS_DESCR
/end CHARACTERISTIC
/begin CHARACTERISTIC InjCrv_facPiI2ETSQCor_CUR "motortemperaturabhängige Mengenkorrekturkennlinie für Voreinspritzung 2" CURVE 0x1D9A6C Kl_Xs16_Ws16 1.000000 Fact 0.00 1.000000 FORMAT "%8.6" EXTENDED_LIMITS -4.000000 3.999878
 /begin AXIS_DESCR STD_AXIS InjCrv_tEng Temp_Cels 8 -50.14000 199.8600 FORMAT "%8.4" EXTENDED_LIMITS -3549.940 3003.560 DEPOSIT ABSOLUTE /end AXIS_DESCR
/end CHARACTERISTIC
/begin CHARACTERISTIC InjCrv_facPiI2ETSSOECor_CUR "motortemperaturabhängige Ansteuerbeginnkorrekturkennlinie für Voreinspritzung 2" CURVE 0x1D9A8E Kl_Xs16_Ws16 1.000000 Fact 0.00 1.000000 FORMAT "%8.6" EXTENDED_LIMITS -4.000000 3.999878
 /begin AXIS_DESCR STD_AXIS InjCrv_tEng Temp_Cels 8 -50.14000 199.8600 FORMAT "%8.4" EXTENDED_LIMITS -3549.940 3003.560 DEPOSIT ABSOLUTE /end AXIS_DESCR
/end CHARACTERISTIC
/begin CHARACTERISTIC InjCrv_facPiI2QntMin_CUR "Faktor zur Berechnung der Mindestmenge fuer die Abschaltung der Voreinspritzung PiI2" CURVE 0x1D9106 Kl_Xs16_Ws16 1.000000 Fact1 0.00 1.000000 FORMAT "%8.6" EXTENDED_LIMITS -256.0000 255.9922
 /begin AXIS_DESCR STD_AXIS RailCD_pPeak Pres_Rail 8 0.00 1800000. FORMAT "%8.0" EXTENDED_LIMITS -3276800. 3276700. DEPOSIT ABSOLUTE /end AXIS_DESCR
/end CHARACTERISTIC
/begin CHARACTERISTIC InjCrv_facPoI1APSQCor_CUR "atmospärendruckabhängige Mengenkorrekturkennlinie für PoI1" CURVE 0x1DB798 Kl_Xs16_Ws16 1.000000 Fact 0.00 1.000000 FORMAT "%8.6" EXTENDED_LIMITS -4.000000 3.999878
 /begin AXIS_DESCR STD_AXIS APSCD_pVal Pres_hPa 6 0.00 3500.000 FORMAT "%8.3" EXTENDED_LIMITS -32768.00 32767.00 DEPOSIT ABSOLUTE /end AXIS_DESCR
/end CHARACTERISTIC
/begin CHARACTERISTIC InjCrv_facPoI1ETSPhiCor_CUR "motortemperaturabhängige Winkelkorrekturkennlinie für PoI1" CURVE 0x1DB7B2 Kl_Xs16_Ws16 1.000000 Fact 0.00 1.000000 FORMAT "%8.6" EXTENDED_LIMITS -4.000000 3.999878
 /begin AXIS_DESCR STD_AXIS InjCrv_tEng Temp_Cels 6 -50.14000 199.8600 FORMAT "%8.4" EXTENDED_LIMITS -3549.940 3003.560 DEPOSIT ABSOLUTE /end AXIS_DESCR
/end CHARACTERISTIC
/begin CHARACTERISTIC InjCrv_facPoI1ETSQCor_CUR "motortemperaturabhängige Mengenkorrekturkennlinie für PoI1" CURVE 0x1DB7CC Kl_Xs16_Ws16 1.000000 Fact 0.00 1.000000 FORMAT "%8.6" EXTENDED_LIMITS -4.000000 3.999878
 /begin AXIS_DESCR STD_AXIS InjCrv_tEng Temp_Cels 6 -50.14000 199.8600 FORMAT "%8.4" EXTENDED_LIMITS -3549.940 3003.560 DEPOSIT ABSOLUTE /end AXIS_DESCR
/end CHARACTERISTIC
/begin CHARACTERISTIC InjCrv_facPoI2ATSQCor_CUR "ansauglufttemperaturabhängige Mengenkorrekturkennlinie für Nacheinspritzung 2" CURVE 0x1DBED8 Kl_Xs16_Ws16 1.000000 Fact 0.00 1.000000 FORMAT "%8.6" EXTENDED_LIMITS -4.000000 3.999878
 /begin AXIS_DESCR STD_AXIS IATSCD_tAir Temp_Cels 6 -50.14000 199.8600 FORMAT "%8.4" EXTENDED_LIMITS -3549.940 3003.560 DEPOSIT ABSOLUTE /end AXIS_DESCR
/end CHARACTERISTIC
/begin CHARACTERISTIC InjCrv_facPoI2ATSSOECor_CUR "ansauglufttemperaturabhängige Ansteuerbeginnkorrekturkennlinie für Nacheinspritzung 2" CURVE 0x1DBEF2 Kl_Xs16_Ws16 1.000000 Fact 0.00 1.000000 FORMAT "%8.6" EXTENDED_LIMITS -4.000000 3.999878
 /begin AXIS_DESCR STD_AXIS IATSCD_tAir Temp_Cels 6 -50.14000 199.8600 FORMAT "%8.4" EXTENDED_LIMITS -3549.940 3003.560 DEPOSIT ABSOLUTE /end AXIS_DESCR
/end CHARACTERISTIC
/begin CHARACTERISTIC InjCrv_facPoI2Eff_MAP "Faktor für Drehmoment bildenden Anteil der Einspritzmenge PoI2" MAP 0x1DC1C4 Kf_Xs16_Ys16_Ws16 1.000000 Fact 0.00 1.000000 FORMAT "%8.6" EXTENDED_LIMITS -4.000000 3.999878
 /begin AXIS_DESCR STD_AXIS Eng_nAvrg EngN 8 0.00 6000.000 FORMAT "%8.3" EXTENDED_LIMITS -32768.00 32767.00 DEPOSIT ABSOLUTE /end AXIS_DESCR
 /begin AXIS_DESCR STD_AXIS InjCtl_qSetUnBal InjMass 8 0.00 327.6700 FORMAT "%8.4" EXTENDED_LIMITS -327.6800 327.6700 DEPOSIT ABSOLUTE /end AXIS_DESCR
/end CHARACTERISTIC
/begin CHARACTERISTIC InjCrv_facPoI2ETSQCor_CUR "motortemperaturabhängige Mengenkorrekturkennlinie für Nacheinspritzung 2" CURVE 0x1DBF0C Kl_Xs16_Ws16 1.000000 Fact 0.00 1.000000 FORMAT "%8.6" EXTENDED_LIMITS -4.000000 3.999878
 /begin AXIS_DESCR STD_AXIS InjCrv_tEng Temp_Cels 6 -50.14000 199.8600 FORMAT "%8.4" EXTENDED_LIMITS -3549.940 3003.560 DEPOSIT ABSOLUTE /end AXIS_DESCR
/end CHARACTERISTIC
/begin CHARACTERISTIC InjCrv_facPoI2ETSSOECor_CUR "motortemperaturabhängige Ansteuerbeginnkorrekturkennlinie für PoI2" CURVE 0x1DBF26 Kl_Xs16_Ws16 1.000000 Fact 0.00 1.000000 FORMAT "%8.6" EXTENDED_LIMITS -4.000000 3.999878
 /begin AXIS_DESCR STD_AXIS InjCrv_tEng Temp_Cels 6 -50.14000 199.8600 FORMAT "%8.4" EXTENDED_LIMITS -3549.940 3003.560 DEPOSIT ABSOLUTE /end AXIS_DESCR
/end CHARACTERISTIC
/begin CHARACTERISTIC InjCrv_facPoI2QntMin_C "Faktor zur applikativen Abschaltung der PoI2 bei Unterschreitung der Mindestmenge" VALUE 0x1DC268 Kw_Ws16 1.000000 Fact1 0.00 1.000000 FORMAT "%8.6" EXTENDED_LIMITS -256.0000 255.9922 /end CHARACTERISTIC
/begin CHARACTERISTIC InjCrv_facPOpPoI2ETSCor_CUR "motortemperaturabhängige Freigabekorrekturkennlinie für PoI2" CURVE 0x1DBF40 Kl_Xs16_Ws16 1.000000 Fact 0.00 1.000000 FORMAT "%8.6" EXTENDED_LIMITS -4.000000 3.999878
 /begin AXIS_DESCR STD_AXIS InjCrv_tEng Temp_Cels 6 -50.14000 199.8600 FORMAT "%8.4" EXTENDED_LIMITS -3549.940 3003.560 DEPOSIT ABSOLUTE /end AXIS_DESCR
/end CHARACTERISTIC
/begin CHARACTERISTIC InjCrv_nCorPRailMax_C "Drehzahlschwelle für SOE Korrektur abh. von Raildruck" VALUE 0x1D753A Kw_Ws16 5960.000 EngN 40.00000 6000.000 FORMAT "%8.3" EXTENDED_LIMITS -32768.00 32767.00 /end CHARACTERISTIC
/begin CHARACTERISTIC InjCrv_nDiffMin_C "Minimaler Drehzahlunterschied für die Freigabe der Voreinspritzung 2" VALUE 0x1D9128 Kw_Ws16 6000.000 EngN 0.00 6000.000 FORMAT "%8.3" EXTENDED_LIMITS -32768.00 32767.00 /end CHARACTERISTIC
/begin CHARACTERISTIC InjCrv_numTDCPoI1Clsn_C "Nummer des kollidierenden Zylinders" VALUE 0x1DB1CE Kw_Wu8 255.0 OneToOne 0.00 255.0 FORMAT "%5.1" /end CHARACTERISTIC
/begin CHARACTERISTIC InjCrv_phiDynOfs_CUR "Winkelvorhalt für schnelle dynamische Vorgänge" CURVE 0x1DB1D0 Kl_Xs16_Ws16 767.9766 AngleCrS 0.00 767.9766 FORMAT "%8.4" EXTENDED_LIMITS -768.0000 767.9766
 /begin AXIS_DESCR STD_AXIS Eng_nAvrg EngN 12 0.00 6000.000 FORMAT "%8.3" EXTENDED_LIMITS -32768.00 32767.00 DEPOSIT ABSOLUTE /end AXIS_DESCR
/end CHARACTERISTIC
/begin CHARACTERISTIC InjCrv_phiMI1Bas11_MAP "Ansteuerbeginnkennfeld 1 MI1" MAP 0x1D5BBA Kf_Xs16_Ys16_Ws16 50.01562 AngleCrS -10.00781 40.00781 FORMAT "%8.5" EXTENDED_LIMITS -768.0000 767.9766
 /begin AXIS_DESCR STD_AXIS Eng_nAvrg EngN 10 0.00 6000.000 FORMAT "%8.3" EXTENDED_LIMITS -32768.00 32767.00 DEPOSIT ABSOLUTE /end AXIS_DESCR
 /begin AXIS_DESCR STD_AXIS InjCtl_qSetUnBal InjMass 10 0.00 327.6700 FORMAT "%8.4" EXTENDED_LIMITS -327.6800 327.6700 DEPOSIT ABSOLUTE /end AXIS_DESCR
/end CHARACTERISTIC
/begin CHARACTERISTIC InjCrv_phiMI1Bas12_MAP "Ansteuerbeginnkennfeld 2 MI1" MAP 0x1D5CAE Kf_Xs16_Ys16_Ws16 50.01562 AngleCrS -10.00781 40.00781 FORMAT "%8.5" EXTENDED_LIMITS -768.0000 767.9766
 /begin AXIS_DESCR STD_AXIS Eng_nAvrg EngN 10 0.00 6000.000 FORMAT "%8.3" EXTENDED_LIMITS -32768.00 32767.00 DEPOSIT ABSOLUTE /end AXIS_DESCR
 /begin AXIS_DESCR STD_AXIS InjCtl_qSetUnBal InjMass 10 0.00 327.6700 FORMAT "%8.4" EXTENDED_LIMITS -327.6800 327.6700 DEPOSIT ABSOLUTE /end AXIS_DESCR
/end CHARACTERISTIC
/begin CHARACTERISTIC InjCrv_phiMI1Bas13_MAP "Ansteuerbeginnkennfeld 3 MI1" MAP 0x1D5DA2 Kf_Xs16_Ys16_Ws16 50.01562 AngleCrS -10.00781 40.00781 FORMAT "%8.5" EXTENDED_LIMITS -768.0000 767.9766
 /begin AXIS_DESCR STD_AXIS Eng_nAvrg EngN 10 0.00 6000.000 FORMAT "%8.3" EXTENDED_LIMITS -32768.00 32767.00 DEPOSIT ABSOLUTE /end AXIS_DESCR
 /begin AXIS_DESCR STD_AXIS InjCtl_qSetUnBal InjMass 10 0.00 327.6700 FORMAT "%8.4" EXTENDED_LIMITS -327.6800 327.6700 DEPOSIT ABSOLUTE /end AXIS_DESCR
/end CHARACTERISTIC
/begin CHARACTERISTIC InjCrv_phiMI1Bas14_MAP "Ansteuerbeginnkennfeld 4 MI1" MAP 0x1D5E96 Kf_Xs16_Ys16_Ws16 50.01562 AngleCrS -10.00781 40.00781 FORMAT "%8.5" EXTENDED_LIMITS -768.0000 767.9766
 /begin AXIS_DESCR STD_AXIS Eng_nAvrg EngN 10 0.00 6000.000 FORMAT "%8.3" EXTENDED_LIMITS -32768.00 32767.00 DEPOSIT ABSOLUTE /end AXIS_DESCR
 /begin AXIS_DESCR STD_AXIS InjCtl_qSetUnBal InjMass 10 0.00 327.6700 FORMAT "%8.4" EXTENDED_LIMITS -327.6800 327.6700 DEPOSIT ABSOLUTE /end AXIS_DESCR
/end CHARACTERISTIC
/begin CHARACTERISTIC InjCrv_phiMI1Bas15_MAP "Ansteuerbeginnkennfeld 5 MI1" MAP 0x1D5F8A Kf_Xs16_Ys16_Ws16 50.01562 AngleCrS -10.00781 40.00781 FORMAT "%8.5" EXTENDED_LIMITS -768.0000 767.9766
 /begin AXIS_DESCR STD_AXIS Eng_nAvrg EngN 10 0.00 6000.000 FORMAT "%8.3" EXTENDED_LIMITS -32768.00 32767.00 DEPOSIT ABSOLUTE /end AXIS_DESCR
 /begin AXIS_DESCR STD_AXIS InjCtl_qSetUnBal InjMass 10 0.00 327.6700 FORMAT "%8.4" EXTENDED_LIMITS -327.6800 327.6700 DEPOSIT ABSOLUTE /end AXIS_DESCR
/end CHARACTERISTIC
/begin CHARACTERISTIC InjCrv_phiMI1Bas16_MAP "Ansteuerbeginnkennfeld 6 MI1" MAP 0x1D607E Kf_Xs16_Ys16_Ws16 50.01562 AngleCrS -10.00781 40.00781 FORMAT "%8.5" EXTENDED_LIMITS -768.0000 767.9766
 /begin AXIS_DESCR STD_AXIS Eng_nAvrg EngN 10 0.00 6000.000 FORMAT "%8.3" EXTENDED_LIMITS -32768.00 32767.00 DEPOSIT ABSOLUTE /end AXIS_DESCR
 /begin AXIS_DESCR STD_AXIS InjCtl_qSetUnBal InjMass 10 0.00 327.6700 FORMAT "%8.4" EXTENDED_LIMITS -327.6800 327.6700 DEPOSIT ABSOLUTE /end AXIS_DESCR
/end CHARACTERISTIC
/begin CHARACTERISTIC InjCrv_phiMI1Bas21_MAP "Ansteuerbeginnkennfeld 1 MI1 (+PI1)" MAP 0x1D6172 Kf_Xs16_Ys16_Ws16 50.01562 AngleCrS -10.00781 40.00781 FORMAT "%8.5" EXTENDED_LIMITS -768.0000 767.9766
 /begin AXIS_DESCR STD_AXIS Eng_nAvrg EngN 14 0.00 6000.000 FORMAT "%8.3" EXTENDED_LIMITS -32768.00 32767.00 DEPOSIT ABSOLUTE /end AXIS_DESCR
 /begin AXIS_DESCR STD_AXIS InjCtl_qSetUnBal InjMass 10 0.00 327.6700 FORMAT "%8.4" EXTENDED_LIMITS -327.6800 327.6700 DEPOSIT ABSOLUTE /end AXIS_DESCR
/end CHARACTERISTIC
/begin CHARACTERISTIC InjCrv_phiMI1Bas22_MAP "Ansteuerbeginnkennfeld 2 MI1 (+PI1)" MAP 0x1D62BE Kf_Xs16_Ys16_Ws16 50.01562 AngleCrS -10.00781 40.00781 FORMAT "%8.5" EXTENDED_LIMITS -768.0000 767.9766
 /begin AXIS_DESCR STD_AXIS Eng_nAvrg EngN 14 0.00 6000.000 FORMAT "%8.3" EXTENDED_LIMITS -32768.00 32767.00 DEPOSIT ABSOLUTE /end AXIS_DESCR
 /begin AXIS_DESCR STD_AXIS InjCtl_qSetUnBal InjMass 10 0.00 327.6700 FORMAT "%8.4" EXTENDED_LIMITS -327.6800 327.6700 DEPOSIT ABSOLUTE /end AXIS_DESCR
/end CHARACTERISTIC
/begin CHARACTERISTIC InjCrv_phiMI1Bas23_MAP "Ansteuerbeginnkennfeld 3 MI1 (+PI1)" MAP 0x1D640A Kf_Xs16_Ys16_Ws16 50.01562 AngleCrS -10.00781 40.00781 FORMAT "%8.5" EXTENDED_LIMITS -768.0000 767.9766
 /begin AXIS_DESCR STD_AXIS Eng_nAvrg EngN 14 0.00 6000.000 FORMAT "%8.3" EXTENDED_LIMITS -32768.00 32767.00 DEPOSIT ABSOLUTE /end AXIS_DESCR
 /begin AXIS_DESCR STD_AXIS InjCtl_qSetUnBal InjMass 10 0.00 327.6700 FORMAT "%8.4" EXTENDED_LIMITS -327.6800 327.6700 DEPOSIT ABSOLUTE /end AXIS_DESCR
/end CHARACTERISTIC
/begin CHARACTERISTIC InjCrv_phiMI1Bas24_MAP "Ansteuerbeginnkennfeld 4 MI1 (+PI1)" MAP 0x1D6556 Kf_Xs16_Ys16_Ws16 50.01562 AngleCrS -10.00781 40.00781 FORMAT "%8.5" EXTENDED_LIMITS -768.0000 767.9766
 /begin AXIS_DESCR STD_AXIS Eng_nAvrg EngN 14 0.00 6000.000 FORMAT "%8.3" EXTENDED_LIMITS -32768.00 32767.00 DEPOSIT ABSOLUTE /end AXIS_DESCR
 /begin AXIS_DESCR STD_AXIS InjCtl_qSetUnBal InjMass 10 0.00 327.6700 FORMAT "%8.4" EXTENDED_LIMITS -327.6800 327.6700 DEPOSIT ABSOLUTE /end AXIS_DESCR
/end CHARACTERISTIC
/begin CHARACTERISTIC InjCrv_phiMI1Bas25_MAP "Ansteuerbeginnkennfeld 5 MI1 (+PI1)" MAP 0x1D66A2 Kf_Xs16_Ys16_Ws16 50.01562 AngleCrS -10.00781 40.00781 FORMAT "%8.5" EXTENDED_LIMITS -768.0000 767.9766
 /begin AXIS_DESCR STD_AXIS Eng_nAvrg EngN 14 0.00 6000.000 FORMAT "%8.3" EXTENDED_LIMITS -32768.00 32767.00 DEPOSIT ABSOLUTE /end AXIS_DESCR
 /begin AXIS_DESCR STD_AXIS InjCtl_qSetUnBal InjMass 10 0.00 327.6700 FORMAT "%8.4" EXTENDED_LIMITS -327.6800 327.6700 DEPOSIT ABSOLUTE /end AXIS_DESCR
/end CHARACTERISTIC
/begin CHARACTERISTIC InjCrv_phiMI1Bas26_MAP "Ansteuerbeginnkennfeld 6 MI1 (+PI1)" MAP 0x1D67EE Kf_Xs16_Ys16_Ws16 50.01562 AngleCrS -10.00781 40.00781 FORMAT "%8.5" EXTENDED_LIMITS -768.0000 767.9766
 /begin AXIS_DESCR STD_AXIS Eng_nAvrg EngN 14 0.00 6000.000 FORMAT "%8.3" EXTENDED_LIMITS -32768.00 32767.00 DEPOSIT ABSOLUTE /end AXIS_DESCR
 /begin AXIS_DESCR STD_AXIS InjCtl_qSetUnBal InjMass 10 0.00 327.6700 FORMAT "%8.4" EXTENDED_LIMITS -327.6800 327.6700 DEPOSIT ABSOLUTE /end AXIS_DESCR
/end CHARACTERISTIC
/begin CHARACTERISTIC InjCrv_phiMI1Bas31_MAP "Ansteuerbeginnkennfeld 1 MI1 (+PI1,2)" MAP 0x1D693A Kf_Xs16_Ys16_Ws16 50.01562 AngleCrS -10.00781 40.00781 FORMAT "%8.5" EXTENDED_LIMITS -768.0000 767.9766
 /begin AXIS_DESCR STD_AXIS Eng_nAvrg EngN 14 0.00 6000.000 FORMAT "%8.3" EXTENDED_LIMITS -32768.00 32767.00 DEPOSIT ABSOLUTE /end AXIS_DESCR
 /begin AXIS_DESCR STD_AXIS InjCtl_qSetUnBal InjMass 10 0.00 327.6700 FORMAT "%8.4" EXTENDED_LIMITS -327.6800 327.6700 DEPOSIT ABSOLUTE /end AXIS_DESCR
/end CHARACTERISTIC
/begin CHARACTERISTIC InjCrv_phiMI1Bas32_MAP "Ansteuerbeginnkennfeld 2 MI1 (+PI1,2)" MAP 0x1D6A86 Kf_Xs16_Ys16_Ws16 50.01562 AngleCrS -10.00781 40.00781 FORMAT "%8.5" EXTENDED_LIMITS -768.0000 767.9766
 /begin AXIS_DESCR STD_AXIS Eng_nAvrg EngN 14 0.00 6000.000 FORMAT "%8.3" EXTENDED_LIMITS -32768.00 32767.00 DEPOSIT ABSOLUTE /end AXIS_DESCR
 /begin AXIS_DESCR STD_AXIS InjCtl_qSetUnBal InjMass 10 0.00 327.6700 FORMAT "%8.4" EXTENDED_LIMITS -327.6800 327.6700 DEPOSIT ABSOLUTE /end AXIS_DESCR
/end CHARACTERISTIC
/begin CHARACTERISTIC InjCrv_phiMI1Bas33_MAP "Ansteuerbeginnkennfeld 3 MI1 (+PI1,2)" MAP 0x1D6BD2 Kf_Xs16_Ys16_Ws16 50.01562 AngleCrS -10.00781 40.00781 FORMAT "%8.5" EXTENDED_LIMITS -768.0000 767.9766
 /begin AXIS_DESCR STD_AXIS Eng_nAvrg EngN 14 0.00 6000.000 FORMAT "%8.3" EXTENDED_LIMITS -32768.00 32767.00 DEPOSIT ABSOLUTE /end AXIS_DESCR
 /begin AXIS_DESCR STD_AXIS InjCtl_qSetUnBal InjMass 10 0.00 327.6700 FORMAT "%8.4" EXTENDED_LIMITS -327.6800 327.6700 DEPOSIT ABSOLUTE /end AXIS_DESCR
/end CHARACTERISTIC
/begin CHARACTERISTIC InjCrv_phiMI1Bas34_MAP "Ansteuerbeginnkennfeld 4 MI1 (+PI1,2)" MAP 0x1D6D1E Kf_Xs16_Ys16_Ws16 50.01562 AngleCrS -10.00781 40.00781 FORMAT "%8.5" EXTENDED_LIMITS -768.0000 767.9766
 /begin AXIS_DESCR STD_AXIS Eng_nAvrg EngN 14 0.00 6000.000 FORMAT "%8.3" EXTENDED_LIMITS -32768.00 32767.00 DEPOSIT ABSOLUTE /end AXIS_DESCR
 /begin AXIS_DESCR STD_AXIS InjCtl_qSetUnBal InjMass 10 0.00 327.6700 FORMAT "%8.4" EXTENDED_LIMITS -327.6800 327.6700 DEPOSIT ABSOLUTE /end AXIS_DESCR
/end CHARACTERISTIC
/begin CHARACTERISTIC InjCrv_phiMI1Bas35_MAP "Ansteuerbeginnkennfeld 5 MI1 (+PI1,2)" MAP 0x1D6E6A Kf_Xs16_Ys16_Ws16 50.01562 AngleCrS -10.00781 40.00781 FORMAT "%8.5" EXTENDED_LIMITS -768.0000 767.9766
 /begin AXIS_DESCR STD_AXIS Eng_nAvrg EngN 14 0.00 6000.000 FORMAT "%8.3" EXTENDED_LIMITS -32768.00 32767.00 DEPOSIT ABSOLUTE /end AXIS_DESCR
 /begin AXIS_DESCR STD_AXIS InjCtl_qSetUnBal InjMass 10 0.00 327.6700 FORMAT "%8.4" EXTENDED_LIMITS -327.6800 327.6700 DEPOSIT ABSOLUTE /end AXIS_DESCR
/end CHARACTERISTIC
/begin CHARACTERISTIC InjCrv_phiMI1Bas36_MAP "Ansteuerbeginnkennfeld 6 MI1 (+PI1,2)" MAP 0x1D6FB6 Kf_Xs16_Ys16_Ws16 50.01562 AngleCrS -10.00781 40.00781 FORMAT "%8.5" EXTENDED_LIMITS -768.0000 767.9766
 /begin AXIS_DESCR STD_AXIS Eng_nAvrg EngN 14 0.00 6000.000 FORMAT "%8.3" EXTENDED_LIMITS -32768.00 32767.00 DEPOSIT ABSOLUTE /end AXIS_DESCR
 /begin AXIS_DESCR STD_AXIS InjCtl_qSetUnBal InjMass 10 0.00 327.6700 FORMAT "%8.4" EXTENDED_LIMITS -327.6800 327.6700 DEPOSIT ABSOLUTE /end AXIS_DESCR
/end CHARACTERISTIC
/begin CHARACTERISTIC InjCrv_phiMI1DesAdd_Vector "Bypass-Label für additiven Bypass von InjCrv_phiMI1Des (Nicht verstellen!)" VALUE 0x1C0AC4 Kw_Wu8 255.0 OneToOne 0.00 255.0 FORMAT "%5.1" /end CHARACTERISTIC
/begin CHARACTERISTIC InjCrv_phiMI1DesAdd_Channel "Bypass-Label für additiven Bypass von InjCrv_phiMI1Des (Nicht verstellen!)" VALUE 0x1C0AC5 Kw_Wu8 255.0 OneToOne 0.00 255.0 FORMAT "%5.1" /end CHARACTERISTIC
/begin CHARACTERISTIC InjCrv_phiMI1Des_C "Fernsteuerwert des Ansteuerbeginns von MI1" VALUE 0x1D87DC Kw_Ws16 50.01562 AngleCrS -10.00781 40.00781 FORMAT "%8.5" EXTENDED_LIMITS -768.0000 767.9766 /end CHARACTERISTIC
/begin CHARACTERISTIC InjCrv_phiMI1Des_Vector "Bypass-Label für InjCrv_phiMI1Des (Nicht verstellen!)" VALUE 0x1C0AC6 Kw_Wu8 255.0 OneToOne 0.00 255.0 FORMAT "%5.1" /end CHARACTERISTIC
/begin CHARACTERISTIC InjCrv_phiMI1Des_Channel "Bypass-Label für InjCrv_phiMI1Des (Nicht verstellen!)" VALUE 0x1C0AC7 Kw_Wu8 255.0 OneToOne 0.00 255.0 FORMAT "%5.1" /end CHARACTERISTIC
/begin CHARACTERISTIC InjCrv_phiMI1ETSRgnCor1_MAP "motortemperaturabhängiges Ansteuerbeginnkorrekturkennfeld  1 für MI1" MAP 0x1D753C Kf_Xs16_Ys16_Ws16 20.01562 AngleCrS -10.00781 10.00781 FORMAT "%8.5" EXTENDED_LIMITS -768.0000 767.9766
 /begin AXIS_DESCR STD_AXIS Eng_nAvrg EngN 16 0.00 6000.000 FORMAT "%8.3" EXTENDED_LIMITS -32768.00 32767.00 DEPOSIT ABSOLUTE /end AXIS_DESCR
 /begin AXIS_DESCR STD_AXIS InjCtl_qSetUnBal InjMass 12 0.00 327.6700 FORMAT "%8.4" EXTENDED_LIMITS -327.6800 327.6700 DEPOSIT ABSOLUTE /end AXIS_DESCR
/end CHARACTERISTIC
/begin CHARACTERISTIC InjCrv_phiMI1ETSRgnCor2_MAP "motortemperaturabhängiges Ansteuerbeginnkorrekturkennfeld  2 für MI1" MAP 0x1D76F8 Kf_Xs16_Ys16_Ws16 20.01562 AngleCrS -10.00781 10.00781 FORMAT "%8.5" EXTENDED_LIMITS -768.0000 767.9766
 /begin AXIS_DESCR STD_AXIS Eng_nAvrg EngN 16 0.00 6000.000 FORMAT "%8.3" EXTENDED_LIMITS -32768.00 32767.00 DEPOSIT ABSOLUTE /end AXIS_DESCR
 /begin AXIS_DESCR STD_AXIS InjCtl_qSetUnBal InjMass 12 0.00 327.6700 FORMAT "%8.4" EXTENDED_LIMITS -327.6800 327.6700 DEPOSIT ABSOLUTE /end AXIS_DESCR
/end CHARACTERISTIC
/begin CHARACTERISTIC InjCrv_phiMI1ETSRgnCor3_MAP "motortemperaturabhängiges Ansteuerbeginnkorrekturkennfeld  3 für MI1" MAP 0x1D78B4 Kf_Xs16_Ys16_Ws16 20.01562 AngleCrS -10.00781 10.00781 FORMAT "%8.5" EXTENDED_LIMITS -768.0000 767.9766
 /begin AXIS_DESCR STD_AXIS Eng_nAvrg EngN 16 0.00 6000.000 FORMAT "%8.3" EXTENDED_LIMITS -32768.00 32767.00 DEPOSIT ABSOLUTE /end AXIS_DESCR
 /begin AXIS_DESCR STD_AXIS InjCtl_qSetUnBal InjMass 12 0.00 327.6700 FORMAT "%8.4" EXTENDED_LIMITS -327.6800 327.6700 DEPOSIT ABSOLUTE /end AXIS_DESCR
/end CHARACTERISTIC
/begin CHARACTERISTIC InjCrv_phiMI1Maxp_MAP "Minimaler Ansteuerbeginn für MI, abh. von Drehzahl, Ladedruck" MAP 0x1D7102 Kf_Xs16_Ys16_Ws16 50.01562 AngleCrS -10.00781 40.00781 FORMAT "%8.5" EXTENDED_LIMITS -768.0000 767.9766
 /begin AXIS_DESCR STD_AXIS Eng_nAvrg EngN 8 0.00 6000.000 FORMAT "%8.3" EXTENDED_LIMITS -32768.00 32767.00 DEPOSIT ABSOLUTE /end AXIS_DESCR
 /begin AXIS_DESCR STD_AXIS BPSCD_pOutVal Pres_hPa 8 0.00 3500.000 FORMAT "%8.3" EXTENDED_LIMITS -32768.00 32767.00 DEPOSIT ABSOLUTE /end AXIS_DESCR
/end CHARACTERISTIC
/begin CHARACTERISTIC InjCrv_phiMI1Maxt_MAP "Minimaler Ansteuerbeginn für MI, abh. von Drehzahl, Motortemp." MAP 0x1D71A6 Kf_Xs16_Ys16_Ws16 50.01562 AngleCrS -10.00781 40.00781 FORMAT "%8.5" EXTENDED_LIMITS -768.0000 767.9766
 /begin AXIS_DESCR STD_AXIS Eng_nAvrg EngN 10 0.00 6000.000 FORMAT "%8.3" EXTENDED_LIMITS -32768.00 32767.00 DEPOSIT ABSOLUTE /end AXIS_DESCR
 /begin AXIS_DESCR STD_AXIS Eng_tEng Temp_Cels 8 -50.14000 199.8600 FORMAT "%8.4" EXTENDED_LIMITS -3549.940 3003.560 DEPOSIT ABSOLUTE /end AXIS_DESCR
/end CHARACTERISTIC
/begin CHARACTERISTIC InjCrv_phiMI1Max_MAP "frühester Ansteuerbeginn der MI1" MAP 0x1D726E Kf_Xs16_Ys16_Ws16 50.01562 AngleCrS -10.00781 40.00781 FORMAT "%8.5" EXTENDED_LIMITS -768.0000 767.9766
 /begin AXIS_DESCR STD_AXIS Eng_nAvrg EngN 16 0.00 6000.000 FORMAT "%8.3" EXTENDED_LIMITS -32768.00 32767.00 DEPOSIT ABSOLUTE /end AXIS_DESCR
 /begin AXIS_DESCR STD_AXIS InjCtl_qSetUnBal InjMass 12 0.00 327.6700 FORMAT "%8.4" EXTENDED_LIMITS -327.6800 327.6700 DEPOSIT ABSOLUTE /end AXIS_DESCR
/end CHARACTERISTIC
/begin CHARACTERISTIC InjCrv_phiMI1Min_C "spätester Ansteuerbeginn der MI1" VALUE 0x1D742A Kw_Ws16 50.01562 AngleCrS -10.00781 40.00781 FORMAT "%8.5" EXTENDED_LIMITS -768.0000 767.9766 /end CHARACTERISTIC
/begin CHARACTERISTIC InjCrv_phiMI1RgnBas1_MAP "1. Grundwertekennfeld,  Ansteuerbeginn MI1 im Regenerationsfall" MAP 0x1D828C Kf_Xs16_Ys16_Ws16 50.01562 AngleCrS -10.00781 40.00781 FORMAT "%8.5" EXTENDED_LIMITS -768.0000 767.9766
 /begin AXIS_DESCR STD_AXIS Eng_nAvrg EngN 16 0.00 6000.000 FORMAT "%8.3" EXTENDED_LIMITS -32768.00 32767.00 DEPOSIT ABSOLUTE /end AXIS_DESCR
 /begin AXIS_DESCR STD_AXIS InjCtl_qSetUnBal InjMass 12 0.00 327.6700 FORMAT "%8.4" EXTENDED_LIMITS -327.6800 327.6700 DEPOSIT ABSOLUTE /end AXIS_DESCR
/end CHARACTERISTIC
/begin CHARACTERISTIC InjCrv_phiMI1RgnBas2_MAP "2. Grundwertekennfeld,  Ansteuerbeginn MI1 im Regenerationsfall" MAP 0x1D8448 Kf_Xs16_Ys16_Ws16 50.01562 AngleCrS -10.00781 40.00781 FORMAT "%8.5" EXTENDED_LIMITS -768.0000 767.9766
 /begin AXIS_DESCR STD_AXIS Eng_nAvrg EngN 16 0.00 6000.000 FORMAT "%8.3" EXTENDED_LIMITS -32768.00 32767.00 DEPOSIT ABSOLUTE /end AXIS_DESCR
 /begin AXIS_DESCR STD_AXIS InjCtl_qSetUnBal InjMass 12 0.00 327.6700 FORMAT "%8.4" EXTENDED_LIMITS -327.6800 327.6700 DEPOSIT ABSOLUTE /end AXIS_DESCR
/end CHARACTERISTIC
/begin CHARACTERISTIC InjCrv_phiMI1RgnBas3_MAP "3. Grundwertekennfeld,  Ansteuerbeginn MI1 im Regenerationsfall" MAP 0x1D8604 Kf_Xs16_Ys16_Ws16 50.01562 AngleCrS -10.00781 40.00781 FORMAT "%8.5" EXTENDED_LIMITS -768.0000 767.9766
 /begin AXIS_DESCR STD_AXIS Eng_nAvrg EngN 16 0.00 6000.000 FORMAT "%8.3" EXTENDED_LIMITS -32768.00 32767.00 DEPOSIT ABSOLUTE /end AXIS_DESCR
 /begin AXIS_DESCR STD_AXIS InjCtl_qSetUnBal InjMass 12 0.00 327.6700 FORMAT "%8.4" EXTENDED_LIMITS -327.6800 327.6700 DEPOSIT ABSOLUTE /end AXIS_DESCR
/end CHARACTERISTIC
/begin CHARACTERISTIC InjCrv_phiMI1Rgn_C "Einspritzbeginn Haupteinspritzung 1 im Regenerationsfall" VALUE 0x1D87C0 Kw_Ws16 50.01562 AngleCrS -10.00781 40.00781 FORMAT "%8.5" EXTENDED_LIMITS -768.0000 767.9766 /end CHARACTERISTIC
/begin CHARACTERISTIC InjCrv_phiMI1Rgn_Vector "Bypass-Label, nicht editieren !" VALUE 0x1C0ACC Kw_Wu8 255.0 OneToOne 0.00 255.0 FORMAT "%5.1" /end CHARACTERISTIC
/begin CHARACTERISTIC InjCrv_phiMI1Rgn_Channel "Bypass-Label, nicht editieren !" VALUE 0x1C0ACD Kw_Wu8 255.0 OneToOne 0.00 255.0 FORMAT "%5.1" /end CHARACTERISTIC
/begin CHARACTERISTIC InjCrv_phiMIAPSCor_MAP "atmosphärendruckabhängiges Ansteuerbeginnkorrekturkennfeld für MI1" MAP 0x1D7A70 Kf_Xs16_Ys16_Ws16 20.01562 AngleCrS -10.00781 10.00781 FORMAT "%8.5" EXTENDED_LIMITS -768.0000 767.9766
 /begin AXIS_DESCR STD_AXIS Eng_nAvrg EngN 16 0.00 6000.000 FORMAT "%8.3" EXTENDED_LIMITS -32768.00 32767.00 DEPOSIT ABSOLUTE /end AXIS_DESCR
 /begin AXIS_DESCR STD_AXIS InjCtl_qSetUnBal InjMass 12 0.00 327.6700 FORMAT "%8.4" EXTENDED_LIMITS -327.6800 327.6700 DEPOSIT ABSOLUTE /end AXIS_DESCR
/end CHARACTERISTIC
/begin CHARACTERISTIC InjCrv_phiMIATSCor_MAP "ansauglufttemperaturabhängiges Ansteuerbeginnkorrekturkennfeld für MI1" MAP 0x1D7C2C Kf_Xs16_Ys16_Ws16 20.01562 AngleCrS -10.00781 10.00781 FORMAT "%8.5" EXTENDED_LIMITS -768.0000 767.9766
 /begin AXIS_DESCR STD_AXIS Eng_nAvrg EngN 16 0.00 6000.000 FORMAT "%8.3" EXTENDED_LIMITS -32768.00 32767.00 DEPOSIT ABSOLUTE /end AXIS_DESCR
 /begin AXIS_DESCR STD_AXIS InjCtl_qSetUnBal InjMass 12 0.00 327.6700 FORMAT "%8.4" EXTENDED_LIMITS -327.6800 327.6700 DEPOSIT ABSOLUTE /end AXIS_DESCR
/end CHARACTERISTIC
/begin CHARACTERISTIC InjCrv_phiMIFTSRailCorMax_C "Maximaler Ansteuerbeginnkorrekturfaktor für MI1, abhängig von der kraftstofftemperaturabhängigen Raildruckkorrektur" VALUE 0x1D7DE8 Kw_Ws16 1535.977 AngleCrS -768.0000 767.9766 FORMAT "%8.4" /end CHARACTERISTIC
/begin CHARACTERISTIC InjCrv_phiMIFTSRailCorMin_C "Minimaler Ansteuerbeginnkorrekturfaktor für MI1, abhängig von der kraftstofftemperaturabhängigen Raildruckkorrektur" VALUE 0x1D7DEA Kw_Ws16 1535.977 AngleCrS -768.0000 767.9766 FORMAT "%8.4" /end CHARACTERISTIC
/begin CHARACTERISTIC InjCrv_phiMIFTSRailCor_MAP "Korrekturfaktorkennfeld für die MI1, abhängig von der kraftstofftemperaturabhängigen Raildruckkorrektur" MAP 0x1D7DEC Kf_Xs16_Ys16_Ws16 20.01562 AngleCrS -10.00781 10.00781 FORMAT "%8.5" EXTENDED_LIMITS -768.0000 767.9766
 /begin AXIS_DESCR STD_AXIS Eng_nAvrg EngN 12 0.00 6000.000 FORMAT "%8.3" EXTENDED_LIMITS -32768.00 32767.00 DEPOSIT ABSOLUTE /end AXIS_DESCR
 /begin AXIS_DESCR STD_AXIS InjCtl_qSetUnBal InjMass 8 0.00 327.6700 FORMAT "%8.4" EXTENDED_LIMITS -327.6800 327.6700 DEPOSIT ABSOLUTE /end AXIS_DESCR
/end CHARACTERISTIC
/begin CHARACTERISTIC InjCrv_phiMIPCRCor_MAP "Kennfeld für SOE Korrektur abh. von PCR_pBGDev" MAP 0x1D7ED8 Kf_Xs16_Ys16_Ws16 20.01562 AngleCrS -10.00781 10.00781 FORMAT "%8.5" EXTENDED_LIMITS -768.0000 767.9766
 /begin AXIS_DESCR STD_AXIS Eng_nAvrg EngN 12 0.00 6000.000 FORMAT "%8.3" EXTENDED_LIMITS -32768.00 32767.00 DEPOSIT ABSOLUTE /end AXIS_DESCR
 /begin AXIS_DESCR STD_AXIS PCR_pBGDev Pres_hPa 8 0.00 1800000. FORMAT "%8.0" EXTENDED_LIMITS -32768.00 32767.00 DEPOSIT ABSOLUTE /end AXIS_DESCR
/end CHARACTERISTIC
/begin CHARACTERISTIC InjCrv_phiMIpRailDiffCor_MAP "SOE Korrekturwinkel abh. von Differenz Raildruck" MAP 0x1D7FC4 Kf_Xs16_Ys16_Ws16 20.01562 AngleCrS -10.00781 10.00781 FORMAT "%8.5" EXTENDED_LIMITS -768.0000 767.9766
 /begin AXIS_DESCR STD_AXIS Eng_nAvrg EngN 12 0.00 6000.000 FORMAT "%8.3" EXTENDED_LIMITS -32768.00 32767.00 DEPOSIT ABSOLUTE /end AXIS_DESCR
 /begin AXIS_DESCR STD_AXIS InjCtl_qSetUnBal InjMass 8 0.00 327.6700 FORMAT "%8.4" EXTENDED_LIMITS -327.6800 327.6700 DEPOSIT ABSOLUTE /end AXIS_DESCR
/end CHARACTERISTIC
/begin CHARACTERISTIC InjCrv_phiMIpRailDiffMax_C "Mindestkorrekturwinkel für SOE abh. von Differenz zw. limit. und unlimit. rail pressure setpoint" VALUE 0x1D80B0 Kw_Ws16 1535.977 AngleCrS -768.0000 767.9766 FORMAT "%8.4" /end CHARACTERISTIC
/begin CHARACTERISTIC InjCrv_phiMIpRailDiffMin_C "Mindestkorrekturwinkel für SOE abh. von Differenz zw. limit. und unlimit. rail pressure setpoint" VALUE 0x1D80B2 Kw_Ws16 1535.977 AngleCrS -768.0000 767.9766 FORMAT "%8.4" /end CHARACTERISTIC
/begin CHARACTERISTIC InjCrv_phiMIpRailDvtCor_MAP "SOE Korrektur abh. von dev. rail pressure" MAP 0x1D80B4 Kf_Xs16_Ys16_Ws16 20.01562 AngleCrS -10.00781 10.00781 FORMAT "%8.5" EXTENDED_LIMITS -768.0000 767.9766
 /begin AXIS_DESCR STD_AXIS Eng_nAvrg EngN 12 0.00 6000.000 FORMAT "%8.3" EXTENDED_LIMITS -32768.00 32767.00 DEPOSIT ABSOLUTE /end AXIS_DESCR
 /begin AXIS_DESCR STD_AXIS Rail_pDvt Pres_Rail 8 0.00 1800000. FORMAT "%8.0" EXTENDED_LIMITS -3276800. 3276700. DEPOSIT ABSOLUTE /end AXIS_DESCR
/end CHARACTERISTIC
/begin CHARACTERISTIC InjCrv_phiPiI1DesAdd_Vector "Bypass-Label für additiven Bypass von InjCrv_phiPiI1Des (Nicht verstellen!)" VALUE 0x1C0AD4 Kw_Wu8 255.0 OneToOne 0.00 255.0 FORMAT "%5.1" /end CHARACTERISTIC
/begin CHARACTERISTIC InjCrv_phiPiI1DesAdd_Channel "Bypass-Label für additiven Bypass von InjCrv_phiPiI1Des (Nicht verstellen!)" VALUE 0x1C0AD5 Kw_Wu8 255.0 OneToOne 0.00 255.0 FORMAT "%5.1" /end CHARACTERISTIC
/begin CHARACTERISTIC InjCrv_phiPiI1Des_C "Fernsteuerwert des Ansteuerbeginns von PiI1" VALUE 0x1DB1C4 Kw_Ws16 720.0000 AngleCrS 0.00 720.0000 FORMAT "%8.4" EXTENDED_LIMITS -768.0000 767.9766 /end CHARACTERISTIC
/begin CHARACTERISTIC InjCrv_phiPiI1Des_Vector "Bypass-Label für InjCrv_phiPiI1Des (Nicht verstellen!)" VALUE 0x1C0AD6 Kw_Wu8 255.0 OneToOne 0.00 255.0 FORMAT "%5.1" /end CHARACTERISTIC
/begin CHARACTERISTIC InjCrv_phiPiI1Des_Channel "Bypass-Label für InjCrv_phiPiI1Des (Nicht verstellen!)" VALUE 0x1C0AD7 Kw_Wu8 255.0 OneToOne 0.00 255.0 FORMAT "%5.1" /end CHARACTERISTIC
/begin CHARACTERISTIC InjCrv_phiPiI1Rgn_Vector "Bypass-Label, nicht editieren !" VALUE 0x1C0AF4 Kw_Wu8 255.0 OneToOne 0.00 255.0 FORMAT "%5.1" /end CHARACTERISTIC
/begin CHARACTERISTIC InjCrv_phiPiI1Rgn_Channel "Bypass-Label, nicht editieren !" VALUE 0x1C0AF5 Kw_Wu8 255.0 OneToOne 0.00 255.0 FORMAT "%5.1" /end CHARACTERISTIC
/begin CHARACTERISTIC InjCrv_phiPiI2DesAdd_Vector "Bypass-Label für additiven Bypass von InjCrv_phiPiI2Des (Nicht verstellen!)" VALUE 0x1C0AD8 Kw_Wu8 255.0 OneToOne 0.00 255.0 FORMAT "%5.1" /end CHARACTERISTIC
/begin CHARACTERISTIC InjCrv_phiPiI2DesAdd_Channel "Bypass-Label für additiven Bypass von InjCrv_phiPiI2Des (Nicht verstellen!)" VALUE 0x1C0AD9 Kw_Wu8 255.0 OneToOne 0.00 255.0 FORMAT "%5.1" /end CHARACTERISTIC
/begin CHARACTERISTIC InjCrv_phiPiI2Des_C "Fernsteuerwert des Ansteuerbeginns von PiI2" VALUE 0x1D9BF0 Kw_Ws16 720.0000 AngleCrS 0.00 720.0000 FORMAT "%8.4" EXTENDED_LIMITS -768.0000 767.9766 /end CHARACTERISTIC
/begin CHARACTERISTIC InjCrv_phiPiI2Des_Vector "Bypass-Label für InjCrv_phiPiI2Des (Nicht verstellen!)" VALUE 0x1C0ADA Kw_Wu8 255.0 OneToOne 0.00 255.0 FORMAT "%5.1" /end CHARACTERISTIC
/begin CHARACTERISTIC InjCrv_phiPiI2Des_Channel "Bypass-Label für InjCrv_phiPiI2Des (Nicht verstellen!)" VALUE 0x1C0ADB Kw_Wu8 255.0 OneToOne 0.00 255.0 FORMAT "%5.1" /end CHARACTERISTIC
/begin CHARACTERISTIC InjCrv_phiPiI2Rgn_Vector "Bypass-Label, nicht editieren !" VALUE 0x1C0ACE Kw_Wu8 255.0 OneToOne 0.00 255.0 FORMAT "%5.1" /end CHARACTERISTIC
/begin CHARACTERISTIC InjCrv_phiPiI2Rgn_Channel "Bypass-Label, nicht editieren !" VALUE 0x1C0ACF Kw_Wu8 255.0 OneToOne 0.00 255.0 FORMAT "%5.1" /end CHARACTERISTIC
/begin CHARACTERISTIC InjCrv_phiPiI3DesAdd_Vector "Bypass-Label für additiven Bypass von InjCrv_phiPiI3Des (Nicht verstellen!)" VALUE 0x1C0ADC Kw_Wu8 255.0 OneToOne 0.00 255.0 FORMAT "%5.1" /end CHARACTERISTIC
/begin CHARACTERISTIC InjCrv_phiPiI3DesAdd_Channel "Bypass-Label für additiven Bypass von InjCrv_phiPiI3Des (Nicht verstellen!)" VALUE 0x1C0ADD Kw_Wu8 255.0 OneToOne 0.00 255.0 FORMAT "%5.1" /end CHARACTERISTIC
/begin CHARACTERISTIC InjCrv_phiPiI3Des_Vector "Bypass-Label für InjCrv_phiPiI3Des (Nicht verstellen!)" VALUE 0x1C0ADE Kw_Wu8 255.0 OneToOne 0.00 255.0 FORMAT "%5.1" /end CHARACTERISTIC
/begin CHARACTERISTIC InjCrv_phiPiI3Des_Channel "Bypass-Label für InjCrv_phiPiI3Des (Nicht verstellen!)" VALUE 0x1C0ADF Kw_Wu8 255.0 OneToOne 0.00 255.0 FORMAT "%5.1" /end CHARACTERISTIC
/begin CHARACTERISTIC InjCrv_phiPiIMax_C "frühester absoluter Ansteuerbeginn einer PiI" VALUE 0x1D8806 Kw_Ws16 100.0078 AngleCrS 0.00 100.0078 FORMAT "%8.4" EXTENDED_LIMITS -768.0000 767.9766 /end CHARACTERISTIC
/begin CHARACTERISTIC InjCrv_phiPoI1Bas_MAP "Grundwert des Ansteuerbeginnwinkels PoI1" MAP 0x1DB202 Kf_Xs16_Ys16_Ws16 60.00000 AngleCrS -100.0078 -40.00781 FORMAT "%8.4" EXTENDED_LIMITS -768.0000 767.9766
 /begin AXIS_DESCR STD_AXIS Eng_nAvrg EngN 8 0.00 6000.000 FORMAT "%8.3" EXTENDED_LIMITS -32768.00 32767.00 DEPOSIT ABSOLUTE /end AXIS_DESCR
 /begin AXIS_DESCR STD_AXIS InjCtl_qSetUnBal InjMass 8 0.00 327.6700 FORMAT "%8.4" EXTENDED_LIMITS -327.6800 327.6700 DEPOSIT ABSOLUTE /end AXIS_DESCR
/end CHARACTERISTIC
/begin CHARACTERISTIC InjCrv_phiPoI1DesAdd_Vector "Bypass-Label für additiven Bypass von InjCrv_phiPoI1Des (Nicht verstellen!)" VALUE 0x1C0AFA Kw_Wu8 255.0 OneToOne 0.00 255.0 FORMAT "%5.1" /end CHARACTERISTIC
/begin CHARACTERISTIC InjCrv_phiPoI1DesAdd_Channel "Bypass-Label für additiven Bypass von InjCrv_phiPoI1Des (Nicht verstellen!)" VALUE 0x1C0AFB Kw_Wu8 255.0 OneToOne 0.00 255.0 FORMAT "%5.1" /end CHARACTERISTIC
/begin CHARACTERISTIC InjCrv_phiPoI1Des_C "Fernsteuerwert des Ansteuerbeginns von PoI1" VALUE 0x1DBDA4 Kw_Ws16 100.0078 AngleCrS -100.0078 0.00 FORMAT "%8.4" EXTENDED_LIMITS -768.0000 767.9766 /end CHARACTERISTIC
/begin CHARACTERISTIC InjCrv_phiPoI1Des_Vector "Bypass-Label für InjCrv_phiPoI1Des (Nicht verstellen!)" VALUE 0x1C0AFC Kw_Wu8 255.0 OneToOne 0.00 255.0 FORMAT "%5.1" /end CHARACTERISTIC
/begin CHARACTERISTIC InjCrv_phiPoI1Des_Channel "Bypass-Label für InjCrv_phiPoI1Des (Nicht verstellen!)" VALUE 0x1C0AFD Kw_Wu8 255.0 OneToOne 0.00 255.0 FORMAT "%5.1" /end CHARACTERISTIC
/begin CHARACTERISTIC InjCrv_phiPoI1ETSCor_MAP "motortemperaturabhängiges Winkelkorrekturkennfeld für PoI1" MAP 0x1DB66C Kf_Xs16_Ys16_Ws16 200.0156 AngleCrS -100.0078 100.0078 FORMAT "%8.4" EXTENDED_LIMITS -768.0000 767.9766
 /begin AXIS_DESCR STD_AXIS Eng_nAvrg EngN 6 0.00 6000.000 FORMAT "%8.3" EXTENDED_LIMITS -32768.00 32767.00 DEPOSIT ABSOLUTE /end AXIS_DESCR
 /begin AXIS_DESCR STD_AXIS InjCtl_qSetUnBal InjMass 6 0.00 327.6700 FORMAT "%8.4" EXTENDED_LIMITS -327.6800 327.6700 DEPOSIT ABSOLUTE /end AXIS_DESCR
/end CHARACTERISTIC
/begin CHARACTERISTIC InjCrv_phiPoI1Max_C "Maximaler Ansteuerbeginnwinkel PoI1" VALUE 0x1DB2A6 Kw_Ws16 60.00000 AngleCrS -100.0078 -40.00781 FORMAT "%8.4" EXTENDED_LIMITS -768.0000 767.9766 /end CHARACTERISTIC
/begin CHARACTERISTIC InjCrv_phiPoI1RgnBas1_MAP "Grundkennfeld Einspritzwinkel PoI1 Regenerationsmode 1" MAP 0x1DB800 Kf_Xs16_Ys16_Ws16 60.00000 AngleCrS -100.0078 -40.00781 FORMAT "%8.4" EXTENDED_LIMITS -768.0000 767.9766
 /begin AXIS_DESCR STD_AXIS Eng_nAvrg EngN 8 0.00 6000.000 FORMAT "%8.3" EXTENDED_LIMITS -32768.00 32767.00 DEPOSIT ABSOLUTE /end AXIS_DESCR
 /begin AXIS_DESCR STD_AXIS InjCtl_qSetUnBal InjMass 8 0.00 327.6700 FORMAT "%8.4" EXTENDED_LIMITS -327.6800 327.6700 DEPOSIT ABSOLUTE /end AXIS_DESCR
/end CHARACTERISTIC
/begin CHARACTERISTIC InjCrv_phiPoI1RgnBas2_MAP "Grundkennfeld Einspritzwinkel PoI1 Regenerationsmode 2" MAP 0x1DB8A4 Kf_Xs16_Ys16_Ws16 60.00000 AngleCrS -100.0078 -40.00781 FORMAT "%8.4" EXTENDED_LIMITS -768.0000 767.9766
 /begin AXIS_DESCR STD_AXIS Eng_nAvrg EngN 8 0.00 6000.000 FORMAT "%8.3" EXTENDED_LIMITS -32768.00 32767.00 DEPOSIT ABSOLUTE /end AXIS_DESCR
 /begin AXIS_DESCR STD_AXIS InjCtl_qSetUnBal InjMass 8 0.00 327.6700 FORMAT "%8.4" EXTENDED_LIMITS -327.6800 327.6700 DEPOSIT ABSOLUTE /end AXIS_DESCR
/end CHARACTERISTIC
/begin CHARACTERISTIC InjCrv_phiPoI1RgnBas3_MAP "Grundkennfeld Einspritzwinkel PoI1 Regenerationsmode 3" MAP 0x1DB948 Kf_Xs16_Ys16_Ws16 60.00000 AngleCrS -100.0078 -40.00781 FORMAT "%8.4" EXTENDED_LIMITS -768.0000 767.9766
 /begin AXIS_DESCR STD_AXIS Eng_nAvrg EngN 8 0.00 6000.000 FORMAT "%8.3" EXTENDED_LIMITS -32768.00 32767.00 DEPOSIT ABSOLUTE /end AXIS_DESCR
 /begin AXIS_DESCR STD_AXIS InjCtl_qSetUnBal InjMass 8 0.00 327.6700 FORMAT "%8.4" EXTENDED_LIMITS -327.6800 327.6700 DEPOSIT ABSOLUTE /end AXIS_DESCR
/end CHARACTERISTIC
/begin CHARACTERISTIC InjCrv_phiPoI1RgnBas4_MAP "Grundkennfeld Einspritzwinkel PoI1 Regenerationsmode 4" MAP 0x1DB9EC Kf_Xs16_Ys16_Ws16 60.00000 AngleCrS -100.0078 -40.00781 FORMAT "%8.4" EXTENDED_LIMITS -768.0000 767.9766
 /begin AXIS_DESCR STD_AXIS Eng_nAvrg EngN 8 0.00 6000.000 FORMAT "%8.3" EXTENDED_LIMITS -32768.00 32767.00 DEPOSIT ABSOLUTE /end AXIS_DESCR
 /begin AXIS_DESCR STD_AXIS InjCtl_qSetUnBal InjMass 8 0.00 327.6700 FORMAT "%8.4" EXTENDED_LIMITS -327.6800 327.6700 DEPOSIT ABSOLUTE /end AXIS_DESCR
/end CHARACTERISTIC
/begin CHARACTERISTIC InjCrv_phiPoI1Rgn_Vector "Bypass-Label, nicht editieren !" VALUE 0x1C0B02 Kw_Wu8 255.0 OneToOne 0.00 255.0 FORMAT "%5.1" /end CHARACTERISTIC
/begin CHARACTERISTIC InjCrv_phiPoI1Rgn_Channel "Bypass-Label, nicht editieren !" VALUE 0x1C0B03 Kw_Wu8 255.0 OneToOne 0.00 255.0 FORMAT "%5.1" /end CHARACTERISTIC
/begin CHARACTERISTIC InjCrv_phiPoI2Des_C "Fernsteuerung - Wert für  InjCrv_phiPoI2Des" VALUE 0x1DC3A8 Kw_Ws16 40.00781 AngleCrS -40.00781 0.00 FORMAT "%8.5" EXTENDED_LIMITS -768.0000 767.9766 /end CHARACTERISTIC
/begin CHARACTERISTIC InjCrv_phiPoI2Min_C "minimaler Ansteuerbeginn PoI2 relativ zum oberen Totpunkt" VALUE 0x1DC390 Kw_Ws16 40.00781 AngleCrS -40.00781 0.00 FORMAT "%8.5" EXTENDED_LIMITS -768.0000 767.9766 /end CHARACTERISTIC
/begin CHARACTERISTIC InjCrv_phiPoI2Rgn_Vector "Bypass-Label, nicht editieren !" VALUE 0x1C0B06 Kw_Wu8 255.0 OneToOne 0.00 255.0 FORMAT "%5.1" /end CHARACTERISTIC
/begin CHARACTERISTIC InjCrv_phiPoI2Rgn_Channel "Bypass-Label, nicht editieren !" VALUE 0x1C0B07 Kw_Wu8 255.0 OneToOne 0.00 255.0 FORMAT "%5.1" /end CHARACTERISTIC
/begin CHARACTERISTIC InjCrv_POpPoI1AddCor1_C "Additive Korrektur der PoI1 Freigabe  schaltbar über eine Hysterese" VALUE 0x1DB3F4 Kw_Ws16 100.0000 OneToOne 0.00 100.0000 FORMAT "%8.4" EXTENDED_LIMITS -32768.00 32767.00 /end CHARACTERISTIC
/begin CHARACTERISTIC InjCrv_POpPoI1AddCor2_C "Additive Korrektur der PoI1 Freigabe  schaltbar über den EGt Status" VALUE 0x1DB3F6 Kw_Ws16 100.0000 OneToOne 0.00 100.0000 FORMAT "%8.4" EXTENDED_LIMITS -32768.00 32767.00 /end CHARACTERISTIC
/begin CHARACTERISTIC InjCrv_POpPoI1Bas_MAP "Grundwert Freigabe PoI1" MAP 0x1DBD3C Kf_Xs16_Ys16_Ws16 100.0000 OneToOne 0.00 100.0000 FORMAT "%8.4" EXTENDED_LIMITS -32768.00 32767.00
 /begin AXIS_DESCR STD_AXIS Eng_nAvrg EngN 6 0.00 6000.000 FORMAT "%8.3" EXTENDED_LIMITS -32768.00 32767.00 DEPOSIT ABSOLUTE /end AXIS_DESCR
 /begin AXIS_DESCR STD_AXIS InjCtl_qSetUnBal InjMass 6 0.00 327.6700 FORMAT "%8.4" EXTENDED_LIMITS -327.6800 327.6700 DEPOSIT ABSOLUTE /end AXIS_DESCR
/end CHARACTERISTIC
/begin CHARACTERISTIC InjCrv_POpPoI1ETSCor_CUR "motortemperaturabhängige Freigabekorrekturkennlinie für PoI1" CURVE 0x1DB7E6 Kl_Xs16_Ws16 100.0000 OneToOne 0.00 100.0000 FORMAT "%8.4" EXTENDED_LIMITS -32768.00 32767.00
 /begin AXIS_DESCR STD_AXIS InjCrv_tEng Temp_Cels 6 -50.14000 199.8600 FORMAT "%8.4" EXTENDED_LIMITS -3549.940 3003.560 DEPOSIT ABSOLUTE /end AXIS_DESCR
/end CHARACTERISTIC
/begin CHARACTERISTIC InjCrv_POpPoI1High_C "obere Hystereseschwelle des Grundwertes Freigabe PoI1" VALUE 0x1DBDA0 Kw_Ws16 100.0000 OneToOne 0.00 100.0000 FORMAT "%8.4" EXTENDED_LIMITS -32768.00 32767.00 /end CHARACTERISTIC
/begin CHARACTERISTIC InjCrv_POpPoI1Low_C "Untere Hystereseschwelle des Grundwertes Freigabe PoI1" VALUE 0x1DBDA2 Kw_Ws16 100.0000 OneToOne 0.00 100.0000 FORMAT "%8.4" EXTENDED_LIMITS -32768.00 32767.00 /end CHARACTERISTIC
/begin CHARACTERISTIC InjCrv_POpPoI1RgnBas1_MAP "Korrektur der  Grundwerte der  Freigabe PoI1 im Regenerationsfall" MAP 0x1DB3F8 Kf_Xs16_Ys16_Ws16 100.0000 OneToOne 0.00 100.0000 FORMAT "%8.4" EXTENDED_LIMITS -32768.00 32767.00
 /begin AXIS_DESCR STD_AXIS Eng_nAvrg EngN 6 0.00 6000.000 FORMAT "%8.3" EXTENDED_LIMITS -32768.00 32767.00 DEPOSIT ABSOLUTE /end AXIS_DESCR
 /begin AXIS_DESCR STD_AXIS InjCtl_qSetUnBal InjMass 6 0.00 327.6700 FORMAT "%8.4" EXTENDED_LIMITS -327.6800 327.6700 DEPOSIT ABSOLUTE /end AXIS_DESCR
/end CHARACTERISTIC
/begin CHARACTERISTIC InjCrv_POpPoI1RgnBas2_MAP "Korrektur der  Grundwerte der  Freigabe PoI1 im Regenerationsfall" MAP 0x1DB45C Kf_Xs16_Ys16_Ws16 100.0000 OneToOne 0.00 100.0000 FORMAT "%8.4" EXTENDED_LIMITS -32768.00 32767.00
 /begin AXIS_DESCR STD_AXIS Eng_nAvrg EngN 6 0.00 6000.000 FORMAT "%8.3" EXTENDED_LIMITS -32768.00 32767.00 DEPOSIT ABSOLUTE /end AXIS_DESCR
 /begin AXIS_DESCR STD_AXIS InjCtl_qSetUnBal InjMass 6 0.00 327.6700 FORMAT "%8.4" EXTENDED_LIMITS -327.6800 327.6700 DEPOSIT ABSOLUTE /end AXIS_DESCR
/end CHARACTERISTIC
/begin CHARACTERISTIC InjCrv_POpPoI2Bas_MAP "grundwert Freigabe PoI2" MAP 0x1DC328 Kf_Xs16_Ys16_Ws16 100.0000 OneToOne 0.00 100.0000 FORMAT "%8.4" EXTENDED_LIMITS -32768.00 32767.00
 /begin AXIS_DESCR STD_AXIS Eng_nAvrg EngN 6 0.00 6000.000 FORMAT "%8.3" EXTENDED_LIMITS -32768.00 32767.00 DEPOSIT ABSOLUTE /end AXIS_DESCR
 /begin AXIS_DESCR STD_AXIS InjCtl_qSetUnBal InjMass 6 0.00 327.6700 FORMAT "%8.4" EXTENDED_LIMITS -327.6800 327.6700 DEPOSIT ABSOLUTE /end AXIS_DESCR
/end CHARACTERISTIC
/begin CHARACTERISTIC InjCrv_POpPoI2ETSCor_MAP "Motortemperaturabhängiges Freigabekorrekturkennfeld für PoI2" MAP 0x1DBDAC Kf_Xs16_Ys16_Ws16 100.0000 OneToOne 0.00 100.0000 FORMAT "%8.4" EXTENDED_LIMITS -32768.00 32767.00
 /begin AXIS_DESCR STD_AXIS Eng_nAvrg EngN 6 0.00 6000.000 FORMAT "%8.3" EXTENDED_LIMITS -32768.00 32767.00 DEPOSIT ABSOLUTE /end AXIS_DESCR
 /begin AXIS_DESCR STD_AXIS InjCtl_qSetUnBal InjMass 6 0.00 327.6700 FORMAT "%8.4" EXTENDED_LIMITS -327.6800 327.6700 DEPOSIT ABSOLUTE /end AXIS_DESCR
/end CHARACTERISTIC
/begin CHARACTERISTIC InjCrv_POpPoI2High_C "Feigabe PoI2 über Betriebspunkt, obere Hystereseschwelle" VALUE 0x1DC38C Kw_Ws16 100.0000 OneToOne 0.00 100.0000 FORMAT "%8.4" EXTENDED_LIMITS -32768.00 32767.00 /end CHARACTERISTIC
/begin CHARACTERISTIC InjCrv_POpPoI2Low_C "Freigabe PoI2 über Betriebspunkt, untere Hystereseschwelle" VALUE 0x1DC38E Kw_Ws16 100.0000 OneToOne 0.00 100.0000 FORMAT "%8.4" EXTENDED_LIMITS -32768.00 32767.00 /end CHARACTERISTIC
/begin CHARACTERISTIC InjCrv_pRailDiffMax_C "Oberer Grenzwert der Differenz zw. limit. und unlimit rail pressure setpoint" VALUE 0x1D81A0 Kw_Ws16 1800000. Pres_Rail 0.00 1800000. FORMAT "%8.0" EXTENDED_LIMITS -3276800. 3276700. /end CHARACTERISTIC
/begin CHARACTERISTIC InjCrv_pRailDiffMin_C "Untere Grenze für Diff. zw. limit. und unlimit. Rail Pressure Setpoint" VALUE 0x1D81A2 Kw_Ws16 1800000. Pres_Rail 0.00 1800000. FORMAT "%8.0" EXTENDED_LIMITS -3276800. 3276700. /end CHARACTERISTIC
/begin CHARACTERISTIC InjCrv_qDiffMin_C "Minimale positive Mengendifferenz für Freigabe Voreinspritzung 2" VALUE 0x1D912A Kw_Ws16 327.6700 InjMassInj 0.00 327.6700 FORMAT "%8.4" EXTENDED_LIMITS -327.6800 327.6700 /end CHARACTERISTIC
/begin CHARACTERISTIC InjCrv_qMI1DesAdd_Vector "Bypass-Label für additiven Bypass von InjCrv_qMI1Des (Nicht verstellen!)" VALUE 0x1C0AC8 Kw_Wu8 255.0 OneToOne 0.00 255.0 FORMAT "%5.1" /end CHARACTERISTIC
/begin CHARACTERISTIC InjCrv_qMI1DesAdd_Channel "Bypass-Label für additiven Bypass von InjCrv_qMI1Des (Nicht verstellen!)" VALUE 0x1C0AC9 Kw_Wu8 255.0 OneToOne 0.00 255.0 FORMAT "%5.1" /end CHARACTERISTIC
/begin CHARACTERISTIC InjCrv_qMI1Des_C "Fernsteuerwert der Einspritzmenge von MI1" VALUE 0x1D87DE Kw_Ws16 10.00000 InjMassInj 0.00 10.00000 FORMAT "%8.5" EXTENDED_LIMITS -327.6800 327.6700 /end CHARACTERISTIC
/begin CHARACTERISTIC InjCrv_qMI1Des_Vector "Bypass-Label für InjCrv_qMI1Des (Nicht verstellen!)" VALUE 0x1C0ACA Kw_Wu8 255.0 OneToOne 0.00 255.0 FORMAT "%5.1" /end CHARACTERISTIC
/begin CHARACTERISTIC InjCrv_qMI1Des_Channel "Bypass-Label für InjCrv_qMI1Des (Nicht verstellen!)" VALUE 0x1C0ACB Kw_Wu8 255.0 OneToOne 0.00 255.0 FORMAT "%5.1" /end CHARACTERISTIC
/begin CHARACTERISTIC InjCrv_qMI1MinPiI1DiffHys_C "Differenzmenge zwischen unterer und oberer Hystereseschwelle bei PiI1 für Freigabe PiI1 wenn genügend Menge für MI und PiI1" VALUE 0x1D8808 Kw_Ws16 10.00000 InjMassInj 0.00 10.00000 FORMAT "%8.5" EXTENDED_LIMITS -327.6800 327.6700 /end CHARACTERISTIC
/begin CHARACTERISTIC InjCrv_qMI1MinPiI2DiffHys_C "Differenzmenge zwischen unterer und oberer Hystereseschwelle bei PiI2 für Freigabe PiI2 wenn genügend Menge für MI und PiI2" VALUE 0x1D912C Kw_Ws16 10.00000 InjMassInj 0.00 10.00000 FORMAT "%8.5" EXTENDED_LIMITS -327.6800 327.6700 /end CHARACTERISTIC
/begin CHARACTERISTIC InjCrv_qPiI1APSCor_MAP "atmosphärendruckabhängiges Mengenkorrekturkennfeld für Voreinspritzung 1" MAP 0x1D9F0E Kf_Xs16_Ys16_Ws16 10.00000 InjMassInj 0.00 10.00000 FORMAT "%8.5" EXTENDED_LIMITS -327.6800 327.6700
 /begin AXIS_DESCR STD_AXIS Eng_nAvrg EngN 16 0.00 6000.000 FORMAT "%8.3" EXTENDED_LIMITS -32768.00 32767.00 DEPOSIT ABSOLUTE /end AXIS_DESCR
 /begin AXIS_DESCR STD_AXIS InjCtl_qSetUnBal InjMass 12 0.00 327.6700 FORMAT "%8.4" EXTENDED_LIMITS -327.6800 327.6700 DEPOSIT ABSOLUTE /end AXIS_DESCR
/end CHARACTERISTIC
/begin CHARACTERISTIC InjCrv_qPiI1ATSCor_MAP "ansauglufttemperaturabhängiges Mengenkorrekturkennfeld für Voreinspritzung 1" MAP 0x1DA0CA Kf_Xs16_Ys16_Ws16 10.00000 InjMassInj 0.00 10.00000 FORMAT "%8.5" EXTENDED_LIMITS -327.6800 327.6700
 /begin AXIS_DESCR STD_AXIS Eng_nAvrg EngN 16 0.00 6000.000 FORMAT "%8.3" EXTENDED_LIMITS -32768.00 32767.00 DEPOSIT ABSOLUTE /end AXIS_DESCR
 /begin AXIS_DESCR STD_AXIS InjCtl_qSetUnBal InjMass 12 0.00 327.6700 FORMAT "%8.4" EXTENDED_LIMITS -327.6800 327.6700 DEPOSIT ABSOLUTE /end AXIS_DESCR
/end CHARACTERISTIC
/begin CHARACTERISTIC InjCrv_qPiI1Bas_MAP "Einspritzmenge PiI1 Grundwertekennfeld" MAP 0x1D880A Kf_Xs16_Ys16_Ws16 10.00000 InjMassInj 0.00 10.00000 FORMAT "%8.5" EXTENDED_LIMITS -327.6800 327.6700
 /begin AXIS_DESCR STD_AXIS Eng_nAvrg EngN 16 0.00 6000.000 FORMAT "%8.3" EXTENDED_LIMITS -32768.00 32767.00 DEPOSIT ABSOLUTE /end AXIS_DESCR
 /begin AXIS_DESCR STD_AXIS InjCtl_qSetUnBal InjMass 16 0.00 327.6700 FORMAT "%8.4" EXTENDED_LIMITS -327.6800 327.6700 DEPOSIT ABSOLUTE /end AXIS_DESCR
/end CHARACTERISTIC
/begin CHARACTERISTIC InjCrv_qPiI1DesAdd_Vector "Bypass-Label für additiven Bypass von InjCrv_qPiI1Des (Nicht verstellen!)" VALUE 0x1C0AE0 Kw_Wu8 255.0 OneToOne 0.00 255.0 FORMAT "%5.1" /end CHARACTERISTIC
/begin CHARACTERISTIC InjCrv_qPiI1DesAdd_Channel "Bypass-Label für additiven Bypass von InjCrv_qPiI1Des (Nicht verstellen!)" VALUE 0x1C0AE1 Kw_Wu8 255.0 OneToOne 0.00 255.0 FORMAT "%5.1" /end CHARACTERISTIC
/begin CHARACTERISTIC InjCrv_qPiI1Des_C "Fernsteuerwert der Einspritzmenge von PiI1" VALUE 0x1DB1C6 Kw_Ws16 10.00000 InjMassInj 0.00 10.00000 FORMAT "%8.5" EXTENDED_LIMITS -327.6800 327.6700 /end CHARACTERISTIC
/begin CHARACTERISTIC InjCrv_qPiI1Des_Vector "Bypass-Label für InjCrv_qPiI1Des (Nicht verstellen!)" VALUE 0x1C0AE2 Kw_Wu8 255.0 OneToOne 0.00 255.0 FORMAT "%5.1" /end CHARACTERISTIC
/begin CHARACTERISTIC InjCrv_qPiI1Des_Channel "Bypass-Label für InjCrv_qPiI1Des (Nicht verstellen!)" VALUE 0x1C0AE3 Kw_Wu8 255.0 OneToOne 0.00 255.0 FORMAT "%5.1" /end CHARACTERISTIC
/begin CHARACTERISTIC InjCrv_qPiI1ETSCor_MAP "motortemperaturabhängiges Mengenkorrekturkennfeld für Voreinspritzung 1" MAP 0x1DA286 Kf_Xs16_Ys16_Ws16 10.00000 InjMassInj 0.00 10.00000 FORMAT "%8.5" EXTENDED_LIMITS -327.6800 327.6700
 /begin AXIS_DESCR STD_AXIS Eng_nAvrg EngN 16 0.00 6000.000 FORMAT "%8.3" EXTENDED_LIMITS -32768.00 32767.00 DEPOSIT ABSOLUTE /end AXIS_DESCR
 /begin AXIS_DESCR STD_AXIS InjCtl_qSetUnBal InjMass 12 0.00 327.6700 FORMAT "%8.4" EXTENDED_LIMITS -327.6800 327.6700 DEPOSIT ABSOLUTE /end AXIS_DESCR
/end CHARACTERISTIC
/begin CHARACTERISTIC InjCrv_qPiI1Max_MAP "Einspritzmenge PiI1 Maximalwertekennfeld" MAP 0x1D8A4E Kf_Xs16_Ys16_Ws16 10.00000 InjMassInj 0.00 10.00000 FORMAT "%8.5" EXTENDED_LIMITS -327.6800 327.6700
 /begin AXIS_DESCR STD_AXIS Eng_nAvrg EngN 16 0.00 6000.000 FORMAT "%8.3" EXTENDED_LIMITS -32768.00 32767.00 DEPOSIT ABSOLUTE /end AXIS_DESCR
 /begin AXIS_DESCR STD_AXIS InjCtl_qSetUnBal InjMass 10 0.00 327.6700 FORMAT "%8.4" EXTENDED_LIMITS -327.6800 327.6700 DEPOSIT ABSOLUTE /end AXIS_DESCR
/end CHARACTERISTIC
/begin CHARACTERISTIC InjCrv_qPiI1MinDiff_C "Minimalmenge zwischen unteren und oberen Hystheresenschwelle für Voreinspritzung 1" VALUE 0x1D8BC6 Kw_Ws16 10.00000 InjMassInj 0.00 10.00000 FORMAT "%8.5" EXTENDED_LIMITS -327.6800 327.6700 /end CHARACTERISTIC
/begin CHARACTERISTIC InjCrv_qPiI1RgnBas1_MAP "Einspritzmengen Grundwertkennfeld 1 für PiI1" MAP 0x1DA6D8 Kf_Xs16_Ys16_Ws16 10.00000 InjMassInj 0.00 10.00000 FORMAT "%8.5" EXTENDED_LIMITS -327.6800 327.6700
 /begin AXIS_DESCR STD_AXIS Eng_nAvrg EngN 10 0.00 6000.000 FORMAT "%8.3" EXTENDED_LIMITS -32768.00 32767.00 DEPOSIT ABSOLUTE /end AXIS_DESCR
 /begin AXIS_DESCR STD_AXIS InjCtl_qSetUnBal InjMass 10 0.00 327.6700 FORMAT "%8.4" EXTENDED_LIMITS -327.6800 327.6700 DEPOSIT ABSOLUTE /end AXIS_DESCR
/end CHARACTERISTIC
/begin CHARACTERISTIC InjCrv_qPiI1RgnBas2_MAP "Einspritzmengen Grundwertkennfeld 2 für PiI1" MAP 0x1DA7CC Kf_Xs16_Ys16_Ws16 10.00000 InjMassInj 0.00 10.00000 FORMAT "%8.5" EXTENDED_LIMITS -327.6800 327.6700
 /begin AXIS_DESCR STD_AXIS Eng_nAvrg EngN 10 0.00 6000.000 FORMAT "%8.3" EXTENDED_LIMITS -32768.00 32767.00 DEPOSIT ABSOLUTE /end AXIS_DESCR
 /begin AXIS_DESCR STD_AXIS InjCtl_qSetUnBal InjMass 10 0.00 327.6700 FORMAT "%8.4" EXTENDED_LIMITS -327.6800 327.6700 DEPOSIT ABSOLUTE /end AXIS_DESCR
/end CHARACTERISTIC
/begin CHARACTERISTIC InjCrv_qPiI1RgnBas3_MAP "Einspritzmengen Grundwertkennfeld 3 für PiI1" MAP 0x1DA8C0 Kf_Xs16_Ys16_Ws16 10.00000 InjMassInj 0.00 10.00000 FORMAT "%8.5" EXTENDED_LIMITS -327.6800 327.6700
 /begin AXIS_DESCR STD_AXIS Eng_nAvrg EngN 10 0.00 6000.000 FORMAT "%8.3" EXTENDED_LIMITS -32768.00 32767.00 DEPOSIT ABSOLUTE /end AXIS_DESCR
 /begin AXIS_DESCR STD_AXIS InjCtl_qSetUnBal InjMass 10 0.00 327.6700 FORMAT "%8.4" EXTENDED_LIMITS -327.6800 327.6700 DEPOSIT ABSOLUTE /end AXIS_DESCR
/end CHARACTERISTIC
/begin CHARACTERISTIC InjCrv_qPiI1Rgn_Vector "Bypass-Label, nicht editieren !" VALUE 0x1C0AF6 Kw_Wu8 255.0 OneToOne 0.00 255.0 FORMAT "%5.1" /end CHARACTERISTIC
/begin CHARACTERISTIC InjCrv_qPiI1Rgn_Channel "Bypass-Label, nicht editieren !" VALUE 0x1C0AF7 Kw_Wu8 255.0 OneToOne 0.00 255.0 FORMAT "%5.1" /end CHARACTERISTIC
/begin CHARACTERISTIC InjCrv_qPiI1WvCorMax_C "Schwelle zur Abschaltung der PiI2 bei Unterschreiten der Mindesteinspritzmenge durch PiI1 bei aktiver Wellenkorrektur" VALUE 0x1D912E Kw_Ws16 3.000000 InjMassInj -3.000000 0.00 FORMAT "%8.6" EXTENDED_LIMITS -327.6800 327.6700 /end CHARACTERISTIC
/begin CHARACTERISTIC InjCrv_qPiI2APSCor_MAP "atmosphärendruckabhängiges Mengenkorrekturkennfeld für Voreinspritzung 2" MAP 0x1D94F4 Kf_Xs16_Ys16_Ws16 10.00000 InjMassInj 0.00 10.00000 FORMAT "%8.5" EXTENDED_LIMITS -327.6800 327.6700
 /begin AXIS_DESCR STD_AXIS Eng_nAvrg EngN 16 0.00 6000.000 FORMAT "%8.3" EXTENDED_LIMITS -32768.00 32767.00 DEPOSIT ABSOLUTE /end AXIS_DESCR
 /begin AXIS_DESCR STD_AXIS InjCtl_qSetUnBal InjMass 12 0.00 327.6700 FORMAT "%8.4" EXTENDED_LIMITS -327.6800 327.6700 DEPOSIT ABSOLUTE /end AXIS_DESCR
/end CHARACTERISTIC
/begin CHARACTERISTIC InjCrv_qPiI2ATSCor_MAP "ansauglufttemperaturabhängiges Mengenkorrekturkennfeld für Voreinspritzung 2" MAP 0x1D96B0 Kf_Xs16_Ys16_Ws16 10.00000 InjMassInj 0.00 10.00000 FORMAT "%8.5" EXTENDED_LIMITS -327.6800 327.6700
 /begin AXIS_DESCR STD_AXIS Eng_nAvrg EngN 16 0.00 6000.000 FORMAT "%8.3" EXTENDED_LIMITS -32768.00 32767.00 DEPOSIT ABSOLUTE /end AXIS_DESCR
 /begin AXIS_DESCR STD_AXIS InjCtl_qSetUnBal InjMass 12 0.00 327.6700 FORMAT "%8.4" EXTENDED_LIMITS -327.6800 327.6700 DEPOSIT ABSOLUTE /end AXIS_DESCR
/end CHARACTERISTIC
/begin CHARACTERISTIC InjCrv_qPiI2Bas_MAP "Einspritzmenge PiI2 Grundwertekennfeld" MAP 0x1D9130 Kf_Xs16_Ys16_Ws16 10.00000 InjMassInj 0.00 10.00000 FORMAT "%8.5" EXTENDED_LIMITS -327.6800 327.6700
 /begin AXIS_DESCR STD_AXIS Eng_nAvrg EngN 16 0.00 6000.000 FORMAT "%8.3" EXTENDED_LIMITS -32768.00 32767.00 DEPOSIT ABSOLUTE /end AXIS_DESCR
 /begin AXIS_DESCR STD_AXIS InjCtl_qSetUnBal InjMass 16 0.00 327.6700 FORMAT "%8.4" EXTENDED_LIMITS -327.6800 327.6700 DEPOSIT ABSOLUTE /end AXIS_DESCR
/end CHARACTERISTIC
/begin CHARACTERISTIC InjCrv_qPiI2DesAdd_Vector "Bypass-Label für additiven Bypass von InjCrv_qPiI2Des (Nicht verstellen!)" VALUE 0x1C0AE4 Kw_Wu8 255.0 OneToOne 0.00 255.0 FORMAT "%5.1" /end CHARACTERISTIC
/begin CHARACTERISTIC InjCrv_qPiI2DesAdd_Channel "Bypass-Label für additiven Bypass von InjCrv_qPiI2Des (Nicht verstellen!)" VALUE 0x1C0AE5 Kw_Wu8 255.0 OneToOne 0.00 255.0 FORMAT "%5.1" /end CHARACTERISTIC
/begin CHARACTERISTIC InjCrv_qPiI2Des_C "Fernsteuerwert der Einspritzmenge von PiI2" VALUE 0x1D9BF2 Kw_Ws16 10.00000 InjMassInj 0.00 10.00000 FORMAT "%8.5" EXTENDED_LIMITS -327.6800 327.6700 /end CHARACTERISTIC
/begin CHARACTERISTIC InjCrv_qPiI2Des_Vector "Bypass-Label für InjCrv_qPiI2Des (Nicht verstellen!)" VALUE 0x1C0AE6 Kw_Wu8 255.0 OneToOne 0.00 255.0 FORMAT "%5.1" /end CHARACTERISTIC
/begin CHARACTERISTIC InjCrv_qPiI2Des_Channel "Bypass-Label für InjCrv_qPiI2Des (Nicht verstellen!)" VALUE 0x1C0AE7 Kw_Wu8 255.0 OneToOne 0.00 255.0 FORMAT "%5.1" /end CHARACTERISTIC
/begin CHARACTERISTIC InjCrv_qPiI2ETSCor_MAP "motortemperaturabhängiges Mengenkorrekturkennfeld für Voreinspritzung 2" MAP 0x1D986C Kf_Xs16_Ys16_Ws16 10.00000 InjMassInj 0.00 10.00000 FORMAT "%8.5" EXTENDED_LIMITS -327.6800 327.6700
 /begin AXIS_DESCR STD_AXIS Eng_nAvrg EngN 16 0.00 6000.000 FORMAT "%8.3" EXTENDED_LIMITS -32768.00 32767.00 DEPOSIT ABSOLUTE /end AXIS_DESCR
 /begin AXIS_DESCR STD_AXIS InjCtl_qSetUnBal InjMass 12 0.00 327.6700 FORMAT "%8.4" EXTENDED_LIMITS -327.6800 327.6700 DEPOSIT ABSOLUTE /end AXIS_DESCR
/end CHARACTERISTIC
/begin CHARACTERISTIC InjCrv_qPiI2Max_MAP "Einspritzmenge PiI2 Maximalwertekennfeld" MAP 0x1D9374 Kf_Xs16_Ys16_Ws16 10.00000 InjMassInj 0.00 10.00000 FORMAT "%8.5" EXTENDED_LIMITS -327.6800 327.6700
 /begin AXIS_DESCR STD_AXIS Eng_nAvrg EngN 16 0.00 6000.000 FORMAT "%8.3" EXTENDED_LIMITS -32768.00 32767.00 DEPOSIT ABSOLUTE /end AXIS_DESCR
 /begin AXIS_DESCR STD_AXIS InjCtl_qSetUnBal InjMass 10 0.00 327.6700 FORMAT "%8.4" EXTENDED_LIMITS -327.6800 327.6700 DEPOSIT ABSOLUTE /end AXIS_DESCR
/end CHARACTERISTIC
/begin CHARACTERISTIC InjCrv_qPiI2MinDiff_C "Minimalmenge zwischen unteren und oberen Hystheresenschwelle für Voreinspritzung 2" VALUE 0x1D94EC Kw_Ws16 10.00000 InjMassInj 0.00 10.00000 FORMAT "%8.5" EXTENDED_LIMITS -327.6800 327.6700 /end CHARACTERISTIC
/begin CHARACTERISTIC InjCrv_qPiI2Rgn_Vector "Bypass-Label, nicht editieren !" VALUE 0x1C0AD0 Kw_Wu8 255.0 OneToOne 0.00 255.0 FORMAT "%5.1" /end CHARACTERISTIC
/begin CHARACTERISTIC InjCrv_qPiI2Rgn_Channel "Bypass-Label, nicht editieren !" VALUE 0x1C0AD1 Kw_Wu8 255.0 OneToOne 0.00 255.0 FORMAT "%5.1" /end CHARACTERISTIC
/begin CHARACTERISTIC InjCrv_qPiI3DesAdd_Vector "Bypass-Label für additiven Bypass von InjCrv_qPiI3Des (Nicht verstellen!)" VALUE 0x1C0AE8 Kw_Wu8 255.0 OneToOne 0.00 255.0 FORMAT "%5.1" /end CHARACTERISTIC
/begin CHARACTERISTIC InjCrv_qPiI3DesAdd_Channel "Bypass-Label für additiven Bypass von InjCrv_qPiI3Des (Nicht verstellen!)" VALUE 0x1C0AE9 Kw_Wu8 255.0 OneToOne 0.00 255.0 FORMAT "%5.1" /end CHARACTERISTIC
/begin CHARACTERISTIC InjCrv_qPiI3Des_Vector "Bypass-Label für InjCrv_qPiI3Des (Nicht verstellen!)" VALUE 0x1C0AEA Kw_Wu8 255.0 OneToOne 0.00 255.0 FORMAT "%5.1" /end CHARACTERISTIC
/begin CHARACTERISTIC InjCrv_qPiI3Des_Channel "Bypass-Label für InjCrv_qPiI3Des (Nicht verstellen!)" VALUE 0x1C0AEB Kw_Wu8 255.0 OneToOne 0.00 255.0 FORMAT "%5.1" /end CHARACTERISTIC
/begin CHARACTERISTIC InjCrv_qPoI1APSCor_MAP "atmospärendruckabhängiges Mengenkorrekturkennfeld für PoI1" MAP 0x1DB6D0 Kf_Xs16_Ys16_Ws16 10.00000 InjMassInj 0.00 10.00000 FORMAT "%8.5" EXTENDED_LIMITS -327.6800 327.6700
 /begin AXIS_DESCR STD_AXIS Eng_nAvrg EngN 6 0.00 6000.000 FORMAT "%8.3" EXTENDED_LIMITS -32768.00 32767.00 DEPOSIT ABSOLUTE /end AXIS_DESCR
 /begin AXIS_DESCR STD_AXIS InjCtl_qSetUnBal InjMass 6 0.00 327.6700 FORMAT "%8.4" EXTENDED_LIMITS -327.6800 327.6700 DEPOSIT ABSOLUTE /end AXIS_DESCR
/end CHARACTERISTIC
/begin CHARACTERISTIC InjCrv_qPoI1Bas_MAP "Grundwert der Einspritzmenge PoI1" MAP 0x1DB2A8 Kf_Xs16_Ys16_Ws16 10.00000 InjMassInj 0.00 10.00000 FORMAT "%8.5" EXTENDED_LIMITS -327.6800 327.6700
 /begin AXIS_DESCR STD_AXIS Eng_nAvrg EngN 8 0.00 6000.000 FORMAT "%8.3" EXTENDED_LIMITS -32768.00 32767.00 DEPOSIT ABSOLUTE /end AXIS_DESCR
 /begin AXIS_DESCR STD_AXIS InjCtl_qSetUnBal InjMass 8 0.00 327.6700 FORMAT "%8.4" EXTENDED_LIMITS -327.6800 327.6700 DEPOSIT ABSOLUTE /end AXIS_DESCR
/end CHARACTERISTIC
/begin CHARACTERISTIC InjCrv_qPoI1DesAdd_Vector "Bypass-Label für additiven Bypass von InjCrv_qPoI1Des (Nicht verstellen!)" VALUE 0x1C0AFE Kw_Wu8 255.0 OneToOne 0.00 255.0 FORMAT "%5.1" /end CHARACTERISTIC
/begin CHARACTERISTIC InjCrv_qPoI1DesAdd_Channel "Bypass-Label für additiven Bypass von InjCrv_qPoI1Des (Nicht verstellen!)" VALUE 0x1C0AFF Kw_Wu8 255.0 OneToOne 0.00 255.0 FORMAT "%5.1" /end CHARACTERISTIC
/begin CHARACTERISTIC InjCrv_qPoI1Des_C "Fernsteuerwert der Einspritzmenge von PoI1" VALUE 0x1DBDA6 Kw_Ws16 10.00000 InjMassInj 0.00 10.00000 FORMAT "%8.5" EXTENDED_LIMITS -327.6800 327.6700 /end CHARACTERISTIC
/begin CHARACTERISTIC InjCrv_qPoI1Des_Vector "Bypass-Label für InjCrv_qPoI1Des (Nicht verstellen!)" VALUE 0x1C0B00 Kw_Wu8 255.0 OneToOne 0.00 255.0 FORMAT "%5.1" /end CHARACTERISTIC
/begin CHARACTERISTIC InjCrv_qPoI1Des_Channel "Bypass-Label für InjCrv_qPoI1Des (Nicht verstellen!)" VALUE 0x1C0B01 Kw_Wu8 255.0 OneToOne 0.00 255.0 FORMAT "%5.1" /end CHARACTERISTIC
/begin CHARACTERISTIC InjCrv_qPoI1ETSCor_MAP "motortemperaturabhängiges Mengenkorrekturkennfeld für PoI1" MAP 0x1DB734 Kf_Xs16_Ys16_Ws16 10.00000 InjMassInj 0.00 10.00000 FORMAT "%8.5" EXTENDED_LIMITS -327.6800 327.6700
 /begin AXIS_DESCR STD_AXIS Eng_nAvrg EngN 6 0.00 6000.000 FORMAT "%8.3" EXTENDED_LIMITS -32768.00 32767.00 DEPOSIT ABSOLUTE /end AXIS_DESCR
 /begin AXIS_DESCR STD_AXIS InjCtl_qSetUnBal InjMass 6 0.00 327.6700 FORMAT "%8.4" EXTENDED_LIMITS -327.6800 327.6700 DEPOSIT ABSOLUTE /end AXIS_DESCR
/end CHARACTERISTIC
/begin CHARACTERISTIC InjCrv_qPoI1Max_MAP "Maximalwert der Einspritzmenge PoI1" MAP 0x1DB34C Kf_Xs16_Ys16_Ws16 10.00000 InjMassInj 0.00 10.00000 FORMAT "%8.5" EXTENDED_LIMITS -327.6800 327.6700
 /begin AXIS_DESCR STD_AXIS Eng_nAvrg EngN 8 0.00 6000.000 FORMAT "%8.3" EXTENDED_LIMITS -32768.00 32767.00 DEPOSIT ABSOLUTE /end AXIS_DESCR
 /begin AXIS_DESCR STD_AXIS InjCtl_qSetUnBal InjMass 8 0.00 327.6700 FORMAT "%8.4" EXTENDED_LIMITS -327.6800 327.6700 DEPOSIT ABSOLUTE /end AXIS_DESCR
/end CHARACTERISTIC
/begin CHARACTERISTIC InjCrv_qPoI1RgnBas1_MAP "Grundkennfeld 1 der Einspritzmenge PoI1 für die Partikelfilter Regeneration." MAP 0x1DBA90 Kf_Xs16_Ys16_Ws16 10.00000 InjMassInj 0.00 10.00000 FORMAT "%8.5" EXTENDED_LIMITS -327.6800 327.6700
 /begin AXIS_DESCR STD_AXIS Eng_nAvrg EngN 8 0.00 6000.000 FORMAT "%8.3" EXTENDED_LIMITS -32768.00 32767.00 DEPOSIT ABSOLUTE /end AXIS_DESCR
 /begin AXIS_DESCR STD_AXIS InjCtl_qSetUnBal InjMass 8 0.00 327.6700 FORMAT "%8.4" EXTENDED_LIMITS -327.6800 327.6700 DEPOSIT ABSOLUTE /end AXIS_DESCR
/end CHARACTERISTIC
/begin CHARACTERISTIC InjCrv_qPoI1RgnBas2_MAP "Grundkennfeld 2 der Einspritzmenge PoI1 für die Partikelfilter Regeneration." MAP 0x1DBB34 Kf_Xs16_Ys16_Ws16 10.00000 InjMassInj 0.00 10.00000 FORMAT "%8.5" EXTENDED_LIMITS -327.6800 327.6700
 /begin AXIS_DESCR STD_AXIS Eng_nAvrg EngN 8 0.00 6000.000 FORMAT "%8.3" EXTENDED_LIMITS -32768.00 32767.00 DEPOSIT ABSOLUTE /end AXIS_DESCR
 /begin AXIS_DESCR STD_AXIS InjCtl_qSetUnBal InjMass 8 0.00 327.6700 FORMAT "%8.4" EXTENDED_LIMITS -327.6800 327.6700 DEPOSIT ABSOLUTE /end AXIS_DESCR
/end CHARACTERISTIC
/begin CHARACTERISTIC InjCrv_qPoI1RgnBas3_MAP "Grundkennfeld 3 der Einspritzmenge PoI1 für die Partikelfilter Regeneration." MAP 0x1DBBD8 Kf_Xs16_Ys16_Ws16 10.00000 InjMassInj 0.00 10.00000 FORMAT "%8.5" EXTENDED_LIMITS -327.6800 327.6700
 /begin AXIS_DESCR STD_AXIS Eng_nAvrg EngN 8 0.00 6000.000 FORMAT "%8.3" EXTENDED_LIMITS -32768.00 32767.00 DEPOSIT ABSOLUTE /end AXIS_DESCR
 /begin AXIS_DESCR STD_AXIS InjCtl_qSetUnBal InjMass 8 0.00 327.6700 FORMAT "%8.4" EXTENDED_LIMITS -327.6800 327.6700 DEPOSIT ABSOLUTE /end AXIS_DESCR
/end CHARACTERISTIC
/begin CHARACTERISTIC InjCrv_qPoI1RgnBas4_MAP "Grundkennfeld 4 der Einspritzmenge PoI1 für die Partikelfilter Regeneration." MAP 0x1DBC7C Kf_Xs16_Ys16_Ws16 10.00000 InjMassInj 0.00 10.00000 FORMAT "%8.5" EXTENDED_LIMITS -327.6800 327.6700
 /begin AXIS_DESCR STD_AXIS Eng_nAvrg EngN 8 0.00 6000.000 FORMAT "%8.3" EXTENDED_LIMITS -32768.00 32767.00 DEPOSIT ABSOLUTE /end AXIS_DESCR
 /begin AXIS_DESCR STD_AXIS InjCtl_qSetUnBal InjMass 8 0.00 327.6700 FORMAT "%8.4" EXTENDED_LIMITS -327.6800 327.6700 DEPOSIT ABSOLUTE /end AXIS_DESCR
/end CHARACTERISTIC
/begin CHARACTERISTIC InjCrv_qPoI1Rgn_Vector "Bypass-Label, nicht editieren !" VALUE 0x1C0B04 Kw_Wu8 255.0 OneToOne 0.00 255.0 FORMAT "%5.1" /end CHARACTERISTIC
/begin CHARACTERISTIC InjCrv_qPoI1Rgn_Channel "Bypass-Label, nicht editieren !" VALUE 0x1C0B05 Kw_Wu8 255.0 OneToOne 0.00 255.0 FORMAT "%5.1" /end CHARACTERISTIC
/begin CHARACTERISTIC InjCrv_qPoI2ATSCor_MAP "ansauglufttemperaturabhängiges Mengenkorrekturkennfeld für PoI2" MAP 0x1DBE10 Kf_Xs16_Ys16_Ws16 10.00000 InjMassInj 0.00 10.00000 FORMAT "%8.5" EXTENDED_LIMITS -327.6800 327.6700
 /begin AXIS_DESCR STD_AXIS Eng_nAvrg EngN 6 0.00 6000.000 FORMAT "%8.3" EXTENDED_LIMITS -32768.00 32767.00 DEPOSIT ABSOLUTE /end AXIS_DESCR
 /begin AXIS_DESCR STD_AXIS InjCtl_qSetUnBal InjMass 6 0.00 327.6700 FORMAT "%8.4" EXTENDED_LIMITS -327.6800 327.6700 DEPOSIT ABSOLUTE /end AXIS_DESCR
/end CHARACTERISTIC
/begin CHARACTERISTIC InjCrv_qPoI2Bas_MAP "Einspritzmenge PoI2 Grundwert" MAP 0x1DC26A Kf_Xs16_Ys16_Ws16 10.00000 InjMassInj 0.00 10.00000 FORMAT "%8.5" EXTENDED_LIMITS -327.6800 327.6700
 /begin AXIS_DESCR STD_AXIS Eng_nAvrg EngN 8 0.00 6000.000 FORMAT "%8.3" EXTENDED_LIMITS -32768.00 32767.00 DEPOSIT ABSOLUTE /end AXIS_DESCR
 /begin AXIS_DESCR STD_AXIS InjCtl_qSetUnBal InjMass 8 0.00 327.6700 FORMAT "%8.4" EXTENDED_LIMITS -327.6800 327.6700 DEPOSIT ABSOLUTE /end AXIS_DESCR
/end CHARACTERISTIC
/begin CHARACTERISTIC InjCrv_qPoI2Des_C "Fernsteuerung - Wert für  InjCrv_qPoI2Des" VALUE 0x1DC314 Kw_Ws16 10.00000 InjMassInj 0.00 10.00000 FORMAT "%8.5" EXTENDED_LIMITS -327.6800 327.6700 /end CHARACTERISTIC
/begin CHARACTERISTIC InjCrv_qPoI2Eff_C "Fernsteuerung - Wert für  InjCrv_qPoI2Eff" VALUE 0x1DC316 Kw_Ws16 10.00000 InjMassInj 0.00 10.00000 FORMAT "%8.5" EXTENDED_LIMITS -327.6800 327.6700 /end CHARACTERISTIC
/begin CHARACTERISTIC InjCrv_qPoI2ETSCor_MAP "motortemperaturabhängiges Mengenkorrekturkennfeld für PoI2" MAP 0x1DBE74 Kf_Xs16_Ys16_Ws16 10.00000 InjMassInj 0.00 10.00000 FORMAT "%8.5" EXTENDED_LIMITS -327.6800 327.6700
 /begin AXIS_DESCR STD_AXIS Eng_nAvrg EngN 6 0.00 6000.000 FORMAT "%8.3" EXTENDED_LIMITS -32768.00 32767.00 DEPOSIT ABSOLUTE /end AXIS_DESCR
 /begin AXIS_DESCR STD_AXIS InjCtl_qSetUnBal InjMass 6 0.00 327.6700 FORMAT "%8.4" EXTENDED_LIMITS -327.6800 327.6700 DEPOSIT ABSOLUTE /end AXIS_DESCR
/end CHARACTERISTIC
/begin CHARACTERISTIC InjCrv_qPoI2Rgn_Vector "Bypass-Label, nicht editieren !" VALUE 0x1C0B08 Kw_Wu8 255.0 OneToOne 0.00 255.0 FORMAT "%5.1" /end CHARACTERISTIC
/begin CHARACTERISTIC InjCrv_qPoI2Rgn_Channel "Bypass-Label, nicht editieren !" VALUE 0x1C0B09 Kw_Wu8 255.0 OneToOne 0.00 255.0 FORMAT "%5.1" /end CHARACTERISTIC
/begin CHARACTERISTIC InjCrv_stMI1RgnDelMsk_C "Maske für die Deaktivierung der MI1 Grundwerteberechnung im Regenerationsbetrieb" VALUE 0x1D742C Kw_Wu32 4294967295.00 OneToOne 0.00 4294967295.00 FORMAT "%13.2" /end CHARACTERISTIC
/begin CHARACTERISTIC InjCrv_stMI1RgnMsk1_C "Auswahl für das Einspritzwinkelgrundkennfeld 1 im Regenerationsfall" VALUE 0x1D87C4 Kw_Wu32 2147483647.00 OneToOne 0.00 2147483647.00 FORMAT "%13.2" EXTENDED_LIMITS 0.00 4294967295.00 /end CHARACTERISTIC
/begin CHARACTERISTIC InjCrv_stMI1RgnMsk2_C "Auswahl für das Einspritzwinkelgrundkennfeld 2 im Regenerationsfall" VALUE 0x1D87C8 Kw_Wu32 2147483647.00 OneToOne 0.00 2147483647.00 FORMAT "%13.2" EXTENDED_LIMITS 0.00 4294967295.00 /end CHARACTERISTIC
/begin CHARACTERISTIC InjCrv_stMI1RgnMsk3_C "Auswahl für das Einspritzwinkelgrundkennfeld 3 im Regenerationsfall" VALUE 0x1D87CC Kw_Wu32 2147483647.00 OneToOne 0.00 2147483647.00 FORMAT "%13.2" EXTENDED_LIMITS 0.00 4294967295.00 /end CHARACTERISTIC
/begin CHARACTERISTIC InjCrv_stMI1RgnMsk_C "Maske für Aktivierung  der Regeneration über MI1" VALUE 0x1D87D8 Kw_Wu32 4294967295.00 OneToOne 0.00 4294967295.00 FORMAT "%13.2" /end CHARACTERISTIC
/begin CHARACTERISTIC InjCrv_stMIEnvRgnMsk1_C "Auswahl für die Ansteuerbeginnkorrekturkennlinie 1 im Regenerationsfall" VALUE 0x1D81A4 Kw_Wu32 2147483647.00 OneToOne 0.00 2147483647.00 FORMAT "%13.2" EXTENDED_LIMITS 0.00 4294967295.00 /end CHARACTERISTIC
/begin CHARACTERISTIC InjCrv_stMIEnvRgnMsk2_C "Auswahl für die Ansteuerbeginnkorrekturkennlinie 2 im Regenerationsfall" VALUE 0x1D81A8 Kw_Wu32 2147483647.00 OneToOne 0.00 2147483647.00 FORMAT "%13.2" EXTENDED_LIMITS 0.00 4294967295.00 /end CHARACTERISTIC
/begin CHARACTERISTIC InjCrv_stMIEnvRgnMsk3_C "Auswahl für die Ansteuerbeginnkorrekturkennlinie 3 im Regenerationsfall" VALUE 0x1D81AC Kw_Wu32 2147483647.00 OneToOne 0.00 2147483647.00 FORMAT "%13.2" EXTENDED_LIMITS 0.00 4294967295.00 /end CHARACTERISTIC
/begin CHARACTERISTIC InjCrv_stMIETSSOERgnMsk1_C "Auswahl für die Ansteuerbeginnkorrekturkennlinie 1 im Regenerationsfall" VALUE 0x1D827C Kw_Wu32 2147483647.00 OneToOne 0.00 2147483647.00 FORMAT "%13.2" EXTENDED_LIMITS 0.00 4294967295.00 /end CHARACTERISTIC
/begin CHARACTERISTIC InjCrv_stMIETSSOERgnMsk2_C "Auswahl für die Ansteuerbeginnkorrekturkennlinie 2 im Regenerationsfall" VALUE 0x1D8280 Kw_Wu32 2147483647.00 OneToOne 0.00 2147483647.00 FORMAT "%13.2" EXTENDED_LIMITS 0.00 4294967295.00 /end CHARACTERISTIC
/begin CHARACTERISTIC InjCrv_stMIETSSOERgnMsk3_C "Auswahl für die Ansteuerbeginnkorrekturkennlinie 3 im Regenerationsfall" VALUE 0x1D8284 Kw_Wu32 2147483647.00 OneToOne 0.00 2147483647.00 FORMAT "%13.2" EXTENDED_LIMITS 0.00 4294967295.00 /end CHARACTERISTIC
/begin CHARACTERISTIC InjCrv_stPiI1EnvCorSlowMsk1_C "Stellgröße zur Ansteuerung der Kennlinie  InjCrv_facPiI1ETSSOERgnCor1_CUR" VALUE 0x1DA598 Kw_Wu32 2147483647.00 OneToOne 0.00 2147483647.00 FORMAT "%13.2" EXTENDED_LIMITS 0.00 4294967295.00 /end CHARACTERISTIC
/begin CHARACTERISTIC InjCrv_stPiI1EnvCorSlowMsk2_C "Stellgröße zur Ansteuerung der Kennlinie  InjCrv_facPiI1ETSSOERgnCor2_CUR" VALUE 0x1DA59C Kw_Wu32 2147483647.00 OneToOne 0.00 2147483647.00 FORMAT "%13.2" EXTENDED_LIMITS 0.00 4294967295.00 /end CHARACTERISTIC
/begin CHARACTERISTIC InjCrv_stPiI1EnvCorSlowMsk3_C "Stellgröße zur Ansteuerung der Kennlinie  InjCrv_facPiI1ETSSOERgnCor3_CUR" VALUE 0x1DA5A0 Kw_Wu32 2147483647.00 OneToOne 0.00 2147483647.00 FORMAT "%13.2" EXTENDED_LIMITS 0.00 4294967295.00 /end CHARACTERISTIC
/begin CHARACTERISTIC InjCrv_stPiI1RgnDelMsk_C "Maske für die Deaktivierung der PiI1 Grundwerteberechnung im Regenerationsbetrieb" VALUE 0x1D8BC8 Kw_Wu32 4294967295.00 OneToOne 0.00 4294967295.00 FORMAT "%13.2" /end CHARACTERISTIC
/begin CHARACTERISTIC InjCrv_stPiI1RgnMsk1_C "Stellgröße zur Ansteuerung der Kennfelder InjCrv_qPiI1RgnBas1_MAP, InjCrv_phiPiI1ETSRgnCor1_MAP, ..." VALUE 0x1DA9B4 Kw_Wu32 2147483647.00 OneToOne 0.00 2147483647.00 FORMAT "%13.2" EXTENDED_LIMITS 0.00 4294967295.00 /end CHARACTERISTIC
/begin CHARACTERISTIC InjCrv_stPiI1RgnMsk2_C "Stellgröße zur Ansteuerung der Kennfelder InjCrv_qPiI1RgnBas2_MAP, InjCrv_phiPiI1ETSRgnCor2_MAP, ..." VALUE 0x1DA9B8 Kw_Wu32 2147483647.00 OneToOne 0.00 2147483647.00 FORMAT "%13.2" EXTENDED_LIMITS 0.00 4294967295.00 /end CHARACTERISTIC
/begin CHARACTERISTIC InjCrv_stPiI1RgnMsk3_C "Stellgröße zur Ansteuerung der Kennfelder InjCrv_qPiI1RgnBas3_MAP, InjCrv_phiPiI1ETSRgnCor3_MAP, ..." VALUE 0x1DA9BC Kw_Wu32 2147483647.00 OneToOne 0.00 2147483647.00 FORMAT "%13.2" EXTENDED_LIMITS 0.00 4294967295.00 /end CHARACTERISTIC
/begin CHARACTERISTIC InjCrv_stPiI1RgnMsk_C "Maske zur Aktivierung  der Regeneration über PiI1" VALUE 0x1DB1C0 Kw_Wu32 4294967295.00 OneToOne 0.00 4294967295.00 FORMAT "%13.2" /end CHARACTERISTIC
/begin CHARACTERISTIC InjCrv_stPiI2RgnDelMsk_C "Maske für die Deaktivierung der PiI2 Grundwerteberechnung im Regenerationsbetrieb" VALUE 0x1D94F0 Kw_Wu32 4294967295.00 OneToOne 0.00 4294967295.00 FORMAT "%13.2" /end CHARACTERISTIC
/begin CHARACTERISTIC InjCrv_stPiI2RgnMsk_C "Maske zur Aktivierung  der Regeneration über PiI2" VALUE 0x1D9BEC Kw_Wu32 4294967295.00 OneToOne 0.00 4294967295.00 FORMAT "%13.2" /end CHARACTERISTIC
/begin CHARACTERISTIC InjCrv_stPoI1AddCorMsk1_C "Maske zur Auswahl von Kennlinie 1 hoher und niedriger Bereich" VALUE 0x1DB4C0 Kw_Wu32 2147483647.00 OneToOne 0.00 2147483647.00 FORMAT "%13.2" EXTENDED_LIMITS 0.00 4294967295.00 /end CHARACTERISTIC
/begin CHARACTERISTIC InjCrv_stPoI1AddCorMsk2_C "Maske zur Auswahl Kennlinie 2 hoher und niedriger Bereich" VALUE 0x1DB4C4 Kw_Wu32 2147483647.00 OneToOne 0.00 2147483647.00 FORMAT "%13.2" EXTENDED_LIMITS 0.00 4294967295.00 /end CHARACTERISTIC
/begin CHARACTERISTIC InjCrv_stPoI1AddCorMsk3_C "Maske zur Auswahl Kennlinie 3 hoher und niedriger Bereich" VALUE 0x1DB4C8 Kw_Wu32 2147483647.00 OneToOne 0.00 2147483647.00 FORMAT "%13.2" EXTENDED_LIMITS 0.00 4294967295.00 /end CHARACTERISTIC
/begin CHARACTERISTIC InjCrv_stPoI1AddCorMsk4_C "Maske zur Auswahl Kennlinie 4 hoher und niedriger Bereich" VALUE 0x1DB4CC Kw_Wu32 2147483647.00 OneToOne 0.00 2147483647.00 FORMAT "%13.2" EXTENDED_LIMITS 0.00 4294967295.00 /end CHARACTERISTIC
/begin CHARACTERISTIC InjCrv_stPoI1BasMsk1_C "Maske zur Auswahl der Korrektur von Basiskennfeld 1" VALUE 0x1DB4D0 Kw_Wu32 2147483647.00 OneToOne 0.00 2147483647.00 FORMAT "%13.2" EXTENDED_LIMITS 0.00 4294967295.00 /end CHARACTERISTIC
/begin CHARACTERISTIC InjCrv_stPoI1BasMsk2_C "Maske zur Auswahl der Korrektur von Basiskennfeld 2" VALUE 0x1DB4D4 Kw_Wu32 2147483647.00 OneToOne 0.00 2147483647.00 FORMAT "%13.2" EXTENDED_LIMITS 0.00 4294967295.00 /end CHARACTERISTIC
/begin CHARACTERISTIC InjCrv_stPoI1RgnMsk1_C "Bitmaske für Aktivierung  des Regenerationsmodes 1 der PoI1" VALUE 0x1DBD20 Kw_Wu32 2147483647.00 OneToOne 0.00 2147483647.00 FORMAT "%13.2" EXTENDED_LIMITS 0.00 4294967295.00 /end CHARACTERISTIC
/begin CHARACTERISTIC InjCrv_stPoI1RgnMsk2_C "Bitmaske für Aktivierung  des Regenerationsmodes 2 der PoI1" VALUE 0x1DBD24 Kw_Wu32 2147483647.00 OneToOne 0.00 2147483647.00 FORMAT "%13.2" EXTENDED_LIMITS 0.00 4294967295.00 /end CHARACTERISTIC
/begin CHARACTERISTIC InjCrv_stPoI1RgnMsk3_C "Bitmaske für Aktivierung  des Regenerationsmodes 3 der PoI1" VALUE 0x1DBD28 Kw_Wu32 2147483647.00 OneToOne 0.00 2147483647.00 FORMAT "%13.2" EXTENDED_LIMITS 0.00 4294967295.00 /end CHARACTERISTIC
/begin CHARACTERISTIC InjCrv_stPoI1RgnMsk4_C "Bitmaske für Aktivierung  des Regenerationsmodes 4 der PoI1" VALUE 0x1DBD2C Kw_Wu32 2147483647.00 OneToOne 0.00 2147483647.00 FORMAT "%13.2" EXTENDED_LIMITS 0.00 4294967295.00 /end CHARACTERISTIC
/begin CHARACTERISTIC InjCrv_stPoI1RgnMsk_C "Bitmaske für Aktivierung  des Regenerationsmodes PoI1" VALUE 0x1DBD38 Kw_Wu32 4294967295.00 OneToOne 0.00 4294967295.00 FORMAT "%13.2" /end CHARACTERISTIC
/begin CHARACTERISTIC InjCrv_stPoI2RgnDelMsk_C "Maske für die Deaktivierung der PoI2 Grundwerteberechnung im Regenerationsbetrieb" VALUE 0x1DC310 Kw_Wu32 4294967295.00 OneToOne 0.00 4294967295.00 FORMAT "%13.2" /end CHARACTERISTIC
/begin CHARACTERISTIC InjCrv_stPoI2RgnMsk_C "Maske zur Aktivierung der Regeneration über PoI2" VALUE 0x1DC324 Kw_Wu32 4294967295.00 OneToOne 0.00 4294967295.00 FORMAT "%13.2" /end CHARACTERISTIC
/begin CHARACTERISTIC InjCrv_stPOpPoI1Msk_C "Maske zur Aktivierung einer additive Korrektur zur Freigabe der PoI1 schaltbar über EGt Status" VALUE 0x1DB4D8 Kw_Wu32 2147483647.00 OneToOne 0.00 2147483647.00 FORMAT "%13.2" EXTENDED_LIMITS 0.00 4294967295.00 /end CHARACTERISTIC
/begin CHARACTERISTIC InjCrv_swtAPSSrcSel_C "Schalter zur Umschaltung der Eingangsgröße für Höhenkorrektur SOE PiI1 zw. Ladedruck und Atmosphärendruck" VALUE 0x1D9DD8 Kw_Wu8 1.000 OneToOne 0.00 1.000 FORMAT "%5.3" EXTENDED_LIMITS 0.00 255.0 /end CHARACTERISTIC
/begin CHARACTERISTIC InjCrv_swtMIAPSSrcSel_C "Druckauswahl (0=Ladedruck;1=Athmosphärendruck) für MI-Druckkorrektur" VALUE 0x1D8288 Kw_Wu8 1.000 OneToOne 0.00 1.000 FORMAT "%5.3" EXTENDED_LIMITS 0.00 255.0 /end CHARACTERISTIC
/begin CHARACTERISTIC InjCrv_swtPhiMI1Des_C "Schalter zur Fernsteuerung des Winkels für den Ansteuerbeginn der Haupteinspritzung" VALUE 0x1D87E0 Kw_Wu8 1.000 OneToOne 0.00 1.000 FORMAT "%5.3" EXTENDED_LIMITS 0.00 255.0 /end CHARACTERISTIC
/begin CHARACTERISTIC InjCrv_swtPhiPiI1Des_C "Schalter zur Fernsteuerung des Winkels für den Ansteuerbeginn der Voreinspritzung 1" VALUE 0x1DB1C8 Kw_Wu8 1.000 OneToOne 0.00 1.000 FORMAT "%5.3" EXTENDED_LIMITS 0.00 255.0 /end CHARACTERISTIC
/begin CHARACTERISTIC InjCrv_swtPhiPiI2Des_C "Schalter zur Fernsteuerung des Winkels für den Ansteuerbeginn der Voreinspritzung 2" VALUE 0x1D9BF4 Kw_Wu8 1.000 OneToOne 0.00 1.000 FORMAT "%5.3" EXTENDED_LIMITS 0.00 255.0 /end CHARACTERISTIC
/begin CHARACTERISTIC InjCrv_swtPhiPoI1Des_C "Schalter zur Fernsteuerung des Winkels für den Ansteuerbeginn für PoI1" VALUE 0x1DBDA8 Kw_Wu8 1.000 OneToOne 0.00 1.000 FORMAT "%5.3" EXTENDED_LIMITS 0.00 255.0 /end CHARACTERISTIC
/begin CHARACTERISTIC InjCrv_swtPhiPoI2Des_C "Fernsteuerung - Schalter für  InjCrv_phiPoI2Des_C nach InjCrv_phiPoI2Des" VALUE 0x1DC3AA Kw_Wu8 1.000 OneToOne 0.00 1.000 FORMAT "%5.3" EXTENDED_LIMITS 0.00 255.0 /end CHARACTERISTIC
/begin CHARACTERISTIC InjCrv_swtPoI1Clsn_C "Auswahlschalter zur Behandlung der PoI1 im Kollisionsfall" VALUE 0x1DB3F0 Kw_Wu8 255.0 OneToOne 0.00 255.0 FORMAT "%5.1" /end CHARACTERISTIC
/begin CHARACTERISTIC InjCrv_swtPoI2AgAbsTDC_C "Status des Betriebsmodus Ansteuerbeginn PoI2 (entweder Winkel absolut zum TDC oder Winkel bzw. Zeit relativ zur MI)" VALUE 0x1DBDAA Kw_Wu8 255.0 OneToOne 0.00 255.0 FORMAT "%5.1" READ_ONLY /end CHARACTERISTIC
/begin CHARACTERISTIC InjCrv_swtQntMI1Des_C "Schalter zur Fernsteuerung der Einspritzmenge der MI1" VALUE 0x1D87E1 Kw_Wu8 1.000 OneToOne 0.00 1.000 FORMAT "%5.3" EXTENDED_LIMITS 0.00 255.0 /end CHARACTERISTIC
/begin CHARACTERISTIC InjCrv_swtQntPiI1Des_C "Schalter zur Fernsteuerung der Einspritzmenge der PiI1" VALUE 0x1DB1C9 Kw_Wu8 1.000 OneToOne 0.00 1.000 FORMAT "%5.3" EXTENDED_LIMITS 0.00 255.0 /end CHARACTERISTIC
/begin CHARACTERISTIC InjCrv_swtQntPiI2Des_C "Schalter zur Fernsteuerung der Einspritzmenge der PiI2" VALUE 0x1D9BF5 Kw_Wu8 1.000 OneToOne 0.00 1.000 FORMAT "%5.3" EXTENDED_LIMITS 0.00 255.0 /end CHARACTERISTIC
/begin CHARACTERISTIC InjCrv_swtQntPoI1Des_C "Schalter zur Fernsteuerung der Einspritzmenge der PoI1" VALUE 0x1DBDA9 Kw_Wu8 1.000 OneToOne 0.00 1.000 FORMAT "%5.3" EXTENDED_LIMITS 0.00 255.0 /end CHARACTERISTIC
/begin CHARACTERISTIC InjCrv_swtQntPoI2Des_C "Fernsteuerung - Schalter für  InjCrv_qPoI2Des_C nach InjCrv_qPoI2Des" VALUE 0x1DC318 Kw_Wu8 1.000 OneToOne 0.00 1.000 FORMAT "%5.3" EXTENDED_LIMITS 0.00 255.0 /end CHARACTERISTIC
/begin CHARACTERISTIC InjCrv_swtQntPoI2Eff_C "Fernsteuerung - Schalter für  InjCrv_swtQntPoI2Eff_C nach InjCrv_qPoI2Eff" VALUE 0x1DC319 Kw_Wu8 1.000 OneToOne 0.00 1.000 FORMAT "%5.3" EXTENDED_LIMITS 0.00 255.0 /end CHARACTERISTIC
/begin CHARACTERISTIC InjCrv_swtTemp_C "Temperaturwahl aus Array for MI Ansteuerbeginn" VALUE 0x1D7430 Kw_Wu8 4.00000000000 EngTempFldSel 0.00 4.00000000000 FORMAT "%13.11" /end CHARACTERISTIC
/begin CHARACTERISTIC InjCrv_swtTiPiI1Des_C "Schalter zur Fernsteuerung der Zeit für den Ansteuerbeginn der Voreinspritzung 1" VALUE 0x1DB1CA Kw_Wu8 1.000 OneToOne 0.00 1.000 FORMAT "%5.3" EXTENDED_LIMITS 0.00 255.0 /end CHARACTERISTIC
/begin CHARACTERISTIC InjCrv_swtTiPiI2Des_C "Schalter zur Fernsteuerung der Zeit für den Ansteuerbeginn der Voreinspritzung 2" VALUE 0x1D9BF6 Kw_Wu8 1.000 OneToOne 0.00 1.000 FORMAT "%5.3" EXTENDED_LIMITS 0.00 255.0 /end CHARACTERISTIC
/begin CHARACTERISTIC InjCrv_swtTiPoI2Des_C "Schalter zur Fernsteuerung der Zeit für den Ansteuerbeginn der Nacheinspritzung 2" VALUE 0x1DC3AB Kw_Wu8 1.000 OneToOne 0.00 1.000 FORMAT "%5.3" EXTENDED_LIMITS 0.00 255.0 /end CHARACTERISTIC
/begin CHARACTERISTIC InjCrv_tAddCorHighRgn1_CUR "Temperaturkennlinie der oberen Hystereseschwelle" CURVE 0x1DB4DC Kl_Xs16_Ws16 1050.000 Temp_Cels -50.14000 999.8600 FORMAT "%8.4" EXTENDED_LIMITS -3549.940 3003.560
 /begin AXIS_DESCR STD_AXIS IATSCD_tAir Temp_Cels 12 -50.14000 199.8600 FORMAT "%8.4" EXTENDED_LIMITS -3549.940 3003.560 DEPOSIT ABSOLUTE /end AXIS_DESCR
/end CHARACTERISTIC
/begin CHARACTERISTIC InjCrv_tAddCorHighRgn2_CUR "Temperaturkennlinie der oberen Hystereseschwelle" CURVE 0x1DB50E Kl_Xs16_Ws16 1050.000 Temp_Cels -50.14000 999.8600 FORMAT "%8.4" EXTENDED_LIMITS -3549.940 3003.560
 /begin AXIS_DESCR STD_AXIS IATSCD_tAir Temp_Cels 12 -50.14000 199.8600 FORMAT "%8.4" EXTENDED_LIMITS -3549.940 3003.560 DEPOSIT ABSOLUTE /end AXIS_DESCR
/end CHARACTERISTIC
/begin CHARACTERISTIC InjCrv_tAddCorHighRgn3_CUR "Temperaturkennlinie der oberen Hystereseschwelle" CURVE 0x1DB540 Kl_Xs16_Ws16 1050.000 Temp_Cels -50.14000 999.8600 FORMAT "%8.4" EXTENDED_LIMITS -3549.940 3003.560
 /begin AXIS_DESCR STD_AXIS IATSCD_tAir Temp_Cels 12 -50.14000 199.8600 FORMAT "%8.4" EXTENDED_LIMITS -3549.940 3003.560 DEPOSIT ABSOLUTE /end AXIS_DESCR
/end CHARACTERISTIC
/begin CHARACTERISTIC InjCrv_tAddCorHighRgn4_CUR "Temperaturkennlinie der oberen Hystereseschwelle" CURVE 0x1DB572 Kl_Xs16_Ws16 1050.000 Temp_Cels -50.14000 999.8600 FORMAT "%8.4" EXTENDED_LIMITS -3549.940 3003.560
 /begin AXIS_DESCR STD_AXIS IATSCD_tAir Temp_Cels 12 -50.14000 199.8600 FORMAT "%8.4" EXTENDED_LIMITS -3549.940 3003.560 DEPOSIT ABSOLUTE /end AXIS_DESCR
/end CHARACTERISTIC
/begin CHARACTERISTIC InjCrv_tAddCorLowRgn1_CUR "Temperaturkennlinie der untere Hystereseschwelle" CURVE 0x1DB5A4 Kl_Xs16_Ws16 1050.000 Temp_Cels -50.14000 999.8600 FORMAT "%8.4" EXTENDED_LIMITS -3549.940 3003.560
 /begin AXIS_DESCR STD_AXIS IATSCD_tAir Temp_Cels 12 -50.14000 199.8600 FORMAT "%8.4" EXTENDED_LIMITS -3549.940 3003.560 DEPOSIT ABSOLUTE /end AXIS_DESCR
/end CHARACTERISTIC
/begin CHARACTERISTIC InjCrv_tAddCorLowRgn2_CUR "Temperaturkennlinie der untere Hystereseschwelle" CURVE 0x1DB5D6 Kl_Xs16_Ws16 1050.000 Temp_Cels -50.14000 999.8600 FORMAT "%8.4" EXTENDED_LIMITS -3549.940 3003.560
 /begin AXIS_DESCR STD_AXIS IATSCD_tAir Temp_Cels 12 -50.14000 199.8600 FORMAT "%8.4" EXTENDED_LIMITS -3549.940 3003.560 DEPOSIT ABSOLUTE /end AXIS_DESCR
/end CHARACTERISTIC
/begin CHARACTERISTIC InjCrv_tAddCorLowRgn3_CUR "Temperaturkennlinie der untere Hystereseschwelle" CURVE 0x1DB608 Kl_Xs16_Ws16 1050.000 Temp_Cels -50.14000 999.8600 FORMAT "%8.4" EXTENDED_LIMITS -3549.940 3003.560
 /begin AXIS_DESCR STD_AXIS IATSCD_tAir Temp_Cels 12 -50.14000 199.8600 FORMAT "%8.4" EXTENDED_LIMITS -3549.940 3003.560 DEPOSIT ABSOLUTE /end AXIS_DESCR
/end CHARACTERISTIC
/begin CHARACTERISTIC InjCrv_tAddCorLowRgn4_CUR "Temperaturkennlinie der untere Hystereseschwelle" CURVE 0x1DB63A Kl_Xs16_Ws16 1050.000 Temp_Cels -50.14000 999.8600 FORMAT "%8.4" EXTENDED_LIMITS -3549.940 3003.560
 /begin AXIS_DESCR STD_AXIS IATSCD_tAir Temp_Cels 12 -50.14000 199.8600 FORMAT "%8.4" EXTENDED_LIMITS -3549.940 3003.560 DEPOSIT ABSOLUTE /end AXIS_DESCR
/end CHARACTERISTIC
/begin CHARACTERISTIC InjCrv_tiPiI1APSCor_MAP "kundenspez. atmosphärendruckabhängiges Korrekturgrundwertekennfeld für die Zeitkomponente des Ansteuerbeginns der PiI1" MAP 0x1D9DDA Kf_Xs16_Ys16_Ws16 26000.00 InjTime_us -13000.00 13000.00 FORMAT "%8.2" EXTENDED_LIMITS -32768.00 32767.00
 /begin AXIS_DESCR STD_AXIS Eng_nAvrg EngN 16 0.00 6000.000 FORMAT "%8.3" EXTENDED_LIMITS -32768.00 32767.00 DEPOSIT ABSOLUTE /end AXIS_DESCR
 /begin AXIS_DESCR STD_AXIS InjCtl_qSetUnBal InjMass 8 0.00 327.6700 FORMAT "%8.4" EXTENDED_LIMITS -327.6800 327.6700 DEPOSIT ABSOLUTE /end AXIS_DESCR
/end CHARACTERISTIC
/begin CHARACTERISTIC InjCrv_tiPiI1Bas1_MAP "Zeitkomponente Ansteuerbeginn Grundwertekennfeld PiI1 ohne Freigabe PiI2" MAP 0x1D8BD0 Kf_Xs16_Ys16_Ws16 13000.00 InjTime_us 0.00 13000.00 FORMAT "%8.2" EXTENDED_LIMITS -32768.00 32767.00
 /begin AXIS_DESCR STD_AXIS Eng_nAvrg EngN 12 0.00 6000.000 FORMAT "%8.3" EXTENDED_LIMITS -32768.00 32767.00 DEPOSIT ABSOLUTE /end AXIS_DESCR
 /begin AXIS_DESCR STD_AXIS InjCtl_qSetUnBal InjMass 16 0.00 327.6700 FORMAT "%8.4" EXTENDED_LIMITS -327.6800 327.6700 DEPOSIT ABSOLUTE /end AXIS_DESCR
/end CHARACTERISTIC
/begin CHARACTERISTIC InjCrv_tiPiI1Bas2_MAP "Zeitkomponente Ansteuerbeginn Grundwertekennfeld PiI1 mit freigabe PiI2" MAP 0x1D8D8C Kf_Xs16_Ys16_Ws16 13000.00 InjTime_us 0.00 13000.00 FORMAT "%8.2" EXTENDED_LIMITS -32768.00 32767.00
 /begin AXIS_DESCR STD_AXIS Eng_nAvrg EngN 12 0.00 6000.000 FORMAT "%8.3" EXTENDED_LIMITS -32768.00 32767.00 DEPOSIT ABSOLUTE /end AXIS_DESCR
 /begin AXIS_DESCR STD_AXIS InjCtl_qSetUnBal InjMass 16 0.00 327.6700 FORMAT "%8.4" EXTENDED_LIMITS -327.6800 327.6700 DEPOSIT ABSOLUTE /end AXIS_DESCR
/end CHARACTERISTIC
/begin CHARACTERISTIC InjCrv_tiPiI1Bas3_MAP "Zeitkomponente Ansteuerbeginn Grundwertekennfeld PiI1 mit Freigabe PiI3" MAP 0x1D8F48 Kf_Xs16_Ys16_Ws16 13000.00 InjTime_us 0.00 13000.00 FORMAT "%8.2" EXTENDED_LIMITS -32768.00 32767.00
 /begin AXIS_DESCR STD_AXIS Eng_nAvrg EngN 12 0.00 6000.000 FORMAT "%8.3" EXTENDED_LIMITS -32768.00 32767.00 DEPOSIT ABSOLUTE /end AXIS_DESCR
 /begin AXIS_DESCR STD_AXIS InjCtl_qSetUnBal InjMass 16 0.00 327.6700 FORMAT "%8.4" EXTENDED_LIMITS -327.6800 327.6700 DEPOSIT ABSOLUTE /end AXIS_DESCR
/end CHARACTERISTIC
/begin CHARACTERISTIC InjCrv_tiPiI1DesAdd_Vector "Bypass-Label für additiven Bypass von InjCrv_tiPiI1Des (Nicht verstellen!)" VALUE 0x1C0AEC Kw_Wu8 255.0 OneToOne 0.00 255.0 FORMAT "%5.1" /end CHARACTERISTIC
/begin CHARACTERISTIC InjCrv_tiPiI1DesAdd_Channel "Bypass-Label für additiven Bypass von InjCrv_tiPiI1Des (Nicht verstellen!)" VALUE 0x1C0AED Kw_Wu8 255.0 OneToOne 0.00 255.0 FORMAT "%5.1" /end CHARACTERISTIC
/begin CHARACTERISTIC InjCrv_tiPiI1Des_C "Fernsteuerwert des Ansteuerbeginns (Zeitkomponente) von PiI1" VALUE 0x1DB1CC Kw_Ws16 10000.00 InjTime_us 0.00 10000.00 FORMAT "%8.2" EXTENDED_LIMITS -32768.00 32767.00 /end CHARACTERISTIC
/begin CHARACTERISTIC InjCrv_tiPiI1Des_Vector "Bypass-Label für InjCrv_tiPiI1Des (Nicht verstellen!)" VALUE 0x1C0AEE Kw_Wu8 255.0 OneToOne 0.00 255.0 FORMAT "%5.1" /end CHARACTERISTIC
/begin CHARACTERISTIC InjCrv_tiPiI1Des_Channel "Bypass-Label für InjCrv_tiPiI1Des (Nicht verstellen!)" VALUE 0x1C0AEF Kw_Wu8 255.0 OneToOne 0.00 255.0 FORMAT "%5.1" /end CHARACTERISTIC
/begin CHARACTERISTIC InjCrv_tiPiI1ETSCor_MAP "motortemperaturabhängiger Korrekturgrundwertekennfeld für die Zeitkomponente des Ansteuerbeginns der PiI1" MAP 0x1DA5A4 Kf_Xs16_Ys16_Ws16 26000.00 InjTime_us -13000.00 13000.00 FORMAT "%8.2" EXTENDED_LIMITS -32768.00 32767.00
 /begin AXIS_DESCR STD_AXIS Eng_nAvrg EngN 16 0.00 6000.000 FORMAT "%8.3" EXTENDED_LIMITS -32768.00 32767.00 DEPOSIT ABSOLUTE /end AXIS_DESCR
 /begin AXIS_DESCR STD_AXIS InjCtl_qSetUnBal InjMass 8 0.00 327.6700 FORMAT "%8.4" EXTENDED_LIMITS -327.6800 327.6700 DEPOSIT ABSOLUTE /end AXIS_DESCR
/end CHARACTERISTIC
/begin CHARACTERISTIC InjCrv_tiPiI1ETSRgnCor1_MAP "Motortemperatur Grundwertkennfeld 1 für PiI1 zeitbasierte Einspritzung" MAP 0x1DA9C0 Kf_Xs16_Ys16_Ws16 26000.00 InjTime_us -13000.00 13000.00 FORMAT "%8.2" EXTENDED_LIMITS -32768.00 32767.00
 /begin AXIS_DESCR STD_AXIS Eng_nAvrg EngN 12 0.00 6000.000 FORMAT "%8.3" EXTENDED_LIMITS -32768.00 32767.00 DEPOSIT ABSOLUTE /end AXIS_DESCR
 /begin AXIS_DESCR STD_AXIS InjCtl_qSetUnBal InjMass 12 0.00 327.6700 FORMAT "%8.4" EXTENDED_LIMITS -327.6800 327.6700 DEPOSIT ABSOLUTE /end AXIS_DESCR
/end CHARACTERISTIC
/begin CHARACTERISTIC InjCrv_tiPiI1ETSRgnCor2_MAP "Motortemperatur Grundwertkennfeld 2 für PiI1 zeitbasierte Einspritzung" MAP 0x1DAB14 Kf_Xs16_Ys16_Ws16 26000.00 InjTime_us -13000.00 13000.00 FORMAT "%8.2" EXTENDED_LIMITS -32768.00 32767.00
 /begin AXIS_DESCR STD_AXIS Eng_nAvrg EngN 12 0.00 6000.000 FORMAT "%8.3" EXTENDED_LIMITS -32768.00 32767.00 DEPOSIT ABSOLUTE /end AXIS_DESCR
 /begin AXIS_DESCR STD_AXIS InjCtl_qSetUnBal InjMass 12 0.00 327.6700 FORMAT "%8.4" EXTENDED_LIMITS -327.6800 327.6700 DEPOSIT ABSOLUTE /end AXIS_DESCR
/end CHARACTERISTIC
/begin CHARACTERISTIC InjCrv_tiPiI1ETSRgnCor3_MAP "Motortemperatur Grundwertkennfeld 3 für PiI1 zeitbasierte Einspritzung" MAP 0x1DAC68 Kf_Xs16_Ys16_Ws16 26000.00 InjTime_us -13000.00 13000.00 FORMAT "%8.2" EXTENDED_LIMITS -32768.00 32767.00
 /begin AXIS_DESCR STD_AXIS Eng_nAvrg EngN 12 0.00 6000.000 FORMAT "%8.3" EXTENDED_LIMITS -32768.00 32767.00 DEPOSIT ABSOLUTE /end AXIS_DESCR
 /begin AXIS_DESCR STD_AXIS InjCtl_qSetUnBal InjMass 12 0.00 327.6700 FORMAT "%8.4" EXTENDED_LIMITS -327.6800 327.6700 DEPOSIT ABSOLUTE /end AXIS_DESCR
/end CHARACTERISTIC
/begin CHARACTERISTIC InjCrv_tiPiI1RgnBas1_MAP "Einspritzzeiten Grundwertkennfeld 1 für PiI1" MAP 0x1DADBC Kf_Xs16_Ys16_Ws16 13000.00 InjTime_us 0.00 13000.00 FORMAT "%8.2" EXTENDED_LIMITS -32768.00 32767.00
 /begin AXIS_DESCR STD_AXIS Eng_nAvrg EngN 12 0.00 6000.000 FORMAT "%8.3" EXTENDED_LIMITS -32768.00 32767.00 DEPOSIT ABSOLUTE /end AXIS_DESCR
 /begin AXIS_DESCR STD_AXIS InjCtl_qSetUnBal InjMass 12 0.00 327.6700 FORMAT "%8.4" EXTENDED_LIMITS -327.6800 327.6700 DEPOSIT ABSOLUTE /end AXIS_DESCR
/end CHARACTERISTIC
/begin CHARACTERISTIC InjCrv_tiPiI1RgnBas2_MAP "Einspritzzeiten Grundwertkennfeld 2 für PiI1" MAP 0x1DAF10 Kf_Xs16_Ys16_Ws16 13000.00 InjTime_us 0.00 13000.00 FORMAT "%8.2" EXTENDED_LIMITS -32768.00 32767.00
 /begin AXIS_DESCR STD_AXIS Eng_nAvrg EngN 12 0.00 6000.000 FORMAT "%8.3" EXTENDED_LIMITS -32768.00 32767.00 DEPOSIT ABSOLUTE /end AXIS_DESCR
 /begin AXIS_DESCR STD_AXIS InjCtl_qSetUnBal InjMass 12 0.00 327.6700 FORMAT "%8.4" EXTENDED_LIMITS -327.6800 327.6700 DEPOSIT ABSOLUTE /end AXIS_DESCR
/end CHARACTERISTIC
/begin CHARACTERISTIC InjCrv_tiPiI1RgnBas3_MAP "Einspritzzeiten Grundwertkennfeld 3 für PiI1" MAP 0x1DB064 Kf_Xs16_Ys16_Ws16 13000.00 InjTime_us 0.00 13000.00 FORMAT "%8.2" EXTENDED_LIMITS -32768.00 32767.00
 /begin AXIS_DESCR STD_AXIS Eng_nAvrg EngN 12 0.00 6000.000 FORMAT "%8.3" EXTENDED_LIMITS -32768.00 32767.00 DEPOSIT ABSOLUTE /end AXIS_DESCR
 /begin AXIS_DESCR STD_AXIS InjCtl_qSetUnBal InjMass 12 0.00 327.6700 FORMAT "%8.4" EXTENDED_LIMITS -327.6800 327.6700 DEPOSIT ABSOLUTE /end AXIS_DESCR
/end CHARACTERISTIC
/begin CHARACTERISTIC InjCrv_tiPiI1Rgn_Vector "Bypass-Label, nicht editieren !" VALUE 0x1C0AF8 Kw_Wu8 255.0 OneToOne 0.00 255.0 FORMAT "%5.1" /end CHARACTERISTIC
/begin CHARACTERISTIC InjCrv_tiPiI1Rgn_Channel "Bypass-Label, nicht editieren !" VALUE 0x1C0AF9 Kw_Wu8 255.0 OneToOne 0.00 255.0 FORMAT "%5.1" /end CHARACTERISTIC
/begin CHARACTERISTIC InjCrv_tiPiI2Bas_MAP "Zeitkomponente Ansteuerbeginn Grundwertekennfeld PiI2" MAP 0x1D9BFA Kf_Xs16_Ys16_Ws16 13000.00 InjTime_us 0.00 13000.00 FORMAT "%8.2" EXTENDED_LIMITS -32768.00 32767.00
 /begin AXIS_DESCR STD_AXIS Eng_nAvrg EngN 12 0.00 6000.000 FORMAT "%8.3" EXTENDED_LIMITS -32768.00 32767.00 DEPOSIT ABSOLUTE /end AXIS_DESCR
 /begin AXIS_DESCR STD_AXIS InjCtl_qSetUnBal InjMass 16 0.00 327.6700 FORMAT "%8.4" EXTENDED_LIMITS -327.6800 327.6700 DEPOSIT ABSOLUTE /end AXIS_DESCR
/end CHARACTERISTIC
/begin CHARACTERISTIC InjCrv_tiPiI2DesAdd_Vector "Bypass-Label für additiven Bypass von InjCrv_tiPiI2Des (Nicht verstellen!)" VALUE 0x1C0AF0 Kw_Wu8 255.0 OneToOne 0.00 255.0 FORMAT "%5.1" /end CHARACTERISTIC
/begin CHARACTERISTIC InjCrv_tiPiI2DesAdd_Channel "Bypass-Label für additiven Bypass von InjCrv_tiPiI2Des (Nicht verstellen!)" VALUE 0x1C0AF1 Kw_Wu8 255.0 OneToOne 0.00 255.0 FORMAT "%5.1" /end CHARACTERISTIC
/begin CHARACTERISTIC InjCrv_tiPiI2Des_C "Fernsteuerwert des Ansteuerbeginns (Zeitkomponente) von PiI2" VALUE 0x1D9BF8 Kw_Ws16 10000.00 InjTime_us 0.00 10000.00 FORMAT "%8.2" EXTENDED_LIMITS -32768.00 32767.00 /end CHARACTERISTIC
/begin CHARACTERISTIC InjCrv_tiPiI2Des_Vector "Bypass-Label für InjCrv_tiPiI2Des (Nicht verstellen!)" VALUE 0x1C0AF2 Kw_Wu8 255.0 OneToOne 0.00 255.0 FORMAT "%5.1" /end CHARACTERISTIC
/begin CHARACTERISTIC InjCrv_tiPiI2Des_Channel "Bypass-Label für InjCrv_tiPiI2Des (Nicht verstellen!)" VALUE 0x1C0AF3 Kw_Wu8 255.0 OneToOne 0.00 255.0 FORMAT "%5.1" /end CHARACTERISTIC
/begin CHARACTERISTIC InjCrv_tiPiI2ETSCor_MAP "motortemperaturabhängiger Korrekturgrundwertekennfeld für die Zeitkomponente des Ansteuerbeginns der PiI2" MAP 0x1D9AB0 Kf_Xs16_Ys16_Ws16 26000.00 InjTime_us -13000.00 13000.00 FORMAT "%8.2" EXTENDED_LIMITS -32768.00 32767.00
 /begin AXIS_DESCR STD_AXIS Eng_nAvrg EngN 16 0.00 6000.000 FORMAT "%8.3" EXTENDED_LIMITS -32768.00 32767.00 DEPOSIT ABSOLUTE /end AXIS_DESCR
 /begin AXIS_DESCR STD_AXIS InjCtl_qSetUnBal InjMass 8 0.00 327.6700 FORMAT "%8.4" EXTENDED_LIMITS -327.6800 327.6700 DEPOSIT ABSOLUTE /end AXIS_DESCR
/end CHARACTERISTIC
/begin CHARACTERISTIC InjCrv_tiPiI2Rgn_Vector "Bypass-Label, nicht editieren !" VALUE 0x1C0AD2 Kw_Wu8 255.0 OneToOne 0.00 255.0 FORMAT "%5.1" /end CHARACTERISTIC
/begin CHARACTERISTIC InjCrv_tiPiI2Rgn_Channel "Bypass-Label, nicht editieren !" VALUE 0x1C0AD3 Kw_Wu8 255.0 OneToOne 0.00 255.0 FORMAT "%5.1" /end CHARACTERISTIC
/begin CHARACTERISTIC InjCrv_tiPiIMax_C "maximale Zeitkomponente PiI, bedingt durch Hardware" VALUE 0x1D8BCC Kw_Ws16 13000.00 InjTime_us 0.00 13000.00 FORMAT "%8.2" EXTENDED_LIMITS -32768.00 32767.00 /end CHARACTERISTIC
/begin CHARACTERISTIC InjCrv_tiPoI2ATSCor_MAP "kundenspez. ansauglufttemperaturabhängiger Korrekturgrundwert für die Zeitkomponente des Ansteuerbeginns der PoI2" MAP 0x1DBF5A Kf_Xs16_Ys16_Ws16 26000.00 InjTime_us -13000.00 13000.00 FORMAT "%8.2" EXTENDED_LIMITS -32768.00 32767.00
 /begin AXIS_DESCR STD_AXIS Eng_nAvrg EngN 16 0.00 6000.000 FORMAT "%8.3" EXTENDED_LIMITS -32768.00 32767.00 DEPOSIT ABSOLUTE /end AXIS_DESCR
 /begin AXIS_DESCR STD_AXIS InjCtl_qSetUnBal InjMass 8 0.00 327.6700 FORMAT "%8.4" EXTENDED_LIMITS -327.6800 327.6700 DEPOSIT ABSOLUTE /end AXIS_DESCR
/end CHARACTERISTIC
/begin CHARACTERISTIC InjCrv_tiPoI2Bas_MAP "Zeitkomponente Ansteuerbeginn Grundwert PoI2" MAP 0x1DC3AE Kf_Xs16_Ys16_Ws16 13000.00 InjTime_us -13000.00 0.00 FORMAT "%8.2" EXTENDED_LIMITS -32768.00 32767.00
 /begin AXIS_DESCR STD_AXIS Eng_nAvrg EngN 10 0.00 6000.000 FORMAT "%8.3" EXTENDED_LIMITS -32768.00 32767.00 DEPOSIT ABSOLUTE /end AXIS_DESCR
 /begin AXIS_DESCR STD_AXIS InjCtl_qSetUnBal InjMass 10 0.00 327.6700 FORMAT "%8.4" EXTENDED_LIMITS -327.6800 327.6700 DEPOSIT ABSOLUTE /end AXIS_DESCR
/end CHARACTERISTIC
/begin CHARACTERISTIC InjCrv_tiPoI2Des_C "Fernsteuerwert des Ansteuerbeginns (Zeitkomponente) von PoI2" VALUE 0x1DC3AC Kw_Ws16 10000.00 InjTime_us -10000.00 0.00 FORMAT "%8.2" EXTENDED_LIMITS -32768.00 32767.00 /end CHARACTERISTIC
/begin CHARACTERISTIC InjCrv_tiPoI2ETSCor_MAP "motortemperaturabhängiger Korrekturgrundwertekennfeld für die Zeitkomponente des Ansteuerbeginns der PoI2" MAP 0x1DC08E Kf_Xs16_Ys16_Ws16 26000.00 InjTime_us -13000.00 13000.00 FORMAT "%8.2" EXTENDED_LIMITS -32768.00 32767.00
 /begin AXIS_DESCR STD_AXIS Eng_nAvrg EngN 16 0.00 6000.000 FORMAT "%8.3" EXTENDED_LIMITS -32768.00 32767.00 DEPOSIT ABSOLUTE /end AXIS_DESCR
 /begin AXIS_DESCR STD_AXIS InjCtl_qSetUnBal InjMass 8 0.00 327.6700 FORMAT "%8.4" EXTENDED_LIMITS -327.6800 327.6700 DEPOSIT ABSOLUTE /end AXIS_DESCR
/end CHARACTERISTIC
/begin CHARACTERISTIC InjCrv_tiPoI2Max_MAP "maximaler Ansteuerbeginn PoI2 relativ zur Haupteinspritzung" MAP 0x1DC392 Kf_Xs16_Ys16_Ws16 13000.00 InjTime_us -13000.00 0.00 FORMAT "%8.2" EXTENDED_LIMITS -32768.00 32767.00
 /begin AXIS_DESCR STD_AXIS RailCD_pPeak Pres_Rail 2 0.00 1800000. FORMAT "%8.0" EXTENDED_LIMITS -3276800. 3276700. DEPOSIT ABSOLUTE /end AXIS_DESCR
 /begin AXIS_DESCR STD_AXIS InjCrv_qMI1Des InjMassInj 2 0.00 327.6700 FORMAT "%8.4" EXTENDED_LIMITS -327.6800 327.6700 DEPOSIT ABSOLUTE /end AXIS_DESCR
/end CHARACTERISTIC
/begin CHARACTERISTIC InjCrv_tiPoI2Min_C "physikalisch bedingter minimaler Ansteuerbeginn PoI2" VALUE 0x1DC3A6 Kw_Ws16 13000.00 InjTime_us -13000.00 0.00 FORMAT "%8.2" EXTENDED_LIMITS -32768.00 32767.00 /end CHARACTERISTIC
/begin CHARACTERISTIC InjCrv_tiPoI2Rgn_Vector "Bypass-Label, nicht editieren !" VALUE 0x1C0B0A Kw_Wu8 255.0 OneToOne 0.00 255.0 FORMAT "%5.1" /end CHARACTERISTIC
/begin CHARACTERISTIC InjCrv_tiPoI2Rgn_Channel "Bypass-Label, nicht editieren !" VALUE 0x1C0B0B Kw_Wu8 255.0 OneToOne 0.00 255.0 FORMAT "%5.1" /end CHARACTERISTIC
/begin MEASUREMENT InjCrv_facMI1ETSSOERgnCor "motortemperaturabhängige Ansteuerbeginnkorrektur für MI1 im Regenerationsfall" SWORD Fact 1 100 -4.000000 3.999878 FORMAT "%8.6" ECU_ADDRESS 0x7F9950 /end MEASUREMENT
/begin MEASUREMENT InjCrv_facMIAPSPhiCor "atmosphärendruckabhängiger Korrekturfaktor für die MI1" SWORD Fact 1 100 -4.000000 3.999878 FORMAT "%8.6" ECU_ADDRESS 0x7F9952 /end MEASUREMENT
/begin MEASUREMENT InjCrv_facMIATSPhiCor "ansauglufttemperaturabhängiger Korrekturfaktor für die MI1" SWORD Fact 1 100 -4.000000 3.999878 FORMAT "%8.6" ECU_ADDRESS 0x7F9954 /end MEASUREMENT
/begin MEASUREMENT InjCrv_facMIFTSRailCor "Korrekturfaktor für die MI1, abhängig von der kraftstofftemperaturabhängigen Raildruckkorrektur" SWORD Fact 1 100 -4.000000 3.999878 FORMAT "%8.6" ECU_ADDRESS 0x7F9956 /end MEASUREMENT
/begin MEASUREMENT InjCrv_facMIPCRCor_mp "Korrekturfaktor abh. von PCR_pBGDev und Eng_tEng" SWORD Fact 1 100 -4.000000 3.999878 FORMAT "%8.6" ECU_ADDRESS 0x802FCE /end MEASUREMENT
/begin MEASUREMENT InjCrv_facMIPRailDiffCorPhi_mp "Korrekturfaktor für SOE Korrektur abh. von Diff. zw. lim. und unlimt. rail pressure setpoint" SWORD Fact 1 100 -4.000000 3.999878 FORMAT "%8.6" ECU_ADDRESS 0x802FD0 /end MEASUREMENT
/begin MEASUREMENT InjCrv_facPiI1APSQCor "atmosphärendruckabhängiger Mengenkorrekturfaktor für Voreinspritzung 1" SWORD Fact 1 100 -4.000000 3.999878 FORMAT "%8.6" ECU_ADDRESS 0x7F995A /end MEASUREMENT
/begin MEASUREMENT InjCrv_facPiI1APSSOECor_mp "kundenspez. atmosphärendruckabhängiger Spritzbeginnkorrekturfaktor der PiI1" SWORD Fact 1 100 -4.000000 3.999878 FORMAT "%8.6" ECU_ADDRESS 0x803068 /end MEASUREMENT
/begin MEASUREMENT InjCrv_facPiI1ATSQCor "ansauglufttemperaturabhängiger Mengenkorrekturfaktor für Voreinspritzung 1" SWORD Fact 1 100 -4.000000 3.999878 FORMAT "%8.6" ECU_ADDRESS 0x7F995C /end MEASUREMENT
/begin MEASUREMENT InjCrv_facPiI1ETSQCor "motortemperaturabhängiger Mengenkorrekturfaktor für Voreinspritzung 1" SWORD Fact 1 100 -4.000000 3.999878 FORMAT "%8.6" ECU_ADDRESS 0x7F995E /end MEASUREMENT
/begin MEASUREMENT InjCrv_facPiI1ETSSOECor "motortemperaturabhängiger Ansteuerbeginnkorrekturfaktor für Voreinspritzung 1" SWORD Fact 1 100 -4.000000 3.999878 FORMAT "%8.6" ECU_ADDRESS 0x7F9960 /end MEASUREMENT
/begin MEASUREMENT InjCrv_facPiI1ETSSOERgnCor "motortemperaturabhängiger Ansteuerbeginnkorrekturfaktor für Voreinspritzung 1 im Regenerationsbetrieb" SWORD Fact 1 100 -4.000000 3.999878 FORMAT "%8.6" ECU_ADDRESS 0x7F9962 /end MEASUREMENT
/begin MEASUREMENT InjCrv_facPiI1QntMin_mp "Wichtungsfaktor zum Abschalten der Berechnung Voreinspritzung 1" SWORD Fact1 1 100 -256.0000 255.9922 FORMAT "%8.4" ECU_ADDRESS 0x803028 /end MEASUREMENT
/begin MEASUREMENT InjCrv_facPiI2APSQCor "atmosphärendruckabhängiger Mengenkorrekturfaktor für Voreinspritzung 2" SWORD Fact 1 100 -4.000000 3.999878 FORMAT "%8.6" ECU_ADDRESS 0x7F9964 /end MEASUREMENT
/begin MEASUREMENT InjCrv_facPiI2ATSQCor "ansauglufttemperaturabhängiger Mengenkorrekturfaktor für Voreinspritzung 2" SWORD Fact 1 100 -4.000000 3.999878 FORMAT "%8.6" ECU_ADDRESS 0x7F9966 /end MEASUREMENT
/begin MEASUREMENT InjCrv_facPiI2ETSQCor "motortemperaturabhängiger Mengenkorrekturfaktor für Voreinspritzung 2" SWORD Fact 1 100 -4.000000 3.999878 FORMAT "%8.6" ECU_ADDRESS 0x7F9968 /end MEASUREMENT
/begin MEASUREMENT InjCrv_facPiI2ETSSOECor "motortemperaturabhängiger Ansteuerbeginnkorrekturfaktor für Voreinspritzung 2" SWORD Fact 1 100 -4.000000 3.999878 FORMAT "%8.6" ECU_ADDRESS 0x7F996A /end MEASUREMENT
/begin MEASUREMENT InjCrv_facPiI2QntMin_mp "Wichtungsfaktor zum Abschalten der Berechnung Voreinspritzung 2" SWORD Fact1 1 100 -256.0000 255.9922 FORMAT "%8.4" ECU_ADDRESS 0x802FEC /end MEASUREMENT
/begin MEASUREMENT InjCrv_facPoI1APSQCor "atmospärendruckabhängiger Mengenkorrekturfaktor für PoI1" SWORD Fact 1 100 -4.000000 3.999878 FORMAT "%8.6" ECU_ADDRESS 0x7F996C /end MEASUREMENT
/begin MEASUREMENT InjCrv_facPoI1ETSPhiCor "motortemperaturabhängiger Winkelkorrekturfaktor für PoI1" SWORD Fact 1 100 -4.000000 3.999878 FORMAT "%8.6" ECU_ADDRESS 0x7F996E /end MEASUREMENT
/begin MEASUREMENT InjCrv_facPoI1ETSQCor "motortemperaturabhängiger Mengenkorrekturfaktor für PoI1" SWORD Fact 1 100 -4.000000 3.999878 FORMAT "%8.6" ECU_ADDRESS 0x7F9970 /end MEASUREMENT
/begin MEASUREMENT InjCrv_facPoI2ATSQCor "ansauglufttemperaturabhängiger Mengenkorrekturfaktor für PoI2" SWORD Fact 1 100 -4.000000 3.999878 FORMAT "%8.6" ECU_ADDRESS 0x7F9972 /end MEASUREMENT
/begin MEASUREMENT InjCrv_facPoI2ATSSOECor "ansauglufttemperaturabhängiger Ansteuerbeginnkorrekturfaktor für PoI2" SWORD Fact 1 100 -4.000000 3.999878 FORMAT "%8.6" ECU_ADDRESS 0x7F9974 /end MEASUREMENT
/begin MEASUREMENT InjCrv_facPoI2EffRgn "Faktor für den drehmomentbildenden Anteil der Einspritzmenge PoI2 im Regenerationsmodus" SWORD Fact 1 100 -4.000000 3.999878 FORMAT "%8.6" ECU_ADDRESS 0x7F997A /end MEASUREMENT
/begin MEASUREMENT InjCrv_facPoI2EffSet_mp "Faktor für den drehmomentbildenden Anteil der Einspritzmenge PoI2 (Sollwert)" SWORD Fact 1 100 -4.000000 3.999878 FORMAT "%8.6" ECU_ADDRESS 0x8030C8 /end MEASUREMENT
/begin MEASUREMENT InjCrv_facPoI2Eff_mp "Faktor für Drehmoment bildenden Anteil der Einspritzmenge PoI2" SWORD Fact 1 100 -4.000000 3.999878 FORMAT "%8.6" ECU_ADDRESS 0x8030CA /end MEASUREMENT
/begin MEASUREMENT InjCrv_facPoI2ETSQCor "motortemperaturabhängiger Mengenkorrekturfaktor für PoI2" SWORD Fact 1 100 -4.000000 3.999878 FORMAT "%8.6" ECU_ADDRESS 0x7F9976 /end MEASUREMENT
/begin MEASUREMENT InjCrv_facPoI2ETSSOECor "motortemperaturabhängiger Ansteuerbeginnkorrekturfaktor für PoI2" SWORD Fact 1 100 -4.000000 3.999878 FORMAT "%8.6" ECU_ADDRESS 0x7F9978 /end MEASUREMENT
/begin MEASUREMENT InjCrv_facPOpPoI2ETSCor "Motortemperaturabhängiger Freigabekorrekturfaktor für  PoI2" SWORD Fact 1 100 -4.000000 3.999878 FORMAT "%8.6" ECU_ADDRESS 0x7F9958 /end MEASUREMENT
/begin MEASUREMENT InjCrv_MI1RgnVal "Wert für Regenerationsstatus MI1" ULONG EGTSwt 1 100 0.00 262.143999939 FORMAT "%13.9" ECU_ADDRESS 0x7F9CDC /end MEASUREMENT
/begin MEASUREMENT InjCrv_pAPSSrcSel_mp "Wert des gewählten Drucks für SOE APS Korrekt.fakt für MI1" SWORD Pres_hPa 1 100 -32768.00 32767.00 FORMAT "%8.2" ECU_ADDRESS 0x802FDC /end MEASUREMENT
/begin MEASUREMENT InjCrv_phiDynOfs_mp "Winkelvorhalt für schnelle dynamische Vorgänge" SWORD AngleCrS 1 100 -768.0000 767.9766 FORMAT "%8.4" ECU_ADDRESS 0x803088 /end MEASUREMENT
/begin MEASUREMENT InjCrv_phiMI1AddCor "Korrekturwinkel für Ansteuerbeginn MI1 in Abhängigkeit kundenspezifischer Funktionen" SWORD AngleCrS 1 100 -768.0000 767.9766 FORMAT "%8.4" ECU_ADDRESS 0x7F997E /end MEASUREMENT
/begin MEASUREMENT InjCrv_phiMI1AddCor_mp "Kundenabhängige Winkelkorrekturwert der Haupteinspritzung im Regenerationsbetrieb des Partikelfilters" SWORD AngleCrS 1 100 -768.0000 767.9766 FORMAT "%8.4" ECU_ADDRESS 0x802FDE /end MEASUREMENT
/begin MEASUREMENT InjCrv_phiMI1Bas_mp "Grundwert Ansteuerbeginn MI1" SWORD AngleCrS 1 100 -768.0000 767.9766 FORMAT "%8.4" ECU_ADDRESS 0x802FB6 /end MEASUREMENT
/begin MEASUREMENT InjCrv_phiMI1Cor_mp "korrigierter Grundwert Ansteuerbeginn MI1" SWORD AngleCrS 1 100 -768.0000 767.9766 FORMAT "%8.4" ECU_ADDRESS 0x802FB8 /end MEASUREMENT
/begin MEASUREMENT InjCrv_phiMI1Des "gewünschter Bezugswinkel für Beginn der MI1" SWORD AngleCrS 1 100 -768.0000 767.9766 FORMAT "%8.4" ECU_ADDRESS 0x7F9980 /end MEASUREMENT
/begin MEASUREMENT InjCrv_phiMI1DesByp_mp "Bypass-Label, Kopie von InjCrv_phiMI1Des" SWORD AngleCrS 1 100 -768.0000 767.9766 FORMAT "%8.4" ECU_ADDRESS 0x802FBA /end MEASUREMENT
/begin MEASUREMENT InjCrv_phiMI1EnvCor "Ansteuerbeginn Korrekturwinkel für MI1" SWORD AngleCrS 1 100 -768.0000 767.9766 FORMAT "%8.4" ECU_ADDRESS 0x7F9982 /end MEASUREMENT
/begin MEASUREMENT InjCrv_phiMI1EnvRgnCor "Ansteuerbeginn Korrekturwinkel für MI1 im Regenerationsbetrieb" SWORD AngleCrS 1 100 -768.0000 767.9766 FORMAT "%8.4" ECU_ADDRESS 0x7F9984 /end MEASUREMENT
/begin MEASUREMENT InjCrv_phiMI1EnvRgnCor_mp "Winkelkorrektur durch Umgebungstemperatur bei Regeneration" SWORD AngleCrS 1 100 -768.0000 767.9766 FORMAT "%8.4" ECU_ADDRESS 0x802FE0 /end MEASUREMENT
/begin MEASUREMENT InjCrv_phiMI1ETSRgnCor_mp "Winkelkorrektur für Regeneration" SWORD AngleCrS 1 100 -768.0000 767.9766 FORMAT "%8.4" ECU_ADDRESS 0x802FD2 /end MEASUREMENT
/begin MEASUREMENT InjCrv_phiMI1Lim_mp "begrenzter Sollwert Ansteuerbeginn MI1" SWORD AngleCrS 1 100 -768.0000 767.9766 FORMAT "%8.4" ECU_ADDRESS 0x802FBC /end MEASUREMENT
/begin MEASUREMENT InjCrv_phiMI1Max_mp "frühester Ansteuerbeginn der MI1" SWORD AngleCrS 1 100 -768.0000 767.9766 FORMAT "%8.4" ECU_ADDRESS 0x802FBE /end MEASUREMENT
/begin MEASUREMENT InjCrv_phiMI1PRailDiffCor_mp "Korrekturwinkel abhängig von Differenz zw. unlimitertem und limitiertem rail pressure sepoint" SWORD AngleCrS 1 100 -768.0000 767.9766 FORMAT "%8.4" ECU_ADDRESS 0x802FD4 /end MEASUREMENT
/begin MEASUREMENT InjCrv_phiMI1Rgn "Regenerationswert für den Ansteuerbeginn der MI1" SWORD AngleCrS 1 100 -768.0000 767.9766 FORMAT "%8.4" ECU_ADDRESS 0x7F9986 /end MEASUREMENT
/begin MEASUREMENT InjCrv_phiMIAPSCor "atmosphärendruckabhängiger Korrekturwert für den Ansteuerbeginn der MI1" SWORD AngleCrS 1 100 -768.0000 767.9766 FORMAT "%8.4" ECU_ADDRESS 0x7F9988 /end MEASUREMENT
/begin MEASUREMENT InjCrv_phiMIATSCor "ansauglufttemperaturabhängiger Korrekturwert für den Ansteuerbeginn der MI1" SWORD AngleCrS 1 100 -768.0000 767.9766 FORMAT "%8.4" ECU_ADDRESS 0x7F998A /end MEASUREMENT
/begin MEASUREMENT InjCrv_phiMIFTSRailCor_mp "Ansteuerbeginnkorrekturfaktor für MI1, abhängig von der kraftstofftemperaturabhängigen Raildruckkorrektur" SWORD AngleCrS 1 100 -768.0000 767.9766 FORMAT "%8.4" ECU_ADDRESS 0x802FD6 /end MEASUREMENT
/begin MEASUREMENT InjCrv_phiMIPCRCor "Korrekturwinkel abh. von PCR_pBGDev und Eng_tEng" SWORD AngleCrS 1 100 -768.0000 767.9766 FORMAT "%8.4" ECU_ADDRESS 0x7F998C /end MEASUREMENT
/begin MEASUREMENT InjCrv_phiMIPRailDiffCor2_mp "SOE Korrekturwinkel abh. von Differenz zw. limit. und unlimit rail pressure setpoint" SWORD AngleCrS 1 100 -768.0000 767.9766 FORMAT "%8.4" ECU_ADDRESS 0x802FD8 /end MEASUREMENT
/begin MEASUREMENT InjCrv_phiMIpRailDvtCor_mp "Korrekturfaktor abh. von deviated rail pressure" SWORD AngleCrS 1 100 -768.0000 767.9766 FORMAT "%8.4" ECU_ADDRESS 0x802FDA /end MEASUREMENT
/begin MEASUREMENT InjCrv_phiNxtCyl_mp "Winkel zwischen aktuellem OT und der frühesten Einspritzung des nächsten Zylinders auf derselben Bank" SWORD AngleCrS 1 100 -768.0000 767.9766 FORMAT "%8.4" ECU_ADDRESS 0x80308A /end MEASUREMENT
/begin MEASUREMENT InjCrv_phiNxtTDCoB_mp "Winkel zw. aktuellem OT und OT des nächsten Zylinders auf derselben Bank" SWORD AngleCrS 1 100 -768.0000 767.9766 FORMAT "%8.4" ECU_ADDRESS 0x80308C /end MEASUREMENT
/begin MEASUREMENT InjCrv_phiPiI1AbsTot_mp "absoluter Ansteuerbeginn PiI1 aus Winkel- und Zeitkomponente" SWORD AngleCrS 1 100 -768.0000 767.9766 FORMAT "%8.4" ECU_ADDRESS 0x80302A /end MEASUREMENT
/begin MEASUREMENT InjCrv_phiPiI1Abs_mp "absolute Winkelkomponente Anteuerbeginn PiI1" SWORD AngleCrS 1 100 -768.0000 767.9766 FORMAT "%8.4" ECU_ADDRESS 0x80302C /end MEASUREMENT
/begin MEASUREMENT InjCrv_phiPiI1AddCor "kundenspezifischer Korrekturwinkel für PiI1" SWORD AngleCrS 1 100 -768.0000 767.9766 FORMAT "%8.4" ECU_ADDRESS 0x7F998E /end MEASUREMENT
/begin MEASUREMENT InjCrv_phiPiI1Bas_mp "Winkelkomponente Ansteuerbeginn PiI1Grundwert" SWORD AngleCrS 1 100 -768.0000 767.9766 FORMAT "%8.4" ECU_ADDRESS 0x802FE2 /end MEASUREMENT
/begin MEASUREMENT InjCrv_phiPiI1Cor_mp "korrigierter Grundwert Winkelkomponente Ansteuerbeginn PiI1" SWORD AngleCrS 1 100 -768.0000 767.9766 FORMAT "%8.4" ECU_ADDRESS 0x80302E /end MEASUREMENT
/begin MEASUREMENT InjCrv_phiPiI1Des "gewünschter Winkelkomponente Ansteuerbeginn PiI1" SWORD AngleCrS 1 100 -768.0000 767.9766 FORMAT "%8.4" ECU_ADDRESS 0x7F9990 /end MEASUREMENT
/begin MEASUREMENT InjCrv_phiPiI1DesByp_mp "Bypass-Label, Kopie von InjCrv_phiPiI1Des" SWORD AngleCrS 1 100 -768.0000 767.9766 FORMAT "%8.4" ECU_ADDRESS 0x803030 /end MEASUREMENT
/begin MEASUREMENT InjCrv_phiPiI1EnvCor "Korrekturwinkel für Voreinspritzung 1" SWORD AngleCrS 1 100 -768.0000 767.9766 FORMAT "%8.4" ECU_ADDRESS 0x7F9992 /end MEASUREMENT
/begin MEASUREMENT InjCrv_phiPiI1ETSCor_mp "motortemperaturabhängiger Korrekturwinkel für die Winkelkomponente des Ansteuerbeginns der PiI1" SWORD AngleCrS 1 100 -768.0000 767.9766 FORMAT "%8.4" ECU_ADDRESS 0x803074 /end MEASUREMENT
/begin MEASUREMENT InjCrv_phiPiI1Rel_mp "Winkelkomponente Ansteuerbeginn PiI1 relaitv zur MI" SWORD AngleCrS 1 100 -768.0000 767.9766 FORMAT "%8.4" ECU_ADDRESS 0x803032 /end MEASUREMENT
/begin MEASUREMENT InjCrv_phiPiI1Rgn "Regenerationswert für die  Winkelkomponente des Ansteuerbeginns der PiI1" SWORD AngleCrS 1 100 -768.0000 767.9766 FORMAT "%8.4" ECU_ADDRESS 0x7F9994 /end MEASUREMENT
/begin MEASUREMENT InjCrv_phiPiI2AbsTot_mp "absoluter Ansteuerbeginn PiI2 aus Winkel- und Zeitkomponente" SWORD AngleCrS 1 100 -768.0000 767.9766 FORMAT "%8.4" ECU_ADDRESS 0x802FEE /end MEASUREMENT
/begin MEASUREMENT InjCrv_phiPiI2Abs_mp "absolute Winkelkomponente Ansteuerbeginn PiI2" SWORD AngleCrS 1 100 -768.0000 767.9766 FORMAT "%8.4" ECU_ADDRESS 0x802FF0 /end MEASUREMENT
/begin MEASUREMENT InjCrv_phiPiI2AddCor "kundenspezifischer Korrekturwinkel für PiI2" SWORD AngleCrS 1 100 -768.0000 767.9766 FORMAT "%8.4" ECU_ADDRESS 0x7F9996 /end MEASUREMENT
/begin MEASUREMENT InjCrv_phiPiI2Bas_mp "Winkelkomponente Ansteuerbeginn PiI2 Grundwert" SWORD AngleCrS 1 100 -768.0000 767.9766 FORMAT "%8.4" ECU_ADDRESS 0x80301E /end MEASUREMENT
/begin MEASUREMENT InjCrv_phiPiI2Cor_mp "korrigierter Grundwert Winkelkomponente Ansteuerbeginn PiI2" SWORD AngleCrS 1 100 -768.0000 767.9766 FORMAT "%8.4" ECU_ADDRESS 0x802FF2 /end MEASUREMENT
/begin MEASUREMENT InjCrv_phiPiI2Des "gewünschte Winkelkomponente Ansteuerbeginn PiI2" SWORD AngleCrS 1 100 -768.0000 767.9766 FORMAT "%8.4" ECU_ADDRESS 0x7F9998 /end MEASUREMENT
/begin MEASUREMENT InjCrv_phiPiI2DesByp_mp "Bypass-Label, Kopie von InjCrv_phiPiI2Des" SWORD AngleCrS 1 100 -768.0000 767.9766 FORMAT "%8.4" ECU_ADDRESS 0x803034 /end MEASUREMENT
/begin MEASUREMENT InjCrv_phiPiI2EnvCor "Korrekturwinkel für Voreinspritzung 2" SWORD AngleCrS 1 100 -768.0000 767.9766 FORMAT "%8.4" ECU_ADDRESS 0x7F999A /end MEASUREMENT
/begin MEASUREMENT InjCrv_phiPiI2ETSCor_mp "motortemperaturabhängiger Korrekturgrundwert für die Winkelkomponente des Ansteuerbeginns der PiI2" SWORD AngleCrS 1 100 -768.0000 767.9766 FORMAT "%8.4" ECU_ADDRESS 0x80301A /end MEASUREMENT
/begin MEASUREMENT InjCrv_phiPiI2Rel_mp "Winkelkomponente Ansteuerbeginn PiI2 relativ zur MI" SWORD AngleCrS 1 100 -768.0000 767.9766 FORMAT "%8.4" ECU_ADDRESS 0x802FF4 /end MEASUREMENT
/begin MEASUREMENT InjCrv_phiPiI2Rgn "Regenerationswert für die  Winkelkomponente des Ansteuerbeginns der PiI2" SWORD AngleCrS 1 100 -768.0000 767.9766 FORMAT "%8.4" ECU_ADDRESS 0x7F999C /end MEASUREMENT
/begin MEASUREMENT InjCrv_phiPiI3Des "gewünschte Winkelkomponente Ansteuerbeginn PiI3" SWORD AngleCrS 1 100 -768.0000 767.9766 FORMAT "%8.4" ECU_ADDRESS 0x7F999E /end MEASUREMENT
/begin MEASUREMENT InjCrv_phiPiI3DesByp_mp "Bypass-Label, Kopie von InjCrv_phiPiI3Des" SWORD AngleCrS 1 100 -768.0000 767.9766 FORMAT "%8.4" ECU_ADDRESS 0x803036 /end MEASUREMENT
/begin MEASUREMENT InjCrv_phiPoI1AddCor "kundenspezifischer Korrekturwinkel für PoI1" SWORD AngleCrS 1 100 -768.0000 767.9766 FORMAT "%8.4" ECU_ADDRESS 0x7F99A0 /end MEASUREMENT
/begin MEASUREMENT InjCrv_phiPoI1Bas_mp "Grundwert des Ansteuerbeginnwinkels PoI1" SWORD AngleCrS 1 100 -768.0000 767.9766 FORMAT "%8.4" ECU_ADDRESS 0x80308E /end MEASUREMENT
/begin MEASUREMENT InjCrv_phiPoI1Des "gewünschter Bezugswinkel für Beginn der PoI1" SWORD AngleCrS 1 100 -768.0000 767.9766 FORMAT "%8.4" ECU_ADDRESS 0x7F99A2 /end MEASUREMENT
/begin MEASUREMENT InjCrv_phiPoI1DesByp_mp "Bypass-Label, Kopie von InjCrv_phiPoI1Des" SWORD AngleCrS 1 100 -768.0000 767.9766 FORMAT "%8.4" ECU_ADDRESS 0x803090 /end MEASUREMENT
/begin MEASUREMENT InjCrv_phiPoI1Dur_mp "Gesamtzeti PoI1 in Winkelgraden" SWORD AngleCrS 1 100 -768.0000 767.9766 FORMAT "%8.4" ECU_ADDRESS 0x803092 /end MEASUREMENT
/begin MEASUREMENT InjCrv_phiPoI1EnvCor "umgebungsbedingungsabhängiger Korrekturwinkel für PoI1" SWORD AngleCrS 1 100 -768.0000 767.9766 FORMAT "%8.4" ECU_ADDRESS 0x7F99A4 /end MEASUREMENT
/begin MEASUREMENT InjCrv_phiPoI1Lim_mp "begrenzeter Ansteuerbeginnwinkel PoI1" SWORD AngleCrS 1 100 -768.0000 767.9766 FORMAT "%8.4" ECU_ADDRESS 0x803094 /end MEASUREMENT
/begin MEASUREMENT InjCrv_phiPoI1Min_mp "spätester Ansteuerbeginnwinkel PoI1" SWORD AngleCrS 1 100 -768.0000 767.9766 FORMAT "%8.4" ECU_ADDRESS 0x803096 /end MEASUREMENT
/begin MEASUREMENT InjCrv_phiPoI1Rgn "Grundwert der Winkelkomponente Ansteuerbeginn PoI1 im Regenerationsbetrieb" SWORD AngleCrS 1 100 -768.0000 767.9766 FORMAT "%8.4" ECU_ADDRESS 0x7F99A6 /end MEASUREMENT
/begin MEASUREMENT InjCrv_phiPoI1Set_mp "Sollwert des Ansteuerbeginnwinkels PoI1" SWORD AngleCrS 1 100 -768.0000 767.9766 FORMAT "%8.4" ECU_ADDRESS 0x803098 /end MEASUREMENT
/begin MEASUREMENT InjCrv_phiPoI2AddCor "kundenspezifischer Korrekturwinkel für PoI2" SWORD AngleCrS 1 100 -768.0000 767.9766 FORMAT "%8.4" ECU_ADDRESS 0x7F99A8 /end MEASUREMENT
/begin MEASUREMENT InjCrv_phiPoI2ATSCor_mp "ansauglufttemperaturabhängiger Korrekturgrundwert für die Winkelkomponente des Ansteuerbeginns der PoI2" SWORD AngleCrS 1 100 -768.0000 767.9766 FORMAT "%8.4" ECU_ADDRESS 0x8030C0 /end MEASUREMENT
/begin MEASUREMENT InjCrv_phiPoI2Bas_mp "Winkelkomponente Ansteuerbeginn PoI2 Grundwert" SWORD AngleCrS 1 100 -768.0000 767.9766 FORMAT "%8.4" ECU_ADDRESS 0x8030F8 /end MEASUREMENT
/begin MEASUREMENT InjCrv_phiPoI2Des "gewünschter Bezugswinkel für Beginn der PoI2" SWORD AngleCrS 1 100 -768.0000 767.9766 FORMAT "%8.4" ECU_ADDRESS 0x7F99AA /end MEASUREMENT
/begin MEASUREMENT InjCrv_phiPoI2EnvCor "Korrekturwinkel für PoI2" SWORD AngleCrS 1 100 -768.0000 767.9766 FORMAT "%8.4" ECU_ADDRESS 0x7F99AC /end MEASUREMENT
/begin MEASUREMENT InjCrv_phiPoI2ETSCor_mp "motortemperaturabhängiger Korrekturgrundwert für die Winkelkomponente des Ansteuerbeginns der PoI2" SWORD AngleCrS 1 100 -768.0000 767.9766 FORMAT "%8.4" ECU_ADDRESS 0x8030C2 /end MEASUREMENT
/begin MEASUREMENT InjCrv_phiPoI2Rgn "Grundwert der Winkelkomponente Ansteuerbeginn PoI2 im Regenerationsbetrieb" SWORD AngleCrS 1 100 -768.0000 767.9766 FORMAT "%8.4" ECU_ADDRESS 0x7F99AE /end MEASUREMENT
/begin MEASUREMENT InjCrv_PiI1RgnVal_mp "Aktivierungswert für die Freigabe PiI1 über das Abgasnachbehandlungssystem" ULONG EGTSwt 1 100 0.00 262.143999939 FORMAT "%13.9" ECU_ADDRESS 0x803024 /end MEASUREMENT
/begin MEASUREMENT InjCrv_PiI2RgnVal_mp "Aktivierungswert für die Freigabe PiI2 über das Abgasnachbehandlungssystem" ULONG EGTSwt 1 100 0.00 262.143999939 FORMAT "%13.9" ECU_ADDRESS 0x802FE8 /end MEASUREMENT
/begin MEASUREMENT InjCrv_PoI1RgnVal_mp "Aktivierungswert für die Freigabe der PoI1 über das Abgasnachbehandlungssystem" ULONG EGTSwt 1 100 0.00 262.143999939 FORMAT "%13.9" ECU_ADDRESS 0x803084 /end MEASUREMENT
/begin MEASUREMENT InjCrv_POpPoI1AddCor "kundespezifischer Korrekturwert für Freigabe PoI1" SWORD OneToOne 1 100 -32768.00 32767.00 FORMAT "%8.2" ECU_ADDRESS 0x7F9948 /end MEASUREMENT
/begin MEASUREMENT InjCrv_POpPoI1Bas_mp "grundwert Freigabe PoI1" SWORD OneToOne 1 100 -32768.00 32767.00 FORMAT "%8.2" ECU_ADDRESS 0x8030B8 /end MEASUREMENT
/begin MEASUREMENT InjCrv_POpPoI1EnvCor "Freigabekorrekturwert für PoI1" SWORD OneToOne 1 100 -32768.00 32767.00 FORMAT "%8.2" ECU_ADDRESS 0x7F994A /end MEASUREMENT
/begin MEASUREMENT InjCrv_POpPoI1RgnBas_mp "Korrektur des Basiskennfeldes im Regenerationsfall zur Freigabe der PoI1" SWORD OneToOne 1 100 -32768.00 32767.00 FORMAT "%8.2" ECU_ADDRESS 0x8030AE /end MEASUREMENT
/begin MEASUREMENT InjCrv_POpPoI1_mp "korrigierter grundwert Freigabe PoI1" SWORD OneToOne 1 100 -32768.00 32767.00 FORMAT "%8.2" ECU_ADDRESS 0x8030BA /end MEASUREMENT
/begin MEASUREMENT InjCrv_POpPoI2AddCor "kundenspezifischer Korrekturwert für Freigabe PoI2" SWORD OneToOne 1 100 -32768.00 32767.00 FORMAT "%8.2" ECU_ADDRESS 0x7F994C /end MEASUREMENT
/begin MEASUREMENT InjCrv_POpPoI2Bas_mp "grundwert Freigabe PoI2" SWORD OneToOne 1 100 -32768.00 32767.00 FORMAT "%8.2" ECU_ADDRESS 0x8030E2 /end MEASUREMENT
/begin MEASUREMENT InjCrv_POpPoI2EnvCor "Korrekturwert für Freigabe PoI2" SWORD OneToOne 1 100 -32768.00 32767.00 FORMAT "%8.2" ECU_ADDRESS 0x7F994E /end MEASUREMENT
/begin MEASUREMENT InjCrv_POpPoI2_mp "reigabe PoI2, korrigierter Grundwert" SWORD OneToOne 1 100 -32768.00 32767.00 FORMAT "%8.2" ECU_ADDRESS 0x8030E4 /end MEASUREMENT
/begin MEASUREMENT InjCrv_pRailDiffLim "Differenz zw. limitiertem und unlimitiertem rail pressure setpoint" SWORD Pres_Rail 1 100 -3276800. 3276700. FORMAT "%8.0" ECU_ADDRESS 0x7F997C /end MEASUREMENT
/begin MEASUREMENT InjCrv_pSrcSel_mp "Wert des gewählten Drucks für Höhenkorrektur SOE PiI1" SWORD Pres_hPa 1 100 -32768.00 32767.00 FORMAT "%8.2" ECU_ADDRESS 0x80306A /end MEASUREMENT
/begin MEASUREMENT InjCrv_qMI1Des "Sollmenge Haupteinspritzung" SWORD InjMassInj 1 100 -327.6800 327.6700 FORMAT "%8.4" ECU_ADDRESS 0x7F99B2 /end MEASUREMENT
/begin MEASUREMENT InjCrv_qMI1DesByp_mp "Bypass-Label, Kopie von InjCrv_qMI1Des" SWORD InjMassInj 1 100 -327.6800 327.6700 FORMAT "%8.4" ECU_ADDRESS 0x802FC0 /end MEASUREMENT
/begin MEASUREMENT InjCrv_qMI1MinPiI1_mp "Minimalmenge der MI1 wenn nur PiI1 abgesetzt wird" SWORD InjMassInj 1 100 -327.6800 327.6700 FORMAT "%8.4" ECU_ADDRESS 0x803038 /end MEASUREMENT
/begin MEASUREMENT InjCrv_qMI1MinPiI2_mp "Minimalmenge der MI1 wenn PiI1 und PiI2 abgesetzt werden" SWORD InjMassInj 1 100 -327.6800 327.6700 FORMAT "%8.4" ECU_ADDRESS 0x802FF6 /end MEASUREMENT
/begin MEASUREMENT InjCrv_qMI1MinPoI2_mp "Minimale Einspritzmenge der MI1 bei der PoI2 Berechnung" SWORD InjMassInj 1 100 -327.6800 327.6700 FORMAT "%8.4" ECU_ADDRESS 0x8030CC /end MEASUREMENT
/begin MEASUREMENT InjCrv_qMI1Min_mp "Minimale Einspritzmenge der Haupteinspritzung 1" SWORD InjMassInj 1 100 -327.6800 327.6700 FORMAT "%8.4" ECU_ADDRESS 0x802FC2 /end MEASUREMENT
/begin MEASUREMENT InjCrv_qMI1Nrm_mp "Normalmenge der Einspritzung MI1" SWORD InjMassInj 1 100 -327.6800 327.6700 FORMAT "%8.4" ECU_ADDRESS 0x802FC4 /end MEASUREMENT
/begin MEASUREMENT InjCrv_qMI1Rgn "Regenerationswert für die Menge der MI1" SWORD InjMassInj 1 100 -327.6800 327.6700 FORMAT "%8.4" ECU_ADDRESS 0x7F99B4 /end MEASUREMENT
/begin MEASUREMENT InjCrv_qMI1Set_mp "Sollmenge der Einspritzung MI1" SWORD InjMassInj 1 100 -327.6800 327.6700 FORMAT "%8.4" ECU_ADDRESS 0x802FC6 /end MEASUREMENT
/begin MEASUREMENT InjCrv_qPiI1AddCor "kundenspezifische Korrekturmenge für PiI1" SWORD InjMassInj 1 100 -327.6800 327.6700 FORMAT "%8.4" ECU_ADDRESS 0x7F99B6 /end MEASUREMENT
/begin MEASUREMENT InjCrv_qPiI1APSCor_mp "atmosphärendruckabhängige Korrekturmenge für Voreinspritzung 1" SWORD InjMassInj 1 100 -327.6800 327.6700 FORMAT "%8.4" ECU_ADDRESS 0x80306E /end MEASUREMENT
/begin MEASUREMENT InjCrv_qPiI1ATSCor_mp "ansauglufttemperaturabhängige Korrekturmenge für Voreinspritzung 1" SWORD InjMassInj 1 100 -327.6800 327.6700 FORMAT "%8.4" ECU_ADDRESS 0x803070 /end MEASUREMENT
/begin MEASUREMENT InjCrv_qPiI1Bas_mp "Einspritzmenge PiI1 Grundwert" SWORD InjMassInj 1 100 -327.6800 327.6700 FORMAT "%8.4" ECU_ADDRESS 0x80303A /end MEASUREMENT
/begin MEASUREMENT InjCrv_qPiI1Des "gewünschte Einspritzmenge PiI 1" SWORD InjMassInj 1 100 -327.6800 327.6700 FORMAT "%8.4" ECU_ADDRESS 0x7F99B8 /end MEASUREMENT
/begin MEASUREMENT InjCrv_qPiI1DesByp_mp "Bypass-Label, Kopie von InjCrv_qPiI1Des" SWORD InjMassInj 1 100 -327.6800 327.6700 FORMAT "%8.4" ECU_ADDRESS 0x80303C /end MEASUREMENT
/begin MEASUREMENT InjCrv_qPiI1EnvCor "Korrekturmenge für Voreinspritzung 1" SWORD InjMassInj 1 100 -327.6800 327.6700 FORMAT "%8.4" ECU_ADDRESS 0x7F99BA /end MEASUREMENT
/begin MEASUREMENT InjCrv_qPiI1ETSCor_mp "motortemperaturabhängige Korrekturmenge für Voreinspritzung 1" SWORD InjMassInj 1 100 -327.6800 327.6700 FORMAT "%8.4" ECU_ADDRESS 0x803072 /end MEASUREMENT
/begin MEASUREMENT InjCrv_qPiI1Max "Maximale Einspritzmenge PiI1" SWORD InjMassInj 1 100 -327.6800 327.6700 FORMAT "%8.4" ECU_ADDRESS 0x7F99BC /end MEASUREMENT
/begin MEASUREMENT InjCrv_qPiI1Max_mp "maximale Einspritzmenge der PiI1" SWORD InjMassInj 1 100 -327.6800 327.6700 FORMAT "%8.4" ECU_ADDRESS 0x80303E /end MEASUREMENT
/begin MEASUREMENT InjCrv_qPiI1Rgn "Regenerationswert für die Einspritmenge der PiI1" SWORD InjMassInj 1 100 -327.6800 327.6700 FORMAT "%8.4" ECU_ADDRESS 0x7F99BE /end MEASUREMENT
/begin MEASUREMENT InjCrv_qPiI1RgnBas_mp "Grundwert der Menge der PiI1 im Regenerationsbetrieb" SWORD InjMassInj 1 100 -327.6800 327.6700 FORMAT "%8.4" ECU_ADDRESS 0x803078 /end MEASUREMENT
/begin MEASUREMENT InjCrv_qPiI1RgnSet_mp "Sollmenge der PiI1 im Regenerationsbetrieb" SWORD InjMassInj 1 100 -327.6800 327.6700 FORMAT "%8.4" ECU_ADDRESS 0x80307A /end MEASUREMENT
/begin MEASUREMENT InjCrv_qPiI1SetLimMax_mp "begrenzte maximale Solleinspritzmenge PiI1" SWORD InjMassInj 1 100 -327.6800 327.6700 FORMAT "%8.4" ECU_ADDRESS 0x803040 /end MEASUREMENT
/begin MEASUREMENT InjCrv_qPiI1SetLim_mp "begrenzte Solleinspritzmenge PiI1" SWORD InjMassInj 1 100 -327.6800 327.6700 FORMAT "%8.4" ECU_ADDRESS 0x803042 /end MEASUREMENT
/begin MEASUREMENT InjCrv_qPiI1Set_mp "Sollwert der Einspritzmenge PiI1" SWORD InjMassInj 1 100 -327.6800 327.6700 FORMAT "%8.4" ECU_ADDRESS 0x803044 /end MEASUREMENT
/begin MEASUREMENT InjCrv_qPiI2AddCor "kundenspezifische Korrekturmenge für PiI2" SWORD InjMassInj 1 100 -327.6800 327.6700 FORMAT "%8.4" ECU_ADDRESS 0x7F99C0 /end MEASUREMENT
/begin MEASUREMENT InjCrv_qPiI2APSCor_mp "atmosphärendruckabhängige Korrekturmenge für Voreinspritzung 2" SWORD InjMassInj 1 100 -327.6800 327.6700 FORMAT "%8.4" ECU_ADDRESS 0x803014 /end MEASUREMENT
/begin MEASUREMENT InjCrv_qPiI2ATSCor_mp "ansauglufttemperaturabhängige Korrekturmenge für Voreinspritzung 2" SWORD InjMassInj 1 100 -327.6800 327.6700 FORMAT "%8.4" ECU_ADDRESS 0x803016 /end MEASUREMENT
/begin MEASUREMENT InjCrv_qPiI2Bas_mp "Einspritzmenge PiI2 Grundwert" SWORD InjMassInj 1 100 -327.6800 327.6700 FORMAT "%8.4" ECU_ADDRESS 0x802FF8 /end MEASUREMENT
/begin MEASUREMENT InjCrv_qPiI2Des "gewünschte Einspritzmenge PiI 2" SWORD InjMassInj 1 100 -327.6800 327.6700 FORMAT "%8.4" ECU_ADDRESS 0x7F99C2 /end MEASUREMENT
/begin MEASUREMENT InjCrv_qPiI2DesByp_mp "Bypass-Label, Kopie von InjCrv_qPiI2Des" SWORD InjMassInj 1 100 -327.6800 327.6700 FORMAT "%8.4" ECU_ADDRESS 0x803046 /end MEASUREMENT
/begin MEASUREMENT InjCrv_qPiI2EnvCor "Korrekturmenge für Voreinspritzung 2" SWORD InjMassInj 1 100 -327.6800 327.6700 FORMAT "%8.4" ECU_ADDRESS 0x7F99C4 /end MEASUREMENT
/begin MEASUREMENT InjCrv_qPiI2ETSCor_mp "motortemperaturabhängige Korrekturmenge für Voreinspritzung 2" SWORD InjMassInj 1 100 -327.6800 327.6700 FORMAT "%8.4" ECU_ADDRESS 0x803018 /end MEASUREMENT
/begin MEASUREMENT InjCrv_qPiI2Max_mp "maximale Einspritzmenge der PiI2" SWORD InjMassInj 1 100 -327.6800 327.6700 FORMAT "%8.4" ECU_ADDRESS 0x802FFA /end MEASUREMENT
/begin MEASUREMENT InjCrv_qPiI2Rgn "Regenerationswert für die Einspritmenge der PiI2" SWORD InjMassInj 1 100 -327.6800 327.6700 FORMAT "%8.4" ECU_ADDRESS 0x7F99C6 /end MEASUREMENT
/begin MEASUREMENT InjCrv_qPiI2SetLimMax_mp "begrenzte maximale Solleinspritzmenge PiI2" SWORD InjMassInj 1 100 -327.6800 327.6700 FORMAT "%8.4" ECU_ADDRESS 0x802FFC /end MEASUREMENT
/begin MEASUREMENT InjCrv_qPiI2SetLim_mp "begrenzte Solleinspritzmenge PiI2" SWORD InjMassInj 1 100 -327.6800 327.6700 FORMAT "%8.4" ECU_ADDRESS 0x802FFE /end MEASUREMENT
/begin MEASUREMENT InjCrv_qPiI2Set_mp "Sollwert der Einspritzmenge PiI2" SWORD InjMassInj 1 100 -327.6800 327.6700 FORMAT "%8.4" ECU_ADDRESS 0x803000 /end MEASUREMENT
/begin MEASUREMENT InjCrv_qPiI3Des "gewünschte Einspritzmenge PiI 3" SWORD InjMassInj 1 100 -327.6800 327.6700 FORMAT "%8.4" ECU_ADDRESS 0x7F99C8 /end MEASUREMENT
/begin MEASUREMENT InjCrv_qPiI3DesByp_mp "Bypass-Label, Kopie von InjCrv_qPiI3Des" SWORD InjMassInj 1 100 -327.6800 327.6700 FORMAT "%8.4" ECU_ADDRESS 0x803048 /end MEASUREMENT
/begin MEASUREMENT InjCrv_qPiIMin_mp "minimale Einspritzmenge einer Voreinspritzung, ohne Wellenkorrektur" SWORD InjMassInj 1 100 -327.6800 327.6700 FORMAT "%8.4" ECU_ADDRESS 0x80304A /end MEASUREMENT
/begin MEASUREMENT InjCrv_qPoI1AddCor "kundenspezifische Korrekturmenge für PoI1" SWORD InjMassInj 1 100 -327.6800 327.6700 FORMAT "%8.4" ECU_ADDRESS 0x7F99CA /end MEASUREMENT
/begin MEASUREMENT InjCrv_qPoI1APSCor_mp "atmospärendruckabhängige Korrekturmenge für PoI1" SWORD InjMassInj 1 100 -327.6800 327.6700 FORMAT "%8.4" ECU_ADDRESS 0x8030B4 /end MEASUREMENT
/begin MEASUREMENT InjCrv_qPoI1Bas_mp "Grundwert der Einspritzmenge PoI1" SWORD InjMassInj 1 100 -327.6800 327.6700 FORMAT "%8.4" ECU_ADDRESS 0x80309A /end MEASUREMENT
/begin MEASUREMENT InjCrv_qPoI1Clsn "zylinderselektiver Mengenanteil PoI1 bei Kollision" SWORD InjMassInj 1 100 -327.6800 327.6700 FORMAT "%8.4" ECU_ADDRESS 0x7F99CC /end MEASUREMENT
/begin MEASUREMENT InjCrv_qPoI1Des "gewünschte Einspritzmenge PoI1" SWORD InjMassInj 1 100 -327.6800 327.6700 FORMAT "%8.4" ARRAY_SIZE 6 ECU_ADDRESS 0x7F9D56 /end MEASUREMENT
/begin MEASUREMENT InjCrv_qPoI1DesByp_mp "Bypass-Label, Kopie von InjCrv_qPoI1Des" SWORD InjMassInj 1 100 -327.6800 327.6700 FORMAT "%8.4" ECU_ADDRESS 0x80309C /end MEASUREMENT
/begin MEASUREMENT InjCrv_qPoI1Des_mp "Sollmenge Nacheinspritzung 1" SWORD InjMassInj 1 100 -327.6800 327.6700 FORMAT "%8.4" ECU_ADDRESS 0x80309E /end MEASUREMENT
/begin MEASUREMENT InjCrv_qPoI1EnvCor "umgebungsbedingungsabhängige Korrekturmenge für PoI1" SWORD InjMassInj 1 100 -327.6800 327.6700 FORMAT "%8.4" ECU_ADDRESS 0x7F99CE /end MEASUREMENT
/begin MEASUREMENT InjCrv_qPoI1ETSCor_mp "motortemperaturabhängige Korrekturmenge für PoI1" SWORD InjMassInj 1 100 -327.6800 327.6700 FORMAT "%8.4" ECU_ADDRESS 0x8030B6 /end MEASUREMENT
/begin MEASUREMENT InjCrv_qPoI1Lim_mp "begrenzte Einspritzmenge PoI1" SWORD InjMassInj 1 100 -327.6800 327.6700 FORMAT "%8.4" ECU_ADDRESS 0x8030A0 /end MEASUREMENT
/begin MEASUREMENT InjCrv_qPoI1Max_mp "Maximalwert der Einspritzmenge PoI1" SWORD InjMassInj 1 100 -327.6800 327.6700 FORMAT "%8.4" ECU_ADDRESS 0x8030A2 /end MEASUREMENT
/begin MEASUREMENT InjCrv_qPoI1Min_mp "Minimalwert der Einspritzmenge PoI1" SWORD InjMassInj 1 100 -327.6800 327.6700 FORMAT "%8.4" ECU_ADDRESS 0x8030A4 /end MEASUREMENT
/begin MEASUREMENT InjCrv_qPoI1Rgn "Grundwert Einspritzmenge PoI1 im Regenerationsbetrieb" SWORD InjMassInj 1 100 -327.6800 327.6700 FORMAT "%8.4" ECU_ADDRESS 0x7F99D0 /end MEASUREMENT
/begin MEASUREMENT InjCrv_qPoI1Set_mp "Sollwert der Einspritzmenge PoI1" SWORD InjMassInj 1 100 -327.6800 327.6700 FORMAT "%8.4" ECU_ADDRESS 0x8030A6 /end MEASUREMENT
/begin MEASUREMENT InjCrv_qPoI2AddCor "kundenspezifische Korrekturmenge für PoI2" SWORD InjMassInj 1 100 -327.6800 327.6700 FORMAT "%8.4" ECU_ADDRESS 0x7F99D2 /end MEASUREMENT
/begin MEASUREMENT InjCrv_qPoI2ATSCor_mp "ansauglufttemperaturabhängige Korrekturmenge für PoI2" SWORD InjMassInj 1 100 -327.6800 327.6700 FORMAT "%8.4" ECU_ADDRESS 0x8030BC /end MEASUREMENT
/begin MEASUREMENT InjCrv_qPoI2Bas_mp "Einspritzmenge PoI2 Grundwert" SWORD InjMassInj 1 100 -327.6800 327.6700 FORMAT "%8.4" ECU_ADDRESS 0x8030CE /end MEASUREMENT
/begin MEASUREMENT InjCrv_qPoI2Cor_mp "korrigierter Grundwert der Einspritzmenge PoI2" SWORD InjMassInj 1 100 -327.6800 327.6700 FORMAT "%8.4" ECU_ADDRESS 0x8030D0 /end MEASUREMENT
/begin MEASUREMENT InjCrv_qPoI2Des "Sollmenge Nacheinspritzung 2" SWORD InjMassInj 1 100 -327.6800 327.6700 FORMAT "%8.4" ARRAY_SIZE 6 ECU_ADDRESS 0x7F9D62 /end MEASUREMENT
/begin MEASUREMENT InjCrv_qPoI2Des_mp "Sollmenge Nacheinspritzung 2" SWORD InjMassInj 1 100 -327.6800 327.6700 FORMAT "%8.4" ECU_ADDRESS 0x8030D2 /end MEASUREMENT
/begin MEASUREMENT InjCrv_qPoI2Eff "wirksame Einspritzmenge PoI2" SWORD InjMassInj 1 100 -327.6800 327.6700 FORMAT "%8.4" ARRAY_SIZE 6 ECU_ADDRESS 0x7F9D6E /end MEASUREMENT
/begin MEASUREMENT InjCrv_qPoI2Eff_mp "Wirksame Menge der PoI2" SWORD InjMassInj 1 100 -327.6800 327.6700 FORMAT "%8.4" ECU_ADDRESS 0x8030D4 /end MEASUREMENT
/begin MEASUREMENT InjCrv_qPoI2EnvCor "Korrekturmenge für PoI2" SWORD InjMassInj 1 100 -327.6800 327.6700 FORMAT "%8.4" ECU_ADDRESS 0x7F99D4 /end MEASUREMENT
/begin MEASUREMENT InjCrv_qPoI2ETSCor_mp "motortemperaturabhängige Korrekturmenge für PoI2" SWORD InjMassInj 1 100 -327.6800 327.6700 FORMAT "%8.4" ECU_ADDRESS 0x8030BE /end MEASUREMENT
/begin MEASUREMENT InjCrv_qPoI2Lim_mp "begrenzter Sollwert, Einspritzmenge PoI2" SWORD InjMassInj 1 100 -327.6800 327.6700 FORMAT "%8.4" ECU_ADDRESS 0x8030D6 /end MEASUREMENT
/begin MEASUREMENT InjCrv_qPoI2Max_mp "maximale Einspritzmenge PoI2" SWORD InjMassInj 1 100 -327.6800 327.6700 FORMAT "%8.4" ECU_ADDRESS 0x8030D8 /end MEASUREMENT
/begin MEASUREMENT InjCrv_qPoI2Min_mp "minimale Einspritzmenge PoI2" SWORD InjMassInj 1 100 -327.6800 327.6700 FORMAT "%8.4" ECU_ADDRESS 0x8030DA /end MEASUREMENT
/begin MEASUREMENT InjCrv_qPoI2Rgn "Grundwert Einspritzmenge PoI2 im Regenerationsbetrieb" SWORD InjMassInj 1 100 -327.6800 327.6700 FORMAT "%8.4" ECU_ADDRESS 0x7F99D6 /end MEASUREMENT
/begin MEASUREMENT InjCrv_qPoI2Set_mp "Sollwert Einspritzmenge PoI2" SWORD InjMassInj 1 100 -327.6800 327.6700 FORMAT "%8.4" ECU_ADDRESS 0x8030DC /end MEASUREMENT
/begin MEASUREMENT InjCrv_stPiI1_mp "Freigabestatus PiI1" UBYTE OneToOne 1 100 0.00 255.0 FORMAT "%5.1" ECU_ADDRESS 0x80304C /end MEASUREMENT
/begin MEASUREMENT InjCrv_stPiI2_mp "Freigabestatus PiI2" UBYTE OneToOne 1 100 0.00 255.0 FORMAT "%5.1" ECU_ADDRESS 0x803002 /end MEASUREMENT
/begin MEASUREMENT InjCrv_stPoI1_mp "Freigabestatus PoI1" UBYTE OneToOne 1 100 0.00 255.0 FORMAT "%5.1" ECU_ADDRESS 0x8030A8 /end MEASUREMENT
/begin MEASUREMENT InjCrv_stPoI2 "Freigabestatus PoI2" UBYTE OneToOne 1 100 0.00 255.0 FORMAT "%5.1" ECU_ADDRESS 0x7F9485 /end MEASUREMENT
/begin MEASUREMENT InjCrv_tAddCorHigh_mp "Obere Temperaturschwelle der Hysterese für Pflt_tPre" SWORD Temp_Cels 1 100 -3549.940 3003.560 FORMAT "%8.3" ECU_ADDRESS 0x8030B0 /end MEASUREMENT
/begin MEASUREMENT InjCrv_tAddCorLow_mp "Untere Temperaturschwelle der Hysterese für Pflt_tPre" SWORD Temp_Cels 1 100 -3549.940 3003.560 FORMAT "%8.3" ECU_ADDRESS 0x8030B2 /end MEASUREMENT
/begin MEASUREMENT InjCrv_tBasMap_mp "Selektierte Temperatur für MI-Ansteuerbeginnkennraum" SWORD Temp_Cels 1 100 -3549.940 3003.560 FORMAT "%8.3" ECU_ADDRESS 0x802FC8 /end MEASUREMENT
/begin MEASUREMENT InjCrv_tiMI1ET "geschätzte Ansteuerdauer MI1" SWORD InjTime_us 1 100 -32768.00 32767.00 FORMAT "%8.2" ECU_ADDRESS 0x7F99DE /end MEASUREMENT
/begin MEASUREMENT InjCrv_tiPiI1AddCor "kundenspezifische Korrekturzeit für PiI1" SWORD InjTime_us 1 100 -32768.00 32767.00 FORMAT "%8.2" ECU_ADDRESS 0x7F99E0 /end MEASUREMENT
/begin MEASUREMENT InjCrv_tiPiI1AddCor_mp "ausgewählte kundenspezifische Korrekturzeit für PiI1" SWORD InjTime_us 1 100 -32768.00 32767.00 FORMAT "%8.2" ECU_ADDRESS 0x80307C /end MEASUREMENT
/begin MEASUREMENT InjCrv_tiPiI1APSCor_mp "kundenspez. atmosphärendruckabhängiger Korrekturgrundwert für die Zeitkomponente des Ansteuerbeginns der PiI1" SWORD InjTime_us 1 100 -32768.00 32767.00 FORMAT "%8.2" ECU_ADDRESS 0x80306C /end MEASUREMENT
/begin MEASUREMENT InjCrv_tiPiI1Bas_mp "Zeitkomponente Ansteuerbeginn PiI1Grundwert" SWORD InjTime_us 1 100 -32768.00 32767.00 FORMAT "%8.2" ECU_ADDRESS 0x802FE4 /end MEASUREMENT
/begin MEASUREMENT InjCrv_tiPiI1Cor_mp "korrigierter Grundwert der Zeitkomponente Ansteuerbeginn PiI" SWORD InjTime_us 1 100 -32768.00 32767.00 FORMAT "%8.2" ECU_ADDRESS 0x80304E /end MEASUREMENT
/begin MEASUREMENT InjCrv_tiPiI1Des "gewünschte Zeitkomponente Ansteuerbeginn PiI1" SWORD InjTime_us 1 100 -32768.00 32767.00 FORMAT "%8.2" ECU_ADDRESS 0x7F99E2 /end MEASUREMENT
/begin MEASUREMENT InjCrv_tiPiI1DesByp_mp "Bypass-Label, Kopie von InjCrv_tiPiI1Des" SWORD InjTime_us 1 100 -32768.00 32767.00 FORMAT "%8.2" ECU_ADDRESS 0x803050 /end MEASUREMENT
/begin MEASUREMENT InjCrv_tiPiI1EnvCor "Korrekturzeit für PiI1" SWORD InjTime_us 1 100 -32768.00 32767.00 FORMAT "%8.2" ECU_ADDRESS 0x7F99E4 /end MEASUREMENT
/begin MEASUREMENT InjCrv_tiPiI1EnvRgnCor_mp "Motortemperaturabhängiger Zeitkorrekturwert der ersten Voreinspritzung im Regenerationsbetrieb des Partikelfilters" SWORD InjTime_us 1 100 -32768.00 32767.00 FORMAT "%8.2" ECU_ADDRESS 0x80307E /end MEASUREMENT
/begin MEASUREMENT InjCrv_tiPiI1ETNoCor_mp "geschätzte Ansteuerdauer der PiI1 ohne Korrekturen" SWORD InjTime_us 1 100 -32768.00 32767.00 FORMAT "%8.2" ECU_ADDRESS 0x803052 /end MEASUREMENT
/begin MEASUREMENT InjCrv_tiPiI1ETSCor_mp "motortemperaturabhängiger Korrekturgrundwert für die Zeitkomponente des Ansteuerbeginns der PiI1" SWORD InjTime_us 1 100 -32768.00 32767.00 FORMAT "%8.2" ECU_ADDRESS 0x803076 /end MEASUREMENT
/begin MEASUREMENT InjCrv_tiPiI1ETSRgnCor_mp "Umgebungstemperaturabhängiger Zeitkorrekturwert der ersten Voreinspritzung im Regenerationsbetrieb des Partikelfilters" SWORD InjTime_us 1 100 -32768.00 32767.00 FORMAT "%8.2" ECU_ADDRESS 0x803080 /end MEASUREMENT
/begin MEASUREMENT InjCrv_tiPiI1ET_mp "geschätzte Ansteuerdauer der PiI1" SWORD InjTime_us 1 100 -32768.00 32767.00 FORMAT "%8.2" ECU_ADDRESS 0x803054 /end MEASUREMENT
/begin MEASUREMENT InjCrv_tiPiI1Hyd_mp "Zeitkomponente Ansteuerbeginn PiI1 für die Berechnung des Ansteuerbeginns der PiI2" SWORD InjTime_us 1 100 -32768.00 32767.00 FORMAT "%8.2" ECU_ADDRESS 0x803056 /end MEASUREMENT
/begin MEASUREMENT InjCrv_tiPiI1RelMI1_mp "Zeitkomponente Ansteuerbeginn PiI1 relativ zur MI1" SWORD InjTime_us 1 100 -32768.00 32767.00 FORMAT "%8.2" ECU_ADDRESS 0x803058 /end MEASUREMENT
/begin MEASUREMENT InjCrv_tiPiI1RelTot_mp "Ansteuerbeginnabstand PiI1 aus Winkel- und Zeitkomponente" SWORD InjTime_us 1 100 -32768.00 32767.00 FORMAT "%8.2" ECU_ADDRESS 0x80305A /end MEASUREMENT
/begin MEASUREMENT InjCrv_tiPiI1Rel_mp "Zeitkomponente Ansteuerbeginn PiI1 relativ zur MI" SWORD InjTime_us 1 100 -32768.00 32767.00 FORMAT "%8.2" ECU_ADDRESS 0x80305C /end MEASUREMENT
/begin MEASUREMENT InjCrv_tiPiI1Rgn "Regenerationswert für die  Zeitkomponente des Ansteuerbeginns der PiI1" SWORD InjTime_us 1 100 -32768.00 32767.00 FORMAT "%8.2" ECU_ADDRESS 0x7F99E6 /end MEASUREMENT
/begin MEASUREMENT InjCrv_tiPiI1Tot_mp "gesamte Ansteuerdauer der Pil1" SWORD InjTime_us 1 100 -32768.00 32767.00 FORMAT "%8.2" ECU_ADDRESS 0x80305E /end MEASUREMENT
/begin MEASUREMENT InjCrv_tiPiI2AddCor "kundenspezifische Korrekturzeit für PiI2" SWORD InjTime_us 1 100 -32768.00 32767.00 FORMAT "%8.2" ECU_ADDRESS 0x7F99E8 /end MEASUREMENT
/begin MEASUREMENT InjCrv_tiPiI2Bas_mp "Zeitkomponente Ansteuerbeginn PiI2 Grundwert" SWORD InjTime_us 1 100 -32768.00 32767.00 FORMAT "%8.2" ECU_ADDRESS 0x803020 /end MEASUREMENT
/begin MEASUREMENT InjCrv_tiPiI2Cor_mp "korrigierter Grundwert der  Zeitkomponente Ansteuerbeginn PiI2" SWORD InjTime_us 1 100 -32768.00 32767.00 FORMAT "%8.2" ECU_ADDRESS 0x803004 /end MEASUREMENT
/begin MEASUREMENT InjCrv_tiPiI2Des "gewünschte Zeitkomponente für Ansteuerbeginn PiI2" SWORD InjTime_us 1 100 -32768.00 32767.00 FORMAT "%8.2" ECU_ADDRESS 0x7F99EA /end MEASUREMENT
/begin MEASUREMENT InjCrv_tiPiI2DesByp_mp "Bypass-Label, Kopie von InjCrv_tiPiI2Des" SWORD InjTime_us 1 100 -32768.00 32767.00 FORMAT "%8.2" ECU_ADDRESS 0x803060 /end MEASUREMENT
/begin MEASUREMENT InjCrv_tiPiI2EnvCor "Korrekturzeit für PiI2" SWORD InjTime_us 1 100 -32768.00 32767.00 FORMAT "%8.2" ECU_ADDRESS 0x7F99EC /end MEASUREMENT
/begin MEASUREMENT InjCrv_tiPiI2ETSCor_mp "motortemperaturabhängiger Korrekturgrundwert für die Zeitkomponente des Ansteuerbeginns der PiI2" SWORD InjTime_us 1 100 -32768.00 32767.00 FORMAT "%8.2" ECU_ADDRESS 0x80301C /end MEASUREMENT
/begin MEASUREMENT InjCrv_tiPiI2ET_mp "geschätzte Ansteuerdauer PiI2" SWORD InjTime_us 1 100 -32768.00 32767.00 FORMAT "%8.2" ECU_ADDRESS 0x803006 /end MEASUREMENT
/begin MEASUREMENT InjCrv_tiPiI2RelMI_mp "Zeitkomponente Ansteuerbeginn PiI2 relaitv zur MI" SWORD InjTime_us 1 100 -32768.00 32767.00 FORMAT "%8.2" ECU_ADDRESS 0x803008 /end MEASUREMENT
/begin MEASUREMENT InjCrv_tiPiI2RelPiI1_mp "Zeitkomponente Ansteuerbeginn PiI2 relativ zur PiI1" SWORD InjTime_us 1 100 -32768.00 32767.00 FORMAT "%8.2" ECU_ADDRESS 0x80300A /end MEASUREMENT
/begin MEASUREMENT InjCrv_tiPiI2RelTot_mp "Ansteuerbeginnabstand PiI2 aus Winkel- und Zeitkomponente" SWORD InjTime_us 1 100 -32768.00 32767.00 FORMAT "%8.2" ECU_ADDRESS 0x80300C /end MEASUREMENT
/begin MEASUREMENT InjCrv_tiPiI2Rgn "Regenerationswert für die  Zeitkomponente des Ansteuerbeginns der PiI2" SWORD InjTime_us 1 100 -32768.00 32767.00 FORMAT "%8.2" ECU_ADDRESS 0x7F99EE /end MEASUREMENT
/begin MEASUREMENT InjCrv_tiPiI2Tot_mp "gesamte Ansteuerdauer der Pil2" SWORD InjTime_us 1 100 -32768.00 32767.00 FORMAT "%8.2" ECU_ADDRESS 0x80300E /end MEASUREMENT
/begin MEASUREMENT InjCrv_tiPoI1ET_mp "geschätzte Ansteuerdauer PoI1" SWORD InjTime_us 1 100 -32768.00 32767.00 FORMAT "%8.2" ECU_ADDRESS 0x8030AA /end MEASUREMENT
/begin MEASUREMENT InjCrv_tiPoI2AddCor "kundenspezifische Korrekturzeit für PoI2" SWORD InjTime_us 1 100 -32768.00 32767.00 FORMAT "%8.2" ECU_ADDRESS 0x7F99F0 /end MEASUREMENT
/begin MEASUREMENT InjCrv_tiPoI2ATSCor_mp "ansauglufttemperaturabhängiger Korrekturgrundwert für die Zeitkomponente des Ansteuerbeginns der PoI2" SWORD InjTime_us 1 100 -32768.00 32767.00 FORMAT "%8.2" ECU_ADDRESS 0x8030C4 /end MEASUREMENT
/begin MEASUREMENT InjCrv_tiPoI2Bas_mp "Zeitkomponente Ansteuerbeginn PoI2 Grundwert" SWORD InjTime_us 1 100 -32768.00 32767.00 FORMAT "%8.2" ECU_ADDRESS 0x8030FA /end MEASUREMENT
/begin MEASUREMENT InjCrv_tiPoI2Des "gewünschte Bezugszeitkomponente für Beginn PoI2" SWORD InjTime_us 1 100 -32768.00 32767.00 FORMAT "%8.2" ECU_ADDRESS 0x7F99F2 /end MEASUREMENT
/begin MEASUREMENT InjCrv_tiPoI2EnvCor "Korrekturzeit für PoI2" SWORD InjTime_us 1 100 -32768.00 32767.00 FORMAT "%8.2" ECU_ADDRESS 0x7F99F4 /end MEASUREMENT
/begin MEASUREMENT InjCrv_tiPoI2ETSCor_mp "motortemperaturabhängiger Korrekturgrundwert für die Zeitkomponente des Ansteuerbeginns der PoI2" SWORD InjTime_us 1 100 -32768.00 32767.00 FORMAT "%8.2" ECU_ADDRESS 0x8030C6 /end MEASUREMENT
/begin MEASUREMENT InjCrv_tiPoI2ET_mp "geschätzte Ansteuerdauer PoI2" SWORD InjTime_us 1 100 -32768.00 32767.00 FORMAT "%8.2" ECU_ADDRESS 0x8030DE /end MEASUREMENT
/begin MEASUREMENT InjCrv_tiPoI2Rgn "Grundwert der Zeitkomponente Ansteuerbeginn PoI2 im Regenerationsbetrieb" SWORD InjTime_us 1 100 -32768.00 32767.00 FORMAT "%8.2" ECU_ADDRESS 0x7F99F6 /end MEASUREMENT
/begin MEASUREMENT InjCrv_volMI1Cor_mp "Einspritzvolumen MI1 mit Korrekturwerten" SWORD InjQntInj 1 100 -327.6800 327.6700 FORMAT "%8.4" ECU_ADDRESS 0x802FCA /end MEASUREMENT
/begin MEASUREMENT InjCrv_volMI1_mp "Einspritzvolumen MI1" SWORD InjQntInj 1 100 -327.6800 327.6700 FORMAT "%8.4" ECU_ADDRESS 0x802FCC /end MEASUREMENT
/begin MEASUREMENT InjCrv_volPiI1Cor_mp "korrigiertes Einspritzvolumen zur Ansteuerdauerabschätzung der PiI1" SWORD InjQntInj 1 100 -327.6800 327.6700 FORMAT "%8.4" ECU_ADDRESS 0x803062 /end MEASUREMENT
/begin MEASUREMENT InjCrv_volPiI1NoCor_mp "Einspritzvolumen ohne Korrekturen zur Ansteuerdauerabschätzung der PiI1" SWORD InjQntInj 1 100 -327.6800 327.6700 FORMAT "%8.4" ECU_ADDRESS 0x803064 /end MEASUREMENT
/begin MEASUREMENT InjCrv_volPiI1_mp "begrenztes Einspritzvolumen PiI1" SWORD InjQntInj 1 100 -327.6800 327.6700 FORMAT "%8.4" ECU_ADDRESS 0x803066 /end MEASUREMENT
/begin MEASUREMENT InjCrv_volPiI2Cor_mp "korrigiertes Einspritzvolumen zur Ansteuerdauerabschätzung der PiI2" SWORD InjQntInj 1 100 -327.6800 327.6700 FORMAT "%8.4" ECU_ADDRESS 0x803010 /end MEASUREMENT
/begin MEASUREMENT InjCrv_volPiI2_mp "begrenztes Einspritzvolumen PiI2" SWORD InjQntInj 1 100 -327.6800 327.6700 FORMAT "%8.4" ECU_ADDRESS 0x803012 /end MEASUREMENT
/begin MEASUREMENT InjCrv_volPoI1_mp "begrenztes Einspritzvolumen PoI1" SWORD InjQntInj 1 100 -327.6800 327.6700 FORMAT "%8.4" ECU_ADDRESS 0x8030AC /end MEASUREMENT
/begin MEASUREMENT InjCrv_volPoI2_mp "begrenztes Einspritzvolumen PoI2" SWORD InjQntInj 1 100 -327.6800 327.6700 FORMAT "%8.4" ECU_ADDRESS 0x8030E0 /end MEASUREMENT
/begin FUNCTION injcrv_mi "Einspritzverlauf - Haupteinspritzung"
 /begin DEF_CHARACTERISTIC InjCrv_dMI1BasMapNr_CUR InjCrv_phiMI1Bas11_MAP InjCrv_phiMI1Bas12_MAP InjCrv_phiMI1Bas13_MAP InjCrv_phiMI1Bas14_MAP InjCrv_phiMI1Bas15_MAP InjCrv_phiMI1Bas16_MAP InjCrv_phiMI1Bas21_MAP InjCrv_phiMI1Bas22_MAP InjCrv_phiMI1Bas23_MAP InjCrv_phiMI1Bas24_MAP InjCrv_phiMI1Bas25_MAP InjCrv_phiMI1Bas26_MAP InjCrv_phiMI1Bas31_MAP InjCrv_phiMI1Bas32_MAP InjCrv_phiMI1Bas33_MAP InjCrv_phiMI1Bas34_MAP InjCrv_phiMI1Bas35_MAP InjCrv_phiMI1Bas36_MAP InjCrv_phiMI1Maxp_MAP InjCrv_phiMI1Maxt_MAP InjCrv_phiMI1Max_MAP InjCrv_phiMI1Min_C InjCrv_stMI1RgnDelMsk_C InjCrv_swtTemp_C /end DEF_CHARACTERISTIC
 /begin IN_MEASUREMENT BPSCD_pOutVal Eng_nAvrg Eng_tEng InjCrv_tBasMap_mp InjCtl_qSetUnBal /end IN_MEASUREMENT
/end FUNCTION
/begin FUNCTION injcrv_miaddcor "Haupteinspritzung - projektspezifische Korrekturen" /end FUNCTION
/begin FUNCTION injcrv_miaddcor_uic "" /end FUNCTION
/begin FUNCTION injcrv_mienvcor "Haupteinspritzung - Umwelt - Korrekturen"
 /begin DEF_CHARACTERISTIC InjCrv_facMIAPStCor_MAP InjCrv_facMIPCRPhiCor_MAP InjCrv_facMIpRailDiffPhiCor_CUR InjCrv_nCorPRailMax_C InjCrv_phiMI1ETSRgnCor1_MAP InjCrv_phiMI1ETSRgnCor2_MAP InjCrv_phiMI1ETSRgnCor3_MAP InjCrv_phiMIAPSCor_MAP InjCrv_phiMIATSCor_MAP InjCrv_phiMIFTSRailCorMax_C InjCrv_phiMIFTSRailCorMin_C InjCrv_phiMIFTSRailCor_MAP InjCrv_phiMIPCRCor_MAP InjCrv_phiMIpRailDiffCor_MAP InjCrv_phiMIpRailDiffMax_C InjCrv_phiMIpRailDiffMin_C InjCrv_phiMIpRailDvtCor_MAP InjCrv_pRailDiffMax_C InjCrv_pRailDiffMin_C InjCrv_stMIEnvRgnMsk1_C InjCrv_stMIEnvRgnMsk2_C InjCrv_stMIEnvRgnMsk3_C /end DEF_CHARACTERISTIC
 /begin IN_MEASUREMENT Eng_nAvrg Eng_tEng InjCrv_pRailDiffLim InjCtl_qSetUnBal PCR_pBGDev Rail_pDvt /end IN_MEASUREMENT
/end FUNCTION
/begin FUNCTION injcrv_mienvcorrgn "Haupteinspritzung - Umwelt - Korrekturen für den Regenerationsbetrieb" /end FUNCTION
/begin FUNCTION injcrv_mienvcorrgn_msg "" /end FUNCTION
/begin FUNCTION injcrv_mienvcorrgn_uic "" /end FUNCTION
/begin FUNCTION injcrv_mienvcorslow "Korrekturen für die Haupteinspritzung (langsamer Prozess)"
 /begin DEF_CHARACTERISTIC InjCrv_facMI1ETSSOERgnCor1_CUR InjCrv_facMI1ETSSOERgnCor2_CUR InjCrv_facMI1ETSSOERgnCor3_CUR InjCrv_facMIAPSPhiCor_CUR InjCrv_facMIATSPhiCor_CUR InjCrv_facMIFTSRailCor_CUR InjCrv_stMIETSSOERgnMsk1_C InjCrv_stMIETSSOERgnMsk2_C InjCrv_stMIETSSOERgnMsk3_C InjCrv_swtMIAPSSrcSel_C /end DEF_CHARACTERISTIC
 /begin IN_MEASUREMENT Eng_tEng IATSCD_tAir InjCrv_pAPSSrcSel_mp Rail_pSetPointFlTempCor /end IN_MEASUREMENT
/end FUNCTION
/begin FUNCTION injcrv_mienvcorslowrgn "Haupteinspritzung - Umwelt - Gewichtungsfaktoren für den Regenerationsbetrieb" /end FUNCTION
/begin FUNCTION injcrv_mienvcorslowrgn_msg "" /end FUNCTION
/begin FUNCTION injcrv_mienvcorslowrgn_uic "" /end FUNCTION
/begin FUNCTION injcrv_mienvcorslow_msg ""
 /begin OUT_MEASUREMENT InjCrv_facMI1ETSSOERgnCor InjCrv_facMIAPSPhiCor InjCrv_facMIATSPhiCor InjCrv_facMIFTSRailCor /end OUT_MEASUREMENT
/end FUNCTION
/begin FUNCTION injcrv_mienvcorslow_uic "" /begin OUT_MEASUREMENT InjCrv_pAPSSrcSel_mp /end OUT_MEASUREMENT /end FUNCTION
/begin FUNCTION injcrv_mienvcor_msg ""
 /begin OUT_MEASUREMENT InjCrv_phiMIAPSCor InjCrv_phiMIATSCor InjCrv_phiMIPCRCor InjCrv_pRailDiffLim /end OUT_MEASUREMENT
/end FUNCTION
/begin FUNCTION injcrv_mienvcor_uic ""
 /begin OUT_MEASUREMENT InjCrv_facMIPCRCor_mp InjCrv_facMIPRailDiffCorPhi_mp InjCrv_phiMI1ETSRgnCor_mp InjCrv_phiMI1PRailDiffCor_mp InjCrv_phiMIFTSRailCor_mp InjCrv_phiMIPRailDiffCor2_mp InjCrv_phiMIpRailDvtCor_mp /end OUT_MEASUREMENT
/end FUNCTION
/begin FUNCTION injcrv_mirgn "Haupteinspritzung Regenerationswertberechnung"
 /begin DEF_CHARACTERISTIC InjCrv_phiMI1RgnBas1_MAP InjCrv_phiMI1RgnBas2_MAP InjCrv_phiMI1RgnBas3_MAP InjCrv_phiMI1Rgn_C InjCrv_stMI1RgnMsk1_C InjCrv_stMI1RgnMsk2_C InjCrv_stMI1RgnMsk3_C /end DEF_CHARACTERISTIC
 /begin IN_MEASUREMENT Eng_nAvrg InjCtl_qSetUnBal /end IN_MEASUREMENT
/end FUNCTION
/begin FUNCTION injcrv_mirgnlib "Regeneration function library for MI"
 /begin DEF_CHARACTERISTIC InjCrv_dtiMI1RgnRmpUp_C InjCrv_dtiMI1RgnRmpDwn_C InjCrv_stMI1RgnMsk_C /end DEF_CHARACTERISTIC
/end FUNCTION
/begin FUNCTION injcrv_mirgn_msg "" /begin OUT_MEASUREMENT InjCrv_phiMI1Rgn InjCrv_qMI1Rgn /end OUT_MEASUREMENT /end FUNCTION
/begin FUNCTION injcrv_mirgn_uic "" /begin DEF_CHARACTERISTIC InjCrv_phiMI1Rgn_Vector InjCrv_phiMI1Rgn_Channel /end DEF_CHARACTERISTIC /begin OUT_MEASUREMENT InjCrv_phiMI1AddCor_mp InjCrv_phiMI1EnvRgnCor_mp /end OUT_MEASUREMENT /end FUNCTION
/begin FUNCTION injcrv_mirmtctl_uic ""
 /begin DEF_CHARACTERISTIC InjCrv_phiMI1Des_C InjCrv_qMI1Des_C InjCrv_swtPhiMI1Des_C InjCrv_swtQntMI1Des_C /end DEF_CHARACTERISTIC
/end FUNCTION
/begin FUNCTION injcrv_misoergn_msg "" /begin OUT_MEASUREMENT InjCrv_MI1RgnVal /end OUT_MEASUREMENT /end FUNCTION
/begin FUNCTION injcrv_misoergn_uic "" /end FUNCTION
/begin FUNCTION injcrv_mi_msg "" /begin OUT_MEASUREMENT InjCrv_tiMI1ET /end OUT_MEASUREMENT /end FUNCTION
/begin FUNCTION injcrv_mi_uic ""
 /begin DEF_CHARACTERISTIC InjCrv_phiMI1DesAdd_Vector InjCrv_phiMI1DesAdd_Channel InjCrv_phiMI1Des_Vector InjCrv_phiMI1Des_Channel InjCrv_qMI1DesAdd_Vector InjCrv_qMI1DesAdd_Channel InjCrv_qMI1Des_Vector InjCrv_qMI1Des_Channel /end DEF_CHARACTERISTIC
 /begin OUT_MEASUREMENT InjCrv_phiMI1Bas_mp InjCrv_phiMI1Cor_mp InjCrv_phiMI1DesByp_mp InjCrv_phiMI1Lim_mp InjCrv_phiMI1Max_mp InjCrv_qMI1DesByp_mp InjCrv_qMI1Min_mp InjCrv_qMI1Nrm_mp InjCrv_qMI1Set_mp InjCrv_tBasMap_mp InjCrv_volMI1Cor_mp InjCrv_volMI1_mp /end OUT_MEASUREMENT
/end FUNCTION
/begin FUNCTION injcrv_msg ""
 /begin OUT_MEASUREMENT InjCrv_phiMI1AddCor InjCrv_phiMI1Des InjCrv_phiMI1EnvCor InjCrv_phiMI1EnvRgnCor InjCrv_phiPiI1AddCor InjCrv_phiPiI1Des InjCrv_phiPiI1EnvCor InjCrv_qMI1Des InjCrv_qPiI1AddCor InjCrv_qPiI1Des InjCrv_qPiI1EnvCor /end OUT_MEASUREMENT
/end FUNCTION
/begin FUNCTION injcrv_pii "Einspritzverlauf - Voreinspritzung"
 /begin DEF_CHARACTERISTIC InjCrv_facPiI1QntMin_CUR InjCrv_phiPiIMax_C InjCrv_qMI1MinPiI1DiffHys_C InjCrv_qPiI1Bas_MAP InjCrv_qPiI1Max_MAP InjCrv_qPiI1MinDiff_C InjCrv_stPiI1RgnDelMsk_C InjCrv_tiPiIMax_C /end DEF_CHARACTERISTIC
 /begin IN_MEASUREMENT Eng_nAvrg InjCtl_qSetUnBal RailCD_pPeak /end IN_MEASUREMENT
 /begin OUT_MEASUREMENT InjCrv_PiI1RgnVal_mp /end OUT_MEASUREMENT
/end FUNCTION
/begin FUNCTION injcrv_pii1soephibas "" /end FUNCTION
/begin FUNCTION injcrv_pii1soephibas_uic "" /begin OUT_MEASUREMENT InjCrv_phiPiI1Bas_mp /end OUT_MEASUREMENT /end FUNCTION
/begin FUNCTION injcrv_pii1soetibas ""
 /begin DEF_CHARACTERISTIC InjCrv_tiPiI1Bas1_MAP InjCrv_tiPiI1Bas2_MAP InjCrv_tiPiI1Bas3_MAP /end DEF_CHARACTERISTIC
 /begin IN_MEASUREMENT Eng_nAvrg InjCtl_qSetUnBal /end IN_MEASUREMENT
/end FUNCTION
/begin FUNCTION injcrv_pii1soetibas_uic "" /begin OUT_MEASUREMENT InjCrv_tiPiI1Bas_mp /end OUT_MEASUREMENT /end FUNCTION
/begin FUNCTION injcrv_pii2 "Einspritzverlauf - Voreinspritzung 2"
 /begin DEF_CHARACTERISTIC InjCrv_facPiI1QntMax_C InjCrv_facPiI2QntMin_CUR InjCrv_nDiffMin_C InjCrv_qDiffMin_C InjCrv_qMI1MinPiI2DiffHys_C InjCrv_qPiI1WvCorMax_C InjCrv_qPiI2Bas_MAP InjCrv_qPiI2Max_MAP InjCrv_qPiI2MinDiff_C InjCrv_stPiI2RgnDelMsk_C /end DEF_CHARACTERISTIC
 /begin IN_MEASUREMENT Eng_nAvrg InjCtl_qSetUnBal RailCD_pPeak /end IN_MEASUREMENT
 /begin OUT_MEASUREMENT InjCrv_PiI2RgnVal_mp /end OUT_MEASUREMENT
/end FUNCTION
/begin FUNCTION injcrv_pii2addcor "PiI2 - projektspezifische Korrektur" /end FUNCTION
/begin FUNCTION injcrv_pii2addcorphi "" /end FUNCTION
/begin FUNCTION injcrv_pii2addcorphi_uic "" /end FUNCTION
/begin FUNCTION injcrv_pii2addcorslow "Gewichtungsfaktor für projektspezifische Korrektur der PiI2" /end FUNCTION
/begin FUNCTION injcrv_pii2addcorslow_msg "" /end FUNCTION
/begin FUNCTION injcrv_pii2addcorslow_uic "" /end FUNCTION
/begin FUNCTION injcrv_pii2addcor_msg ""
 /begin OUT_MEASUREMENT InjCrv_phiPiI2AddCor InjCrv_qPiI2AddCor InjCrv_tiPiI2AddCor /end OUT_MEASUREMENT
/end FUNCTION
/begin FUNCTION injcrv_pii2addcor_uic "" /end FUNCTION
/begin FUNCTION injcrv_pii2envcor "Voreinspritzung 2 - Umwelt -Korrekturen"
 /begin DEF_CHARACTERISTIC InjCrv_qPiI2APSCor_MAP InjCrv_qPiI2ATSCor_MAP InjCrv_qPiI2ETSCor_MAP /end DEF_CHARACTERISTIC
 /begin IN_MEASUREMENT Eng_nAvrg InjCtl_qSetUnBal /end IN_MEASUREMENT
/end FUNCTION
/begin FUNCTION injcrv_pii2envcorphi "" /end FUNCTION
/begin FUNCTION injcrv_pii2envcorphi_uic "" /begin OUT_MEASUREMENT InjCrv_phiPiI2ETSCor_mp /end OUT_MEASUREMENT /end FUNCTION
/begin FUNCTION injcrv_pii2envcorslow ""
 /begin DEF_CHARACTERISTIC InjCrv_facPiI2APSQCor_CUR InjCrv_facPiI2ATSQCor_CUR InjCrv_facPiI2ETSQCor_CUR InjCrv_facPiI2ETSSOECor_CUR /end DEF_CHARACTERISTIC
 /begin IN_MEASUREMENT APSCD_pVal IATSCD_tAir InjCrv_tEng /end IN_MEASUREMENT
/end FUNCTION
/begin FUNCTION injcrv_pii2envcorslow_msg ""
 /begin OUT_MEASUREMENT InjCrv_facPiI2APSQCor InjCrv_facPiI2ATSQCor InjCrv_facPiI2ETSQCor InjCrv_facPiI2ETSSOECor /end OUT_MEASUREMENT
/end FUNCTION
/begin FUNCTION injcrv_pii2envcorslow_uic "" /end FUNCTION
/begin FUNCTION injcrv_pii2envcorti "" /begin DEF_CHARACTERISTIC InjCrv_tiPiI2ETSCor_MAP /end DEF_CHARACTERISTIC /begin IN_MEASUREMENT Eng_nAvrg InjCtl_qSetUnBal /end IN_MEASUREMENT /end FUNCTION
/begin FUNCTION injcrv_pii2envcorti_uic "" /begin OUT_MEASUREMENT InjCrv_tiPiI2ETSCor_mp /end OUT_MEASUREMENT /end FUNCTION
/begin FUNCTION injcrv_pii2envcor_msg ""
 /begin OUT_MEASUREMENT InjCrv_phiPiI2EnvCor InjCrv_qPiI2EnvCor InjCrv_tiPiI2EnvCor /end OUT_MEASUREMENT
/end FUNCTION
/begin FUNCTION injcrv_pii2envcor_uic ""
 /begin OUT_MEASUREMENT InjCrv_qPiI2APSCor_mp InjCrv_qPiI2ATSCor_mp InjCrv_qPiI2ETSCor_mp /end OUT_MEASUREMENT
/end FUNCTION
/begin FUNCTION injcrv_pii2rgn "Voreinspritzung 2, Regenerationswertberechnung" /end FUNCTION
/begin FUNCTION injcrv_pii2rgnlib ""
 /begin DEF_CHARACTERISTIC InjCrv_dtiPiI2RgnRmpUp_C InjCrv_dtiPiI2RgnRmpDwn_C InjCrv_stPiI2RgnMsk_C /end DEF_CHARACTERISTIC
/end FUNCTION
/begin FUNCTION injcrv_pii2rgn_msg "" /begin OUT_MEASUREMENT InjCrv_phiPiI2Rgn InjCrv_qPiI2Rgn InjCrv_tiPiI2Rgn /end OUT_MEASUREMENT /end FUNCTION
/begin FUNCTION injcrv_pii2rgn_uic ""
 /begin DEF_CHARACTERISTIC InjCrv_phiPiI2Rgn_Vector InjCrv_phiPiI2Rgn_Channel InjCrv_qPiI2Rgn_Vector InjCrv_qPiI2Rgn_Channel InjCrv_tiPiI2Rgn_Vector InjCrv_tiPiI2Rgn_Channel /end DEF_CHARACTERISTIC
/end FUNCTION
/begin FUNCTION injcrv_pii2rmtctl_uic ""
 /begin DEF_CHARACTERISTIC InjCrv_phiPiI2Des_C InjCrv_qPiI2Des_C InjCrv_swtPhiPiI2Des_C InjCrv_swtQntPiI2Des_C InjCrv_swtTiPiI2Des_C InjCrv_tiPiI2Des_C /end DEF_CHARACTERISTIC
/end FUNCTION
/begin FUNCTION injcrv_pii2soephibas "" /end FUNCTION
/begin FUNCTION injcrv_pii2soephibas_uic "" /begin OUT_MEASUREMENT InjCrv_phiPiI2Bas_mp /end OUT_MEASUREMENT /end FUNCTION
/begin FUNCTION injcrv_pii2soetibas "" /begin DEF_CHARACTERISTIC InjCrv_tiPiI2Bas_MAP /end DEF_CHARACTERISTIC /begin IN_MEASUREMENT Eng_nAvrg InjCtl_qSetUnBal /end IN_MEASUREMENT /end FUNCTION
/begin FUNCTION injcrv_pii2soetibas_uic "" /begin OUT_MEASUREMENT InjCrv_tiPiI2Bas_mp /end OUT_MEASUREMENT /end FUNCTION
/begin FUNCTION injcrv_pii2_uic ""
 /begin OUT_MEASUREMENT InjCrv_facPiI2QntMin_mp InjCrv_phiPiI2AbsTot_mp InjCrv_phiPiI2Abs_mp InjCrv_phiPiI2Cor_mp InjCrv_phiPiI2Rel_mp InjCrv_qMI1MinPiI2_mp InjCrv_qPiI2Bas_mp InjCrv_qPiI2Max_mp InjCrv_qPiI2SetLimMax_mp InjCrv_qPiI2SetLim_mp InjCrv_qPiI2Set_mp InjCrv_stPiI2_mp InjCrv_tiPiI2Cor_mp InjCrv_tiPiI2ET_mp InjCrv_tiPiI2RelMI_mp InjCrv_tiPiI2RelPiI1_mp InjCrv_tiPiI2RelTot_mp InjCrv_tiPiI2Tot_mp InjCrv_volPiI2Cor_mp InjCrv_volPiI2_mp /end OUT_MEASUREMENT
/end FUNCTION
/begin FUNCTION injcrv_pii3 "Berechnung von Menge und Ansteuerbeginn von Voreinspritzung 3" /end FUNCTION
/begin FUNCTION injcrv_pii3addcor "Calculation of customer specific correction values for pilot injection 3." /end FUNCTION
/begin FUNCTION injcrv_pii3addcor_msg "" /end FUNCTION
/begin FUNCTION injcrv_pii3addcor_uic "" /end FUNCTION
/begin FUNCTION injcrv_pii3envcor "Voreinspritzung 3 Korrektur durch Umweltbedingungen" /end FUNCTION
/begin FUNCTION injcrv_pii3envcorslow "" /end FUNCTION
/begin FUNCTION injcrv_pii3envcorslow_msg "" /end FUNCTION
/begin FUNCTION injcrv_pii3envcorslow_uic "" /end FUNCTION
/begin FUNCTION injcrv_pii3envcor_msg "" /end FUNCTION
/begin FUNCTION injcrv_pii3envcor_uic "" /end FUNCTION
/begin FUNCTION injcrv_pii3rgnlib "" /end FUNCTION
/begin FUNCTION injcrv_pii3rgn_msg "" /end FUNCTION
/begin FUNCTION injcrv_pii3rgn_uic "" /end FUNCTION
/begin FUNCTION injcrv_pii3rmtctl_uic "" /end FUNCTION
/begin FUNCTION injcrv_pii3_uic "" /end FUNCTION
/begin FUNCTION injcrv_piiaddcor "Voreinspritzung - projektspezifische Korrektur" /begin DEF_CHARACTERISTIC InjCrv_facPiI1APSSOECor_CUR InjCrv_swtAPSSrcSel_C /end DEF_CHARACTERISTIC /begin IN_MEASUREMENT InjCrv_pSrcSel_mp /end IN_MEASUREMENT /end FUNCTION
/begin FUNCTION injcrv_piiaddcorphi "" /end FUNCTION
/begin FUNCTION injcrv_piiaddcorphi_uic "" /end FUNCTION
/begin FUNCTION injcrv_piiaddcorslow "Gewichtungsfaktor für projektspezifische Korrektur der PiI1" /end FUNCTION
/begin FUNCTION injcrv_piiaddcorslow_msg "" /end FUNCTION
/begin FUNCTION injcrv_piiaddcorslow_uic "" /end FUNCTION
/begin FUNCTION injcrv_piiaddcorti "" /begin DEF_CHARACTERISTIC InjCrv_tiPiI1APSCor_MAP /end DEF_CHARACTERISTIC /begin IN_MEASUREMENT Eng_nAvrg InjCtl_qSetUnBal /end IN_MEASUREMENT /end FUNCTION
/begin FUNCTION injcrv_piiaddcorti_uic "" /begin OUT_MEASUREMENT InjCrv_tiPiI1APSCor_mp /end OUT_MEASUREMENT /end FUNCTION
/begin FUNCTION injcrv_piiaddcor_msg "" /begin OUT_MEASUREMENT InjCrv_tiPiI1AddCor /end OUT_MEASUREMENT /end FUNCTION
/begin FUNCTION injcrv_piiaddcor_uic "" /begin OUT_MEASUREMENT InjCrv_facPiI1APSSOECor_mp InjCrv_pSrcSel_mp /end OUT_MEASUREMENT /end FUNCTION
/begin FUNCTION injcrv_piienvcor "Voreinspritzung - Umwelt -Korrekturen"
 /begin DEF_CHARACTERISTIC InjCrv_qPiI1APSCor_MAP InjCrv_qPiI1ATSCor_MAP InjCrv_qPiI1ETSCor_MAP /end DEF_CHARACTERISTIC
 /begin IN_MEASUREMENT Eng_nAvrg InjCtl_qSetUnBal /end IN_MEASUREMENT
/end FUNCTION
/begin FUNCTION injcrv_piienvcorphi "" /end FUNCTION
/begin FUNCTION injcrv_piienvcorphi_uic "" /begin OUT_MEASUREMENT InjCrv_phiPiI1ETSCor_mp /end OUT_MEASUREMENT /end FUNCTION
/begin FUNCTION injcrv_piienvcorrgn "Haupteinspritzung - Umwelt - Gewichtungsfaktoren für den Regenerationsbetrieb" /end FUNCTION
/begin FUNCTION injcrv_piienvcorrgn_msg "" /end FUNCTION
/begin FUNCTION injcrv_piienvcorrgn_uic "" /end FUNCTION
/begin FUNCTION injcrv_piienvcorslow "Berechnung der Gewichtungsfunktionen für die Voreinspritzung"
 /begin DEF_CHARACTERISTIC InjCrv_facPiI1APSQCor2_CUR InjCrv_facPiI1APSQCor_CUR InjCrv_facPiI1ATSQCor2_CUR InjCrv_facPiI1ATSQCor_CUR InjCrv_facPiI1ETSQCor2_CUR InjCrv_facPiI1ETSQCor_CUR InjCrv_facPiI1ETSSOECor_CUR InjCrv_facPiI1ETSSOERgnCor1_CUR InjCrv_facPiI1ETSSOERgnCor2_CUR InjCrv_facPiI1ETSSOERgnCor3_CUR InjCrv_stPiI1EnvCorSlowMsk1_C InjCrv_stPiI1EnvCorSlowMsk2_C InjCrv_stPiI1EnvCorSlowMsk3_C /end DEF_CHARACTERISTIC
 /begin IN_MEASUREMENT APSCD_pVal Eng_tEng IATSCD_tAir /end IN_MEASUREMENT
/end FUNCTION
/begin FUNCTION injcrv_piienvcorslowrgn "Voreinspritzung - Umwelt - Gewichtungsfaktoren für den Regenerationsbetrieb" /end FUNCTION
/begin FUNCTION injcrv_piienvcorslowrgn_msg "" /end FUNCTION
/begin FUNCTION injcrv_piienvcorslowrgn_uic "" /end FUNCTION
/begin FUNCTION injcrv_piienvcorslow_msg ""
 /begin OUT_MEASUREMENT InjCrv_facPiI1APSQCor InjCrv_facPiI1ATSQCor InjCrv_facPiI1ETSQCor InjCrv_facPiI1ETSSOECor InjCrv_facPiI1ETSSOERgnCor /end OUT_MEASUREMENT
/end FUNCTION
/begin FUNCTION injcrv_piienvcorslow_uic "" /end FUNCTION
/begin FUNCTION injcrv_piienvcorti "" /begin DEF_CHARACTERISTIC InjCrv_tiPiI1ETSCor_MAP /end DEF_CHARACTERISTIC /begin IN_MEASUREMENT Eng_nAvrg InjCtl_qSetUnBal /end IN_MEASUREMENT /end FUNCTION
/begin FUNCTION injcrv_piienvcorti_uic "" /begin OUT_MEASUREMENT InjCrv_tiPiI1ETSCor_mp /end OUT_MEASUREMENT /end FUNCTION
/begin FUNCTION injcrv_piienvcor_msg "" /begin OUT_MEASUREMENT InjCrv_tiPiI1EnvCor /end OUT_MEASUREMENT /end FUNCTION
/begin FUNCTION injcrv_piienvcor_uic ""
 /begin OUT_MEASUREMENT InjCrv_qPiI1APSCor_mp InjCrv_qPiI1ATSCor_mp InjCrv_qPiI1ETSCor_mp /end OUT_MEASUREMENT
/end FUNCTION
/begin FUNCTION injcrv_piirgn "Voreinspritzung 1, Regenerationswertberechnung"
 /begin DEF_CHARACTERISTIC InjCrv_qPiI1RgnBas1_MAP InjCrv_qPiI1RgnBas2_MAP InjCrv_qPiI1RgnBas3_MAP InjCrv_stPiI1RgnMsk1_C InjCrv_stPiI1RgnMsk2_C InjCrv_stPiI1RgnMsk3_C InjCrv_tiPiI1ETSRgnCor1_MAP InjCrv_tiPiI1ETSRgnCor2_MAP InjCrv_tiPiI1ETSRgnCor3_MAP InjCrv_tiPiI1RgnBas1_MAP InjCrv_tiPiI1RgnBas2_MAP InjCrv_tiPiI1RgnBas3_MAP /end DEF_CHARACTERISTIC
 /begin IN_MEASUREMENT Eng_nAvrg InjCtl_qSetUnBal /end IN_MEASUREMENT
/end FUNCTION
/begin FUNCTION injcrv_piirgnlib ""
 /begin DEF_CHARACTERISTIC InjCrv_dtiPiI1RgnRmpUp_C InjCrv_dtiPiI1RgnRmpDwn_C InjCrv_stPiI1RgnMsk_C /end DEF_CHARACTERISTIC
/end FUNCTION
/begin FUNCTION injcrv_piirgn_msg "" /begin OUT_MEASUREMENT InjCrv_phiPiI1Rgn InjCrv_qPiI1Rgn InjCrv_tiPiI1Rgn /end OUT_MEASUREMENT /end FUNCTION
/begin FUNCTION injcrv_piirgn_uic ""
 /begin DEF_CHARACTERISTIC InjCrv_phiPiI1Rgn_Vector InjCrv_phiPiI1Rgn_Channel InjCrv_qPiI1Rgn_Vector InjCrv_qPiI1Rgn_Channel InjCrv_tiPiI1Rgn_Vector InjCrv_tiPiI1Rgn_Channel /end DEF_CHARACTERISTIC
 /begin OUT_MEASUREMENT InjCrv_qPiI1RgnBas_mp InjCrv_qPiI1RgnSet_mp InjCrv_tiPiI1AddCor_mp InjCrv_tiPiI1EnvRgnCor_mp InjCrv_tiPiI1ETSRgnCor_mp /end OUT_MEASUREMENT
/end FUNCTION
/begin FUNCTION injcrv_piirmtctl_uic ""
 /begin DEF_CHARACTERISTIC InjCrv_phiPiI1Des_C InjCrv_qPiI1Des_C InjCrv_swtPhiPiI1Des_C InjCrv_swtQntPiI1Des_C InjCrv_swtTiPiI1Des_C InjCrv_tiPiI1Des_C /end DEF_CHARACTERISTIC
/end FUNCTION
/begin FUNCTION injcrv_pii_msg ""
 /begin OUT_MEASUREMENT InjCrv_phiPiI2Des InjCrv_phiPiI3Des InjCrv_qPiI1Max InjCrv_qPiI2Des InjCrv_qPiI3Des InjCrv_tiPiI1Des InjCrv_tiPiI2Des /end OUT_MEASUREMENT
/end FUNCTION
/begin FUNCTION injcrv_pii_uic ""
 /begin DEF_CHARACTERISTIC InjCrv_phiPiI1DesAdd_Vector InjCrv_phiPiI1DesAdd_Channel InjCrv_phiPiI1Des_Vector InjCrv_phiPiI1Des_Channel InjCrv_phiPiI2DesAdd_Vector InjCrv_phiPiI2DesAdd_Channel InjCrv_phiPiI2Des_Vector InjCrv_phiPiI2Des_Channel InjCrv_phiPiI3DesAdd_Vector InjCrv_phiPiI3DesAdd_Channel InjCrv_phiPiI3Des_Vector InjCrv_phiPiI3Des_Channel InjCrv_qPiI1DesAdd_Vector InjCrv_qPiI1DesAdd_Channel InjCrv_qPiI1Des_Vector InjCrv_qPiI1Des_Channel InjCrv_qPiI2DesAdd_Vector InjCrv_qPiI2DesAdd_Channel InjCrv_qPiI2Des_Vector InjCrv_qPiI2Des_Channel InjCrv_qPiI3DesAdd_Vector InjCrv_qPiI3DesAdd_Channel InjCrv_qPiI3Des_Vector InjCrv_qPiI3Des_Channel InjCrv_tiPiI1DesAdd_Vector InjCrv_tiPiI1DesAdd_Channel InjCrv_tiPiI1Des_Vector InjCrv_tiPiI1Des_Channel InjCrv_tiPiI2DesAdd_Vector InjCrv_tiPiI2DesAdd_Channel InjCrv_tiPiI2Des_Vector InjCrv_tiPiI2Des_Channel /end DEF_CHARACTERISTIC
 /begin OUT_MEASUREMENT InjCrv_facPiI1QntMin_mp InjCrv_phiPiI1AbsTot_mp InjCrv_phiPiI1Abs_mp InjCrv_phiPiI1Cor_mp InjCrv_phiPiI1DesByp_mp InjCrv_phiPiI1Rel_mp InjCrv_phiPiI2DesByp_mp InjCrv_phiPiI3DesByp_mp InjCrv_qMI1MinPiI1_mp InjCrv_qPiI1Bas_mp InjCrv_qPiI1DesByp_mp InjCrv_qPiI1Max_mp InjCrv_qPiI1SetLimMax_mp InjCrv_qPiI1SetLim_mp InjCrv_qPiI1Set_mp InjCrv_qPiI2DesByp_mp InjCrv_qPiI3DesByp_mp InjCrv_qPiIMin_mp InjCrv_stPiI1_mp InjCrv_tiPiI1Cor_mp InjCrv_tiPiI1DesByp_mp InjCrv_tiPiI1ETNoCor_mp InjCrv_tiPiI1ET_mp InjCrv_tiPiI1Hyd_mp InjCrv_tiPiI1RelMI1_mp InjCrv_tiPiI1RelTot_mp InjCrv_tiPiI1Rel_mp InjCrv_tiPiI1Tot_mp InjCrv_tiPiI2DesByp_mp InjCrv_volPiI1Cor_mp InjCrv_volPiI1NoCor_mp InjCrv_volPiI1_mp /end OUT_MEASUREMENT
/end FUNCTION
/begin FUNCTION injcrv_poi1 "Einspritzverlauf - Nacheinspritzung 1"
 /begin DEF_CHARACTERISTIC InjCrv_numTDCPoI1Clsn_C InjCrv_phiDynOfs_CUR InjCrv_phiPoI1Bas_MAP InjCrv_phiPoI1Max_C InjCrv_qPoI1Bas_MAP InjCrv_qPoI1Max_MAP InjCrv_swtPoI1Clsn_C /end DEF_CHARACTERISTIC
 /begin IN_MEASUREMENT Eng_nAvrg InjCtl_qSetUnBal /end IN_MEASUREMENT
 /begin OUT_MEASUREMENT InjCrv_PoI1RgnVal_mp /end OUT_MEASUREMENT
/end FUNCTION
/begin FUNCTION injcrv_poi1addcor "Nacheinspritzung 1 - projektspezifische Korrekturen"
 /begin DEF_CHARACTERISTIC InjCrv_POpPoI1AddCor1_C InjCrv_POpPoI1AddCor2_C InjCrv_POpPoI1RgnBas1_MAP InjCrv_POpPoI1RgnBas2_MAP InjCrv_stPoI1AddCorMsk1_C InjCrv_stPoI1AddCorMsk2_C InjCrv_stPoI1AddCorMsk3_C InjCrv_stPoI1AddCorMsk4_C InjCrv_stPoI1BasMsk1_C InjCrv_stPoI1BasMsk2_C InjCrv_stPOpPoI1Msk_C InjCrv_tAddCorHighRgn1_CUR InjCrv_tAddCorHighRgn2_CUR InjCrv_tAddCorHighRgn3_CUR InjCrv_tAddCorHighRgn4_CUR InjCrv_tAddCorLowRgn1_CUR InjCrv_tAddCorLowRgn2_CUR InjCrv_tAddCorLowRgn3_CUR InjCrv_tAddCorLowRgn4_CUR /end DEF_CHARACTERISTIC
 /begin IN_MEASUREMENT Eng_nAvrg IATSCD_tAir InjCtl_qSetUnBal /end IN_MEASUREMENT
/end FUNCTION
/begin FUNCTION injcrv_poi1addcor_msg ""
 /begin OUT_MEASUREMENT InjCrv_phiPoI1AddCor InjCrv_POpPoI1AddCor InjCrv_qPoI1AddCor /end OUT_MEASUREMENT
/end FUNCTION
/begin FUNCTION injcrv_poi1addcor_uic ""
 /begin OUT_MEASUREMENT InjCrv_POpPoI1RgnBas_mp InjCrv_tAddCorHigh_mp InjCrv_tAddCorLow_mp /end OUT_MEASUREMENT
/end FUNCTION
/begin FUNCTION injcrv_poi1envcor "Nacheinspritzung 1 - Umwelt- Korrekturen (20 ms task)"
 /begin DEF_CHARACTERISTIC InjCrv_phiPoI1ETSCor_MAP InjCrv_qPoI1APSCor_MAP InjCrv_qPoI1ETSCor_MAP /end DEF_CHARACTERISTIC
 /begin IN_MEASUREMENT Eng_nAvrg InjCtl_qSetUnBal /end IN_MEASUREMENT
/end FUNCTION
/begin FUNCTION injcrv_poi1envcorslow "Nacheinspritzung 1 - Umwelt- Korrekturen (100ms task)"
 /begin DEF_CHARACTERISTIC InjCrv_facPoI1APSQCor_CUR InjCrv_facPoI1ETSPhiCor_CUR InjCrv_facPoI1ETSQCor_CUR InjCrv_POpPoI1ETSCor_CUR /end DEF_CHARACTERISTIC
 /begin IN_MEASUREMENT APSCD_pVal InjCrv_tEng /end IN_MEASUREMENT
/end FUNCTION
/begin FUNCTION injcrv_poi1envcorslow_msg ""
 /begin OUT_MEASUREMENT InjCrv_facPoI1APSQCor InjCrv_facPoI1ETSPhiCor InjCrv_facPoI1ETSQCor InjCrv_POpPoI1EnvCor /end OUT_MEASUREMENT
/end FUNCTION
/begin FUNCTION injcrv_poi1envcorslow_uic "" /end FUNCTION
/begin FUNCTION injcrv_poi1envcor_msg "" /begin OUT_MEASUREMENT InjCrv_phiPoI1EnvCor InjCrv_qPoI1EnvCor /end OUT_MEASUREMENT /end FUNCTION
/begin FUNCTION injcrv_poi1envcor_uic "" /begin OUT_MEASUREMENT InjCrv_qPoI1APSCor_mp InjCrv_qPoI1ETSCor_mp /end OUT_MEASUREMENT /end FUNCTION
/begin FUNCTION injcrv_poi1rgn "Regenerationswertberechnung der PoI1"
 /begin DEF_CHARACTERISTIC InjCrv_phiPoI1RgnBas1_MAP InjCrv_phiPoI1RgnBas2_MAP InjCrv_phiPoI1RgnBas3_MAP InjCrv_phiPoI1RgnBas4_MAP InjCrv_qPoI1RgnBas1_MAP InjCrv_qPoI1RgnBas2_MAP InjCrv_qPoI1RgnBas3_MAP InjCrv_qPoI1RgnBas4_MAP InjCrv_stPoI1RgnMsk1_C InjCrv_stPoI1RgnMsk2_C InjCrv_stPoI1RgnMsk3_C InjCrv_stPoI1RgnMsk4_C /end DEF_CHARACTERISTIC
 /begin IN_MEASUREMENT Eng_nAvrg InjCtl_qSetUnBal /end IN_MEASUREMENT
/end FUNCTION
/begin FUNCTION injcrv_poi1rgnlib "Funktionbibliothek der Regenerationswetberechnung für PoI1"
 /begin DEF_CHARACTERISTIC InjCrv_dtiPoI1RgnRmpUp_C InjCrv_dtiPoI1RgnRmpDwn_C InjCrv_stPoI1RgnMsk_C /end DEF_CHARACTERISTIC
/end FUNCTION
/begin FUNCTION injcrv_poi1rgn_msg "" /begin OUT_MEASUREMENT InjCrv_phiPoI1Rgn InjCrv_qPoI1Rgn /end OUT_MEASUREMENT /end FUNCTION
/begin FUNCTION injcrv_poi1rgn_uic ""
 /begin DEF_CHARACTERISTIC InjCrv_phiPoI1Rgn_Vector InjCrv_phiPoI1Rgn_Channel InjCrv_qPoI1Rgn_Vector InjCrv_qPoI1Rgn_Channel /end DEF_CHARACTERISTIC
/end FUNCTION
/begin FUNCTION injcrv_poi1rls "Freigabe der PoI1"
 /begin DEF_CHARACTERISTIC InjCrv_POpPoI1Bas_MAP InjCrv_POpPoI1High_C InjCrv_POpPoI1Low_C /end DEF_CHARACTERISTIC
 /begin IN_MEASUREMENT Eng_nAvrg InjCtl_qSetUnBal /end IN_MEASUREMENT
/end FUNCTION
/begin FUNCTION injcrv_poi1rls_uic "" /begin OUT_MEASUREMENT InjCrv_POpPoI1Bas_mp InjCrv_POpPoI1_mp /end OUT_MEASUREMENT /end FUNCTION
/begin FUNCTION injcrv_poi1rmtctl_uic ""
 /begin DEF_CHARACTERISTIC InjCrv_phiPoI1Des_C InjCrv_qPoI1Des_C InjCrv_swtPhiPoI1Des_C InjCrv_swtQntPoI1Des_C /end DEF_CHARACTERISTIC
/end FUNCTION
/begin FUNCTION injcrv_poi1_msg "" /begin OUT_MEASUREMENT InjCrv_phiPoI1Des InjCrv_qPoI1Clsn InjCrv_qPoI1Des /end OUT_MEASUREMENT /end FUNCTION
/begin FUNCTION injcrv_poi1_uic ""
 /begin DEF_CHARACTERISTIC InjCrv_phiPoI1DesAdd_Vector InjCrv_phiPoI1DesAdd_Channel InjCrv_phiPoI1Des_Vector InjCrv_phiPoI1Des_Channel InjCrv_qPoI1DesAdd_Vector InjCrv_qPoI1DesAdd_Channel InjCrv_qPoI1Des_Vector InjCrv_qPoI1Des_Channel /end DEF_CHARACTERISTIC
 /begin OUT_MEASUREMENT InjCrv_phiDynOfs_mp InjCrv_phiNxtCyl_mp InjCrv_phiNxtTDCoB_mp InjCrv_phiPoI1Bas_mp InjCrv_phiPoI1DesByp_mp InjCrv_phiPoI1Dur_mp InjCrv_phiPoI1Lim_mp InjCrv_phiPoI1Min_mp InjCrv_phiPoI1Set_mp InjCrv_qPoI1Bas_mp InjCrv_qPoI1DesByp_mp InjCrv_qPoI1Des_mp InjCrv_qPoI1Lim_mp InjCrv_qPoI1Max_mp InjCrv_qPoI1Min_mp InjCrv_qPoI1Set_mp InjCrv_stPoI1_mp InjCrv_tiPoI1ET_mp InjCrv_volPoI1_mp /end OUT_MEASUREMENT
/end FUNCTION
/begin FUNCTION injcrv_poi2addcor "Nacheinspritzung 2 - projektspezifische Korrekturen" /end FUNCTION
/begin FUNCTION injcrv_poi2addcor_msg ""
 /begin OUT_MEASUREMENT InjCrv_phiPoI2AddCor InjCrv_POpPoI2AddCor InjCrv_qPoI2AddCor InjCrv_tiPoI2AddCor /end OUT_MEASUREMENT
/end FUNCTION
/begin FUNCTION injcrv_poi2addcor_uic "" /end FUNCTION
/begin FUNCTION injcrv_poi2agabstdc "Umschaltung des Ansteuerbeginns PoI2 in Winkel absolut zum TDC" /begin DEF_CHARACTERISTIC InjCrv_swtPoI2AgAbsTDC_C /end DEF_CHARACTERISTIC /end FUNCTION
/begin FUNCTION injcrv_poi2agabstdc_uic "" /end FUNCTION
/begin FUNCTION injcrv_poi2envcor "Nacheinspritzung 2 - Umwelt- Korrekturen"
 /begin DEF_CHARACTERISTIC InjCrv_POpPoI2ETSCor_MAP InjCrv_qPoI2ATSCor_MAP InjCrv_qPoI2ETSCor_MAP /end DEF_CHARACTERISTIC
 /begin IN_MEASUREMENT Eng_nAvrg InjCtl_qSetUnBal /end IN_MEASUREMENT
/end FUNCTION
/begin FUNCTION injcrv_poi2envcorphi "" /end FUNCTION
/begin FUNCTION injcrv_poi2envcorphi_uic "" /begin OUT_MEASUREMENT InjCrv_phiPoI2ATSCor_mp InjCrv_phiPoI2ETSCor_mp /end OUT_MEASUREMENT /end FUNCTION
/begin FUNCTION injcrv_poi2envcorslow ""
 /begin DEF_CHARACTERISTIC InjCrv_facPoI2ATSQCor_CUR InjCrv_facPoI2ATSSOECor_CUR InjCrv_facPoI2ETSQCor_CUR InjCrv_facPoI2ETSSOECor_CUR InjCrv_facPOpPoI2ETSCor_CUR /end DEF_CHARACTERISTIC
 /begin IN_MEASUREMENT IATSCD_tAir InjCrv_tEng /end IN_MEASUREMENT
/end FUNCTION
/begin FUNCTION injcrv_poi2envcorslowrgn "PoI2 Korrekturwerte für Umweltbedingungen im Regenerationsmodus" /end FUNCTION
/begin FUNCTION injcrv_poi2envcorslowrgn_msg "" /end FUNCTION
/begin FUNCTION injcrv_poi2envcorslowrgn_uic "" /end FUNCTION
/begin FUNCTION injcrv_poi2envcorslow_msg ""
 /begin OUT_MEASUREMENT InjCrv_facPoI2ATSQCor InjCrv_facPoI2ATSSOECor InjCrv_facPoI2ETSQCor InjCrv_facPoI2ETSSOECor InjCrv_facPOpPoI2ETSCor /end OUT_MEASUREMENT
/end FUNCTION
/begin FUNCTION injcrv_poi2envcorslow_uic "" /end FUNCTION
/begin FUNCTION injcrv_poi2envcorti "" /begin DEF_CHARACTERISTIC InjCrv_tiPoI2ATSCor_MAP InjCrv_tiPoI2ETSCor_MAP /end DEF_CHARACTERISTIC /begin IN_MEASUREMENT Eng_nAvrg InjCtl_qSetUnBal /end IN_MEASUREMENT /end FUNCTION
/begin FUNCTION injcrv_poi2envcorti_uic "" /begin OUT_MEASUREMENT InjCrv_tiPoI2ATSCor_mp InjCrv_tiPoI2ETSCor_mp /end OUT_MEASUREMENT /end FUNCTION
/begin FUNCTION injcrv_poi2envcor_msg ""
 /begin OUT_MEASUREMENT InjCrv_phiPoI2EnvCor InjCrv_POpPoI2EnvCor InjCrv_qPoI2EnvCor InjCrv_tiPoI2EnvCor /end OUT_MEASUREMENT
/end FUNCTION
/begin FUNCTION injcrv_poi2envcor_uic "" /begin OUT_MEASUREMENT InjCrv_qPoI2ATSCor_mp InjCrv_qPoI2ETSCor_mp /end OUT_MEASUREMENT /end FUNCTION
/begin FUNCTION injcrv_poi2q "Nacheinspritzung 2, Mengenberechnung"
 /begin DEF_CHARACTERISTIC InjCrv_facPoI2Eff_MAP InjCrv_facPoI2QntMin_C InjCrv_qPoI2Bas_MAP InjCrv_stPoI2RgnDelMsk_C /end DEF_CHARACTERISTIC
 /begin IN_MEASUREMENT Eng_nAvrg InjCtl_qSetUnBal /end IN_MEASUREMENT
/end FUNCTION
/begin FUNCTION injcrv_poi2qrmtctl_uic ""
 /begin DEF_CHARACTERISTIC InjCrv_qPoI2Des_C InjCrv_qPoI2Eff_C InjCrv_swtQntPoI2Des_C InjCrv_swtQntPoI2Eff_C /end DEF_CHARACTERISTIC
/end FUNCTION
/begin FUNCTION injcrv_poi2q_msg "" /begin OUT_MEASUREMENT InjCrv_qPoI2Des InjCrv_qPoI2Eff InjCrv_stPoI2 /end OUT_MEASUREMENT /end FUNCTION
/begin FUNCTION injcrv_poi2q_uic ""
 /begin OUT_MEASUREMENT InjCrv_facPoI2EffSet_mp InjCrv_facPoI2Eff_mp InjCrv_qMI1MinPoI2_mp InjCrv_qPoI2Bas_mp InjCrv_qPoI2Cor_mp InjCrv_qPoI2Des_mp InjCrv_qPoI2Eff_mp InjCrv_qPoI2Lim_mp InjCrv_qPoI2Max_mp InjCrv_qPoI2Min_mp InjCrv_qPoI2Set_mp InjCrv_tiPoI2ET_mp InjCrv_volPoI2_mp /end OUT_MEASUREMENT
/end FUNCTION
/begin FUNCTION injcrv_poi2rgn "Nacheinspritzung 2, Regenerationswertberechnung" /end FUNCTION
/begin FUNCTION injcrv_poi2rgnlib "Library function  of exhaust gas regeneration for Post Injection 2"
 /begin DEF_CHARACTERISTIC InjCrv_dtiPoI2RgnRmpUp_C InjCrv_dtiPoI2RgnRmpDwn_C InjCrv_stPoI2RgnMsk_C /end DEF_CHARACTERISTIC
/end FUNCTION
/begin FUNCTION injcrv_poi2rgn_msg ""
 /begin OUT_MEASUREMENT InjCrv_facPoI2EffRgn InjCrv_phiPoI2Rgn InjCrv_qPoI2Rgn InjCrv_tiPoI2Rgn /end OUT_MEASUREMENT
/end FUNCTION
/begin FUNCTION injcrv_poi2rgn_uic ""
 /begin DEF_CHARACTERISTIC InjCrv_phiPoI2Rgn_Vector InjCrv_phiPoI2Rgn_Channel InjCrv_qPoI2Rgn_Vector InjCrv_qPoI2Rgn_Channel InjCrv_tiPoI2Rgn_Vector InjCrv_tiPoI2Rgn_Channel /end DEF_CHARACTERISTIC
/end FUNCTION
/begin FUNCTION injcrv_poi2rls ""
 /begin DEF_CHARACTERISTIC InjCrv_POpPoI2Bas_MAP InjCrv_POpPoI2High_C InjCrv_POpPoI2Low_C /end DEF_CHARACTERISTIC
 /begin IN_MEASUREMENT Eng_nAvrg InjCtl_qSetUnBal /end IN_MEASUREMENT
/end FUNCTION
/begin FUNCTION injcrv_poi2rls_uic "" /begin OUT_MEASUREMENT InjCrv_POpPoI2Bas_mp InjCrv_POpPoI2_mp /end OUT_MEASUREMENT /end FUNCTION
/begin FUNCTION injcrv_poi2soe "Nacheinspritzung 2, Ansteuerdauerberechnung"
 /begin DEF_CHARACTERISTIC InjCrv_phiPoI2Min_C InjCrv_tiPoI2Max_MAP InjCrv_tiPoI2Min_C /end DEF_CHARACTERISTIC
 /begin IN_MEASUREMENT InjCrv_qMI1Des RailCD_pPeak /end IN_MEASUREMENT
/end FUNCTION
/begin FUNCTION injcrv_poi2soephibas "" /end FUNCTION
/begin FUNCTION injcrv_poi2soephibas_uic "" /begin OUT_MEASUREMENT InjCrv_phiPoI2Bas_mp /end OUT_MEASUREMENT /end FUNCTION
/begin FUNCTION injcrv_poi2soermtctl_uic ""
 /begin DEF_CHARACTERISTIC InjCrv_phiPoI2Des_C InjCrv_swtPhiPoI2Des_C InjCrv_swtTiPoI2Des_C InjCrv_tiPoI2Des_C /end DEF_CHARACTERISTIC
/end FUNCTION
/begin FUNCTION injcrv_poi2soetibas "" /begin DEF_CHARACTERISTIC InjCrv_tiPoI2Bas_MAP /end DEF_CHARACTERISTIC /begin IN_MEASUREMENT Eng_nAvrg InjCtl_qSetUnBal /end IN_MEASUREMENT /end FUNCTION
/begin FUNCTION injcrv_poi2soetibas_uic "" /begin OUT_MEASUREMENT InjCrv_tiPoI2Bas_mp /end OUT_MEASUREMENT /end FUNCTION
/begin FUNCTION injcrv_poi2soe_msg "" /begin OUT_MEASUREMENT InjCrv_phiPoI2Des InjCrv_tiPoI2Des /end OUT_MEASUREMENT /end FUNCTION
/begin COMPU_METHOD AngleCrS "Winkel Kurbelwelle" RAT_FUNC "%6.4" "[deg CrS]" COEFFS 0 42.6666666666667 0 0 0 1 /end COMPU_METHOD
/begin COMPU_METHOD EGTSwt "Umrechnung für EGT Rampenschalter (1 / 1000*2^14 )" RAT_FUNC "%10.9" "-" COEFFS 0 16384000 0 0 0 1 /end COMPU_METHOD
/begin COMPU_METHOD EngN "Motordrehzahl" RAT_FUNC "%6.2" "[rpm]" COEFFS 0 1 0 0 0 1 /end COMPU_METHOD
/begin COMPU_METHOD EngTempFldSel "Verbale Umrechnung für Auswahl aus dem Motortemperatur-Feld Eng_tFld" TAB_VERB "%6.3" "" COMPU_TAB_REF EngTempFldSel /end COMPU_METHOD
/begin COMPU_VTAB EngTempFldSel "Verbale Umrechnung für Auswahl aus dem Motortemperatur-Feld Eng_tFld" TAB_VERB 5 0 "Coolant_Temperature" 1 "Oil_Temperature" 2 "Engine_Temperature" 3 "Fuel_Temperature" 4 "Coolant_Temperature_CAN" /end COMPU_VTAB
/begin COMPU_METHOD Fact "Faktor mit Auflösung 1 / 8192, hauptsächlich für einen Faktorenbereich 0...1 verwendet" RAT_FUNC "%6.5" "[-]" COEFFS 0 8192 0 0 0 1 /end COMPU_METHOD
/begin COMPU_METHOD Fact1 "Faktor mit Auflösung 0,01 (100 mal höherer Bereich als Fact)" RAT_FUNC "%6.4" "[-]" COEFFS 0 128 0 0 0 1 /end COMPU_METHOD
/begin COMPU_METHOD InjMass "Einspritzmenge" RAT_FUNC "%6.4" "[mg/hub]" COEFFS 0 100 0 0 0 1 /end COMPU_METHOD
/begin COMPU_METHOD InjMassInj "Einspritzmenge pro Einspritzung (mg/Einspritzung)" RAT_FUNC "%6.4" "[mg/inj]" COEFFS 0 100 0 0 0 1 /end COMPU_METHOD
/begin COMPU_METHOD InjQntInj "Einspritzmenge der einzelnen Einspritzung" RAT_FUNC "%6.4" "mm^3/inj" COEFFS 0 100 0 0 0 1 /end COMPU_METHOD
/begin COMPU_METHOD InjTime_us "Zeit in Microsekunden für das Einspritztiming" RAT_FUNC "%6.2" "[us]" COEFFS 0 1 0 0 0 1 /end COMPU_METHOD
/begin COMPU_METHOD Map_Select "Umsetzungsfaktor von Kennfeldern fuer vierdimensionale Raeume" RAT_FUNC "%6.4" "[-]" COEFFS 0 256 0 0 0 1 /end COMPU_METHOD
/begin COMPU_METHOD OneToOne "eins zu eins (physikalischer Wert ist gleich dem internen Wert)" RAT_FUNC "%6.2" "[-]" COEFFS 0 1 0 0 0 1 /end COMPU_METHOD
/begin COMPU_METHOD Pres_hPa "Druck (angezeigt in [hPa])" RAT_FUNC "%6.2" "[hPa]" COEFFS 0 1 0 0 0 1 /end COMPU_METHOD
/begin COMPU_METHOD Pres_Rail "Raildruck in hPa" RAT_FUNC "%6.0" "[hPa]" COEFFS 0 0.01 0 0 0 1 /end COMPU_METHOD
/begin COMPU_METHOD P_Class "Umwandlung von kw in Internen Wert" RAT_FUNC "%6.2" "[kW]" COEFFS 0 1 0 0 0 1 /end COMPU_METHOD
/begin COMPU_METHOD Res_kOhm "Auflösung für Widerstände im Kilo-Ohm Bereich" RAT_FUNC "%6.3" "kOhm" COEFFS 0 10 0 0 0 1 /end COMPU_METHOD
/begin COMPU_METHOD Rmp "einheitenloser Rampengradient (für Library Ramp, etc.)" RAT_FUNC "%6.4" "[1/s]" COEFFS 0 65.536 0 0 0 1 /end COMPU_METHOD
/begin COMPU_METHOD Rmp_1 "Rampe für EGT" RAT_FUNC "%6.5" "1/s" COEFFS 0 1000 0 0 0 1 /end COMPU_METHOD
/begin COMPU_METHOD Temp_Cels "Temperatur dargestellt in °C (gleiche interne Darstellung wie Temp_Kelv)" RAT_FUNC "%6.1" "[deg C]" COEFFS 0 10 2731.4 0 0 1 /end COMPU_METHOD
/begin RECORD_LAYOUT Kf_Xs16_Ys16_Ws16 NO_AXIS_PTS_X 1 SWORD NO_AXIS_PTS_Y 2 SWORD AXIS_PTS_X 3 SWORD INDEX_INCR DIRECT AXIS_PTS_Y 4 SWORD INDEX_INCR DIRECT FNC_VALUES 5 SWORD COLUMN_DIR DIRECT /end RECORD_LAYOUT
/begin RECORD_LAYOUT Kl_Xs16_Ws16 NO_AXIS_PTS_X 1 SWORD AXIS_PTS_X 2 SWORD INDEX_INCR DIRECT FNC_VALUES 3 SWORD COLUMN_DIR DIRECT /end RECORD_LAYOUT
/begin RECORD_LAYOUT Kw_Ws16 FNC_VALUES 1 SWORD COLUMN_DIR DIRECT /end RECORD_LAYOUT
/begin RECORD_LAYOUT Kw_Wu32 FNC_VALUES 1 ULONG COLUMN_DIR DIRECT /end RECORD_LAYOUT
/begin RECORD_LAYOUT Kw_Wu8 FNC_VALUES 1 UBYTE COLUMN_DIR DIRECT /end RECORD_LAYOUT
/end MODULE
/end PROJECT
