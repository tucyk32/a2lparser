ASAP2_VERSION 1 3
/begin PROJECT C177 "EDC16CP"
/begin HEADER "" VERSION "VCP7A3" PROJECT_NO C177 /end HEADER
/begin MODULE DIM ""
/begin MOD_COMMON "" BYTE_ORDER MSB_FIRST ALIGNMENT_BYTE 1 ALIGNMENT_WORD 2 ALIGNMENT_LONG 4 ALIGNMENT_FLOAT32_IEEE 4 /end MOD_COMMON
/begin CHARACTERISTIC DSM_EnvDfp_ACCCDWrongCoded_C "Fehlerpfad spezifische Umweltbedingungen fuer Fehlerpfad Dfp_ACCCDWrongCoded" VAL_BLK 0x1CB870 Kwb_Wu16 602.000000000 SigName 0.00 602.000000000 FORMAT "%13.9" NUMBER 5 /end CHARACTERISTIC
/begin CHARACTERISTIC DSM_EnvDfp_ACCD_C "Fehlerpfad spezifische Umweltbedingungen fuer Fehlerpfad Dfp_ACCD" VAL_BLK 0x1CB87A Kwb_Wu16 602.000000000 SigName 0.00 602.000000000 FORMAT "%13.9" NUMBER 5 /end CHARACTERISTIC
/begin CHARACTERISTIC DSM_EnvDfp_ACCD_PAC_C "Fehlerpfad spezifische Umweltbedingungen fuer Fehlerpfad Dfp_ACCD_PAC" VAL_BLK 0x1CB884 Kwb_Wu16 602.000000000 SigName 0.00 602.000000000 FORMAT "%13.9" NUMBER 5 /end CHARACTERISTIC
/begin CHARACTERISTIC DSM_EnvDfp_ACCD_pCAN_C "Fehlerpfad spezifische Umweltbedingungen fuer Fehlerpfad Dfp_ACCD_pCAN" VAL_BLK 0x1CB88E Kwb_Wu16 602.000000000 SigName 0.00 602.000000000 FORMAT "%13.9" NUMBER 5 /end CHARACTERISTIC
/begin CHARACTERISTIC DSM_EnvDfp_ACCD_trqCAN_C "Fehlerpfad spezifische Umweltbedingungen fuer Fehlerpfad Dfp_ACCD_trqCAN" VAL_BLK 0x1CB898 Kwb_Wu16 602.000000000 SigName 0.00 602.000000000 FORMAT "%13.9" NUMBER 5 /end CHARACTERISTIC
/begin CHARACTERISTIC DSM_EnvDfp_ACCnotPlaus_C "Fehlerpfad spezifische Umweltbedingungen fuer Fehlerpfad Dfp_ACCnotPlaus" VAL_BLK 0x1CB8A2 Kwb_Wu16 602.000000000 SigName 0.00 602.000000000 FORMAT "%13.9" NUMBER 5 /end CHARACTERISTIC
/begin CHARACTERISTIC DSM_EnvDfp_ADCMon_C "Fehlerpfad spezifische Umweltbedingungen fuer Fehlerpfad Dfp_ADCMon" VAL_BLK 0x1CB8AC Kwb_Wu16 602.000000000 SigName 0.00 602.000000000 FORMAT "%13.9" NUMBER 5 /end CHARACTERISTIC
/begin CHARACTERISTIC DSM_EnvDfp_AFSCD_AirTempDcyc_C "Fehlerpfad spezifische Umweltbedingungen fuer Fehlerpfad Dfp_AFSCD_AirTempDcyc" VAL_BLK 0x1CB8B6 Kwb_Wu16 602.000000000 SigName 0.00 602.000000000 FORMAT "%13.9" NUMBER 5 /end CHARACTERISTIC
/begin CHARACTERISTIC DSM_EnvDfp_AFSCD_PlOffsDrft_C "Fehlerpfad spezifische Umweltbedingungen fuer Fehlerpfad Dfp_AFSCD_PlOffsDrft" VAL_BLK 0x1CB8C0 Kwb_Wu16 602.000000000 SigName 0.00 602.000000000 FORMAT "%13.9" NUMBER 5 /end CHARACTERISTIC
/begin CHARACTERISTIC DSM_EnvDfp_AFSCD_PlSetyDrft_C "Fehlerpfad spezifische Umweltbedingungen fuer Fehlerpfad Dfp_AFSCD_PlSetyDrft" VAL_BLK 0x1CB8CA Kwb_Wu16 602.000000000 SigName 0.00 602.000000000 FORMAT "%13.9" NUMBER 5 /end CHARACTERISTIC
/begin CHARACTERISTIC DSM_EnvDfp_AFSCD_Plaus_C "Fehlerpfad spezifische Umweltbedingungen fuer Fehlerpfad Dfp_AFSCD_Plaus" VAL_BLK 0x1CB8D4 Kwb_Wu16 602.000000000 SigName 0.00 602.000000000 FORMAT "%13.9" NUMBER 5 /end CHARACTERISTIC
/begin CHARACTERISTIC DSM_EnvDfp_AFSCD_SRCAirTemp_C "Fehlerpfad spezifische Umweltbedingungen fuer Fehlerpfad Dfp_AFSCD_SRCAirTemp" VAL_BLK 0x1CB8DE Kwb_Wu16 602.000000000 SigName 0.00 602.000000000 FORMAT "%13.9" NUMBER 5 /end CHARACTERISTIC
/begin CHARACTERISTIC DSM_EnvDfp_AFSCD_SRCAirm_C "Fehlerpfad spezifische Umweltbedingungen fuer Fehlerpfad Dfp_AFSCD_SRCAirm" VAL_BLK 0x1CB8E8 Kwb_Wu16 602.000000000 SigName 0.00 602.000000000 FORMAT "%13.9" NUMBER 5 /end CHARACTERISTIC
/begin CHARACTERISTIC DSM_EnvDfp_AFSCD_SRCAirm2_C "Fehlerpfad spezifische Umweltbedingungen fuer Fehlerpfad Dfp_AFSCD_SRCAirm2" VAL_BLK 0x1CB8F2 Kwb_Wu16 602.000000000 SigName 0.00 602.000000000 FORMAT "%13.9" NUMBER 5 /end CHARACTERISTIC
/begin CHARACTERISTIC DSM_EnvDfp_AFSCD_SRCBatt_C "Fehlerpfad spezifische Umweltbedingungen fuer Fehlerpfad Dfp_AFSCD_SRCBatt" VAL_BLK 0x1CB8FC Kwb_Wu16 602.000000000 SigName 0.00 602.000000000 FORMAT "%13.9" NUMBER 5 /end CHARACTERISTIC
/begin CHARACTERISTIC DSM_EnvDfp_AFSCD_SRCCorrAirm_C "Fehlerpfad spezifische Umweltbedingungen fuer Fehlerpfad Dfp_AFSCD_SRCCorrAirm" VAL_BLK 0x1CB906 Kwb_Wu16 602.000000000 SigName 0.00 602.000000000 FORMAT "%13.9" NUMBER 5 /end CHARACTERISTIC
/begin CHARACTERISTIC DSM_EnvDfp_AFSCD_SRCRawAirm_C "Fehlerpfad spezifische Umweltbedingungen fuer Fehlerpfad Dfp_AFSCD_SRCRawAirm" VAL_BLK 0x1CB910 Kwb_Wu16 602.000000000 SigName 0.00 602.000000000 FORMAT "%13.9" NUMBER 5 /end CHARACTERISTIC
/begin CHARACTERISTIC DSM_EnvDfp_AFSCD_SRCRefSigPer_C "Fehlerpfad spezifische Umweltbedingungen fuer Fehlerpfad Dfp_AFSCD_SRCRefSigPer" VAL_BLK 0x1CB91A Kwb_Wu16 602.000000000 SigName 0.00 602.000000000 FORMAT "%13.9" NUMBER 5 /end CHARACTERISTIC
/begin CHARACTERISTIC DSM_EnvDfp_AFVCD_Actr_C "Fehlerpfad spezifische Umweltbedingungen fuer Fehlerpfad Dfp_AFVCD_Actr" VAL_BLK 0x1CB924 Kwb_Wu16 602.000000000 SigName 0.00 602.000000000 FORMAT "%13.9" NUMBER 5 /end CHARACTERISTIC
/begin CHARACTERISTIC DSM_EnvDfp_AOHtCDHt1_C "Fehlerpfad spezifische Umweltbedingungen fuer Fehlerpfad Dfp_AOHtCDHt1" VAL_BLK 0x1CB92E Kwb_Wu16 602.000000000 SigName 0.00 602.000000000 FORMAT "%13.9" NUMBER 5 /end CHARACTERISTIC
/begin CHARACTERISTIC DSM_EnvDfp_AOHtCDHt2_C "Fehlerpfad spezifische Umweltbedingungen fuer Fehlerpfad Dfp_AOHtCDHt2" VAL_BLK 0x1CB938 Kwb_Wu16 602.000000000 SigName 0.00 602.000000000 FORMAT "%13.9" NUMBER 5 /end CHARACTERISTIC
/begin CHARACTERISTIC DSM_EnvDfp_AOHtCDHt3_C "Fehlerpfad spezifische Umweltbedingungen fuer Fehlerpfad Dfp_AOHtCDHt3" VAL_BLK 0x1CB942 Kwb_Wu16 602.000000000 SigName 0.00 602.000000000 FORMAT "%13.9" NUMBER 5 /end CHARACTERISTIC
/begin CHARACTERISTIC DSM_EnvDfp_APP1_C "Fehlerpfad spezifische Umweltbedingungen fuer Fehlerpfad Dfp_APP1" VAL_BLK 0x1CB94C Kwb_Wu16 602.000000000 SigName 0.00 602.000000000 FORMAT "%13.9" NUMBER 5 /end CHARACTERISTIC
/begin CHARACTERISTIC DSM_EnvDfp_APP2_C "Fehlerpfad spezifische Umweltbedingungen fuer Fehlerpfad Dfp_APP2" VAL_BLK 0x1CB956 Kwb_Wu16 602.000000000 SigName 0.00 602.000000000 FORMAT "%13.9" NUMBER 5 /end CHARACTERISTIC
/begin CHARACTERISTIC DSM_EnvDfp_APPCD_KickDown_C "Fehlerpfad spezifische Umweltbedingungen fuer Fehlerpfad Dfp_APPCD_KickDown" VAL_BLK 0x1CB960 Kwb_Wu16 602.000000000 SigName 0.00 602.000000000 FORMAT "%13.9" NUMBER 5 /end CHARACTERISTIC
/begin CHARACTERISTIC DSM_EnvDfp_APPSync_C "Fehlerpfad spezifische Umweltbedingungen fuer Fehlerpfad Dfp_APPSync" VAL_BLK 0x1CB96A Kwb_Wu16 602.000000000 SigName 0.00 602.000000000 FORMAT "%13.9" NUMBER 5 /end CHARACTERISTIC
/begin CHARACTERISTIC DSM_EnvDfp_APP_Npl_C "Fehlerpfad spezifische Umweltbedingungen fuer Fehlerpfad Dfp_APP_Npl" VAL_BLK 0x1CB974 Kwb_Wu16 602.000000000 SigName 0.00 602.000000000 FORMAT "%13.9" NUMBER 5 /end CHARACTERISTIC
/begin CHARACTERISTIC DSM_EnvDfp_APSCD_C "Fehlerpfad spezifische Umweltbedingungen fuer Fehlerpfad Dfp_APSCD" VAL_BLK 0x1CB97E Kwb_Wu16 602.000000000 SigName 0.00 602.000000000 FORMAT "%13.9" NUMBER 5 /end CHARACTERISTIC
/begin CHARACTERISTIC DSM_EnvDfp_AccPedPlausBrk_C "Fehlerpfad spezifische Umweltbedingungen fuer Fehlerpfad Dfp_AccPedPlausBrk" VAL_BLK 0x1CB988 Kwb_Wu16 602.000000000 SigName 0.00 602.000000000 FORMAT "%13.9" NUMBER 5 /end CHARACTERISTIC
/begin CHARACTERISTIC DSM_EnvDfp_AddPCD_C "Fehlerpfad spezifische Umweltbedingungen fuer Fehlerpfad Dfp_AddPCD" VAL_BLK 0x1CB992 Kwb_Wu16 602.000000000 SigName 0.00 602.000000000 FORMAT "%13.9" NUMBER 5 /end CHARACTERISTIC
/begin CHARACTERISTIC DSM_EnvDfp_AddPCDTnkLvl_C "Fehlerpfad spezifische Umweltbedingungen fuer Fehlerpfad Dfp_AddPCDTnkLvl" VAL_BLK 0x1CB99C Kwb_Wu16 602.000000000 SigName 0.00 602.000000000 FORMAT "%13.9" NUMBER 5 /end CHARACTERISTIC
/begin CHARACTERISTIC DSM_EnvDfp_AddPCDTnkLvlDef_C "Fehlerpfad spezifische Umweltbedingungen fuer Fehlerpfad Dfp_AddPCDTnkLvlDef" VAL_BLK 0x1CB9A6 Kwb_Wu16 602.000000000 SigName 0.00 602.000000000 FORMAT "%13.9" NUMBER 5 /end CHARACTERISTIC
/begin CHARACTERISTIC DSM_EnvDfp_AirCtl_GovDev_C "Fehlerpfad spezifische Umweltbedingungen fuer Fehlerpfad Dfp_AirCtl_GovDev" VAL_BLK 0x1CB9B0 Kwb_Wu16 602.000000000 SigName 0.00 602.000000000 FORMAT "%13.9" NUMBER 5 /end CHARACTERISTIC
/begin CHARACTERISTIC DSM_EnvDfp_AirbCDCrash_C "Fehlerpfad spezifische Umweltbedingungen fuer Fehlerpfad Dfp_AirbCDCrash" VAL_BLK 0x1CB9BA Kwb_Wu16 602.000000000 SigName 0.00 602.000000000 FORMAT "%13.9" NUMBER 5 /end CHARACTERISTIC
/begin CHARACTERISTIC DSM_EnvDfp_AirbCDCrashCrCtl_C "Fehlerpfad spezifische Umweltbedingungen fuer Fehlerpfad Dfp_AirbCDCrashCrCtl" VAL_BLK 0x1CB9C4 Kwb_Wu16 602.000000000 SigName 0.00 602.000000000 FORMAT "%13.9" NUMBER 5 /end CHARACTERISTIC
/begin CHARACTERISTIC DSM_EnvDfp_AirbCDCrashPSP_C "Fehlerpfad spezifische Umweltbedingungen fuer Fehlerpfad Dfp_AirbCDCrashPSP" VAL_BLK 0x1CB9CE Kwb_Wu16 602.000000000 SigName 0.00 602.000000000 FORMAT "%13.9" NUMBER 5 /end CHARACTERISTIC
/begin CHARACTERISTIC DSM_EnvDfp_AltCDExc_C "Fehlerpfad spezifische Umweltbedingungen fuer Fehlerpfad Dfp_AltCDExc" VAL_BLK 0x1CB9D8 Kwb_Wu16 602.000000000 SigName 0.00 602.000000000 FORMAT "%13.9" NUMBER 5 /end CHARACTERISTIC
/begin CHARACTERISTIC DSM_EnvDfp_AltCD_Load_C "Fehlerpfad spezifische Umweltbedingungen fuer Fehlerpfad Dfp_AltCD_Load" VAL_BLK 0x1CB9E2 Kwb_Wu16 602.000000000 SigName 0.00 602.000000000 FORMAT "%13.9" NUMBER 5 /end CHARACTERISTIC
/begin CHARACTERISTIC DSM_EnvDfp_AltPwrCan_C "Fehlerpfad spezifische Umweltbedingungen fuer Fehlerpfad Dfp_AltPwrCan" VAL_BLK 0x1CB9EC Kwb_Wu16 602.000000000 SigName 0.00 602.000000000 FORMAT "%13.9" NUMBER 5 /end CHARACTERISTIC
/begin CHARACTERISTIC DSM_EnvDfp_BPACD_Max_C "Fehlerpfad spezifische Umweltbedingungen fuer Fehlerpfad Dfp_BPACD_Max" VAL_BLK 0x1CB9F6 Kwb_Wu16 602.000000000 SigName 0.00 602.000000000 FORMAT "%13.9" NUMBER 5 /end CHARACTERISTIC
/begin CHARACTERISTIC DSM_EnvDfp_BPACD_Min_C "Fehlerpfad spezifische Umweltbedingungen fuer Fehlerpfad Dfp_BPACD_Min" VAL_BLK 0x1CBA00 Kwb_Wu16 602.000000000 SigName 0.00 602.000000000 FORMAT "%13.9" NUMBER 5 /end CHARACTERISTIC
/begin CHARACTERISTIC DSM_EnvDfp_BPACD_SigNpl_C "Fehlerpfad spezifische Umweltbedingungen fuer Fehlerpfad Dfp_BPACD_SigNpl" VAL_BLK 0x1CBA0A Kwb_Wu16 602.000000000 SigName 0.00 602.000000000 FORMAT "%13.9" NUMBER 5 /end CHARACTERISTIC
/begin CHARACTERISTIC DSM_EnvDfp_BPAExcSensTemp_C "Fehlerpfad spezifische Umweltbedingungen fuer Fehlerpfad Dfp_BPAExcSensTemp" VAL_BLK 0x1CBA14 Kwb_Wu16 602.000000000 SigName 0.00 602.000000000 FORMAT "%13.9" NUMBER 5 /end CHARACTERISTIC
/begin CHARACTERISTIC DSM_EnvDfp_BPANotLrn_C "Fehlerpfad spezifische Umweltbedingungen fuer Fehlerpfad Dfp_BPANotLrn" VAL_BLK 0x1CBA1E Kwb_Wu16 602.000000000 SigName 0.00 602.000000000 FORMAT "%13.9" NUMBER 5 /end CHARACTERISTIC
/begin CHARACTERISTIC DSM_EnvDfp_BPASCDDcyc_C "Fehlerpfad spezifische Umweltbedingungen fuer Fehlerpfad Dfp_BPASCDDcyc" VAL_BLK 0x1CBA28 Kwb_Wu16 602.000000000 SigName 0.00 602.000000000 FORMAT "%13.9" NUMBER 5 /end CHARACTERISTIC
/begin CHARACTERISTIC DSM_EnvDfp_BPASCDPeriod_C "Fehlerpfad spezifische Umweltbedingungen fuer Fehlerpfad Dfp_BPASCDPeriod" VAL_BLK 0x1CBA32 Kwb_Wu16 602.000000000 SigName 0.00 602.000000000 FORMAT "%13.9" NUMBER 5 /end CHARACTERISTIC
/begin CHARACTERISTIC DSM_EnvDfp_BPSCD_C "Fehlerpfad spezifische Umweltbedingungen fuer Fehlerpfad Dfp_BPSCD" VAL_BLK 0x1CBA3C Kwb_Wu16 602.000000000 SigName 0.00 602.000000000 FORMAT "%13.9" NUMBER 5 /end CHARACTERISTIC
/begin CHARACTERISTIC DSM_EnvDfp_BPSCDPlaus_C "Fehlerpfad spezifische Umweltbedingungen fuer Fehlerpfad Dfp_BPSCDPlaus" VAL_BLK 0x1CBA46 Kwb_Wu16 602.000000000 SigName 0.00 602.000000000 FORMAT "%13.9" NUMBER 5 /end CHARACTERISTIC
/begin CHARACTERISTIC DSM_EnvDfp_BattCD_C "Fehlerpfad spezifische Umweltbedingungen fuer Fehlerpfad Dfp_BattCD" VAL_BLK 0x1CBA50 Kwb_Wu16 602.000000000 SigName 0.00 602.000000000 FORMAT "%13.9" NUMBER 5 /end CHARACTERISTIC
/begin CHARACTERISTIC DSM_EnvDfp_BrkCD_C "Fehlerpfad spezifische Umweltbedingungen fuer Fehlerpfad Dfp_BrkCD" VAL_BLK 0x1CBA5A Kwb_Wu16 602.000000000 SigName 0.00 602.000000000 FORMAT "%13.9" NUMBER 5 /end CHARACTERISTIC
/begin CHARACTERISTIC DSM_EnvDfp_BrkCDdynPl_C "Fehlerpfad spezifische Umweltbedingungen fuer Fehlerpfad Dfp_BrkCDdynPl" VAL_BLK 0x1CBA64 Kwb_Wu16 602.000000000 SigName 0.00 602.000000000 FORMAT "%13.9" NUMBER 5 /end CHARACTERISTIC
/begin CHARACTERISTIC DSM_EnvDfp_CANA_C "Fehlerpfad spezifische Umweltbedingungen fuer Fehlerpfad Dfp_CANA" VAL_BLK 0x1CBA6E Kwb_Wu16 602.000000000 SigName 0.00 602.000000000 FORMAT "%13.9" NUMBER 5 /end CHARACTERISTIC
/begin CHARACTERISTIC DSM_EnvDfp_CANB_C "Fehlerpfad spezifische Umweltbedingungen fuer Fehlerpfad Dfp_CANB" VAL_BLK 0x1CBA78 Kwb_Wu16 602.000000000 SigName 0.00 602.000000000 FORMAT "%13.9" NUMBER 5 /end CHARACTERISTIC
/begin CHARACTERISTIC DSM_EnvDfp_CANBus1_C "Fehlerpfad spezifische Umweltbedingungen fuer Fehlerpfad Dfp_CANBus1" VAL_BLK 0x1CBA82 Kwb_Wu16 602.000000000 SigName 0.00 602.000000000 FORMAT "%13.9" NUMBER 5 /end CHARACTERISTIC
/begin CHARACTERISTIC DSM_EnvDfp_CANBus2_C "Fehlerpfad spezifische Umweltbedingungen fuer Fehlerpfad Dfp_CANBus2" VAL_BLK 0x1CBA8C Kwb_Wu16 602.000000000 SigName 0.00 602.000000000 FORMAT "%13.9" NUMBER 5 /end CHARACTERISTIC
/begin CHARACTERISTIC DSM_EnvDfp_CANBus3_C "Fehlerpfad spezifische Umweltbedingungen fuer Fehlerpfad Dfp_CANBus3" VAL_BLK 0x1CBA96 Kwb_Wu16 602.000000000 SigName 0.00 602.000000000 FORMAT "%13.9" NUMBER 5 /end CHARACTERISTIC
/begin CHARACTERISTIC DSM_EnvDfp_CANC_C "Fehlerpfad spezifische Umweltbedingungen fuer Fehlerpfad Dfp_CANC" VAL_BLK 0x1CBAA0 Kwb_Wu16 602.000000000 SigName 0.00 602.000000000 FORMAT "%13.9" NUMBER 5 /end CHARACTERISTIC
/begin CHARACTERISTIC DSM_EnvDfp_CANErrActA_C "Fehlerpfad spezifische Umweltbedingungen fuer Fehlerpfad Dfp_CANErrActA" VAL_BLK 0x1CBAAA Kwb_Wu16 602.000000000 SigName 0.00 602.000000000 FORMAT "%13.9" NUMBER 5 /end CHARACTERISTIC
/begin CHARACTERISTIC DSM_EnvDfp_CANErrActB_C "Fehlerpfad spezifische Umweltbedingungen fuer Fehlerpfad Dfp_CANErrActB" VAL_BLK 0x1CBAB4 Kwb_Wu16 602.000000000 SigName 0.00 602.000000000 FORMAT "%13.9" NUMBER 5 /end CHARACTERISTIC
/begin CHARACTERISTIC DSM_EnvDfp_CANErrActC_C "Fehlerpfad spezifische Umweltbedingungen fuer Fehlerpfad Dfp_CANErrActC" VAL_BLK 0x1CBABE Kwb_Wu16 602.000000000 SigName 0.00 602.000000000 FORMAT "%13.9" NUMBER 5 /end CHARACTERISTIC
/begin CHARACTERISTIC DSM_EnvDfp_COTSCD_C "Fehlerpfad spezifische Umweltbedingungen fuer Fehlerpfad Dfp_COTSCD" VAL_BLK 0x1CBAC8 Kwb_Wu16 602.000000000 SigName 0.00 602.000000000 FORMAT "%13.9" NUMBER 5 /end CHARACTERISTIC
/begin CHARACTERISTIC DSM_EnvDfp_CTSCD_C "Fehlerpfad spezifische Umweltbedingungen fuer Fehlerpfad Dfp_CTSCD" VAL_BLK 0x1CBAD2 Kwb_Wu16 602.000000000 SigName 0.00 602.000000000 FORMAT "%13.9" NUMBER 5 /end CHARACTERISTIC
/begin CHARACTERISTIC DSM_EnvDfp_CTSCDCanInac_C "Fehlerpfad spezifische Umweltbedingungen fuer Fehlerpfad Dfp_CTSCDCanInac" VAL_BLK 0x1CBADC Kwb_Wu16 602.000000000 SigName 0.00 602.000000000 FORMAT "%13.9" NUMBER 5 /end CHARACTERISTIC
/begin CHARACTERISTIC DSM_EnvDfp_CTSCDCanSig_C "Fehlerpfad spezifische Umweltbedingungen fuer Fehlerpfad Dfp_CTSCDCanSig" VAL_BLK 0x1CBAE6 Kwb_Wu16 602.000000000 SigName 0.00 602.000000000 FORMAT "%13.9" NUMBER 5 /end CHARACTERISTIC
/begin CHARACTERISTIC DSM_EnvDfp_Clg_DynTst_C "Fehlerpfad spezifische Umweltbedingungen fuer Fehlerpfad Dfp_Clg_DynTst" VAL_BLK 0x1CBAF0 Kwb_Wu16 602.000000000 SigName 0.00 602.000000000 FORMAT "%13.9" NUMBER 5 /end CHARACTERISTIC
/begin CHARACTERISTIC DSM_EnvDfp_CmbChbMisfire1_C "Fehlerpfad spezifische Umweltbedingungen fuer Fehlerpfad Dfp_CmbChbMisfire1" VAL_BLK 0x1CBAFA Kwb_Wu16 602.000000000 SigName 0.00 602.000000000 FORMAT "%13.9" NUMBER 5 /end CHARACTERISTIC
/begin CHARACTERISTIC DSM_EnvDfp_CmbChbMisfire2_C "Fehlerpfad spezifische Umweltbedingungen fuer Fehlerpfad Dfp_CmbChbMisfire2" VAL_BLK 0x1CBB04 Kwb_Wu16 602.000000000 SigName 0.00 602.000000000 FORMAT "%13.9" NUMBER 5 /end CHARACTERISTIC
/begin CHARACTERISTIC DSM_EnvDfp_CmbChbMisfire3_C "Fehlerpfad spezifische Umweltbedingungen fuer Fehlerpfad Dfp_CmbChbMisfire3" VAL_BLK 0x1CBB0E Kwb_Wu16 602.000000000 SigName 0.00 602.000000000 FORMAT "%13.9" NUMBER 5 /end CHARACTERISTIC
/begin CHARACTERISTIC DSM_EnvDfp_CmbChbMisfire4_C "Fehlerpfad spezifische Umweltbedingungen fuer Fehlerpfad Dfp_CmbChbMisfire4" VAL_BLK 0x1CBB18 Kwb_Wu16 602.000000000 SigName 0.00 602.000000000 FORMAT "%13.9" NUMBER 5 /end CHARACTERISTIC
/begin CHARACTERISTIC DSM_EnvDfp_CmbChbMisfire5_C "Fehlerpfad spezifische Umweltbedingungen fuer Fehlerpfad Dfp_CmbChbMisfire5" VAL_BLK 0x1CBB22 Kwb_Wu16 602.000000000 SigName 0.00 602.000000000 FORMAT "%13.9" NUMBER 5 /end CHARACTERISTIC
/begin CHARACTERISTIC DSM_EnvDfp_CmbChbMisfire6_C "Fehlerpfad spezifische Umweltbedingungen fuer Fehlerpfad Dfp_CmbChbMisfire6" VAL_BLK 0x1CBB2C Kwb_Wu16 602.000000000 SigName 0.00 602.000000000 FORMAT "%13.9" NUMBER 5 /end CHARACTERISTIC
/begin CHARACTERISTIC DSM_EnvDfp_CmbChbMisfireMul_C "Fehlerpfad spezifische Umweltbedingungen fuer Fehlerpfad Dfp_CmbChbMisfireMul" VAL_BLK 0x1CBB36 Kwb_Wu16 602.000000000 SigName 0.00 602.000000000 FORMAT "%13.9" NUMBER 5 /end CHARACTERISTIC
/begin CHARACTERISTIC DSM_EnvDfp_CoVMDCSh_C "Fehlerpfad spezifische Umweltbedingungen fuer Fehlerpfad Dfp_CoVMDCSh" VAL_BLK 0x1CBB40 Kwb_Wu16 602.000000000 SigName 0.00 602.000000000 FORMAT "%13.9" NUMBER 5 /end CHARACTERISTIC
/begin CHARACTERISTIC DSM_EnvDfp_CoVMDCSp_C "Fehlerpfad spezifische Umweltbedingungen fuer Fehlerpfad Dfp_CoVMDCSp" VAL_BLK 0x1CBB4A Kwb_Wu16 602.000000000 SigName 0.00 602.000000000 FORMAT "%13.9" NUMBER 5 /end CHARACTERISTIC
/begin CHARACTERISTIC DSM_EnvDfp_CoVehEcoErr_C "Fehlerpfad spezifische Umweltbedingungen fuer Fehlerpfad Dfp_CoVehEcoErr" VAL_BLK 0x1CBB54 Kwb_Wu16 602.000000000 SigName 0.00 602.000000000 FORMAT "%13.9" NUMBER 5 /end CHARACTERISTIC
/begin CHARACTERISTIC DSM_EnvDfp_CoVehLvl2_C "Fehlerpfad spezifische Umweltbedingungen fuer Fehlerpfad Dfp_CoVehLvl2" VAL_BLK 0x1CBB5E Kwb_Wu16 602.000000000 SigName 0.00 602.000000000 FORMAT "%13.9" NUMBER 5 /end CHARACTERISTIC
/begin CHARACTERISTIC DSM_EnvDfp_ConvCD_C "Fehlerpfad spezifische Umweltbedingungen fuer Fehlerpfad Dfp_ConvCD" VAL_BLK 0x1CBB68 Kwb_Wu16 602.000000000 SigName 0.00 602.000000000 FORMAT "%13.9" NUMBER 5 /end CHARACTERISTIC
/begin CHARACTERISTIC DSM_EnvDfp_ConvCD_ConvErr_C "Fehlerpfad spezifische Umweltbedingungen fuer Fehlerpfad Dfp_ConvCD_ConvErr" VAL_BLK 0x1CBB72 Kwb_Wu16 602.000000000 SigName 0.00 602.000000000 FORMAT "%13.9" NUMBER 5 /end CHARACTERISTIC
/begin CHARACTERISTIC DSM_EnvDfp_CrCtlPLmpDef_C "Fehlerpfad spezifische Umweltbedingungen fuer Fehlerpfad Dfp_CrCtlPLmpDef" VAL_BLK 0x1CBB7C Kwb_Wu16 602.000000000 SigName 0.00 602.000000000 FORMAT "%13.9" NUMBER 5 /end CHARACTERISTIC
/begin CHARACTERISTIC DSM_EnvDfp_CrCtlPShutOff_C "Fehlerpfad spezifische Umweltbedingungen fuer Fehlerpfad Dfp_CrCtlPShutOff" VAL_BLK 0x1CBB86 Kwb_Wu16 602.000000000 SigName 0.00 602.000000000 FORMAT "%13.9" NUMBER 5 /end CHARACTERISTIC
/begin CHARACTERISTIC DSM_EnvDfp_CrCtlPTlrDef_C "Fehlerpfad spezifische Umweltbedingungen fuer Fehlerpfad Dfp_CrCtlPTlrDef" VAL_BLK 0x1CBB90 Kwb_Wu16 602.000000000 SigName 0.00 602.000000000 FORMAT "%13.9" NUMBER 5 /end CHARACTERISTIC
/begin CHARACTERISTIC DSM_EnvDfp_CrCtlPanErr_C "Fehlerpfad spezifische Umweltbedingungen fuer Fehlerpfad Dfp_CrCtlPanErr" VAL_BLK 0x1CBB9A Kwb_Wu16 602.000000000 SigName 0.00 602.000000000 FORMAT "%13.9" NUMBER 5 /end CHARACTERISTIC
/begin CHARACTERISTIC DSM_EnvDfp_CrCtlPanSwtErr_C "Fehlerpfad spezifische Umweltbedingungen fuer Fehlerpfad Dfp_CrCtlPanSwtErr" VAL_BLK 0x1CBBA4 Kwb_Wu16 602.000000000 SigName 0.00 602.000000000 FORMAT "%13.9" NUMBER 5 /end CHARACTERISTIC
/begin CHARACTERISTIC DSM_EnvDfp_CtApCD_C "Fehlerpfad spezifische Umweltbedingungen fuer Fehlerpfad Dfp_CtApCD" VAL_BLK 0x1CBBAE Kwb_Wu16 602.000000000 SigName 0.00 602.000000000 FORMAT "%13.9" NUMBER 5 /end CHARACTERISTIC
/begin CHARACTERISTIC DSM_EnvDfp_CtTCD_C "Fehlerpfad spezifische Umweltbedingungen fuer Fehlerpfad Dfp_CtTCD" VAL_BLK 0x1CBBB8 Kwb_Wu16 602.000000000 SigName 0.00 602.000000000 FORMAT "%13.9" NUMBER 5 /end CHARACTERISTIC
/begin CHARACTERISTIC DSM_EnvDfp_CtT_Mon_C "Fehlerpfad spezifische Umweltbedingungen fuer Fehlerpfad Dfp_CtT_Mon" VAL_BLK 0x1CBBC2 Kwb_Wu16 602.000000000 SigName 0.00 602.000000000 FORMAT "%13.9" NUMBER 5 /end CHARACTERISTIC
/begin CHARACTERISTIC DSM_EnvDfp_DifftrqLimErrPat_C "Fehlerpfad spezifische Umweltbedingungen fuer Fehlerpfad Dfp_DifftrqLimErrPat" VAL_BLK 0x1CBBCC Kwb_Wu16 602.000000000 SigName 0.00 602.000000000 FORMAT "%13.9" NUMBER 5 /end CHARACTERISTIC
/begin CHARACTERISTIC DSM_EnvDfp_EATSCD_C "Fehlerpfad spezifische Umweltbedingungen fuer Fehlerpfad Dfp_EATSCD" VAL_BLK 0x1CBBD6 Kwb_Wu16 602.000000000 SigName 0.00 602.000000000 FORMAT "%13.9" NUMBER 5 /end CHARACTERISTIC
/begin CHARACTERISTIC DSM_EnvDfp_EATSCDCanInac_C "Fehlerpfad spezifische Umweltbedingungen fuer Fehlerpfad Dfp_EATSCDCanInac" VAL_BLK 0x1CBBE0 Kwb_Wu16 602.000000000 SigName 0.00 602.000000000 FORMAT "%13.9" NUMBER 5 /end CHARACTERISTIC
/begin CHARACTERISTIC DSM_EnvDfp_EATSCDCanSig_C "Fehlerpfad spezifische Umweltbedingungen fuer Fehlerpfad Dfp_EATSCDCanSig" VAL_BLK 0x1CBBEA Kwb_Wu16 602.000000000 SigName 0.00 602.000000000 FORMAT "%13.9" NUMBER 5 /end CHARACTERISTIC
/begin CHARACTERISTIC DSM_EnvDfp_EEPCDVarMng_C "Fehlerpfad spezifische Umweltbedingungen fuer Fehlerpfad Dfp_EEPCDVarMng" VAL_BLK 0x1CBBF4 Kwb_Wu16 602.000000000 SigName 0.00 602.000000000 FORMAT "%13.9" NUMBER 5 /end CHARACTERISTIC
/begin CHARACTERISTIC DSM_EnvDfp_EGPpCDTPreTrbn_C "Fehlerpfad spezifische Umweltbedingungen fuer Fehlerpfad Dfp_EgPpCDTPreTrbn" VAL_BLK 0x1CBBFE Kwb_Wu16 602.000000000 SigName 0.00 602.000000000 FORMAT "%13.9" NUMBER 5 /end CHARACTERISTIC
/begin CHARACTERISTIC DSM_EnvDfp_EGPpCDTPreTrbn1_C "Fehlerpfad spezifische Umweltbedingungen fuer Fehlerpfad Dfp_EGPpCDTPreTrbn1" VAL_BLK 0x1CBC08 Kwb_Wu16 602.000000000 SigName 0.00 602.000000000 FORMAT "%13.9" NUMBER 5 /end CHARACTERISTIC
/begin CHARACTERISTIC DSM_EnvDfp_EGRCD_CBV_C "Fehlerpfad spezifische Umweltbedingungen fuer Fehlerpfad Dfp_EGRCD_CBV" VAL_BLK 0x1CBC12 Kwb_Wu16 602.000000000 SigName 0.00 602.000000000 FORMAT "%13.9" NUMBER 5 /end CHARACTERISTIC
/begin CHARACTERISTIC DSM_EnvDfp_EGRCD_Max_C "Fehlerpfad spezifische Umweltbedingungen fuer Fehlerpfad Dfp_EGRCD_Max" VAL_BLK 0x1CBC1C Kwb_Wu16 602.000000000 SigName 0.00 602.000000000 FORMAT "%13.9" NUMBER 5 /end CHARACTERISTIC
/begin CHARACTERISTIC DSM_EnvDfp_EGRCD_Min_C "Fehlerpfad spezifische Umweltbedingungen fuer Fehlerpfad Dfp_EGRCD_Min" VAL_BLK 0x1CBC26 Kwb_Wu16 602.000000000 SigName 0.00 602.000000000 FORMAT "%13.9" NUMBER 5 /end CHARACTERISTIC
/begin CHARACTERISTIC DSM_EnvDfp_EGRCD_SigNpl_C "Fehlerpfad spezifische Umweltbedingungen fuer Fehlerpfad Dfp_EGRCD_SigNpl" VAL_BLK 0x1CBC30 Kwb_Wu16 602.000000000 SigName 0.00 602.000000000 FORMAT "%13.9" NUMBER 5 /end CHARACTERISTIC
/begin CHARACTERISTIC DSM_EnvDfp_EMCCD_GTL1_C "Fehlerpfad spezifische Umweltbedingungen fuer Fehlerpfad Dfp_EMCCD_GTL1" VAL_BLK 0x1CBC3A Kwb_Wu16 602.000000000 SigName 0.00 602.000000000 FORMAT "%13.9" NUMBER 5 /end CHARACTERISTIC
/begin CHARACTERISTIC DSM_EnvDfp_EMCCD_GTL2_C "Fehlerpfad spezifische Umweltbedingungen fuer Fehlerpfad Dfp_EMCCD_GTL2" VAL_BLK 0x1CBC44 Kwb_Wu16 602.000000000 SigName 0.00 602.000000000 FORMAT "%13.9" NUMBER 5 /end CHARACTERISTIC
/begin CHARACTERISTIC DSM_EnvDfp_EMCCD_MLS1_C "Fehlerpfad spezifische Umweltbedingungen fuer Fehlerpfad Dfp_EMCCD_MLS1" VAL_BLK 0x1CBC4E Kwb_Wu16 602.000000000 SigName 0.00 602.000000000 FORMAT "%13.9" NUMBER 5 /end CHARACTERISTIC
/begin CHARACTERISTIC DSM_EnvDfp_EMCCD_MLS2_C "Fehlerpfad spezifische Umweltbedingungen fuer Fehlerpfad Dfp_EMCCD_MLS2" VAL_BLK 0x1CBC58 Kwb_Wu16 602.000000000 SigName 0.00 602.000000000 FORMAT "%13.9" NUMBER 5 /end CHARACTERISTIC
/begin CHARACTERISTIC DSM_EnvDfp_ETClbInj1_C "Fehlerpfad spezifische Umweltbedingungen fuer Fehlerpfad Dfp_ETClbInj1" VAL_BLK 0x1CBC62 Kwb_Wu16 602.000000000 SigName 0.00 602.000000000 FORMAT "%13.9" NUMBER 5 /end CHARACTERISTIC
/begin CHARACTERISTIC DSM_EnvDfp_ETClbInj2_C "Fehlerpfad spezifische Umweltbedingungen fuer Fehlerpfad Dfp_ETClbInj2" VAL_BLK 0x1CBC6C Kwb_Wu16 602.000000000 SigName 0.00 602.000000000 FORMAT "%13.9" NUMBER 5 /end CHARACTERISTIC
/begin CHARACTERISTIC DSM_EnvDfp_ETClbInj3_C "Fehlerpfad spezifische Umweltbedingungen fuer Fehlerpfad Dfp_ETClbInj3" VAL_BLK 0x1CBC76 Kwb_Wu16 602.000000000 SigName 0.00 602.000000000 FORMAT "%13.9" NUMBER 5 /end CHARACTERISTIC
/begin CHARACTERISTIC DSM_EnvDfp_ETClbInj4_C "Fehlerpfad spezifische Umweltbedingungen fuer Fehlerpfad Dfp_ETClbInj4" VAL_BLK 0x1CBC80 Kwb_Wu16 602.000000000 SigName 0.00 602.000000000 FORMAT "%13.9" NUMBER 5 /end CHARACTERISTIC
/begin CHARACTERISTIC DSM_EnvDfp_ETClbInj5_C "Fehlerpfad spezifische Umweltbedingungen fuer Fehlerpfad Dfp_ETClbInj5" VAL_BLK 0x1CBC8A Kwb_Wu16 602.000000000 SigName 0.00 602.000000000 FORMAT "%13.9" NUMBER 5 /end CHARACTERISTIC
/begin CHARACTERISTIC DSM_EnvDfp_ETClbInj6_C "Fehlerpfad spezifische Umweltbedingungen fuer Fehlerpfad Dfp_ETClbInj6" VAL_BLK 0x1CBC94 Kwb_Wu16 602.000000000 SigName 0.00 602.000000000 FORMAT "%13.9" NUMBER 5 /end CHARACTERISTIC
/begin CHARACTERISTIC DSM_EnvDfp_EngMCaS1_C "Fehlerpfad spezifische Umweltbedingungen fuer Fehlerpfad Dfp_EngMCaS1" VAL_BLK 0x1CBC9E Kwb_Wu16 602.000000000 SigName 0.00 602.000000000 FORMAT "%13.9" NUMBER 5 /end CHARACTERISTIC
/begin CHARACTERISTIC DSM_EnvDfp_EngMCrS1_C "Fehlerpfad spezifische Umweltbedingungen fuer Fehlerpfad Dfp_EngMCrS1" VAL_BLK 0x1CBCA8 Kwb_Wu16 602.000000000 SigName 0.00 602.000000000 FORMAT "%13.9" NUMBER 5 /end CHARACTERISTIC
/begin CHARACTERISTIC DSM_EnvDfp_EngMOfsCaSCrS_C "Fehlerpfad spezifische Umweltbedingungen fuer Fehlerpfad Dfp_EngMOfsCaSCrS" VAL_BLK 0x1CBCB2 Kwb_Wu16 602.000000000 SigName 0.00 602.000000000 FORMAT "%13.9" NUMBER 5 /end CHARACTERISTIC
/begin CHARACTERISTIC DSM_EnvDfp_EngMonIrrCmb_C "Fehlerpfad spezifische Umweltbedingungen fuer Fehlerpfad Dfp_EngMonIrrCmb" VAL_BLK 0x1CBCBC Kwb_Wu16 602.000000000 SigName 0.00 602.000000000 FORMAT "%13.9" NUMBER 5 /end CHARACTERISTIC
/begin CHARACTERISTIC DSM_EnvDfp_EngPrt_C "Fehlerpfad spezifische Umweltbedingungen fuer Fehlerpfad Dfp_EngPrt" VAL_BLK 0x1CBCC6 Kwb_Wu16 602.000000000 SigName 0.00 602.000000000 FORMAT "%13.9" NUMBER 5 /end CHARACTERISTIC
/begin CHARACTERISTIC DSM_EnvDfp_ErLpCDMILReqON_C "Fehlerpfad spezifische Umweltbedingungen fuer Fehlerpfad Dfp_ErLpCDMILReqON" VAL_BLK 0x1CBCD0 Kwb_Wu16 602.000000000 SigName 0.00 602.000000000 FORMAT "%13.9" NUMBER 5 /end CHARACTERISTIC
/begin CHARACTERISTIC DSM_EnvDfp_FMTC_NonMonotonMap_C "Fehlerpfad spezifische Umweltbedingungen fuer Fehlerpfad Dfp_FMTC_NonMonotonMap" VAL_BLK 0x1CBCDA Kwb_Wu16 602.000000000 SigName 0.00 602.000000000 FORMAT "%13.9" NUMBER 5 /end CHARACTERISTIC
/begin CHARACTERISTIC DSM_EnvDfp_FQlSCD_C "Fehlerpfad spezifische Umweltbedingungen fuer Fehlerpfad Dfp_FQlSCD" VAL_BLK 0x1CBCE4 Kwb_Wu16 602.000000000 SigName 0.00 602.000000000 FORMAT "%13.9" NUMBER 5 /end CHARACTERISTIC
/begin CHARACTERISTIC DSM_EnvDfp_FTSCD_C "Fehlerpfad spezifische Umweltbedingungen fuer Fehlerpfad Dfp_FTSCD" VAL_BLK 0x1CBCEE Kwb_Wu16 602.000000000 SigName 0.00 602.000000000 FORMAT "%13.9" NUMBER 5 /end CHARACTERISTIC
/begin CHARACTERISTIC DSM_EnvDfp_FTSCDNpl_C "Fehlerpfad spezifische Umweltbedingungen fuer Fehlerpfad Dfp_FTSCDNpl" VAL_BLK 0x1CBCF8 Kwb_Wu16 602.000000000 SigName 0.00 602.000000000 FORMAT "%13.9" NUMBER 5 /end CHARACTERISTIC
/begin CHARACTERISTIC DSM_EnvDfp_FanCD_Fan1Ctlr1_C "Fehlerpfad spezifische Umweltbedingungen fuer Fehlerpfad Dfp_FanCD_Fan1Ctlr1" VAL_BLK 0x1CBD02 Kwb_Wu16 602.000000000 SigName 0.00 602.000000000 FORMAT "%13.9" NUMBER 5 /end CHARACTERISTIC
/begin CHARACTERISTIC DSM_EnvDfp_FanCD_Fan1Ctlr2_C "Fehlerpfad spezifische Umweltbedingungen fuer Fehlerpfad Dfp_FanCD_Fan1Ctlr2" VAL_BLK 0x1CBD0C Kwb_Wu16 602.000000000 SigName 0.00 602.000000000 FORMAT "%13.9" NUMBER 5 /end CHARACTERISTIC
/begin CHARACTERISTIC DSM_EnvDfp_FanCD_Fan2Ctlr1_C "Fehlerpfad spezifische Umweltbedingungen fuer Fehlerpfad Dfp_FanCD_Fan2Ctlr1" VAL_BLK 0x1CBD16 Kwb_Wu16 602.000000000 SigName 0.00 602.000000000 FORMAT "%13.9" NUMBER 5 /end CHARACTERISTIC
/begin CHARACTERISTIC DSM_EnvDfp_FanCD_Fan2Ctlr2_C "Fehlerpfad spezifische Umweltbedingungen fuer Fehlerpfad Dfp_FanCD_Fan2Ctlr2" VAL_BLK 0x1CBD20 Kwb_Wu16 602.000000000 SigName 0.00 602.000000000 FORMAT "%13.9" NUMBER 5 /end CHARACTERISTIC
/begin CHARACTERISTIC DSM_EnvDfp_FanCD_FanCtlr1_C "Fehlerpfad spezifische Umweltbedingungen fuer Fehlerpfad Dfp_FanCD_FanCtlr1" VAL_BLK 0x1CBD2A Kwb_Wu16 602.000000000 SigName 0.00 602.000000000 FORMAT "%13.9" NUMBER 5 /end CHARACTERISTIC
/begin CHARACTERISTIC DSM_EnvDfp_FanCD_FanCtlr2_C "Fehlerpfad spezifische Umweltbedingungen fuer Fehlerpfad Dfp_FanCD_FanCtlr2" VAL_BLK 0x1CBD34 Kwb_Wu16 602.000000000 SigName 0.00 602.000000000 FORMAT "%13.9" NUMBER 5 /end CHARACTERISTIC
/begin CHARACTERISTIC DSM_EnvDfp_FanCD_OutFanCtlr1_C "Fehlerpfad spezifische Umweltbedingungen fuer Fehlerpfad Dfp_FanCD_OutFanCtlr1" VAL_BLK 0x1CBD3E Kwb_Wu16 602.000000000 SigName 0.00 602.000000000 FORMAT "%13.9" NUMBER 5 /end CHARACTERISTIC
/begin CHARACTERISTIC DSM_EnvDfp_FanCD_OutFanCtlr2_C "Fehlerpfad spezifische Umweltbedingungen fuer Fehlerpfad Dfp_FanCD_OutFanCtlr2" VAL_BLK 0x1CBD48 Kwb_Wu16 602.000000000 SigName 0.00 602.000000000 FORMAT "%13.9" NUMBER 5 /end CHARACTERISTIC
/begin CHARACTERISTIC DSM_EnvDfp_FlPpCD_C "Fehlerpfad spezifische Umweltbedingungen fuer Fehlerpfad Dfp_FlPpCD" VAL_BLK 0x1CBD52 Kwb_Wu16 602.000000000 SigName 0.00 602.000000000 FORMAT "%13.9" NUMBER 5 /end CHARACTERISTIC
/begin CHARACTERISTIC DSM_EnvDfp_FlSCDT1_C "Fehlerpfad spezifische Umweltbedingungen fuer Fehlerpfad Dfp_FlSCDT1" VAL_BLK 0x1CBD5C Kwb_Wu16 602.000000000 SigName 0.00 602.000000000 FORMAT "%13.9" NUMBER 5 /end CHARACTERISTIC
/begin CHARACTERISTIC DSM_EnvDfp_FrmMngAAGNpl_C "Fehlerpfad spezifische Umweltbedingungen fuer Fehlerpfad Dfp_FrmMngAAGNpl" VAL_BLK 0x1CBD66 Kwb_Wu16 602.000000000 SigName 0.00 602.000000000 FORMAT "%13.9" NUMBER 5 /end CHARACTERISTIC
/begin CHARACTERISTIC DSM_EnvDfp_FrmMngAAGTO_C "Fehlerpfad spezifische Umweltbedingungen fuer Fehlerpfad Dfp_FrmMngAAGTO" VAL_BLK 0x1CBD70 Kwb_Wu16 602.000000000 SigName 0.00 602.000000000 FORMAT "%13.9" NUMBER 5 /end CHARACTERISTIC
/begin CHARACTERISTIC DSM_EnvDfp_FrmMngAC1Npl_C "Fehlerpfad spezifische Umweltbedingungen fuer Fehlerpfad Dfp_FrmMngAC1Npl" VAL_BLK 0x1CBD7A Kwb_Wu16 602.000000000 SigName 0.00 602.000000000 FORMAT "%13.9" NUMBER 5 /end CHARACTERISTIC
/begin CHARACTERISTIC DSM_EnvDfp_FrmMngAC1TO_C "Fehlerpfad spezifische Umweltbedingungen fuer Fehlerpfad Dfp_FrmMngAC1TO" VAL_BLK 0x1CBD84 Kwb_Wu16 602.000000000 SigName 0.00 602.000000000 FORMAT "%13.9" NUMBER 5 /end CHARACTERISTIC
/begin CHARACTERISTIC DSM_EnvDfp_FrmMngACCNpl_C "Fehlerpfad spezifische Umweltbedingungen fuer Fehlerpfad Dfp_FrmMngACCNpl" VAL_BLK 0x1CBD8E Kwb_Wu16 602.000000000 SigName 0.00 602.000000000 FORMAT "%13.9" NUMBER 5 /end CHARACTERISTIC
/begin CHARACTERISTIC DSM_EnvDfp_FrmMngACCTO_C "Fehlerpfad spezifische Umweltbedingungen fuer Fehlerpfad Dfp_FrmMngACCTO" VAL_BLK 0x1CBD98 Kwb_Wu16 602.000000000 SigName 0.00 602.000000000 FORMAT "%13.9" NUMBER 5 /end CHARACTERISTIC
/begin CHARACTERISTIC DSM_EnvDfp_FrmMngAIRBGNpl_C "Fehlerpfad spezifische Umweltbedingungen fuer Fehlerpfad Dfp_FrmMngAIRBGNpl" VAL_BLK 0x1CBDA2 Kwb_Wu16 602.000000000 SigName 0.00 602.000000000 FORMAT "%13.9" NUMBER 5 /end CHARACTERISTIC
/begin CHARACTERISTIC DSM_EnvDfp_FrmMngAIRBGTO_C "Fehlerpfad spezifische Umweltbedingungen fuer Fehlerpfad Dfp_FrmMngAIRBGTO" VAL_BLK 0x1CBDAC Kwb_Wu16 602.000000000 SigName 0.00 602.000000000 FORMAT "%13.9" NUMBER 5 /end CHARACTERISTIC
/begin CHARACTERISTIC DSM_EnvDfp_FrmMngAWD1Npl_C "Fehlerpfad spezifische Umweltbedingungen fuer Fehlerpfad Dfp_FrmMngAWD1Npl" VAL_BLK 0x1CBDB6 Kwb_Wu16 602.000000000 SigName 0.00 602.000000000 FORMAT "%13.9" NUMBER 5 /end CHARACTERISTIC
/begin CHARACTERISTIC DSM_EnvDfp_FrmMngAWD1TO_C "Fehlerpfad spezifische Umweltbedingungen fuer Fehlerpfad Dfp_FrmMngAWD1TO" VAL_BLK 0x1CBDC0 Kwb_Wu16 602.000000000 SigName 0.00 602.000000000 FORMAT "%13.9" NUMBER 5 /end CHARACTERISTIC
/begin CHARACTERISTIC DSM_EnvDfp_FrmMngBEM1Npl_C "Fehlerpfad spezifische Umweltbedingungen für Fehlerpfad Dfp_FrmMngBEM1Npl" VAL_BLK 0x1CBDCA Kwb_Wu16 602.000000000 SigName 0.00 602.000000000 FORMAT "%13.9" NUMBER 5 /end CHARACTERISTIC
/begin CHARACTERISTIC DSM_EnvDfp_FrmMngBEM1TO_C "Fehlerpfad spezifische Umweltbedingungen fuer Fehlerpfad Dfp_FrmMngBEM1TO" VAL_BLK 0x1CBDD4 Kwb_Wu16 602.000000000 SigName 0.00 602.000000000 FORMAT "%13.9" NUMBER 5 /end CHARACTERISTIC
/begin CHARACTERISTIC DSM_EnvDfp_FrmMngBRK1Npl_C "Fehlerpfad spezifische Umweltbedingungen fuer Fehlerpfad Dfp_FrmMngBRK1Npl" VAL_BLK 0x1CBDDE Kwb_Wu16 602.000000000 SigName 0.00 602.000000000 FORMAT "%13.9" NUMBER 5 /end CHARACTERISTIC
/begin CHARACTERISTIC DSM_EnvDfp_FrmMngBRK1TO_C "Fehlerpfad spezifische Umweltbedingungen fuer Fehlerpfad Dfp_FrmMngBRK1TO" VAL_BLK 0x1CBDE8 Kwb_Wu16 602.000000000 SigName 0.00 602.000000000 FORMAT "%13.9" NUMBER 5 /end CHARACTERISTIC
/begin CHARACTERISTIC DSM_EnvDfp_FrmMngBRK2Npl_C "Fehlerpfad spezifische Umweltbedingungen fuer Fehlerpfad Dfp_FrmMngBRK2Npl" VAL_BLK 0x1CBDF2 Kwb_Wu16 602.000000000 SigName 0.00 602.000000000 FORMAT "%13.9" NUMBER 5 /end CHARACTERISTIC
/begin CHARACTERISTIC DSM_EnvDfp_FrmMngBRK2TO_C "Fehlerpfad spezifische Umweltbedingungen fuer Fehlerpfad Dfp_FrmMngBRK2TO" VAL_BLK 0x1CBDFC Kwb_Wu16 602.000000000 SigName 0.00 602.000000000 FORMAT "%13.9" NUMBER 5 /end CHARACTERISTIC
/begin CHARACTERISTIC DSM_EnvDfp_FrmMngBRK8Npl_C "Fehlerpfad spezifische Umweltbedingungen fuer Fehlerpfad Dfp_FrmMngBRK8Npl" VAL_BLK 0x1CBE06 Kwb_Wu16 602.000000000 SigName 0.00 602.000000000 FORMAT "%13.9" NUMBER 5 /end CHARACTERISTIC
/begin CHARACTERISTIC DSM_EnvDfp_FrmMngBRK8TO_C "Fehlerpfad spezifische Umweltbedingungen fuer Fehlerpfad Dfp_FrmMngBRK8TO" VAL_BLK 0x1CBE10 Kwb_Wu16 602.000000000 SigName 0.00 602.000000000 FORMAT "%13.9" NUMBER 5 /end CHARACTERISTIC
/begin CHARACTERISTIC DSM_EnvDfp_FrmMngCANVerErr_C "Fehlerpfad spezifische Umweltbedingungen fuer Fehlerpfad Dfp_FrmMngCANVerErr" VAL_BLK 0x1CBE1A Kwb_Wu16 602.000000000 SigName 0.00 602.000000000 FORMAT "%13.9" NUMBER 5 /end CHARACTERISTIC
/begin CHARACTERISTIC DSM_EnvDfp_FrmMngCCSel_C "Fehlerpfad spezifische Umweltbedingungen fuer Fehlerpfad Dfp_FrmMngCCSel_C" VAL_BLK 0x1CBE24 Kwb_Wu16 602.000000000 SigName 0.00 602.000000000 FORMAT "%13.9" NUMBER 5 /end CHARACTERISTIC
/begin CHARACTERISTIC DSM_EnvDfp_FrmMngCCTLNpl_C "Fehlerpfad spezifische Umweltbedingungen fuer Fehlerpfad Dfp_FrmMngCCTLNpl" VAL_BLK 0x1CBE2E Kwb_Wu16 602.000000000 SigName 0.00 602.000000000 FORMAT "%13.9" NUMBER 5 /end CHARACTERISTIC
/begin CHARACTERISTIC DSM_EnvDfp_FrmMngCCTLTO_C "Fehlerpfad spezifische Umweltbedingungen fuer Fehlerpfad Dfp_FrmMngCCTLTO" VAL_BLK 0x1CBE38 Kwb_Wu16 602.000000000 SigName 0.00 602.000000000 FORMAT "%13.9" NUMBER 5 /end CHARACTERISTIC
/begin CHARACTERISTIC DSM_EnvDfp_FrmMngCHRGR1Npl_C "Fehlerpfad spezifische Umweltbedingungen fuer Fehlerpfad Dfp_FrmMngCHRGR1Npl" VAL_BLK 0x1CBE42 Kwb_Wu16 602.000000000 SigName 0.00 602.000000000 FORMAT "%13.9" NUMBER 5 /end CHARACTERISTIC
/begin CHARACTERISTIC DSM_EnvDfp_FrmMngCHRGR1TO_C "Fehlerpfad spezifische Umweltbedingungen fuer Fehlerpfad Dfp_FrmMngCHRGR1TO" VAL_BLK 0x1CBE4C Kwb_Wu16 602.000000000 SigName 0.00 602.000000000 FORMAT "%13.9" NUMBER 5 /end CHARACTERISTIC
/begin CHARACTERISTIC DSM_EnvDfp_FrmMngCHRGR2Npl_C "Fehlerpfad spezifische Umweltbedingungen fuer Fehlerpfad Dfp_FrmMngCHRGR2Npl" VAL_BLK 0x1CBE56 Kwb_Wu16 602.000000000 SigName 0.00 602.000000000 FORMAT "%13.9" NUMBER 5 /end CHARACTERISTIC
/begin CHARACTERISTIC DSM_EnvDfp_FrmMngCHRGR2TO_C "Fehlerpfad spezifische Umweltbedingungen fuer Fehlerpfad Dfp_FrmMngCHRGR2TO" VAL_BLK 0x1CBE60 Kwb_Wu16 602.000000000 SigName 0.00 602.000000000 FORMAT "%13.9" NUMBER 5 /end CHARACTERISTIC
/begin CHARACTERISTIC DSM_EnvDfp_FrmMngChrgr1A_C "Fehlerpfad spezifische Umweltbedingungen fuer Fehlerpfad Dfp_FrmMngChrgr1A" VAL_BLK 0x1CBE6A Kwb_Wu16 602.000000000 SigName 0.00 602.000000000 FORMAT "%13.9" NUMBER 5 /end CHARACTERISTIC
/begin CHARACTERISTIC DSM_EnvDfp_FrmMngChrgr1C_C "Fehlerpfad spezifische Umweltbedingungen fuer Fehlerpfad Dfp_FrmMngChrgr1C" VAL_BLK 0x1CBE74 Kwb_Wu16 602.000000000 SigName 0.00 602.000000000 FORMAT "%13.9" NUMBER 5 /end CHARACTERISTIC
/begin CHARACTERISTIC DSM_EnvDfp_FrmMngChrgr1N_C "Fehlerpfad spezifische Umweltbedingungen fuer Fehlerpfad Dfp_FrmMngChrgr1N" VAL_BLK 0x1CBE7E Kwb_Wu16 602.000000000 SigName 0.00 602.000000000 FORMAT "%13.9" NUMBER 5 /end CHARACTERISTIC
/begin CHARACTERISTIC DSM_EnvDfp_FrmMngChrgr1T_C "Fehlerpfad spezifische Umweltbedingungen fuer Fehlerpfad Dfp_FrmMngChrgr1T" VAL_BLK 0x1CBE88 Kwb_Wu16 602.000000000 SigName 0.00 602.000000000 FORMAT "%13.9" NUMBER 5 /end CHARACTERISTIC
/begin CHARACTERISTIC DSM_EnvDfp_FrmMngChrgr1V_C "Fehlerpfad spezifische Umweltbedingungen fuer Fehlerpfad Dfp_FrmMngChrgr1V" VAL_BLK 0x1CBE92 Kwb_Wu16 602.000000000 SigName 0.00 602.000000000 FORMAT "%13.9" NUMBER 5 /end CHARACTERISTIC
/begin CHARACTERISTIC DSM_EnvDfp_FrmMngChrgr2A_C "Fehlerpfad spezifische Umweltbedingungen fuer Fehlerpfad Dfp_FrmMngChrgr2A" VAL_BLK 0x1CBE9C Kwb_Wu16 602.000000000 SigName 0.00 602.000000000 FORMAT "%13.9" NUMBER 5 /end CHARACTERISTIC
/begin CHARACTERISTIC DSM_EnvDfp_FrmMngChrgr2C_C "Fehlerpfad spezifische Umweltbedingungen fuer Fehlerpfad Dfp_FrmMngChrgr2C" VAL_BLK 0x1CBEA6 Kwb_Wu16 602.000000000 SigName 0.00 602.000000000 FORMAT "%13.9" NUMBER 5 /end CHARACTERISTIC
/begin CHARACTERISTIC DSM_EnvDfp_FrmMngChrgr2N_C "Fehlerpfad spezifische Umweltbedingungen fuer Fehlerpfad Dfp_FrmMngChrgr2N" VAL_BLK 0x1CBEB0 Kwb_Wu16 602.000000000 SigName 0.00 602.000000000 FORMAT "%13.9" NUMBER 5 /end CHARACTERISTIC
/begin CHARACTERISTIC DSM_EnvDfp_FrmMngChrgr2T_C "Fehlerpfad spezifische Umweltbedingungen fuer Fehlerpfad Dfp_FrmMngChrgr2T" VAL_BLK 0x1CBEBA Kwb_Wu16 602.000000000 SigName 0.00 602.000000000 FORMAT "%13.9" NUMBER 5 /end CHARACTERISTIC
/begin CHARACTERISTIC DSM_EnvDfp_FrmMngChrgr2V_C "Fehlerpfad spezifische Umweltbedingungen fuer Fehlerpfad Dfp_FrmMngChrgr2V" VAL_BLK 0x1CBEC4 Kwb_Wu16 602.000000000 SigName 0.00 602.000000000 FORMAT "%13.9" NUMBER 5 /end CHARACTERISTIC
/begin CHARACTERISTIC DSM_EnvDfp_FrmMngDIA1Npl_C "Fehlerpfad spezifische Umweltbedingungen fuer Fehlerpfad Dfp_FrmMngDIA1Npl" VAL_BLK 0x1CBECE Kwb_Wu16 602.000000000 SigName 0.00 602.000000000 FORMAT "%13.9" NUMBER 5 /end CHARACTERISTIC
/begin CHARACTERISTIC DSM_EnvDfp_FrmMngDIA1TO_C "Fehlerpfad spezifische Umweltbedingungen fuer Fehlerpfad Dfp_FrmMngDIA1TO" VAL_BLK 0x1CBED8 Kwb_Wu16 602.000000000 SigName 0.00 602.000000000 FORMAT "%13.9" NUMBER 5 /end CHARACTERISTIC
/begin CHARACTERISTIC DSM_EnvDfp_FrmMngDSP1Npl_C "Fehlerpfad spezifische Umweltbedingungen fuer Fehlerpfad Dfp_FrmMngDSP1Npl" VAL_BLK 0x1CBEE2 Kwb_Wu16 602.000000000 SigName 0.00 602.000000000 FORMAT "%13.9" NUMBER 5 /end CHARACTERISTIC
/begin CHARACTERISTIC DSM_EnvDfp_FrmMngDSP1TO_C "Fehlerpfad spezifische Umweltbedingungen fuer Fehlerpfad Dfp_FrmMngDSP1TO" VAL_BLK 0x1CBEEC Kwb_Wu16 602.000000000 SigName 0.00 602.000000000 FORMAT "%13.9" NUMBER 5 /end CHARACTERISTIC
/begin CHARACTERISTIC DSM_EnvDfp_FrmMngDSP2Npl_C "Fehlerpfad spezifische Umweltbedingungen fuer Fehlerpfad Dfp_FrmMngDSP2Npl" VAL_BLK 0x1CBEF6 Kwb_Wu16 602.000000000 SigName 0.00 602.000000000 FORMAT "%13.9" NUMBER 5 /end CHARACTERISTIC
/begin CHARACTERISTIC DSM_EnvDfp_FrmMngDSP2TO_C "Fehlerpfad spezifische Umweltbedingungen fuer Fehlerpfad Dfp_FrmMngDSP2TO" VAL_BLK 0x1CBF00 Kwb_Wu16 602.000000000 SigName 0.00 602.000000000 FORMAT "%13.9" NUMBER 5 /end CHARACTERISTIC
/begin CHARACTERISTIC DSM_EnvDfp_FrmMngESCUNpl_C "Fehlerpfad spezifische Umweltbedingungen fuer Fehlerpfad Dfp_FrmMngESCUNpl" VAL_BLK 0x1CBF0A Kwb_Wu16 602.000000000 SigName 0.00 602.000000000 FORMAT "%13.9" NUMBER 5 /end CHARACTERISTIC
/begin CHARACTERISTIC DSM_EnvDfp_FrmMngESCUTO_C "Fehlerpfad spezifische Umweltbedingungen fuer Fehlerpfad Dfp_FrmMngESCUTO" VAL_BLK 0x1CBF14 Kwb_Wu16 602.000000000 SigName 0.00 602.000000000 FORMAT "%13.9" NUMBER 5 /end CHARACTERISTIC
/begin CHARACTERISTIC DSM_EnvDfp_FrmMngGW1Npl_C "Fehlerpfad spezifische Umweltbedingungen fuer Fehlerpfad Dfp_FrmMngGW1Npl" VAL_BLK 0x1CBF1E Kwb_Wu16 602.000000000 SigName 0.00 602.000000000 FORMAT "%13.9" NUMBER 5 /end CHARACTERISTIC
/begin CHARACTERISTIC DSM_EnvDfp_FrmMngGW1TO_C "Fehlerpfad spezifische Umweltbedingungen fuer Fehlerpfad Dfp_FrmMngGW1TO" VAL_BLK 0x1CBF28 Kwb_Wu16 602.000000000 SigName 0.00 602.000000000 FORMAT "%13.9" NUMBER 5 /end CHARACTERISTIC
/begin CHARACTERISTIC DSM_EnvDfp_FrmMngILMNpl_C "Fehlerpfad spezifische Umweltbedingungen fuer Fehlerpfad Dfp_FrmMngILMNpl" VAL_BLK 0x1CBF32 Kwb_Wu16 602.000000000 SigName 0.00 602.000000000 FORMAT "%13.9" NUMBER 5 /end CHARACTERISTIC
/begin CHARACTERISTIC DSM_EnvDfp_FrmMngILMTO_C "Fehlerpfad spezifische Umweltbedingungen fuer Fehlerpfad Dfp_FrmMngILMTO" VAL_BLK 0x1CBF3C Kwb_Wu16 602.000000000 SigName 0.00 602.000000000 FORMAT "%13.9" NUMBER 5 /end CHARACTERISTIC
/begin CHARACTERISTIC DSM_EnvDfp_FrmMngNIV1WrngCod_C "Fehlerpfad spezifische Umweltbedingungen fuer Fehlerpfad Dfp_FrmMngNIV1WrngCod" VAL_BLK 0x1CBF46 Kwb_Wu16 602.000000000 SigName 0.00 602.000000000 FORMAT "%13.9" NUMBER 5 /end CHARACTERISTIC
/begin CHARACTERISTIC DSM_EnvDfp_FrmMngNIVEAU1Npl_C "Fehlerpfad spezifische Umweltbedingungen fuer Fehlerpfad Dfp_FrmMngNIVEAU1Npl" VAL_BLK 0x1CBF50 Kwb_Wu16 602.000000000 SigName 0.00 602.000000000 FORMAT "%13.9" NUMBER 5 /end CHARACTERISTIC
/begin CHARACTERISTIC DSM_EnvDfp_FrmMngNIVEAU1TO_C "Fehlerpfad spezifische Umweltbedingungen fuer Fehlerpfad Dfp_FrmMngNIVEAU1TO" VAL_BLK 0x1CBF5A Kwb_Wu16 602.000000000 SigName 0.00 602.000000000 FORMAT "%13.9" NUMBER 5 /end CHARACTERISTIC
/begin CHARACTERISTIC DSM_EnvDfp_FrmMngSTIGNNpl_C "Fehlerpfad spezifische Umweltbedingungen fuer Fehlerpfad Dfp_FrmMngSTIGNNpl" VAL_BLK 0x1CBF64 Kwb_Wu16 602.000000000 SigName 0.00 602.000000000 FORMAT "%13.9" NUMBER 5 /end CHARACTERISTIC
/begin CHARACTERISTIC DSM_EnvDfp_FrmMngStIgnTO_C "Fehlerpfad spezifische Umweltbedingungen fuer Fehlerpfad Dfp_FrmMngStIgnTO" VAL_BLK 0x1CBF6E Kwb_Wu16 602.000000000 SigName 0.00 602.000000000 FORMAT "%13.9" NUMBER 5 /end CHARACTERISTIC
/begin CHARACTERISTIC DSM_EnvDfp_FrmMngTOSNpl_C "Fehlerpfad spezifische Umweltbedingungen fuer Fehlerpfad Dfp_FrmMngTOSNpl" VAL_BLK 0x1CBF78 Kwb_Wu16 602.000000000 SigName 0.00 602.000000000 FORMAT "%13.9" NUMBER 5 /end CHARACTERISTIC
/begin CHARACTERISTIC DSM_EnvDfp_FrmMngTOSTO_C "Fehlerpfad spezifische Umweltbedingungen fuer Fehlerpfad Dfp_FrmMngTOSTO" VAL_BLK 0x1CBF82 Kwb_Wu16 602.000000000 SigName 0.00 602.000000000 FORMAT "%13.9" NUMBER 5 /end CHARACTERISTIC
/begin CHARACTERISTIC DSM_EnvDfp_FrmMngTSC1Npl_C "Fehlerpfad spezifische Umweltbedingungen fuer Fehlerpfad Dfp_FrmMngTSC1Npl" VAL_BLK 0x1CBF8C Kwb_Wu16 602.000000000 SigName 0.00 602.000000000 FORMAT "%13.9" NUMBER 5 /end CHARACTERISTIC
/begin CHARACTERISTIC DSM_EnvDfp_FrmMngTSC1TO_C "Fehlerpfad spezifische Umweltbedingungen fuer Fehlerpfad Dfp_FrmMngTSC1TO" VAL_BLK 0x1CBF96 Kwb_Wu16 602.000000000 SigName 0.00 602.000000000 FORMAT "%13.9" NUMBER 5 /end CHARACTERISTIC
/begin CHARACTERISTIC DSM_EnvDfp_FrmMngTSC2Npl_C "Fehlerpfad spezifische Umweltbedingungen fuer Fehlerpfad Dfp_FrmMngTSC2Npl" VAL_BLK 0x1CBFA0 Kwb_Wu16 602.000000000 SigName 0.00 602.000000000 FORMAT "%13.9" NUMBER 5 /end CHARACTERISTIC
/begin CHARACTERISTIC DSM_EnvDfp_FrmMngTSC2TO_C "Fehlerpfad spezifische Umweltbedingungen fuer Fehlerpfad Dfp_FrmMngTSC2TO" VAL_BLK 0x1CBFAA Kwb_Wu16 602.000000000 SigName 0.00 602.000000000 FORMAT "%13.9" NUMBER 5 /end CHARACTERISTIC
/begin CHARACTERISTIC DSM_EnvDfp_FrmMngTSC3Npl_C "Fehlerpfad spezifische Umweltbedingungen fuer Fehlerpfad Dfp_FrmMngTSC3Npl" VAL_BLK 0x1CBFB4 Kwb_Wu16 602.000000000 SigName 0.00 602.000000000 FORMAT "%13.9" NUMBER 5 /end CHARACTERISTIC
/begin CHARACTERISTIC DSM_EnvDfp_FrmMngTSC3TO_C "Fehlerpfad spezifische Umweltbedingungen fuer Fehlerpfad Dfp_FrmMngTSC3TO" VAL_BLK 0x1CBFBE Kwb_Wu16 602.000000000 SigName 0.00 602.000000000 FORMAT "%13.9" NUMBER 5 /end CHARACTERISTIC
/begin CHARACTERISTIC DSM_EnvDfp_GearbxASTh_C "Fehlerpfad spezifische Umweltbedingungen fuer Fehlerpfad Dfp_GearbxASTh" VAL_BLK 0x1CBFC8 Kwb_Wu16 602.000000000 SigName 0.00 602.000000000 FORMAT "%13.9" NUMBER 5 /end CHARACTERISTIC
/begin CHARACTERISTIC DSM_EnvDfp_GearbxASTl_C "Fehlerpfad spezifische Umweltbedingungen fuer Fehlerpfad Dfp_GearbxASTl" VAL_BLK 0x1CBFD2 Kwb_Wu16 602.000000000 SigName 0.00 602.000000000 FORMAT "%13.9" NUMBER 5 /end CHARACTERISTIC
/begin CHARACTERISTIC DSM_EnvDfp_GearbxTSC_C "Fehlerpfad spezifische Umweltbedingungen fuer Fehlerpfad Dfp_GearbxTSC" VAL_BLK 0x1CBFDC Kwb_Wu16 602.000000000 SigName 0.00 602.000000000 FORMAT "%13.9" NUMBER 5 /end CHARACTERISTIC
/begin CHARACTERISTIC DSM_EnvDfp_GearbxTypeMTErr_C "Fehlerpfad spezifische Umweltbedingungen fuer Fehlerpfad Dfp_GearbxTypeMTErr" VAL_BLK 0x1CBFE6 Kwb_Wu16 602.000000000 SigName 0.00 602.000000000 FORMAT "%13.9" NUMBER 5 /end CHARACTERISTIC
/begin CHARACTERISTIC DSM_EnvDfp_GlwCD_Actr_C "Fehlerpfad spezifische Umweltbedingungen fuer Fehlerpfad Dfp_GlwCD_Actr" VAL_BLK 0x1CBFF0 Kwb_Wu16 602.000000000 SigName 0.00 602.000000000 FORMAT "%13.9" NUMBER 5 /end CHARACTERISTIC
/begin CHARACTERISTIC DSM_EnvDfp_GlwCD_DIAG_C "Fehlerpfad spezifische Umweltbedingungen fuer Fehlerpfad Dfp_GlwCD_DIAG" VAL_BLK 0x1CBFFA Kwb_Wu16 602.000000000 SigName 0.00 602.000000000 FORMAT "%13.9" NUMBER 5 /end CHARACTERISTIC
/begin CHARACTERISTIC DSM_EnvDfp_GlwCD_Error1_C "Fehlerpfad spezifische Umweltbedingungen fuer Fehlerpfad Dfp_GlwCD_Error1" VAL_BLK 0x1CC004 Kwb_Wu16 602.000000000 SigName 0.00 602.000000000 FORMAT "%13.9" NUMBER 5 /end CHARACTERISTIC
/begin CHARACTERISTIC DSM_EnvDfp_GlwCD_Error2_C "Fehlerpfad spezifische Umweltbedingungen fuer Fehlerpfad Dfp_GlwCD_Error2" VAL_BLK 0x1CC00E Kwb_Wu16 602.000000000 SigName 0.00 602.000000000 FORMAT "%13.9" NUMBER 5 /end CHARACTERISTIC
/begin CHARACTERISTIC DSM_EnvDfp_GlwCD_EvalCod_C "Fehlerpfad spezifische Umweltbedingungen fuer Fehlerpfad Dfp_GlwCD_EvalCod" VAL_BLK 0x1CC018 Kwb_Wu16 602.000000000 SigName 0.00 602.000000000 FORMAT "%13.9" NUMBER 5 /end CHARACTERISTIC
/begin CHARACTERISTIC DSM_EnvDfp_GlwCD_GSK_C "Fehlerpfad spezifische Umweltbedingungen fuer Fehlerpfad Dfp_GlwCD_GSK" VAL_BLK 0x1CC022 Kwb_Wu16 602.000000000 SigName 0.00 602.000000000 FORMAT "%13.9" NUMBER 5 /end CHARACTERISTIC
/begin CHARACTERISTIC DSM_EnvDfp_GlwCD_Lamp_C "Fehlerpfad spezifische Umweltbedingungen fuer Fehlerpfad Dfp_GlwCD_Lamp" VAL_BLK 0x1CC02C Kwb_Wu16 602.000000000 SigName 0.00 602.000000000 FORMAT "%13.9" NUMBER 5 /end CHARACTERISTIC
/begin CHARACTERISTIC DSM_EnvDfp_GlwCD_LampCan_C "Fehlerpfad spezifische Umweltbedingungen fuer Fehlerpfad Dfp_GlwCD_LampCan" VAL_BLK 0x1CC036 Kwb_Wu16 602.000000000 SigName 0.00 602.000000000 FORMAT "%13.9" NUMBER 5 /end CHARACTERISTIC
/begin CHARACTERISTIC DSM_EnvDfp_GlwCD_PLUG0_C "Fehlerpfad spezifische Umweltbedingungen fuer Fehlerpfad Dfp_GlwCD_PLUG0" VAL_BLK 0x1CC040 Kwb_Wu16 602.000000000 SigName 0.00 602.000000000 FORMAT "%13.9" NUMBER 5 /end CHARACTERISTIC
/begin CHARACTERISTIC DSM_EnvDfp_GlwCD_PLUG1_C "Fehlerpfad spezifische Umweltbedingungen fuer Fehlerpfad Dfp_GlwCD_PLUG1" VAL_BLK 0x1CC04A Kwb_Wu16 602.000000000 SigName 0.00 602.000000000 FORMAT "%13.9" NUMBER 5 /end CHARACTERISTIC
/begin CHARACTERISTIC DSM_EnvDfp_GlwCD_PLUG2_C "Fehlerpfad spezifische Umweltbedingungen fuer Fehlerpfad Dfp_GlwCD_PLUG2" VAL_BLK 0x1CC054 Kwb_Wu16 602.000000000 SigName 0.00 602.000000000 FORMAT "%13.9" NUMBER 5 /end CHARACTERISTIC
/begin CHARACTERISTIC DSM_EnvDfp_GlwCD_PLUG3_C "Fehlerpfad spezifische Umweltbedingungen fuer Fehlerpfad Dfp_GlwCD_PLUG3" VAL_BLK 0x1CC05E Kwb_Wu16 602.000000000 SigName 0.00 602.000000000 FORMAT "%13.9" NUMBER 5 /end CHARACTERISTIC
/begin CHARACTERISTIC DSM_EnvDfp_GlwCD_PLUG4_C "Fehlerpfad spezifische Umweltbedingungen fuer Fehlerpfad Dfp_GlwCD_PLUG4" VAL_BLK 0x1CC068 Kwb_Wu16 602.000000000 SigName 0.00 602.000000000 FORMAT "%13.9" NUMBER 5 /end CHARACTERISTIC
/begin CHARACTERISTIC DSM_EnvDfp_GlwCD_PLUG5_C "Fehlerpfad spezifische Umweltbedingungen fuer Fehlerpfad Dfp_GlwCD_PLUG5" VAL_BLK 0x1CC072 Kwb_Wu16 602.000000000 SigName 0.00 602.000000000 FORMAT "%13.9" NUMBER 5 /end CHARACTERISTIC
/begin CHARACTERISTIC DSM_EnvDfp_GlwCD_SFD_C "Fehlerpfad spezifische Umweltbedingungen fuer Fehlerpfad Dfp_GlwCD_SFD" VAL_BLK 0x1CC07C Kwb_Wu16 602.000000000 SigName 0.00 602.000000000 FORMAT "%13.9" NUMBER 5 /end CHARACTERISTIC
/begin CHARACTERISTIC DSM_EnvDfp_HDSCD_C "Fehlerpfad spezifische Umweltbedingungen fuer Fehlerpfad Dfp_HDSCD" VAL_BLK 0x1CC086 Kwb_Wu16 602.000000000 SigName 0.00 602.000000000 FORMAT "%13.9" NUMBER 5 /end CHARACTERISTIC
/begin CHARACTERISTIC DSM_EnvDfp_HWEMonCom_C "Fehlerpfad spezifische Umweltbedingungen fuer Fehlerpfad Dfp_HWEMonCom" VAL_BLK 0x1CC090 Kwb_Wu16 602.000000000 SigName 0.00 602.000000000 FORMAT "%13.9" NUMBER 5 /end CHARACTERISTIC
/begin CHARACTERISTIC DSM_EnvDfp_HWEMonEEPROM_C "Fehlerpfad spezifische Umweltbedingungen fuer Fehlerpfad Dfp_HWEMonEEPROM" VAL_BLK 0x1CC09A Kwb_Wu16 602.000000000 SigName 0.00 602.000000000 FORMAT "%13.9" NUMBER 5 /end CHARACTERISTIC
/begin CHARACTERISTIC DSM_EnvDfp_HWEMonRcyLocked_C "Fehlerpfad spezifische Umweltbedingungen fuer Fehlerpfad Dfp_HWEMonRcyLocked" VAL_BLK 0x1CC0A4 Kwb_Wu16 602.000000000 SigName 0.00 602.000000000 FORMAT "%13.9" NUMBER 5 /end CHARACTERISTIC
/begin CHARACTERISTIC DSM_EnvDfp_HWEMonRcySuppressed_C "Fehlerpfad spezifische Umweltbedingungen fuer Fehlerpfad Dfp_HWEMonRcySuppressed" VAL_BLK 0x1CC0AE Kwb_Wu16 602.000000000 SigName 0.00 602.000000000 FORMAT "%13.9" NUMBER 5 /end CHARACTERISTIC
/begin CHARACTERISTIC DSM_EnvDfp_HWEMonRcyVisible_C "Fehlerpfad spezifische Umweltbedingungen fuer Fehlerpfad Dfp_HWEMonRcyVisible" VAL_BLK 0x1CC0B8 Kwb_Wu16 602.000000000 SigName 0.00 602.000000000 FORMAT "%13.9" NUMBER 5 /end CHARACTERISTIC
/begin CHARACTERISTIC DSM_EnvDfp_HWEMonUMaxSupply_C "Fehlerpfad spezifische Umweltbedingungen fuer Fehlerpfad Dfp_HWEMonUMaxSupply" VAL_BLK 0x1CC0C2 Kwb_Wu16 602.000000000 SigName 0.00 602.000000000 FORMAT "%13.9" NUMBER 5 /end CHARACTERISTIC
/begin CHARACTERISTIC DSM_EnvDfp_HWEMonUMinSupply_C "Fehlerpfad spezifische Umweltbedingungen fuer Fehlerpfad Dfp_HWEMonUMinSupply" VAL_BLK 0x1CC0CC Kwb_Wu16 602.000000000 SigName 0.00 602.000000000 FORMAT "%13.9" NUMBER 5 /end CHARACTERISTIC
/begin CHARACTERISTIC DSM_EnvDfp_IATSCD_C "Fehlerpfad spezifische Umweltbedingungen fuer Fehlerpfad Dfp_IATSCD" VAL_BLK 0x1CC0D6 Kwb_Wu16 602.000000000 SigName 0.00 602.000000000 FORMAT "%13.9" NUMBER 5 /end CHARACTERISTIC
/begin CHARACTERISTIC DSM_EnvDfp_IFCD_C "Fehlerpfad spezifische Umweltbedingungen fuer Fehlerpfad Dfp_IFCD" VAL_BLK 0x1CC0E0 Kwb_Wu16 602.000000000 SigName 0.00 602.000000000 FORMAT "%13.9" NUMBER 5 /end CHARACTERISTIC
/begin CHARACTERISTIC DSM_EnvDfp_ImmCtl_C "Fehlerpfad spezifische Umweltbedingungen fuer Fehlerpfad Dfp_ImmCtl" VAL_BLK 0x1CC0EA Kwb_Wu16 602.000000000 SigName 0.00 602.000000000 FORMAT "%13.9" NUMBER 5 /end CHARACTERISTIC
/begin CHARACTERISTIC DSM_EnvDfp_InjCrv_InjLim_C "Fehlerpfad spezifische Umweltbedingungen fuer Fehlerpfad Dfp_InjCrv_InjLim" VAL_BLK 0x1CC0F4 Kwb_Wu16 602.000000000 SigName 0.00 602.000000000 FORMAT "%13.9" NUMBER 5 /end CHARACTERISTIC
/begin CHARACTERISTIC DSM_EnvDfp_InjVCDActrChrg_C "Fehlerpfad spezifische Umweltbedingungen fuer Fehlerpfad Dfp_InjVCDActrChrg" VAL_BLK 0x1CC0FE Kwb_Wu16 602.000000000 SigName 0.00 602.000000000 FORMAT "%13.9" NUMBER 5 /end CHARACTERISTIC
/begin CHARACTERISTIC DSM_EnvDfp_InjVCDActrVolt_C "Fehlerpfad spezifische Umweltbedingungen fuer Fehlerpfad Dfp_InjVCDActrVolt" VAL_BLK 0x1CC108 Kwb_Wu16 602.000000000 SigName 0.00 602.000000000 FORMAT "%13.9" NUMBER 5 /end CHARACTERISTIC
/begin CHARACTERISTIC DSM_EnvDfp_InjVCDClsBank1_C "Fehlerpfad spezifische Umweltbedingungen fuer Fehlerpfad Dfp_InjVCDClsBank1" VAL_BLK 0x1CC112 Kwb_Wu16 602.000000000 SigName 0.00 602.000000000 FORMAT "%13.9" NUMBER 5 /end CHARACTERISTIC
/begin CHARACTERISTIC DSM_EnvDfp_InjVCDClsBank2_C "Fehlerpfad spezifische Umweltbedingungen fuer Fehlerpfad Dfp_InjVCDClsBank2" VAL_BLK 0x1CC11C Kwb_Wu16 602.000000000 SigName 0.00 602.000000000 FORMAT "%13.9" NUMBER 5 /end CHARACTERISTIC
/begin CHARACTERISTIC DSM_EnvDfp_InjVCDMonCab_C "Fehlerpfad spezifische Umweltbedingungen fuer Fehlerpfad Dfp_InjVCDMonCab" VAL_BLK 0x1CC126 Kwb_Wu16 602.000000000 SigName 0.00 602.000000000 FORMAT "%13.9" NUMBER 5 /end CHARACTERISTIC
/begin CHARACTERISTIC DSM_EnvDfp_InjVCDMonSwt_C "Fehlerpfad spezifische Umweltbedingungen fuer Fehlerpfad Dfp_InjVCDMonSwt" VAL_BLK 0x1CC130 Kwb_Wu16 602.000000000 SigName 0.00 602.000000000 FORMAT "%13.9" NUMBER 5 /end CHARACTERISTIC
/begin CHARACTERISTIC DSM_EnvDfp_InjVCDShOffDCDC_C "Fehlerpfad spezifische Umweltbedingungen fuer Fehlerpfad Dfp_InjVCDShOffDCDC" VAL_BLK 0x1CC13A Kwb_Wu16 602.000000000 SigName 0.00 602.000000000 FORMAT "%13.9" NUMBER 5 /end CHARACTERISTIC
/begin CHARACTERISTIC DSM_EnvDfp_InjVCDUBuf_C "Fehlerpfad spezifische Umweltbedingungen fuer Fehlerpfad Dfp_InjVCDUBuf" VAL_BLK 0x1CC144 Kwb_Wu16 602.000000000 SigName 0.00 602.000000000 FORMAT "%13.9" NUMBER 5 /end CHARACTERISTIC
/begin CHARACTERISTIC DSM_EnvDfp_InjVCD_CY370Ampl_C "Fehlerpfad spezifische Umweltbedingungen fuer Fehlerpfad Dfp_InjVCD_CY370Ampl" VAL_BLK 0x1CC14E Kwb_Wu16 602.000000000 SigName 0.00 602.000000000 FORMAT "%13.9" NUMBER 5 /end CHARACTERISTIC
/begin CHARACTERISTIC DSM_EnvDfp_InjVlvBnk1A_C "Fehlerpfad spezifische Umweltbedingungen fuer Fehlerpfad Dfp_InjVlvBnk1A" VAL_BLK 0x1CC158 Kwb_Wu16 602.000000000 SigName 0.00 602.000000000 FORMAT "%13.9" NUMBER 5 /end CHARACTERISTIC
/begin CHARACTERISTIC DSM_EnvDfp_InjVlvBnk1B_C "Fehlerpfad spezifische Umweltbedingungen fuer Fehlerpfad Dfp_InjVlvBnk1B" VAL_BLK 0x1CC162 Kwb_Wu16 602.000000000 SigName 0.00 602.000000000 FORMAT "%13.9" NUMBER 5 /end CHARACTERISTIC
/begin CHARACTERISTIC DSM_EnvDfp_InjVlvBnk2A_C "Fehlerpfad spezifische Umweltbedingungen fuer Fehlerpfad Dfp_InjVlvBnk2A" VAL_BLK 0x1CC16C Kwb_Wu16 602.000000000 SigName 0.00 602.000000000 FORMAT "%13.9" NUMBER 5 /end CHARACTERISTIC
/begin CHARACTERISTIC DSM_EnvDfp_InjVlvBnk2B_C "Fehlerpfad spezifische Umweltbedingungen fuer Fehlerpfad Dfp_InjVlvBnk2B" VAL_BLK 0x1CC176 Kwb_Wu16 602.000000000 SigName 0.00 602.000000000 FORMAT "%13.9" NUMBER 5 /end CHARACTERISTIC
/begin CHARACTERISTIC DSM_EnvDfp_InjVlvChipA_C "Fehlerpfad spezifische Umweltbedingungen fuer Fehlerpfad Dfp_InjVlvChipA" VAL_BLK 0x1CC180 Kwb_Wu16 602.000000000 SigName 0.00 602.000000000 FORMAT "%13.9" NUMBER 5 /end CHARACTERISTIC
/begin CHARACTERISTIC DSM_EnvDfp_InjVlvChipB_C "Fehlerpfad spezifische Umweltbedingungen fuer Fehlerpfad Dfp_InjVlvChipB" VAL_BLK 0x1CC18A Kwb_Wu16 602.000000000 SigName 0.00 602.000000000 FORMAT "%13.9" NUMBER 5 /end CHARACTERISTIC
/begin CHARACTERISTIC DSM_EnvDfp_InjVlvCyl1A_C "Fehlerpfad spezifische Umweltbedingungen fuer Fehlerpfad Dfp_InjVlvCyl1A" VAL_BLK 0x1CC194 Kwb_Wu16 602.000000000 SigName 0.00 602.000000000 FORMAT "%13.9" NUMBER 5 /end CHARACTERISTIC
/begin CHARACTERISTIC DSM_EnvDfp_InjVlvCyl1B_C "Fehlerpfad spezifische Umweltbedingungen fuer Fehlerpfad Dfp_InjVlvCyl1B" VAL_BLK 0x1CC19E Kwb_Wu16 602.000000000 SigName 0.00 602.000000000 FORMAT "%13.9" NUMBER 5 /end CHARACTERISTIC
/begin CHARACTERISTIC DSM_EnvDfp_InjVlvCyl1C_C "Fehlerpfad spezifische Umweltbedingungen fuer Fehlerpfad Dfp_InjVlvCyl1C" VAL_BLK 0x1CC1A8 Kwb_Wu16 602.000000000 SigName 0.00 602.000000000 FORMAT "%13.9" NUMBER 5 /end CHARACTERISTIC
/begin CHARACTERISTIC DSM_EnvDfp_InjVlvCyl2A_C "Fehlerpfad spezifische Umweltbedingungen fuer Fehlerpfad Dfp_InjVlvCyl2A" VAL_BLK 0x1CC1B2 Kwb_Wu16 602.000000000 SigName 0.00 602.000000000 FORMAT "%13.9" NUMBER 5 /end CHARACTERISTIC
/begin CHARACTERISTIC DSM_EnvDfp_InjVlvCyl2B_C "Fehlerpfad spezifische Umweltbedingungen fuer Fehlerpfad Dfp_InjVlvCyl2B" VAL_BLK 0x1CC1BC Kwb_Wu16 602.000000000 SigName 0.00 602.000000000 FORMAT "%13.9" NUMBER 5 /end CHARACTERISTIC
/begin CHARACTERISTIC DSM_EnvDfp_InjVlvCyl2C_C "Fehlerpfad spezifische Umweltbedingungen fuer Fehlerpfad Dfp_InjVlvCyl2C" VAL_BLK 0x1CC1C6 Kwb_Wu16 602.000000000 SigName 0.00 602.000000000 FORMAT "%13.9" NUMBER 5 /end CHARACTERISTIC
/begin CHARACTERISTIC DSM_EnvDfp_InjVlvCyl3A_C "Fehlerpfad spezifische Umweltbedingungen fuer Fehlerpfad Dfp_InjVlvCyl3A" VAL_BLK 0x1CC1D0 Kwb_Wu16 602.000000000 SigName 0.00 602.000000000 FORMAT "%13.9" NUMBER 5 /end CHARACTERISTIC
/begin CHARACTERISTIC DSM_EnvDfp_InjVlvCyl3B_C "Fehlerpfad spezifische Umweltbedingungen fuer Fehlerpfad Dfp_InjVlvCyl3B" VAL_BLK 0x1CC1DA Kwb_Wu16 602.000000000 SigName 0.00 602.000000000 FORMAT "%13.9" NUMBER 5 /end CHARACTERISTIC
/begin CHARACTERISTIC DSM_EnvDfp_InjVlvCyl3C_C "Fehlerpfad spezifische Umweltbedingungen fuer Fehlerpfad Dfp_InjVlvCyl3C" VAL_BLK 0x1CC1E4 Kwb_Wu16 602.000000000 SigName 0.00 602.000000000 FORMAT "%13.9" NUMBER 5 /end CHARACTERISTIC
/begin CHARACTERISTIC DSM_EnvDfp_InjVlvCyl4A_C "Fehlerpfad spezifische Umweltbedingungen fuer Fehlerpfad Dfp_InjVlvCyl4A" VAL_BLK 0x1CC1EE Kwb_Wu16 602.000000000 SigName 0.00 602.000000000 FORMAT "%13.9" NUMBER 5 /end CHARACTERISTIC
/begin CHARACTERISTIC DSM_EnvDfp_InjVlvCyl4B_C "Fehlerpfad spezifische Umweltbedingungen fuer Fehlerpfad Dfp_InjVlvCyl4B" VAL_BLK 0x1CC1F8 Kwb_Wu16 602.000000000 SigName 0.00 602.000000000 FORMAT "%13.9" NUMBER 5 /end CHARACTERISTIC
/begin CHARACTERISTIC DSM_EnvDfp_InjVlvCyl4C_C "Fehlerpfad spezifische Umweltbedingungen fuer Fehlerpfad Dfp_InjVlvCyl4C" VAL_BLK 0x1CC202 Kwb_Wu16 602.000000000 SigName 0.00 602.000000000 FORMAT "%13.9" NUMBER 5 /end CHARACTERISTIC
/begin CHARACTERISTIC DSM_EnvDfp_InjVlvCyl5A_C "Fehlerpfad spezifische Umweltbedingungen fuer Fehlerpfad Dfp_InjVlvCyl5A" VAL_BLK 0x1CC20C Kwb_Wu16 602.000000000 SigName 0.00 602.000000000 FORMAT "%13.9" NUMBER 5 /end CHARACTERISTIC
/begin CHARACTERISTIC DSM_EnvDfp_InjVlvCyl5B_C "Fehlerpfad spezifische Umweltbedingungen fuer Fehlerpfad Dfp_InjVlvCyl5B" VAL_BLK 0x1CC216 Kwb_Wu16 602.000000000 SigName 0.00 602.000000000 FORMAT "%13.9" NUMBER 5 /end CHARACTERISTIC
/begin CHARACTERISTIC DSM_EnvDfp_InjVlvCyl5C_C "Fehlerpfad spezifische Umweltbedingungen fuer Fehlerpfad Dfp_InjVlvCyl5C" VAL_BLK 0x1CC220 Kwb_Wu16 602.000000000 SigName 0.00 602.000000000 FORMAT "%13.9" NUMBER 5 /end CHARACTERISTIC
/begin CHARACTERISTIC DSM_EnvDfp_InjVlvCyl6A_C "Fehlerpfad spezifische Umweltbedingungen fuer Fehlerpfad Dfp_InjVlvCyl6A" VAL_BLK 0x1CC22A Kwb_Wu16 602.000000000 SigName 0.00 602.000000000 FORMAT "%13.9" NUMBER 5 /end CHARACTERISTIC
/begin CHARACTERISTIC DSM_EnvDfp_InjVlvCyl6B_C "Fehlerpfad spezifische Umweltbedingungen fuer Fehlerpfad Dfp_InjVlvCyl6B" VAL_BLK 0x1CC234 Kwb_Wu16 602.000000000 SigName 0.00 602.000000000 FORMAT "%13.9" NUMBER 5 /end CHARACTERISTIC
/begin CHARACTERISTIC DSM_EnvDfp_InjVlvCyl6C_C "Fehlerpfad spezifische Umweltbedingungen fuer Fehlerpfad Dfp_InjVlvCyl6C" VAL_BLK 0x1CC23E Kwb_Wu16 602.000000000 SigName 0.00 602.000000000 FORMAT "%13.9" NUMBER 5 /end CHARACTERISTIC
/begin CHARACTERISTIC DSM_EnvDfp_InjVlvCyl7A_C "Fehlerpfad spezifische Umweltbedingungen fuer Fehlerpfad Dfp_InjVlvCyl7A" VAL_BLK 0x1CC248 Kwb_Wu16 602.000000000 SigName 0.00 602.000000000 FORMAT "%13.9" NUMBER 5 /end CHARACTERISTIC
/begin CHARACTERISTIC DSM_EnvDfp_InjVlvCyl7B_C "Fehlerpfad spezifische Umweltbedingungen fuer Fehlerpfad Dfp_InjVlvCyl7B" VAL_BLK 0x1CC252 Kwb_Wu16 602.000000000 SigName 0.00 602.000000000 FORMAT "%13.9" NUMBER 5 /end CHARACTERISTIC
/begin CHARACTERISTIC DSM_EnvDfp_InjVlvCyl7C_C "Fehlerpfad spezifische Umweltbedingungen fuer Fehlerpfad Dfp_InjVlvCyl7C" VAL_BLK 0x1CC25C Kwb_Wu16 602.000000000 SigName 0.00 602.000000000 FORMAT "%13.9" NUMBER 5 /end CHARACTERISTIC
/begin CHARACTERISTIC DSM_EnvDfp_InjVlvCyl8A_C "Fehlerpfad spezifische Umweltbedingungen fuer Fehlerpfad Dfp_InjVlvCyl8A" VAL_BLK 0x1CC266 Kwb_Wu16 602.000000000 SigName 0.00 602.000000000 FORMAT "%13.9" NUMBER 5 /end CHARACTERISTIC
/begin CHARACTERISTIC DSM_EnvDfp_InjVlvCyl8B_C "Fehlerpfad spezifische Umweltbedingungen fuer Fehlerpfad Dfp_InjVlvCyl8B" VAL_BLK 0x1CC270 Kwb_Wu16 602.000000000 SigName 0.00 602.000000000 FORMAT "%13.9" NUMBER 5 /end CHARACTERISTIC
/begin CHARACTERISTIC DSM_EnvDfp_InjVlvCyl8C_C "Fehlerpfad spezifische Umweltbedingungen fuer Fehlerpfad Dfp_InjVlvCyl8C" VAL_BLK 0x1CC27A Kwb_Wu16 602.000000000 SigName 0.00 602.000000000 FORMAT "%13.9" NUMBER 5 /end CHARACTERISTIC
/begin CHARACTERISTIC DSM_EnvDfp_LSUCDCircNernst0_C "Fehlerpfad spezifische Umweltbedingungen fuer Fehlerpfad Dfp_LSUCDCircNernst0" VAL_BLK 0x1CC284 Kwb_Wu16 602.000000000 SigName 0.00 602.000000000 FORMAT "%13.9" NUMBER 5 /end CHARACTERISTIC
/begin CHARACTERISTIC DSM_EnvDfp_LSUCDCircPumpCur0_C "Fehlerpfad spezifische Umweltbedingungen fuer Fehlerpfad Dfp_LSUCDCircPumpCur0" VAL_BLK 0x1CC28E Kwb_Wu16 602.000000000 SigName 0.00 602.000000000 FORMAT "%13.9" NUMBER 5 /end CHARACTERISTIC
/begin CHARACTERISTIC DSM_EnvDfp_LSUCDCircVirtGnd0_C "Fehlerpfad spezifische Umweltbedingungen fuer Fehlerpfad Dfp_LSUCDCircVirtGnd0" VAL_BLK 0x1CC298 Kwb_Wu16 602.000000000 SigName 0.00 602.000000000 FORMAT "%13.9" NUMBER 5 /end CHARACTERISTIC
/begin CHARACTERISTIC DSM_EnvDfp_LSUCDHeater0_C "Fehlerpfad spezifische Umweltbedingungen fuer Fehlerpfad Dfp_LSUCDHeater0" VAL_BLK 0x1CC2A2 Kwb_Wu16 602.000000000 SigName 0.00 602.000000000 FORMAT "%13.9" NUMBER 5 /end CHARACTERISTIC
/begin CHARACTERISTIC DSM_EnvDfp_LSUCDHtCoup0_C "Fehlerpfad spezifische Umweltbedingungen fuer Fehlerpfad Dfp_LSUCDHtCoup0" VAL_BLK 0x1CC2AC Kwb_Wu16 602.000000000 SigName 0.00 602.000000000 FORMAT "%13.9" NUMBER 5 /end CHARACTERISTIC
/begin CHARACTERISTIC DSM_EnvDfp_LSUCDO20_C "Fehlerpfad spezifische Umweltbedingungen fuer Fehlerpfad Dfp_LSUCDO20" VAL_BLK 0x1CC2B6 Kwb_Wu16 602.000000000 SigName 0.00 602.000000000 FORMAT "%13.9" NUMBER 5 /end CHARACTERISTIC
/begin CHARACTERISTIC DSM_EnvDfp_LSUCDO2Clb0_C "Fehlerpfad spezifische Umweltbedingungen fuer Fehlerpfad Dfp_LSUCDO2Clb0" VAL_BLK 0x1CC2C0 Kwb_Wu16 602.000000000 SigName 0.00 602.000000000 FORMAT "%13.9" NUMBER 5 /end CHARACTERISTIC
/begin CHARACTERISTIC DSM_EnvDfp_LSUCDRiClb0_C "Fehlerpfad spezifische Umweltbedingungen fuer Fehlerpfad Dfp_LSUCDRiClb0" VAL_BLK 0x1CC2CA Kwb_Wu16 602.000000000 SigName 0.00 602.000000000 FORMAT "%13.9" NUMBER 5 /end CHARACTERISTIC
/begin CHARACTERISTIC DSM_EnvDfp_LSUCDSPI0_C "Fehlerpfad spezifische Umweltbedingungen fuer Fehlerpfad Dfp_LSUCDSPI0" VAL_BLK 0x1CC2D4 Kwb_Wu16 602.000000000 SigName 0.00 602.000000000 FORMAT "%13.9" NUMBER 5 /end CHARACTERISTIC
/begin CHARACTERISTIC DSM_EnvDfp_LSUCDSPIBattLow0_C "Fehlerpfad spezifische Umweltbedingungen fuer Fehlerpfad Dfp_LSUCDSPIBattLow0" VAL_BLK 0x1CC2DE Kwb_Wu16 602.000000000 SigName 0.00 602.000000000 FORMAT "%13.9" NUMBER 5 /end CHARACTERISTIC
/begin CHARACTERISTIC DSM_EnvDfp_LSUCDWireIP0_C "Fehlerpfad spezifische Umweltbedingungen fuer Fehlerpfad Dfp_LSUCDWireIP0" VAL_BLK 0x1CC2E8 Kwb_Wu16 602.000000000 SigName 0.00 602.000000000 FORMAT "%13.9" NUMBER 5 /end CHARACTERISTIC
/begin CHARACTERISTIC DSM_EnvDfp_LSUCtlRiExc0_C "Fehlerpfad spezifische Umweltbedingungen fuer Fehlerpfad Dfp_LSUCtlRiExc0" VAL_BLK 0x1CC2F2 Kwb_Wu16 602.000000000 SigName 0.00 602.000000000 FORMAT "%13.9" NUMBER 5 /end CHARACTERISTIC
/begin CHARACTERISTIC DSM_EnvDfp_LSUMon1Sens_C "Fehlerpfad spezifische Umweltbedingungen fuer Fehlerpfad Dfp_LSUMon1Sens" VAL_BLK 0x1CC2FC Kwb_Wu16 602.000000000 SigName 0.00 602.000000000 FORMAT "%13.9" NUMBER 5 /end CHARACTERISTIC
/begin CHARACTERISTIC DSM_EnvDfp_LSUMon2Sens_C "Fehlerpfad spezifische Umweltbedingungen fuer Fehlerpfad Dfp_LSUMon2Sens" VAL_BLK 0x1CC306 Kwb_Wu16 602.000000000 SigName 0.00 602.000000000 FORMAT "%13.9" NUMBER 5 /end CHARACTERISTIC
/begin CHARACTERISTIC DSM_EnvDfp_MIL_C "Fehlerpfad spezifische Umweltbedingungen fuer Fehlerpfad Dfp_MIL" VAL_BLK 0x1CC310 Kwb_Wu16 602.000000000 SigName 0.00 602.000000000 FORMAT "%13.9" NUMBER 5 /end CHARACTERISTIC
/begin CHARACTERISTIC DSM_EnvDfp_MRlyCD_C "Fehlerpfad spezifische Umweltbedingungen fuer Fehlerpfad Dfp_MRlyCD" VAL_BLK 0x1CC31A Kwb_Wu16 602.000000000 SigName 0.00 602.000000000 FORMAT "%13.9" NUMBER 5 /end CHARACTERISTIC
/begin CHARACTERISTIC DSM_EnvDfp_MeUnCDNoLoad_C "Fehlerpfad spezifische Umweltbedingungen fuer Fehlerpfad Dfp_MeUnCDNoLoad" VAL_BLK 0x1CC324 Kwb_Wu16 602.000000000 SigName 0.00 602.000000000 FORMAT "%13.9" NUMBER 5 /end CHARACTERISTIC
/begin CHARACTERISTIC DSM_EnvDfp_MeUnCDSCBat_C "Fehlerpfad spezifische Umweltbedingungen fuer Fehlerpfad Dfp_MeUnCDSCBat" VAL_BLK 0x1CC32E Kwb_Wu16 602.000000000 SigName 0.00 602.000000000 FORMAT "%13.9" NUMBER 5 /end CHARACTERISTIC
/begin CHARACTERISTIC DSM_EnvDfp_MeUnCDSCGnd_C "Fehlerpfad spezifische Umweltbedingungen fuer Fehlerpfad Dfp_MeUnCDSCGnd" VAL_BLK 0x1CC338 Kwb_Wu16 602.000000000 SigName 0.00 602.000000000 FORMAT "%13.9" NUMBER 5 /end CHARACTERISTIC
/begin CHARACTERISTIC DSM_EnvDfp_MeUnCD_ADC_C "Fehlerpfad spezifische Umweltbedingungen fuer Fehlerpfad Dfp_MeUnCD_ADC" VAL_BLK 0x1CC342 Kwb_Wu16 602.000000000 SigName 0.00 602.000000000 FORMAT "%13.9" NUMBER 5 /end CHARACTERISTIC
/begin CHARACTERISTIC DSM_EnvDfp_Montr_C "Fehlerpfad spezifische Umweltbedingungen fuer Fehlerpfad Dfp_Montr" VAL_BLK 0x1CC34C Kwb_Wu16 602.000000000 SigName 0.00 602.000000000 FORMAT "%13.9" NUMBER 5 /end CHARACTERISTIC
/begin CHARACTERISTIC DSM_EnvDfp_OTSCD_C "Fehlerpfad spezifische Umweltbedingungen fuer Fehlerpfad Dfp_OTSCD" VAL_BLK 0x1CC356 Kwb_Wu16 602.000000000 SigName 0.00 602.000000000 FORMAT "%13.9" NUMBER 5 /end CHARACTERISTIC
/begin CHARACTERISTIC DSM_EnvDfp_OTSCDCanInac_C "Fehlerpfad spezifische Umweltbedingungen fuer Fehlerpfad Dfp_OTSCDCanInac" VAL_BLK 0x1CC360 Kwb_Wu16 602.000000000 SigName 0.00 602.000000000 FORMAT "%13.9" NUMBER 5 /end CHARACTERISTIC
/begin CHARACTERISTIC DSM_EnvDfp_OTSCDCanSig_C "Fehlerpfad spezifische Umweltbedingungen fuer Fehlerpfad Dfp_OTSCDCanSig" VAL_BLK 0x1CC36A Kwb_Wu16 602.000000000 SigName 0.00 602.000000000 FORMAT "%13.9" NUMBER 5 /end CHARACTERISTIC
/begin CHARACTERISTIC DSM_EnvDfp_OvRMon_C "Fehlerpfad spezifische Umweltbedingungen fuer Fehlerpfad Dfp_OvRMon" VAL_BLK 0x1CC374 Kwb_Wu16 602.000000000 SigName 0.00 602.000000000 FORMAT "%13.9" NUMBER 5 /end CHARACTERISTIC
/begin CHARACTERISTIC DSM_EnvDfp_OvRMonCrCtlP_C "Fehlerpfad spezifische Umweltbedingungen fuer Fehlerpfad Dfp_OvRMonCrCtlP" VAL_BLK 0x1CC37E Kwb_Wu16 602.000000000 SigName 0.00 602.000000000 FORMAT "%13.9" NUMBER 5 /end CHARACTERISTIC
/begin CHARACTERISTIC DSM_EnvDfp_OvRMonSigA_C "Fehlerpfad spezifische Umweltbedingungen fuer Fehlerpfad Dfp_OvRMonSigA" VAL_BLK 0x1CC388 Kwb_Wu16 602.000000000 SigName 0.00 602.000000000 FORMAT "%13.9" NUMBER 5 /end CHARACTERISTIC
/begin CHARACTERISTIC DSM_EnvDfp_OxiCCDTPre_C "Fehlerpfad spezifische Umweltbedingungen fuer Fehlerpfad Dfp_OxiCCDTPre" VAL_BLK 0x1CC392 Kwb_Wu16 602.000000000 SigName 0.00 602.000000000 FORMAT "%13.9" NUMBER 5 /end CHARACTERISTIC
/begin CHARACTERISTIC DSM_EnvDfp_OxiCCDTPre1_C "Fehlerpfad spezifische Umweltbedingungen fuer Fehlerpfad Dfp_OxiCCDTPre1" VAL_BLK 0x1CC39C Kwb_Wu16 602.000000000 SigName 0.00 602.000000000 FORMAT "%13.9" NUMBER 5 /end CHARACTERISTIC
/begin CHARACTERISTIC DSM_EnvDfp_PCR_BalGovDev_C "Fehlerpfad spezifische Umweltbedingungen fuer Fehlerpfad Dfp_PCR_BalGovDev" VAL_BLK 0x1CC3A6 Kwb_Wu16 602.000000000 SigName 0.00 602.000000000 FORMAT "%13.9" NUMBER 5 /end CHARACTERISTIC
/begin CHARACTERISTIC DSM_EnvDfp_PCR_GovDev_C "Fehlerpfad spezifische Umweltbedingungen fuer Fehlerpfad Dfp_PCR_GovDev" VAL_BLK 0x1CC3B0 Kwb_Wu16 602.000000000 SigName 0.00 602.000000000 FORMAT "%13.9" NUMBER 5 /end CHARACTERISTIC
/begin CHARACTERISTIC DSM_EnvDfp_PCVCDNoLoad_C "Fehlerpfad spezifische Umweltbedingungen fuer Fehlerpfad Dfp_PCVCDNoLoad" VAL_BLK 0x1CC3BA Kwb_Wu16 602.000000000 SigName 0.00 602.000000000 FORMAT "%13.9" NUMBER 5 /end CHARACTERISTIC
/begin CHARACTERISTIC DSM_EnvDfp_PCVCDSCBat_C "Fehlerpfad spezifische Umweltbedingungen fuer Fehlerpfad Dfp_PCVCDSCBat" VAL_BLK 0x1CC3C4 Kwb_Wu16 602.000000000 SigName 0.00 602.000000000 FORMAT "%13.9" NUMBER 5 /end CHARACTERISTIC
/begin CHARACTERISTIC DSM_EnvDfp_PCVCDSCGnd_C "Fehlerpfad spezifische Umweltbedingungen fuer Fehlerpfad Dfp_PCVCDSCGnd" VAL_BLK 0x1CC3CE Kwb_Wu16 602.000000000 SigName 0.00 602.000000000 FORMAT "%13.9" NUMBER 5 /end CHARACTERISTIC
/begin CHARACTERISTIC DSM_EnvDfp_PCVCD_ADC_C "Fehlerpfad spezifische Umweltbedingungen fuer Fehlerpfad Dfp_PCVCD_ADC" VAL_BLK 0x1CC3D8 Kwb_Wu16 602.000000000 SigName 0.00 602.000000000 FORMAT "%13.9" NUMBER 5 /end CHARACTERISTIC
/begin CHARACTERISTIC DSM_EnvDfp_PFltCDHtg_C "Fehlerpfad spezifische Umweltbedingungen fuer Fehlerpfad Dfp_PFltCDHtg" VAL_BLK 0x1CC3E2 Kwb_Wu16 602.000000000 SigName 0.00 602.000000000 FORMAT "%13.9" NUMBER 5 /end CHARACTERISTIC
/begin CHARACTERISTIC DSM_EnvDfp_PFltCDHtg1_C "Fehlerpfad spezifische Umweltbedingungen fuer Fehlerpfad Dfp_PFltCDHtg1" VAL_BLK 0x1CC3EC Kwb_Wu16 602.000000000 SigName 0.00 602.000000000 FORMAT "%13.9" NUMBER 5 /end CHARACTERISTIC
/begin CHARACTERISTIC DSM_EnvDfp_PFltCDPDiff_C "Fehlerpfad spezifische Umweltbedingungen fuer Fehlerpfad Dfp_PFltCDPDiff" VAL_BLK 0x1CC3F6 Kwb_Wu16 602.000000000 SigName 0.00 602.000000000 FORMAT "%13.9" NUMBER 5 /end CHARACTERISTIC
/begin CHARACTERISTIC DSM_EnvDfp_PFltCDPDiff1_C "Fehlerpfad spezifische Umweltbedingungen fuer Fehlerpfad Dfp_PFltCDPDiff1" VAL_BLK 0x1CC400 Kwb_Wu16 602.000000000 SigName 0.00 602.000000000 FORMAT "%13.9" NUMBER 5 /end CHARACTERISTIC
/begin CHARACTERISTIC DSM_EnvDfp_PFltCDTPre_C "Fehlerpfad spezifische Umweltbedingungen fuer Fehlerpfad Dfp_PFltCDTPre" VAL_BLK 0x1CC40A Kwb_Wu16 602.000000000 SigName 0.00 602.000000000 FORMAT "%13.9" NUMBER 5 /end CHARACTERISTIC
/begin CHARACTERISTIC DSM_EnvDfp_PFltCDTPst_C "Fehlerpfad spezifische Umweltbedingungen fuer Fehlerpfad Dfp_PFltCDTPst" VAL_BLK 0x1CC414 Kwb_Wu16 602.000000000 SigName 0.00 602.000000000 FORMAT "%13.9" NUMBER 5 /end CHARACTERISTIC
/begin CHARACTERISTIC DSM_EnvDfp_PFltCDTempPre_C "Fehlerpfad spezifische Umweltbedingungen fuer Fehlerpfad Dfp_PFltCDTempPre" VAL_BLK 0x1CC41E Kwb_Wu16 602.000000000 SigName 0.00 602.000000000 FORMAT "%13.9" NUMBER 5 /end CHARACTERISTIC
/begin CHARACTERISTIC DSM_EnvDfp_PFltCDTempPre1_C "Fehlerpfad spezifische Umweltbedingungen fuer Fehlerpfad Dfp_PFltCDTempPre1" VAL_BLK 0x1CC428 Kwb_Wu16 602.000000000 SigName 0.00 602.000000000 FORMAT "%13.9" NUMBER 5 /end CHARACTERISTIC
/begin CHARACTERISTIC DSM_EnvDfp_PFltChar_C "Fehlerpfad spezifische Umweltbedingungen fuer Fehlerpfad Dfp_PFltChar" VAL_BLK 0x1CC432 Kwb_Wu16 602.000000000 SigName 0.00 602.000000000 FORMAT "%13.9" NUMBER 5 /end CHARACTERISTIC
/begin CHARACTERISTIC DSM_EnvDfp_PFltEngPrt_C "Fehlerpfad spezifische Umweltbedingungen fuer Fehlerpfad Dfp_PFltEngPrt" VAL_BLK 0x1CC43C Kwb_Wu16 602.000000000 SigName 0.00 602.000000000 FORMAT "%13.9" NUMBER 5 /end CHARACTERISTIC
/begin CHARACTERISTIC DSM_EnvDfp_PFltPresDynPlaus_C "Fehlerpfad spezifische Umweltbedingungen fuer Fehlerpfad Dfp_PFltPresDynPlaus" VAL_BLK 0x1CC446 Kwb_Wu16 602.000000000 SigName 0.00 602.000000000 FORMAT "%13.9" NUMBER 5 /end CHARACTERISTIC
/begin CHARACTERISTIC DSM_EnvDfp_PFltPresSens_C "Fehlerpfad spezifische Umweltbedingungen fuer Fehlerpfad Dfp_PFltPresSens" VAL_BLK 0x1CC450 Kwb_Wu16 602.000000000 SigName 0.00 602.000000000 FORMAT "%13.9" NUMBER 5 /end CHARACTERISTIC
/begin CHARACTERISTIC DSM_EnvDfp_PFltPresSensHsLn_C "Fehlerpfad spezifische Umweltbedingungen fuer Fehlerpfad Dfp_PFltPresSensHsLn" VAL_BLK 0x1CC45A Kwb_Wu16 602.000000000 SigName 0.00 602.000000000 FORMAT "%13.9" NUMBER 5 /end CHARACTERISTIC
/begin CHARACTERISTIC DSM_EnvDfp_PFltPresSensSot_C "Fehlerpfad spezifische Umweltbedingungen fuer Fehlerpfad Dfp_PFltPresSensSot" VAL_BLK 0x1CC464 Kwb_Wu16 602.000000000 SigName 0.00 602.000000000 FORMAT "%13.9" NUMBER 5 /end CHARACTERISTIC
/begin CHARACTERISTIC DSM_EnvDfp_PFltRgnPerm_C "Fehlerpfad spezifische Umweltbedingungen fuer Fehlerpfad Dfp_PFltRgnPerm" VAL_BLK 0x1CC46E Kwb_Wu16 602.000000000 SigName 0.00 602.000000000 FORMAT "%13.9" NUMBER 5 /end CHARACTERISTIC
/begin CHARACTERISTIC DSM_EnvDfp_PFltTempDwnStrm_C "Fehlerpfad spezifische Umweltbedingungen fuer Fehlerpfad Dfp_PFltTempDwnStrm" VAL_BLK 0x1CC478 Kwb_Wu16 602.000000000 SigName 0.00 602.000000000 FORMAT "%13.9" NUMBER 5 /end CHARACTERISTIC
/begin CHARACTERISTIC DSM_EnvDfp_PFltTempSens_C "Fehlerpfad spezifische Umweltbedingungen fuer Fehlerpfad Dfp_PFltTempSens" VAL_BLK 0x1CC482 Kwb_Wu16 602.000000000 SigName 0.00 602.000000000 FORMAT "%13.9" NUMBER 5 /end CHARACTERISTIC
/begin CHARACTERISTIC DSM_EnvDfp_PFltTempUpStrm_C "Fehlerpfad spezifische Umweltbedingungen fuer Fehlerpfad Dfp_PFltTempUpStrm" VAL_BLK 0x1CC48C Kwb_Wu16 602.000000000 SigName 0.00 602.000000000 FORMAT "%13.9" NUMBER 5 /end CHARACTERISTIC
/begin CHARACTERISTIC DSM_EnvDfp_PSPCD_Actr_C "Fehlerpfad spezifische Umweltbedingungen fuer Fehlerpfad Dfp_PSPCD_Actr" VAL_BLK 0x1CC496 Kwb_Wu16 602.000000000 SigName 0.00 602.000000000 FORMAT "%13.9" NUMBER 5 /end CHARACTERISTIC
/begin CHARACTERISTIC DSM_EnvDfp_PrpCtlvLimErrPat_C "Fehlerpfad spezifische Umweltbedingungen fuer Fehlerpfad Dfp_PrpCtlvLimErrPat" VAL_BLK 0x1CC4A0 Kwb_Wu16 602.000000000 SigName 0.00 602.000000000 FORMAT "%13.9" NUMBER 5 /end CHARACTERISTIC
/begin CHARACTERISTIC DSM_EnvDfp_RailCD_C "Fehlerpfad spezifische Umweltbedingungen fuer Fehlerpfad Dfp_RailCD" VAL_BLK 0x1CC4AA Kwb_Wu16 602.000000000 SigName 0.00 602.000000000 FORMAT "%13.9" NUMBER 5 /end CHARACTERISTIC
/begin CHARACTERISTIC DSM_EnvDfp_RailCDOfsTst_C "Fehlerpfad spezifische Umweltbedingungen fuer Fehlerpfad Dfp_RailCDOfsTst" VAL_BLK 0x1CC4B4 Kwb_Wu16 602.000000000 SigName 0.00 602.000000000 FORMAT "%13.9" NUMBER 5 /end CHARACTERISTIC
/begin CHARACTERISTIC DSM_EnvDfp_RailMeUn0_C "Fehlerpfad spezifische Umweltbedingungen fuer Fehlerpfad Dfp_RailMeUn0" VAL_BLK 0x1CC4BE Kwb_Wu16 602.000000000 SigName 0.00 602.000000000 FORMAT "%13.9" NUMBER 5 /end CHARACTERISTIC
/begin CHARACTERISTIC DSM_EnvDfp_RailMeUn1_C "Fehlerpfad spezifische Umweltbedingungen fuer Fehlerpfad Dfp_RailMeUn1" VAL_BLK 0x1CC4C8 Kwb_Wu16 602.000000000 SigName 0.00 602.000000000 FORMAT "%13.9" NUMBER 5 /end CHARACTERISTIC
/begin CHARACTERISTIC DSM_EnvDfp_RailMeUn2_C "Fehlerpfad spezifische Umweltbedingungen fuer Fehlerpfad Dfp_RailMeUn2" VAL_BLK 0x1CC4D2 Kwb_Wu16 602.000000000 SigName 0.00 602.000000000 FORMAT "%13.9" NUMBER 5 /end CHARACTERISTIC
/begin CHARACTERISTIC DSM_EnvDfp_RailMeUn3_C "Fehlerpfad spezifische Umweltbedingungen fuer Fehlerpfad Dfp_RailMeUn3" VAL_BLK 0x1CC4DC Kwb_Wu16 602.000000000 SigName 0.00 602.000000000 FORMAT "%13.9" NUMBER 5 /end CHARACTERISTIC
/begin CHARACTERISTIC DSM_EnvDfp_RailMeUn4_C "Fehlerpfad spezifische Umweltbedingungen fuer Fehlerpfad Dfp_RailMeUn4" VAL_BLK 0x1CC4E6 Kwb_Wu16 602.000000000 SigName 0.00 602.000000000 FORMAT "%13.9" NUMBER 5 /end CHARACTERISTIC
/begin CHARACTERISTIC DSM_EnvDfp_RailPCV0_C "Fehlerpfad spezifische Umweltbedingungen fuer Fehlerpfad Dfp_RailPCV0" VAL_BLK 0x1CC4F0 Kwb_Wu16 602.000000000 SigName 0.00 602.000000000 FORMAT "%13.9" NUMBER 5 /end CHARACTERISTIC
/begin CHARACTERISTIC DSM_EnvDfp_RailPCV1_C "Fehlerpfad spezifische Umweltbedingungen fuer Fehlerpfad Dfp_RailPCV1" VAL_BLK 0x1CC4FA Kwb_Wu16 602.000000000 SigName 0.00 602.000000000 FORMAT "%13.9" NUMBER 5 /end CHARACTERISTIC
/begin CHARACTERISTIC DSM_EnvDfp_RailPCV2_C "Fehlerpfad spezifische Umweltbedingungen fuer Fehlerpfad Dfp_RailPCV2" VAL_BLK 0x1CC504 Kwb_Wu16 602.000000000 SigName 0.00 602.000000000 FORMAT "%13.9" NUMBER 5 /end CHARACTERISTIC
/begin CHARACTERISTIC DSM_EnvDfp_RailPCV3_C "Fehlerpfad spezifische Umweltbedingungen fuer Fehlerpfad Dfp_RailPCV3" VAL_BLK 0x1CC50E Kwb_Wu16 602.000000000 SigName 0.00 602.000000000 FORMAT "%13.9" NUMBER 5 /end CHARACTERISTIC
/begin CHARACTERISTIC DSM_EnvDfp_RailPCV4_C "Fehlerpfad spezifische Umweltbedingungen fuer Fehlerpfad Dfp_RailPCV4" VAL_BLK 0x1CC518 Kwb_Wu16 602.000000000 SigName 0.00 602.000000000 FORMAT "%13.9" NUMBER 5 /end CHARACTERISTIC
/begin CHARACTERISTIC DSM_EnvDfp_RailPCV5_C "Fehlerpfad spezifische Umweltbedingungen fuer Fehlerpfad Dfp_RailPCV5" VAL_BLK 0x1CC522 Kwb_Wu16 602.000000000 SigName 0.00 602.000000000 FORMAT "%13.9" NUMBER 5 /end CHARACTERISTIC
/begin CHARACTERISTIC DSM_EnvDfp_SOPTst_C "Fehlerpfad spezifische Umweltbedingungen fuer Fehlerpfad Dfp_SOPTst" VAL_BLK 0x1CC52C Kwb_Wu16 602.000000000 SigName 0.00 602.000000000 FORMAT "%13.9" NUMBER 5 /end CHARACTERISTIC
/begin CHARACTERISTIC DSM_EnvDfp_SSpMon1_C "Fehlerpfad spezifische Umweltbedingungen fuer Fehlerpfad Dfp_SSpMon1" VAL_BLK 0x1CC536 Kwb_Wu16 602.000000000 SigName 0.00 602.000000000 FORMAT "%13.9" NUMBER 5 /end CHARACTERISTIC
/begin CHARACTERISTIC DSM_EnvDfp_SSpMon2_C "Fehlerpfad spezifische Umweltbedingungen fuer Fehlerpfad Dfp_SSpMon2" VAL_BLK 0x1CC540 Kwb_Wu16 602.000000000 SigName 0.00 602.000000000 FORMAT "%13.9" NUMBER 5 /end CHARACTERISTIC
/begin CHARACTERISTIC DSM_EnvDfp_SSpMon3_C "Fehlerpfad spezifische Umweltbedingungen fuer Fehlerpfad Dfp_SSpMon3" VAL_BLK 0x1CC54A Kwb_Wu16 602.000000000 SigName 0.00 602.000000000 FORMAT "%13.9" NUMBER 5 /end CHARACTERISTIC
/begin CHARACTERISTIC DSM_EnvDfp_StrtCDOffRly_C "Fehlerpfad spezifische Umweltbedingungen für Fehlerpfad Dfp_StrtCDOffRly" VAL_BLK 0x1CC554 Kwb_Wu16 602.000000000 SigName 0.00 602.000000000 FORMAT "%13.9" NUMBER 5 /end CHARACTERISTIC
/begin CHARACTERISTIC DSM_EnvDfp_StrtCDOnRly_C "Fehlerpfad spezifische Umweltbedingungen für Fehlerpfad Dfp_StrtCDOnRly" VAL_BLK 0x1CC55E Kwb_Wu16 602.000000000 SigName 0.00 602.000000000 FORMAT "%13.9" NUMBER 5 /end CHARACTERISTIC
/begin CHARACTERISTIC DSM_EnvDfp_StrtCtlIlsNotPlaus_C "Fehlerpfad spezifische Umweltbedingungen für Fehlerpfad Dfp_StrtCtlIlsNotPlaus" VAL_BLK 0x1CC568 Kwb_Wu16 602.000000000 SigName 0.00 602.000000000 FORMAT "%13.9" NUMBER 5 /end CHARACTERISTIC
/begin CHARACTERISTIC DSM_EnvDfp_StrtCtlT50ROneRly1_C "Fehlerpfad spezifische Umweltbedingungen fuer Fehlerpfad Dfp_StrtCtlT50ROneRly1" VAL_BLK 0x1CC572 Kwb_Wu16 602.000000000 SigName 0.00 602.000000000 FORMAT "%13.9" NUMBER 5 /end CHARACTERISTIC
/begin CHARACTERISTIC DSM_EnvDfp_StrtCtlT50ROneRly2_C "Fehlerpfad spezifische Umweltbedingungen fuer Fehlerpfad Dfp_StrtCtlT50ROneRly2" VAL_BLK 0x1CC57C Kwb_Wu16 602.000000000 SigName 0.00 602.000000000 FORMAT "%13.9" NUMBER 5 /end CHARACTERISTIC
/begin CHARACTERISTIC DSM_EnvDfp_StrtCtlT50RZero_C "Fehlerpfad spezifische Umweltbedingungen fuer Fehlerpfad Dfp_StrtCtlT50RZero" VAL_BLK 0x1CC586 Kwb_Wu16 602.000000000 SigName 0.00 602.000000000 FORMAT "%13.9" NUMBER 5 /end CHARACTERISTIC
/begin CHARACTERISTIC DSM_EnvDfp_SysLamp_C "Fehlerpfad spezifische Umweltbedingungen fuer Fehlerpfad Dfp_SysLamp" VAL_BLK 0x1CC590 Kwb_Wu16 602.000000000 SigName 0.00 602.000000000 FORMAT "%13.9" NUMBER 5 /end CHARACTERISTIC
/begin CHARACTERISTIC DSM_EnvDfp_T15CD_C "Fehlerpfad spezifische Umweltbedingungen fuer Fehlerpfad Dfp_T15CD" VAL_BLK 0x1CC59A Kwb_Wu16 602.000000000 SigName 0.00 602.000000000 FORMAT "%13.9" NUMBER 5 /end CHARACTERISTIC
/begin CHARACTERISTIC DSM_EnvDfp_TPUMon_C "Fehlerpfad spezifische Umweltbedingungen fuer Fehlerpfad Dfp_TPUMon" VAL_BLK 0x1CC5A4 Kwb_Wu16 602.000000000 SigName 0.00 602.000000000 FORMAT "%13.9" NUMBER 5 /end CHARACTERISTIC
/begin CHARACTERISTIC DSM_EnvDfp_TTSCD_C "Fehlerpfad spezifische Umweltbedingungen fuer Fehlerpfad Dfp_TTSCD" VAL_BLK 0x1CC5AE Kwb_Wu16 602.000000000 SigName 0.00 602.000000000 FORMAT "%13.9" NUMBER 5 /end CHARACTERISTIC
/begin CHARACTERISTIC DSM_EnvDfp_TVACD_Max_C "Fehlerpfad spezifische Umweltbedingungen fuer Fehlerpfad Dfp_TVACD_Max" VAL_BLK 0x1CC5B8 Kwb_Wu16 602.000000000 SigName 0.00 602.000000000 FORMAT "%13.9" NUMBER 5 /end CHARACTERISTIC
/begin CHARACTERISTIC DSM_EnvDfp_TVACD_Min_C "Fehlerpfad spezifische Umweltbedingungen fuer Fehlerpfad Dfp_TVACD_Min" VAL_BLK 0x1CC5C2 Kwb_Wu16 602.000000000 SigName 0.00 602.000000000 FORMAT "%13.9" NUMBER 5 /end CHARACTERISTIC
/begin CHARACTERISTIC DSM_EnvDfp_TVACD_SigNpl_C "Fehlerpfad spezifische Umweltbedingungen fuer Fehlerpfad Dfp_TVACD_SigNpl" VAL_BLK 0x1CC5CC Kwb_Wu16 602.000000000 SigName 0.00 602.000000000 FORMAT "%13.9" NUMBER 5 /end CHARACTERISTIC
/begin CHARACTERISTIC DSM_EnvDfp_TVACD_stLineDef_C "Fehlerpfad spezifische Umweltbedingungen fuer Fehlerpfad Dfp_TVACD_stLineDef" VAL_BLK 0x1CC5D6 Kwb_Wu16 602.000000000 SigName 0.00 602.000000000 FORMAT "%13.9" NUMBER 5 /end CHARACTERISTIC
/begin CHARACTERISTIC DSM_EnvDfp_UAcc_CodeBitErr_C "Fehlerpfad spezifische Umweltbedingungen fuer Fehlerpfad Dfp_UAcc_CodeBitErr" VAL_BLK 0x1CC5E0 Kwb_Wu16 602.000000000 SigName 0.00 602.000000000 FORMAT "%13.9" NUMBER 5 /end CHARACTERISTIC
/begin CHARACTERISTIC DSM_EnvDfp_USAp_DataVariant_C "Fehlerpfad spezifische Umweltbedingungen fuer Fehlerpfad Dfp_USAp_DataVariant" VAL_BLK 0x1CC5EA Kwb_Wu16 602.000000000 SigName 0.00 602.000000000 FORMAT "%13.9" NUMBER 5 /end CHARACTERISTIC
/begin CHARACTERISTIC DSM_EnvDfp_USAp_FuncCodeRead_C "Fehlerpfad spezifische Umweltbedingungen fuer Fehlerpfad Dfp_USAp_FuncCodeRead" VAL_BLK 0x1CC5F4 Kwb_Wu16 602.000000000 SigName 0.00 602.000000000 FORMAT "%13.9" NUMBER 5 /end CHARACTERISTIC
/begin CHARACTERISTIC DSM_EnvDfp_VSACD1_Max_C "Fehlerpfad spezifische Umweltbedingungen fuer Fehlerpfad Dfp_VSACD1_Max" VAL_BLK 0x1CC5FE Kwb_Wu16 602.000000000 SigName 0.00 602.000000000 FORMAT "%13.9" NUMBER 5 /end CHARACTERISTIC
/begin CHARACTERISTIC DSM_EnvDfp_VSACD1_Min_C "Fehlerpfad spezifische Umweltbedingungen fuer Fehlerpfad Dfp_VSACD1_Min" VAL_BLK 0x1CC608 Kwb_Wu16 602.000000000 SigName 0.00 602.000000000 FORMAT "%13.9" NUMBER 5 /end CHARACTERISTIC
/begin CHARACTERISTIC DSM_EnvDfp_VSACD1_SigNpl_C "Fehlerpfad spezifische Umweltbedingungen fuer Fehlerpfad Dfp_VSACD1_SigNpl" VAL_BLK 0x1CC612 Kwb_Wu16 602.000000000 SigName 0.00 602.000000000 FORMAT "%13.9" NUMBER 5 /end CHARACTERISTIC
/begin CHARACTERISTIC DSM_EnvDfp_VSACD2_Max_C "Fehlerpfad spezifische Umweltbedingungen fuer Fehlerpfad Dfp_VSACD2_Max" VAL_BLK 0x1CC61C Kwb_Wu16 602.000000000 SigName 0.00 602.000000000 FORMAT "%13.9" NUMBER 5 /end CHARACTERISTIC
/begin CHARACTERISTIC DSM_EnvDfp_VSACD2_Min_C "Fehlerpfad spezifische Umweltbedingungen fuer Fehlerpfad Dfp_VSACD2_Min" VAL_BLK 0x1CC626 Kwb_Wu16 602.000000000 SigName 0.00 602.000000000 FORMAT "%13.9" NUMBER 5 /end CHARACTERISTIC
/begin CHARACTERISTIC DSM_EnvDfp_VSACD2_SigNpl_C "Fehlerpfad spezifische Umweltbedingungen fuer Fehlerpfad Dfp_VSACD2_SigNpl" VAL_BLK 0x1CC630 Kwb_Wu16 602.000000000 SigName 0.00 602.000000000 FORMAT "%13.9" NUMBER 5 /end CHARACTERISTIC
/begin CHARACTERISTIC DSM_EnvDfp_VSAExcSensTemp1_C "Fehlerpfad spezifische Umweltbedingungen fuer Fehlerpfad Dfp_VSAExcSensTemp1" VAL_BLK 0x1CC63A Kwb_Wu16 602.000000000 SigName 0.00 602.000000000 FORMAT "%13.9" NUMBER 5 /end CHARACTERISTIC
/begin CHARACTERISTIC DSM_EnvDfp_VSAExcSensTemp2_C "Fehlerpfad spezifische Umweltbedingungen fuer Fehlerpfad Dfp_VSAExcSensTemp2" VAL_BLK 0x1CC644 Kwb_Wu16 602.000000000 SigName 0.00 602.000000000 FORMAT "%13.9" NUMBER 5 /end CHARACTERISTIC
/begin CHARACTERISTIC DSM_EnvDfp_VSANotLrn1_C "Fehlerpfad spezifische Umweltbedingungen fuer Fehlerpfad Dfp_VSANotLrn1" VAL_BLK 0x1CC64E Kwb_Wu16 602.000000000 SigName 0.00 602.000000000 FORMAT "%13.9" NUMBER 5 /end CHARACTERISTIC
/begin CHARACTERISTIC DSM_EnvDfp_VSANotLrn2_C "Fehlerpfad spezifische Umweltbedingungen fuer Fehlerpfad Dfp_VSANotLrn2" VAL_BLK 0x1CC658 Kwb_Wu16 602.000000000 SigName 0.00 602.000000000 FORMAT "%13.9" NUMBER 5 /end CHARACTERISTIC
/begin CHARACTERISTIC DSM_EnvDfp_VSASCDDcyc1_C "Fehlerpfad spezifische Umweltbedingungen fuer Fehlerpfad Dfp_VSASCDDcyc1" VAL_BLK 0x1CC662 Kwb_Wu16 602.000000000 SigName 0.00 602.000000000 FORMAT "%13.9" NUMBER 5 /end CHARACTERISTIC
/begin CHARACTERISTIC DSM_EnvDfp_VSASCDDcyc2_C "Fehlerpfad spezifische Umweltbedingungen fuer Fehlerpfad Dfp_VSASCDDcyc2" VAL_BLK 0x1CC66C Kwb_Wu16 602.000000000 SigName 0.00 602.000000000 FORMAT "%13.9" NUMBER 5 /end CHARACTERISTIC
/begin CHARACTERISTIC DSM_EnvDfp_VSASCDPeriod1_C "Fehlerpfad spezifische Umweltbedingungen fuer Fehlerpfad Dfp_VSASCDPeriod1" VAL_BLK 0x1CC676 Kwb_Wu16 602.000000000 SigName 0.00 602.000000000 FORMAT "%13.9" NUMBER 5 /end CHARACTERISTIC
/begin CHARACTERISTIC DSM_EnvDfp_VSASCDPeriod2_C "Fehlerpfad spezifische Umweltbedingungen fuer Fehlerpfad Dfp_VSASCDPeriod2" VAL_BLK 0x1CC680 Kwb_Wu16 602.000000000 SigName 0.00 602.000000000 FORMAT "%13.9" NUMBER 5 /end CHARACTERISTIC
/begin CHARACTERISTIC DSM_EnvDfp_VSSCD1_C "Fehlerpfad spezifische Umweltbedingungen fuer Fehlerpfad Dfp_VSSCD1" VAL_BLK 0x1CC68A Kwb_Wu16 602.000000000 SigName 0.00 602.000000000 FORMAT "%13.9" NUMBER 5 /end CHARACTERISTIC
/begin CHARACTERISTIC DSM_EnvDfp_VSSCD2_C "Fehlerpfad spezifische Umweltbedingungen fuer Fehlerpfad Dfp_VSSCD2" VAL_BLK 0x1CC694 Kwb_Wu16 602.000000000 SigName 0.00 602.000000000 FORMAT "%13.9" NUMBER 5 /end CHARACTERISTIC
/begin CHARACTERISTIC DSM_EnvDfp_VSSCD4_C "Fehlerpfad spezifische Umweltbedingungen fuer Fehlerpfad Dfp_VSSCD4" VAL_BLK 0x1CC69E Kwb_Wu16 602.000000000 SigName 0.00 602.000000000 FORMAT "%13.9" NUMBER 5 /end CHARACTERISTIC
/begin CHARACTERISTIC DSM_EnvDfp_VSSCDBrkLowVltg_C "Fehlerpfad spezifische Umweltbedingungen fuer Fehlerpfad Dfp_VSSCDBrkLowVltg" VAL_BLK 0x1CC6A8 Kwb_Wu16 602.000000000 SigName 0.00 602.000000000 FORMAT "%13.9" NUMBER 5 /end CHARACTERISTIC
/begin CHARACTERISTIC DSM_EnvDfp_VSSCDCAN_C "Fehlerpfad spezifische Umweltbedingungen fuer Fehlerpfad Dfp_VSSCDCAN" VAL_BLK 0x1CC6B2 Kwb_Wu16 602.000000000 SigName 0.00 602.000000000 FORMAT "%13.9" NUMBER 5 /end CHARACTERISTIC
/begin CHARACTERISTIC DSM_EnvDfp_VSSCDNpl_C "Fehlerpfad spezifische Umweltbedingungen fuer Fehlerpfad Dfp_VSSCDNpl" VAL_BLK 0x1CC6BC Kwb_Wu16 602.000000000 SigName 0.00 602.000000000 FORMAT "%13.9" NUMBER 5 /end CHARACTERISTIC
/begin CHARACTERISTIC DSM_EnvDfp_WdCom_C "Fehlerpfad spezifische Umweltbedingungen fuer Fehlerpfad Dfp_WdCom" VAL_BLK 0x1CC6C6 Kwb_Wu16 602.000000000 SigName 0.00 602.000000000 FORMAT "%13.9" NUMBER 5 /end CHARACTERISTIC
/begin MEASUREMENT Dfp_ACCCDWrongCoded_mp "Fehlerpfad falsch codiertes MSG" UWORD OneToOne 1 100 0.00 65535.00 FORMAT "%8.2" ECU_ADDRESS 0x8023B2 /end MEASUREMENT
/begin MEASUREMENT Dfp_ACCD_mp "Messpunkt fuer Fehlerpfad  Dfp_ACCD" UWORD OneToOne 1 100 0.00 65535.00 FORMAT "%8.2" ECU_ADDRESS 0x8023B4 /end MEASUREMENT
/begin MEASUREMENT Dfp_ACCD_PAC_mp "Fehlerpfad PWM-Input Kältemitteldruck" UWORD OneToOne 1 100 0.00 65535.00 FORMAT "%8.2" ECU_ADDRESS 0x8023B6 /end MEASUREMENT
/begin MEASUREMENT Dfp_ACCD_pCAN_mp "Meßpunkt für Fehlerpfad Dfp_ACCD_pCAN" UWORD OneToOne 1 100 0.00 65535.00 FORMAT "%8.2" ECU_ADDRESS 0x8023B8 /end MEASUREMENT
/begin MEASUREMENT Dfp_ACCD_trqCAN_mp "Meßpunkt für Fehlerpfad Dfp_ACCD_trqCAN" UWORD OneToOne 1 100 0.00 65535.00 FORMAT "%8.2" ECU_ADDRESS 0x8023BA /end MEASUREMENT
/begin MEASUREMENT Dfp_ACCnotPlaus_mp "Fehlerpfad für nicht plausibles ACC-Steuergerät" UWORD OneToOne 1 100 0.00 65535.00 FORMAT "%8.2" ECU_ADDRESS 0x8023BC /end MEASUREMENT
/begin MEASUREMENT Dfp_AccPedPlausBrk_mp "Fehlerpfad für Unplausibilität AccPed-Brk" UWORD OneToOne 1 100 0.00 65535.00 FORMAT "%8.2" ECU_ADDRESS 0x8023BE /end MEASUREMENT
/begin MEASUREMENT Dfp_ADCMon_mp "Messpunkt fuer Fehlerpfad  Dfp_ADCMon" UWORD OneToOne 1 100 0.00 65535.00 FORMAT "%8.2" ECU_ADDRESS 0x8023C0 /end MEASUREMENT
/begin MEASUREMENT Dfp_AddPCDTnkLvlDef_mp "Fehlerpfad der Signalfehlermeldung" UWORD OneToOne 1 100 0.00 65535.00 FORMAT "%8.2" ECU_ADDRESS 0x8023C2 /end MEASUREMENT
/begin MEASUREMENT Dfp_AddPCDTnkLvl_mp "Fehlerpfad des Additiv-Tankleerschalters" UWORD OneToOne 1 100 0.00 65535.00 FORMAT "%8.2" ECU_ADDRESS 0x8023C4 /end MEASUREMENT
/begin MEASUREMENT Dfp_AddPCD_mp "Messpunkt fuer Fehlerpfad  Dfp_AddPCD" UWORD OneToOne 1 100 0.00 65535.00 FORMAT "%8.2" ECU_ADDRESS 0x8023C6 /end MEASUREMENT
/begin MEASUREMENT Dfp_AFSCD_AirTempDcyc_mp "Messpunkt fuer Fehlerpfad  Dfp_AFSCD_AirTempDcyc" UWORD OneToOne 1 100 0.00 65535.00 FORMAT "%8.2" ECU_ADDRESS 0x8023C8 /end MEASUREMENT
/begin MEASUREMENT Dfp_AFSCD_Plaus_mp "Messpunkt fuer Fehlerpfad  Dfp_AFSCD_Plaus" UWORD OneToOne 1 100 0.00 65535.00 FORMAT "%8.2" ECU_ADDRESS 0x8023CA /end MEASUREMENT
/begin MEASUREMENT Dfp_AFSCD_PlOffsDrft_mp "Messpunkt fuer Fehlerpfad  Dfp_AFSCD_PlOffsDrft" UWORD OneToOne 1 100 0.00 65535.00 FORMAT "%8.2" ECU_ADDRESS 0x8023CC /end MEASUREMENT
/begin MEASUREMENT Dfp_AFSCD_PlSetyDrft_mp "Messpunkt fuer Fehlerpfad  Dfp_AFSCD_PlSetyDrft" UWORD OneToOne 1 100 0.00 65535.00 FORMAT "%8.2" ECU_ADDRESS 0x8023CE /end MEASUREMENT
/begin MEASUREMENT Dfp_AFSCD_SRCAirm2_mp "Messpunkt fuer Fehlerpfad  Dfp_AFSCD_SRCAirm2" UWORD OneToOne 1 100 0.00 65535.00 FORMAT "%8.2" ECU_ADDRESS 0x8023D0 /end MEASUREMENT
/begin MEASUREMENT Dfp_AFSCD_SRCAirm_mp "Fehlerpfad für SRC des Luftmassenrohwerts" UWORD OneToOne 1 100 0.00 65535.00 FORMAT "%8.2" ECU_ADDRESS 0x8023D2 /end MEASUREMENT
/begin MEASUREMENT Dfp_AFSCD_SRCAirTemp_mp "Fehlerpfad für Prüfung auf optimal Lufttemperatur" UWORD OneToOne 1 100 0.00 65535.00 FORMAT "%8.2" ECU_ADDRESS 0x8023D4 /end MEASUREMENT
/begin MEASUREMENT Dfp_AFSCD_SRCBatt_mp "Fehlerpfad für Prüfung auf optimale Batteriespannung" UWORD OneToOne 1 100 0.00 65535.00 FORMAT "%8.2" ECU_ADDRESS 0x8023D6 /end MEASUREMENT
/begin MEASUREMENT Dfp_AFSCD_SRCCorrAirm_mp "Fehlerpfad für SRC des korrigierten Sensorsignals (HFM6)" UWORD OneToOne 1 100 0.00 65535.00 FORMAT "%8.2" ECU_ADDRESS 0x8023D8 /end MEASUREMENT
/begin MEASUREMENT Dfp_AFSCD_SRCRawAirm_mp "Fehlerpfad für SRC des unkorrigierten Sensorsignals (HFM6)" UWORD OneToOne 1 100 0.00 65535.00 FORMAT "%8.2" ECU_ADDRESS 0x8023DA /end MEASUREMENT
/begin MEASUREMENT Dfp_AFSCD_SRCRefSigPer_mp "Fehlerpfad für SRC des Referenzsignals (Lufttemperatur-Periodendauer beim HFM6)" UWORD OneToOne 1 100 0.00 65535.00 FORMAT "%8.2" ECU_ADDRESS 0x8023DC /end MEASUREMENT
/begin MEASUREMENT Dfp_AFVCD_Actr_mp "Messpunkt für Fehlerpfad aus der HWK" UWORD OneToOne 1 100 0.00 65535.00 FORMAT "%8.2" ECU_ADDRESS 0x8023DE /end MEASUREMENT
/begin MEASUREMENT Dfp_AirbCDCrashCrCtl_mp "Meßpunkt für Fehlerpfad Abschaltung CrCtl durch Airbag" UWORD OneToOne 1 100 0.00 65535.00 FORMAT "%8.2" ECU_ADDRESS 0x8023E0 /end MEASUREMENT
/begin MEASUREMENT Dfp_AirbCDCrashPSP_mp "Meßpunkt für Fehlerpfad Abschaltung PSP durch Airbag" UWORD OneToOne 1 100 0.00 65535.00 FORMAT "%8.2" ECU_ADDRESS 0x8023E2 /end MEASUREMENT
/begin MEASUREMENT Dfp_AirbCDCrash_mp "Meßpunkt für Fehlerpfad tatsächlicher Crash durch Airbag erkannt" UWORD OneToOne 1 100 0.00 65535.00 FORMAT "%8.2" ECU_ADDRESS 0x8023E4 /end MEASUREMENT
/begin MEASUREMENT Dfp_AirCtl_GovDev_mp "Messpunkt fuer Fehlerpfad  Dfp_AirCtl_GovDev" UWORD OneToOne 1 100 0.00 65535.00 FORMAT "%8.2" ECU_ADDRESS 0x8023E6 /end MEASUREMENT
/begin MEASUREMENT Dfp_AltCDExc_mp "Meßpunkt für Fehlerpfad Dfp_AltCDExc" UWORD OneToOne 1 100 0.00 65535.00 FORMAT "%8.2" ECU_ADDRESS 0x8023E8 /end MEASUREMENT
/begin MEASUREMENT Dfp_AltCD_Load_mp "Messpunkt fuer Fehlerpfad  Dfp_AltCD_Load" UWORD OneToOne 1 100 0.00 65535.00 FORMAT "%8.2" ECU_ADDRESS 0x8023EA /end MEASUREMENT
/begin MEASUREMENT Dfp_AltPwrCan_mp "Fehlerpfad für Generatorleistung über CAN" UWORD OneToOne 1 100 0.00 65535.00 FORMAT "%8.2" ECU_ADDRESS 0x8023EC /end MEASUREMENT
/begin MEASUREMENT Dfp_AOHtCDHt1_mp "Messpunkt fuer Fehlerpfad  Dfp_AOHtCDHt1" UWORD OneToOne 1 100 0.00 65535.00 FORMAT "%8.2" ECU_ADDRESS 0x8023EE /end MEASUREMENT
/begin MEASUREMENT Dfp_AOHtCDHt2_mp "Messpunkt fuer Fehlerpfad  Dfp_AOHtCDHt2" UWORD OneToOne 1 100 0.00 65535.00 FORMAT "%8.2" ECU_ADDRESS 0x8023F0 /end MEASUREMENT
/begin MEASUREMENT Dfp_AOHtCDHt3_mp "Messpunkt fuer Fehlerpfad  Dfp_AOHtCDHt3" UWORD OneToOne 1 100 0.00 65535.00 FORMAT "%8.2" ECU_ADDRESS 0x8023F2 /end MEASUREMENT
/begin MEASUREMENT Dfp_APP1_mp "Messpunkt fuer Fehlerpfad  Dfp_APP1" UWORD OneToOne 1 100 0.00 65535.00 FORMAT "%8.2" ECU_ADDRESS 0x8023F4 /end MEASUREMENT
/begin MEASUREMENT Dfp_APP2_mp "Messpunkt fuer Fehlerpfad  Dfp_APP2" UWORD OneToOne 1 100 0.00 65535.00 FORMAT "%8.2" ECU_ADDRESS 0x8023F6 /end MEASUREMENT
/begin MEASUREMENT Dfp_APPCD_KickDown_mp "Messpunkt fuer Fehlerpfad  Dfp_APPCD_KickDown" UWORD OneToOne 1 100 0.00 65535.00 FORMAT "%8.2" ECU_ADDRESS 0x8023F8 /end MEASUREMENT
/begin MEASUREMENT Dfp_APPSync_mp "Messpunkt für Fehlerpfad Dfp_APPSync" UWORD OneToOne 1 100 0.00 65535.00 FORMAT "%8.2" ECU_ADDRESS 0x8023FA /end MEASUREMENT
/begin MEASUREMENT Dfp_APP_Npl_mp "Messpunkt fuer Fehlerpfad  Dfp_APP_Npl" UWORD OneToOne 1 100 0.00 65535.00 FORMAT "%8.2" ECU_ADDRESS 0x8023FC /end MEASUREMENT
/begin MEASUREMENT Dfp_APSCD_mp "Messpunkt fuer Fehlerpfad  Dfp_APSCD" UWORD OneToOne 1 100 0.00 65535.00 FORMAT "%8.2" ECU_ADDRESS 0x8023FE /end MEASUREMENT
/begin MEASUREMENT Dfp_BattCD_mp "Messpunkt fuer Fehlerpfad  Dfp_BattCD" UWORD OneToOne 1 100 0.00 65535.00 FORMAT "%8.2" ECU_ADDRESS 0x802400 /end MEASUREMENT
/begin MEASUREMENT Dfp_BPACD_Max_mp "Fehlerpfad für Kurzschluss nach Batteriespannung des Ladedruckstrellers" UWORD OneToOne 1 100 0.00 65535.00 FORMAT "%8.2" ECU_ADDRESS 0x802402 /end MEASUREMENT
/begin MEASUREMENT Dfp_BPACD_Min_mp "Fehlerpfad für Kurzschluss nach Masse des Ladedruckstellers" UWORD OneToOne 1 100 0.00 65535.00 FORMAT "%8.2" ECU_ADDRESS 0x802404 /end MEASUREMENT
/begin MEASUREMENT Dfp_BPACD_SigNpl_mp "Fehlerpfad für Lastabfall und Übertemperatur des Ladedruckstellers" UWORD OneToOne 1 100 0.00 65535.00 FORMAT "%8.2" ECU_ADDRESS 0x802406 /end MEASUREMENT
/begin MEASUREMENT Dfp_BPAExcSensTemp_mp "Messpunkt fuer Fehlerpfad Dfp_BPAExcSensTemp" UWORD OneToOne 1 100 0.00 65535.00 FORMAT "%8.2" ECU_ADDRESS 0x802408 /end MEASUREMENT
/begin MEASUREMENT Dfp_BPANotLrn_mp "Fehlerpfad für Defekt beim Anlernen der mechanischen Anschläge" UWORD OneToOne 1 100 0.00 65535.00 FORMAT "%8.2" ECU_ADDRESS 0x80240A /end MEASUREMENT
/begin MEASUREMENT Dfp_BPASCDDcyc_mp "Messpunkt für Fehlerpfad Dfp_BPASCDDcyc" UWORD OneToOne 1 100 0.00 65535.00 FORMAT "%8.2" ECU_ADDRESS 0x80240C /end MEASUREMENT
/begin MEASUREMENT Dfp_BPASCDPeriod_mp "Messpunkt für Fehlerpfad Dfp_BPASCDPeriod" UWORD OneToOne 1 100 0.00 65535.00 FORMAT "%8.2" ECU_ADDRESS 0x80240E /end MEASUREMENT
/begin MEASUREMENT Dfp_BPSCDPlaus_mp "Dfp nur für die APS-BPS Plausibilisierung des BPSCD" UWORD OneToOne 1 100 0.00 65535.00 FORMAT "%8.2" ECU_ADDRESS 0x802410 /end MEASUREMENT
/begin MEASUREMENT Dfp_BPSCD_mp "Messpunkt fuer Fehlerpfad  Dfp_BPSCD" UWORD OneToOne 1 100 0.00 65535.00 FORMAT "%8.2" ECU_ADDRESS 0x802412 /end MEASUREMENT
/begin MEASUREMENT Dfp_BrkCDdynPl_mp "Messpunkt fuer Fehlerpfad  Dfp_BrkCDdynPl" UWORD OneToOne 1 100 0.00 65535.00 FORMAT "%8.2" ECU_ADDRESS 0x802414 /end MEASUREMENT
/begin MEASUREMENT Dfp_BrkCD_mp "Messpunkt fuer Fehlerpfad  Dfp_BrkCD" UWORD OneToOne 1 100 0.00 65535.00 FORMAT "%8.2" ECU_ADDRESS 0x802416 /end MEASUREMENT
/begin MEASUREMENT Dfp_CANA_mp "Messpunkt fuer Fehlerpfad  Dfp_CANA" UWORD OneToOne 1 100 0.00 65535.00 FORMAT "%8.2" ECU_ADDRESS 0x802418 /end MEASUREMENT
/begin MEASUREMENT Dfp_CANBus1_mp "Messpunkt fuer Fehlerpfad  Bus1" UWORD OneToOne 1 100 0.00 65535.00 FORMAT "%8.2" ECU_ADDRESS 0x80241A /end MEASUREMENT
/begin MEASUREMENT Dfp_CANBus2_mp "Messpunkt fuer Fehlerpfad  Bus2" UWORD OneToOne 1 100 0.00 65535.00 FORMAT "%8.2" ECU_ADDRESS 0x80241C /end MEASUREMENT
/begin MEASUREMENT Dfp_CANBus3_mp "Messpunkt fuer Fehlerpfad  Bus3" UWORD OneToOne 1 100 0.00 65535.00 FORMAT "%8.2" ECU_ADDRESS 0x80241E /end MEASUREMENT
/begin MEASUREMENT Dfp_CANB_mp "Messpunkt fuer Fehlerpfad  Dfp_CANB" UWORD OneToOne 1 100 0.00 65535.00 FORMAT "%8.2" ECU_ADDRESS 0x802420 /end MEASUREMENT
/begin MEASUREMENT Dfp_CANC_mp "Messpunkt fuer Fehlerpfad  Dfp_CANC" UWORD OneToOne 1 100 0.00 65535.00 FORMAT "%8.2" ECU_ADDRESS 0x802422 /end MEASUREMENT
/begin MEASUREMENT Dfp_CANErrActA_mp "Messpunkt fuer Fehlerpfad  Dfp_CANErrActA" UWORD OneToOne 1 100 0.00 65535.00 FORMAT "%8.2" ECU_ADDRESS 0x802424 /end MEASUREMENT
/begin MEASUREMENT Dfp_CANErrActB_mp "Messpunkt fuer Fehlerpfad  Dfp_CANErrActB" UWORD OneToOne 1 100 0.00 65535.00 FORMAT "%8.2" ECU_ADDRESS 0x802426 /end MEASUREMENT
/begin MEASUREMENT Dfp_CANErrActC_mp "Messpunkt fuer Fehlerpfad  Dfp_CANErrActC" UWORD OneToOne 1 100 0.00 65535.00 FORMAT "%8.2" ECU_ADDRESS 0x802428 /end MEASUREMENT
/begin MEASUREMENT Dfp_Clg_DynTst_mp "Messpunkt fuer Fehlerpfad  Dfp_Clg_DynTst" UWORD OneToOne 1 100 0.00 65535.00 FORMAT "%8.2" ECU_ADDRESS 0x80242A /end MEASUREMENT
/begin MEASUREMENT Dfp_CmbChbMisfire1_mp "Fehlerpfad Zündaussetzer in Zylinder 1" UWORD OneToOne 1 100 0.00 65535.00 FORMAT "%8.2" ECU_ADDRESS 0x80242C /end MEASUREMENT
/begin MEASUREMENT Dfp_CmbChbMisfire2_mp "Fehlerpfad Zündaussetzer in Zylinder 2" UWORD OneToOne 1 100 0.00 65535.00 FORMAT "%8.2" ECU_ADDRESS 0x80242E /end MEASUREMENT
/begin MEASUREMENT Dfp_CmbChbMisfire3_mp "Fehlerpfad Zündaussetzer in Zylinder 3" UWORD OneToOne 1 100 0.00 65535.00 FORMAT "%8.2" ECU_ADDRESS 0x802430 /end MEASUREMENT
/begin MEASUREMENT Dfp_CmbChbMisfire4_mp "Fehlerpfad Zündaussetzer in Zylinder 4" UWORD OneToOne 1 100 0.00 65535.00 FORMAT "%8.2" ECU_ADDRESS 0x802432 /end MEASUREMENT
/begin MEASUREMENT Dfp_CmbChbMisfire5_mp "Fehlerpfad Zündaussetzer in Zylinder 5" UWORD OneToOne 1 100 0.00 65535.00 FORMAT "%8.2" ECU_ADDRESS 0x802434 /end MEASUREMENT
/begin MEASUREMENT Dfp_CmbChbMisfire6_mp "Fehlerpfad Zündaussetzer in Zylinder 6" UWORD OneToOne 1 100 0.00 65535.00 FORMAT "%8.2" ECU_ADDRESS 0x802436 /end MEASUREMENT
/begin MEASUREMENT Dfp_CmbChbMisfireMul_mp "Fehlerpfad Zündaussetzer in mehreren Zylindern" UWORD OneToOne 1 100 0.00 65535.00 FORMAT "%8.2" ECU_ADDRESS 0x802438 /end MEASUREMENT
/begin MEASUREMENT Dfp_ConvCD_ConvErr_mp "Meßpunkt für Fehlerpfad Dfp_ConvCD_ConvErr" UWORD OneToOne 1 100 0.00 65535.00 FORMAT "%8.2" ECU_ADDRESS 0x80243A /end MEASUREMENT
/begin MEASUREMENT Dfp_ConvCD_mp "Messpunkt fuer Fehlerpfad  Dfp_ConvCD" UWORD OneToOne 1 100 0.00 65535.00 FORMAT "%8.2" ECU_ADDRESS 0x80243C /end MEASUREMENT
/begin MEASUREMENT Dfp_COTSCD_mp "Fehlerpfad des WTK-Sensors" UWORD OneToOne 1 100 0.00 65535.00 FORMAT "%8.2" ECU_ADDRESS 0x80243E /end MEASUREMENT
/begin MEASUREMENT Dfp_CoVehEcoErr_mp "Ecomatic Fehlerpfad" UWORD OneToOne 1 100 0.00 65535.00 FORMAT "%8.2" ECU_ADDRESS 0x802440 /end MEASUREMENT
/begin MEASUREMENT Dfp_CoVehLvl2_mp "Fehlerpfad für Leerlaufdrehzahlerhöhung der Stufe 2" UWORD OneToOne 1 100 0.00 65535.00 FORMAT "%8.2" ECU_ADDRESS 0x802442 /end MEASUREMENT
/begin MEASUREMENT Dfp_CoVMDCSh_mp "Fehlerpfade physikalische Unplausibilität der  Motorschlupfregelung" UWORD OneToOne 1 100 0.00 65535.00 FORMAT "%8.2" ECU_ADDRESS 0x802444 /end MEASUREMENT
/begin MEASUREMENT Dfp_CoVMDCSp_mp "Status des Fehlerpfades funktionale Plausibilität Motorschlupfregelung mit Geschwindigkeit über Grund" UWORD OneToOne 1 100 0.00 65535.00 FORMAT "%8.2" ECU_ADDRESS 0x802446 /end MEASUREMENT
/begin MEASUREMENT Dfp_CrCtlPanErr_mp "Messpunkt fuer Fehlerpfad  Dfp_CrCtlPanErr" UWORD OneToOne 1 100 0.00 65535.00 FORMAT "%8.2" ECU_ADDRESS 0x802448 /end MEASUREMENT
/begin MEASUREMENT Dfp_CrCtlPanSwtErr_mp "Messpunkt fuer Fehlerpfad  Dfp_CrCtlPanSwtErr" UWORD OneToOne 1 100 0.00 65535.00 FORMAT "%8.2" ECU_ADDRESS 0x80244A /end MEASUREMENT
/begin MEASUREMENT Dfp_CrCtlPLmpDef_mp "Dfp für Bremslicht-Fehler" UWORD OneToOne 1 100 0.00 65535.00 FORMAT "%8.2" ECU_ADDRESS 0x80244C /end MEASUREMENT
/begin MEASUREMENT Dfp_CrCtlPShutOff_mp "Dfp für Abschaltbedingungen der  CrCtl und CrCtl+" UWORD OneToOne 1 100 0.00 65535.00 FORMAT "%8.2" ECU_ADDRESS 0x80244E /end MEASUREMENT
/begin MEASUREMENT Dfp_CrCtlPTlrDef_mp "Dfp für Bremslichtfehler am Anhängerr" UWORD OneToOne 1 100 0.00 65535.00 FORMAT "%8.2" ECU_ADDRESS 0x802450 /end MEASUREMENT
/begin MEASUREMENT Dfp_CtApCD_mp "Messpunkt fuer Fehlerpfad  Dfp_CtApCD" UWORD OneToOne 1 100 0.00 65535.00 FORMAT "%8.2" ECU_ADDRESS 0x802452 /end MEASUREMENT
/begin MEASUREMENT Dfp_CTSCDCanInac_mp "Messpunkt fuer Fehlerpfad  Dfp_CTSCDCanInac" UWORD OneToOne 1 100 0.00 65535.00 FORMAT "%8.2" ECU_ADDRESS 0x802454 /end MEASUREMENT
/begin MEASUREMENT Dfp_CTSCDCanSig_mp "Messpunkt fuer Fehlerpfad  Dfp_CTSCDCanSig" UWORD OneToOne 1 100 0.00 65535.00 FORMAT "%8.2" ECU_ADDRESS 0x802456 /end MEASUREMENT
/begin MEASUREMENT Dfp_CTSCD_mp "Messpunkt fuer Fehlerpfad  Dfp_CTSCD" UWORD OneToOne 1 100 0.00 65535.00 FORMAT "%8.2" ECU_ADDRESS 0x802458 /end MEASUREMENT
/begin MEASUREMENT Dfp_CtTCD_mp "Messpunkt fuer Fehlerpfad  Dfp_CtTCD" UWORD OneToOne 1 100 0.00 65535.00 FORMAT "%8.2" ECU_ADDRESS 0x80245A /end MEASUREMENT
/begin MEASUREMENT Dfp_CtT_Mon_mp "Fehlerpfad Thermostatdiagnose" UWORD OneToOne 1 100 0.00 65535.00 FORMAT "%8.2" ECU_ADDRESS 0x80245C /end MEASUREMENT
/begin MEASUREMENT Dfp_DifftrqLimErrPat_mp "Fehlerpfad für physikalisches Fehlermuster in Message" UWORD OneToOne 1 100 0.00 65535.00 FORMAT "%8.2" ECU_ADDRESS 0x80245E /end MEASUREMENT
/begin MEASUREMENT Dfp_EATSCDCanInac_mp "Messpunkt fuer Fehlerpfad  Dfp_EATSCDCanInac" UWORD OneToOne 1 100 0.00 65535.00 FORMAT "%8.2" ECU_ADDRESS 0x802460 /end MEASUREMENT
/begin MEASUREMENT Dfp_EATSCDCanSig_mp "Messpunkt fuer Fehlerpfad  Dfp_EATSCDCanSig" UWORD OneToOne 1 100 0.00 65535.00 FORMAT "%8.2" ECU_ADDRESS 0x802462 /end MEASUREMENT
/begin MEASUREMENT Dfp_EATSCD_mp "Messpunkt fuer Fehlerpfad  Dfp_EATSCD" UWORD OneToOne 1 100 0.00 65535.00 FORMAT "%8.2" ECU_ADDRESS 0x802464 /end MEASUREMENT
/begin MEASUREMENT Dfp_EEPCDVarMng_mp "Messpunkt fuer Fehlerpfad  Dfp_EEPCDVarMng" UWORD OneToOne 1 100 0.00 65535.00 FORMAT "%8.2" ECU_ADDRESS 0x802466 /end MEASUREMENT
/begin MEASUREMENT Dfp_EGPpCDTPreTrbn1_mp "Messpunkt fuer Fehlerpfad  Dfp_EGPpCDTPreTrbn1" UWORD OneToOne 1 100 0.00 65535.00 FORMAT "%8.2" ECU_ADDRESS 0x802468 /end MEASUREMENT
/begin MEASUREMENT Dfp_EGPpCDTPreTrbn_mp "Messpunkt fuer Fehlerpfad  Dfp_EgPpCD" UWORD OneToOne 1 100 0.00 65535.00 FORMAT "%8.2" ECU_ADDRESS 0x80246A /end MEASUREMENT
/begin MEASUREMENT Dfp_EGRCD_CBV_mp "Fehlerpfad für den EGR-Kühler Bypass Ventil Komponententreibers" UWORD OneToOne 1 100 0.00 65535.00 FORMAT "%8.2" ECU_ADDRESS 0x80246C /end MEASUREMENT
/begin MEASUREMENT Dfp_EGRCD_Max_mp "Fehlerpfad für Kurzschluss nach Batteriespannung des Abgasrückführstellers" UWORD OneToOne 1 100 0.00 65535.00 FORMAT "%8.2" ECU_ADDRESS 0x80246E /end MEASUREMENT
/begin MEASUREMENT Dfp_EGRCD_Min_mp "Fehlerpfad für Kurzschluss nach Masse des Abgasrückführstellers" UWORD OneToOne 1 100 0.00 65535.00 FORMAT "%8.2" ECU_ADDRESS 0x802470 /end MEASUREMENT
/begin MEASUREMENT Dfp_EGRCD_SigNpl_mp "Fehlerpfad für Lastabfall und Übertemperatur des Abgasrückführstellers" UWORD OneToOne 1 100 0.00 65535.00 FORMAT "%8.2" ECU_ADDRESS 0x802472 /end MEASUREMENT
/begin MEASUREMENT Dfp_EMCCD_GTL1_mp "Messpunkt fuer Fehlerpfad  Dfp_EMCCD_GTL1" UWORD OneToOne 1 100 0.00 65535.00 FORMAT "%8.2" ECU_ADDRESS 0x802474 /end MEASUREMENT
/begin MEASUREMENT Dfp_EMCCD_GTL2_mp "Messpunkt fuer Fehlerpfad  Dfp_EMCCD_GTL2" UWORD OneToOne 1 100 0.00 65535.00 FORMAT "%8.2" ECU_ADDRESS 0x802476 /end MEASUREMENT
/begin MEASUREMENT Dfp_EMCCD_MLS1_mp "Messpunkt fuer Fehlerpfad  Dfp_EMCCD_MLS1" UWORD OneToOne 1 100 0.00 65535.00 FORMAT "%8.2" ECU_ADDRESS 0x802478 /end MEASUREMENT
/begin MEASUREMENT Dfp_EMCCD_MLS2_mp "Messpunkt fuer Fehlerpfad  Dfp_EMCCD_MLS2" UWORD OneToOne 1 100 0.00 65535.00 FORMAT "%8.2" ECU_ADDRESS 0x80247A /end MEASUREMENT
/begin MEASUREMENT Dfp_EngMCaS1_mp "Meßpunkt für Fehlerpfad Dfp_EngMCaS1" UWORD OneToOne 1 100 0.00 65535.00 FORMAT "%8.2" ECU_ADDRESS 0x80247C /end MEASUREMENT
/begin MEASUREMENT Dfp_EngMCrS1_mp "Meßpunkt für Fehlerpfad Dfp_EngMCrS1" UWORD OneToOne 1 100 0.00 65535.00 FORMAT "%8.2" ECU_ADDRESS 0x80247E /end MEASUREMENT
/begin MEASUREMENT Dfp_EngMOfsCaSCrS_mp "Meßpunkt fuer Fehlerpfad Dfp_EngMOfsCaSCrS" UWORD OneToOne 1 100 0.00 65535.00 FORMAT "%8.2" ECU_ADDRESS 0x802480 /end MEASUREMENT
/begin MEASUREMENT Dfp_EngMonIrrCmb_mp "Messpunkt für Fehlerpfad der Verbrennungserkennung mit Lambda-Sonde" UWORD OneToOne 1 100 0.00 65535.00 FORMAT "%8.2" ECU_ADDRESS 0x802482 /end MEASUREMENT
/begin MEASUREMENT Dfp_EngPrt_mp "Überdrehzahl-Fehler" UWORD OneToOne 1 100 0.00 65535.00 FORMAT "%8.2" ECU_ADDRESS 0x802484 /end MEASUREMENT
/begin MEASUREMENT Dfp_ErLpCDMILReqON_mp "Fehlerpfad bei permanentem EIN-Zustand der MIL-Lampe" UWORD OneToOne 1 100 0.00 65535.00 FORMAT "%8.2" ECU_ADDRESS 0x802486 /end MEASUREMENT
/begin MEASUREMENT Dfp_ETClbInj1_mp "Messpunkt fuer Fehlerpfad  Dfp_ETClbInj1" UWORD OneToOne 1 100 0.00 65535.00 FORMAT "%8.2" ECU_ADDRESS 0x802488 /end MEASUREMENT
/begin MEASUREMENT Dfp_ETClbInj2_mp "Messpunkt fuer Fehlerpfad  Dfp_ETClbInj2" UWORD OneToOne 1 100 0.00 65535.00 FORMAT "%8.2" ECU_ADDRESS 0x80248A /end MEASUREMENT
/begin MEASUREMENT Dfp_ETClbInj3_mp "Messpunkt fuer Fehlerpfad  Dfp_ETClbInj3" UWORD OneToOne 1 100 0.00 65535.00 FORMAT "%8.2" ECU_ADDRESS 0x80248C /end MEASUREMENT
/begin MEASUREMENT Dfp_ETClbInj4_mp "Messpunkt fuer Fehlerpfad  Dfp_ETClbInj4" UWORD OneToOne 1 100 0.00 65535.00 FORMAT "%8.2" ECU_ADDRESS 0x80248E /end MEASUREMENT
/begin MEASUREMENT Dfp_ETClbInj5_mp "Messpunkt fuer Fehlerpfad  Dfp_ETClbInj5" UWORD OneToOne 1 100 0.00 65535.00 FORMAT "%8.2" ECU_ADDRESS 0x802490 /end MEASUREMENT
/begin MEASUREMENT Dfp_ETClbInj6_mp "Messpunkt fuer Fehlerpfad  Dfp_ETClbInj6" UWORD OneToOne 1 100 0.00 65535.00 FORMAT "%8.2" ECU_ADDRESS 0x802492 /end MEASUREMENT
/begin MEASUREMENT Dfp_FanCD_Fan1Ctlr1_mp "Messpunkt fuer Fehlerpfad  Dfp_FanCD_Fan1Ctlr1" UWORD OneToOne 1 100 0.00 65535.00 FORMAT "%8.2" ECU_ADDRESS 0x802494 /end MEASUREMENT
/begin MEASUREMENT Dfp_FanCD_Fan1Ctlr2_mp "Messpunkt fuer Fehlerpfad  Dfp_FanCD_Fan1Ctlr2" UWORD OneToOne 1 100 0.00 65535.00 FORMAT "%8.2" ECU_ADDRESS 0x802496 /end MEASUREMENT
/begin MEASUREMENT Dfp_FanCD_Fan2Ctlr1_mp "Messpunkt fuer Fehlerpfad  Dfp_FanCD_Fan2Ctlr1" UWORD OneToOne 1 100 0.00 65535.00 FORMAT "%8.2" ECU_ADDRESS 0x802498 /end MEASUREMENT
/begin MEASUREMENT Dfp_FanCD_Fan2Ctlr2_mp "Messpunkt fuer Fehlerpfad  Dfp_FanCD_Fan2Ctlr2" UWORD OneToOne 1 100 0.00 65535.00 FORMAT "%8.2" ECU_ADDRESS 0x80249A /end MEASUREMENT
/begin MEASUREMENT Dfp_FanCD_FanCtlr1_mp "Messpunkt fuer Fehlerpfad  Dfp_FanCD_FanCtlr1" UWORD OneToOne 1 100 0.00 65535.00 FORMAT "%8.2" ECU_ADDRESS 0x80249C /end MEASUREMENT
/begin MEASUREMENT Dfp_FanCD_FanCtlr2_mp "Messpunkt fuer Fehlerpfad  Dfp_FanCD_FanCtlr2" UWORD OneToOne 1 100 0.00 65535.00 FORMAT "%8.2" ECU_ADDRESS 0x80249E /end MEASUREMENT
/begin MEASUREMENT Dfp_FanCD_OutFanCtlr1_mp "Messpunkt fuer Fehlerpfad  Dfp_FanCD_OutFanCtlr1" UWORD OneToOne 1 100 0.00 65535.00 FORMAT "%8.2" ECU_ADDRESS 0x8024A0 /end MEASUREMENT
/begin MEASUREMENT Dfp_FanCD_OutFanCtlr2_mp "Messpunkt fuer Fehlerpfad  Dfp_FanCD_OutFanCtlr2" UWORD OneToOne 1 100 0.00 65535.00 FORMAT "%8.2" ECU_ADDRESS 0x8024A2 /end MEASUREMENT
/begin MEASUREMENT Dfp_FlPpCD_mp "Messpunkt fuer Fehlerpfad  Dfp_FlPpCD" UWORD OneToOne 1 100 0.00 65535.00 FORMAT "%8.2" ECU_ADDRESS 0x8024A4 /end MEASUREMENT
/begin MEASUREMENT Dfp_FlSCDT1_mp "Messpunkt fuer Fehlerpfad  Dfp_FlSCDT1" UWORD OneToOne 1 100 0.00 65535.00 FORMAT "%8.2" ECU_ADDRESS 0x8024A6 /end MEASUREMENT
/begin MEASUREMENT Dfp_FMTC_NonMonotonMap_mp "Prüfung Monotonie der Mengenstützpunkte über Moment in FMTC_trq2qBas_MAP" UWORD OneToOne 1 100 0.00 65535.00 FORMAT "%8.2" ECU_ADDRESS 0x8024A8 /end MEASUREMENT
/begin MEASUREMENT Dfp_FQlSCD_mp "Messpunkt fuer Fehlerpfad  Dfp_FQlSCD" UWORD OneToOne 1 100 0.00 65535.00 FORMAT "%8.2" ECU_ADDRESS 0x8024AA /end MEASUREMENT
/begin MEASUREMENT Dfp_FrmMngAAGNpl_mp "Messpunkt für Fehlerpfad FrmMngAAGNpl (Botschaftszähler Fehler)" UWORD OneToOne 1 100 0.00 65535.00 FORMAT "%8.2" ECU_ADDRESS 0x8024AC /end MEASUREMENT
/begin MEASUREMENT Dfp_FrmMngAAGTO_mp "Timeout-Fehlerpfad Botschaft AAG" UWORD OneToOne 1 100 0.00 65535.00 FORMAT "%8.2" ECU_ADDRESS 0x8024AE /end MEASUREMENT
/begin MEASUREMENT Dfp_FrmMngAC1Npl_mp "Messpunkt für Fehlerpfad FrmMngAC1Npl (DLC-Fehler)" UWORD OneToOne 1 100 0.00 65535.00 FORMAT "%8.2" ECU_ADDRESS 0x8024B0 /end MEASUREMENT
/begin MEASUREMENT Dfp_FrmMngAC1TO_mp "Messpunkt fuer Fehlerpfad  Dfp_FrmMngAC1TO" UWORD OneToOne 1 100 0.00 65535.00 FORMAT "%8.2" ECU_ADDRESS 0x8024B2 /end MEASUREMENT
/begin MEASUREMENT Dfp_FrmMngACCNpl_mp "Messpunkt für Fehlerpfad FrmMngACCNpl (Botschaftszähler und Checksummen Fehler)" UWORD OneToOne 1 100 0.00 65535.00 FORMAT "%8.2" ECU_ADDRESS 0x8024B4 /end MEASUREMENT
/begin MEASUREMENT Dfp_FrmMngACCTO_mp "Fehlerpfad für Timeout der Can-Massage ACC-System" UWORD OneToOne 1 100 0.00 65535.00 FORMAT "%8.2" ECU_ADDRESS 0x8024B6 /end MEASUREMENT
/begin MEASUREMENT Dfp_FrmMngAIRBGNpl_mp "Messpunkt für Fehlerpfad FrmMngAIRBG (Botschaftszähler und Checksummen Fehler)" UWORD OneToOne 1 100 0.00 65535.00 FORMAT "%8.2" ECU_ADDRESS 0x8024B8 /end MEASUREMENT
/begin MEASUREMENT Dfp_FrmMngAIRBGTO_mp "Messpunkt fuer Fehlerpfad Dfp_FrmMngAIRBGTO" UWORD OneToOne 1 100 0.00 65535.00 FORMAT "%8.2" ECU_ADDRESS 0x8024BA /end MEASUREMENT
/begin MEASUREMENT Dfp_FrmMngAWD1Npl_mp "Messpunkt für Fehlerpfad FrmMngAWD1Npl (Botschaftszähler Fehler)" UWORD OneToOne 1 100 0.00 65535.00 FORMAT "%8.2" ECU_ADDRESS 0x8024BC /end MEASUREMENT
/begin MEASUREMENT Dfp_FrmMngAWD1TO_mp "Messpunkt fuer Fehlerpfad  Dfp_FrmMngAWD1TO" UWORD OneToOne 1 100 0.00 65535.00 FORMAT "%8.2" ECU_ADDRESS 0x8024BE /end MEASUREMENT
/begin MEASUREMENT Dfp_FrmMngBEM1Npl_mp "Messpunkt für Fehlerpfad FrmMngBEM1Npl (Botschaftszähler und Checksummen Fehler)" UWORD OneToOne 1 100 0.00 65535.00 FORMAT "%8.2" ECU_ADDRESS 0x8024C0 /end MEASUREMENT
/begin MEASUREMENT Dfp_FrmMngBEM1TO_mp "Fehlerpfad für Timeout-Fehler von Energiemanager (BEM1)-Botschaft" UWORD OneToOne 1 100 0.00 65535.00 FORMAT "%8.2" ECU_ADDRESS 0x8024C2 /end MEASUREMENT
/begin MEASUREMENT Dfp_FrmMngBRK1Npl_mp "Messpunkt für Fehlerpfad FrmMngBRK1Npl (Botschaftszähler Fehler)" UWORD OneToOne 1 100 0.00 65535.00 FORMAT "%8.2" ECU_ADDRESS 0x8024C4 /end MEASUREMENT
/begin MEASUREMENT Dfp_FrmMngBRK1TO_mp "Messpunkt fuer Fehlerpfad  Dfp_FrmMngBRK1TO" UWORD OneToOne 1 100 0.00 65535.00 FORMAT "%8.2" ECU_ADDRESS 0x8024C6 /end MEASUREMENT
/begin MEASUREMENT Dfp_FrmMngBRK2Npl_mp "Messpunkt für Fehlerpfad FrmMngBRK2Npl (DLC-Fehler)" UWORD OneToOne 1 100 0.00 65535.00 FORMAT "%8.2" ECU_ADDRESS 0x8024C8 /end MEASUREMENT
/begin MEASUREMENT Dfp_FrmMngBRK2TO_mp "Messpunkt fuer DSM Dfp_FrmMngBRK2TO_mp" UWORD OneToOne 1 100 0.00 65535.00 FORMAT "%8.2" ECU_ADDRESS 0x8024CA /end MEASUREMENT
/begin MEASUREMENT Dfp_FrmMngBRK8Npl_mp "Messpunkt für Fehlerpfad FrmMngBRK8Npl (Botschaftszähler und Checksummen Fehler)" UWORD OneToOne 1 100 0.00 65535.00 FORMAT "%8.2" ECU_ADDRESS 0x8024CC /end MEASUREMENT
/begin MEASUREMENT Dfp_FrmMngBRK8TO_mp "Messpunkt fuer Fehlerpfad  Dfp_FrmMngBRK8TO" UWORD OneToOne 1 100 0.00 65535.00 FORMAT "%8.2" ECU_ADDRESS 0x8024CE /end MEASUREMENT
/begin MEASUREMENT Dfp_FrmMngCANVerErr_mp "Fehlerpfad für falsche CAN-Version" UWORD OneToOne 1 100 0.00 65535.00 FORMAT "%8.2" ECU_ADDRESS 0x8024D0 /end MEASUREMENT
/begin MEASUREMENT Dfp_FrmMngCCSel_mp "Plausibility Error => Audi-ACC" UWORD OneToOne 1 100 0.00 65535.00 FORMAT "%8.2" ECU_ADDRESS 0x8024D2 /end MEASUREMENT
/begin MEASUREMENT Dfp_FrmMngCCTLNpl_mp "Messpunkt für Fehlerpfad FrmMngCCTLNpl (Botschaftszähler und Checksummen Fehler)" UWORD OneToOne 1 100 0.00 65535.00 FORMAT "%8.2" ECU_ADDRESS 0x8024D4 /end MEASUREMENT
/begin MEASUREMENT Dfp_FrmMngCCTLTO_mp "Messpunkt fuer Fehlerpfad  Dfp_FrmMngCCTLTO" UWORD OneToOne 1 100 0.00 65535.00 FORMAT "%8.2" ECU_ADDRESS 0x8024D6 /end MEASUREMENT
/begin MEASUREMENT Dfp_FrmMngChrgr1A_mp "Fehlerpfad für Chrgr1 Lage Regelabweichung" UWORD OneToOne 1 100 0.00 65535.00 FORMAT "%8.2" ECU_ADDRESS 0x8024D8 /end MEASUREMENT
/begin MEASUREMENT Dfp_FrmMngChrgr1C_mp "Fehlerpfad für Chrgr1 Treiberstrom" UWORD OneToOne 1 100 0.00 65535.00 FORMAT "%8.2" ECU_ADDRESS 0x8024DA /end MEASUREMENT
/begin MEASUREMENT Dfp_FrmMngCHRGR1Npl_mp "Messpunkt für Fehlerpfad FrmMngCHRGR1Npl (DLC-Fehler)" UWORD OneToOne 1 100 0.00 65535.00 FORMAT "%8.2" ECU_ADDRESS 0x8024DC /end MEASUREMENT
/begin MEASUREMENT Dfp_FrmMngChrgr1N_mp "Fehlerpfad für Chrgr1 CAN Kommunikation" UWORD OneToOne 1 100 0.00 65535.00 FORMAT "%8.2" ECU_ADDRESS 0x8024DE /end MEASUREMENT
/begin MEASUREMENT Dfp_FrmMngCHRGR1TO_mp "Fehlerpfad für Timeout der CAN-Message CHRGR1" UWORD OneToOne 1 100 0.00 65535.00 FORMAT "%8.2" ECU_ADDRESS 0x8024E0 /end MEASUREMENT
/begin MEASUREMENT Dfp_FrmMngChrgr1T_mp "Fehlerpfad für Chrgr1 Treiberübertemperatur" UWORD OneToOne 1 100 0.00 65535.00 FORMAT "%8.2" ECU_ADDRESS 0x8024E2 /end MEASUREMENT
/begin MEASUREMENT Dfp_FrmMngChrgr1V_mp "Fehlerpfad für Chrgr1 SRC Versorgungsspannung" UWORD OneToOne 1 100 0.00 65535.00 FORMAT "%8.2" ECU_ADDRESS 0x8024E4 /end MEASUREMENT
/begin MEASUREMENT Dfp_FrmMngChrgr2A_mp "Fehlerpfad für Chrgr2 Lage Regelabweichung" UWORD OneToOne 1 100 0.00 65535.00 FORMAT "%8.2" ECU_ADDRESS 0x8024E6 /end MEASUREMENT
/begin MEASUREMENT Dfp_FrmMngChrgr2C_mp "Fehlerpfad für Chrgr2 Treiberstrom" UWORD OneToOne 1 100 0.00 65535.00 FORMAT "%8.2" ECU_ADDRESS 0x8024E8 /end MEASUREMENT
/begin MEASUREMENT Dfp_FrmMngCHRGR2Npl_mp "Messpunkt für Fehlerpfad FrmMngCHRGR2Npl (DLC-Fehler)" UWORD OneToOne 1 100 0.00 65535.00 FORMAT "%8.2" ECU_ADDRESS 0x8024EA /end MEASUREMENT
/begin MEASUREMENT Dfp_FrmMngChrgr2N_mp "Fehlerpfad für Chrgr2 CAN Kommunikation" UWORD OneToOne 1 100 0.00 65535.00 FORMAT "%8.2" ECU_ADDRESS 0x8024EC /end MEASUREMENT
/begin MEASUREMENT Dfp_FrmMngCHRGR2TO_mp "Fehlerpfad für Timeout der CAN-Message CHRGR2" UWORD OneToOne 1 100 0.00 65535.00 FORMAT "%8.2" ECU_ADDRESS 0x8024EE /end MEASUREMENT
/begin MEASUREMENT Dfp_FrmMngChrgr2T_mp "Fehlerpfad für Chrgr2 Treiberübertemperatur" UWORD OneToOne 1 100 0.00 65535.00 FORMAT "%8.2" ECU_ADDRESS 0x8024F0 /end MEASUREMENT
/begin MEASUREMENT Dfp_FrmMngChrgr2V_mp "Fehlerpfad für Chrgr2 SRC Versorgungsspannung" UWORD OneToOne 1 100 0.00 65535.00 FORMAT "%8.2" ECU_ADDRESS 0x8024F2 /end MEASUREMENT
/begin MEASUREMENT Dfp_FrmMngDIA1Npl_mp "Messpunkt für Fehlerpfad FrmMngDIA1Npl (DLC-Fehler)" UWORD OneToOne 1 100 0.00 65535.00 FORMAT "%8.2" ECU_ADDRESS 0x8024F4 /end MEASUREMENT
/begin MEASUREMENT Dfp_FrmMngDIA1TO_mp "Fehlerpfad für Timeout-Fehler von Diagnose(DIA1)-Botschaft" UWORD OneToOne 1 100 0.00 65535.00 FORMAT "%8.2" ECU_ADDRESS 0x8024F6 /end MEASUREMENT
/begin MEASUREMENT Dfp_FrmMngDSP1Npl_mp "Messpunkt für Fehlerpfad FrmMngDSP1Npl (Botschaftszähler Fehler)" UWORD OneToOne 1 100 0.00 65535.00 FORMAT "%8.2" ECU_ADDRESS 0x8024F8 /end MEASUREMENT
/begin MEASUREMENT Dfp_FrmMngDSP1TO_mp "Messpunkt fuer Fehlerpfad  Dfp_FrmMngDSP1TO" UWORD OneToOne 1 100 0.00 65535.00 FORMAT "%8.2" ECU_ADDRESS 0x8024FA /end MEASUREMENT
/begin MEASUREMENT Dfp_FrmMngDSP2Npl_mp "Messpunkt für Fehlerpfad FrmMngDSP2Npl (DLC-Fehler)" UWORD OneToOne 1 100 0.00 65535.00 FORMAT "%8.2" ECU_ADDRESS 0x8024FC /end MEASUREMENT
/begin MEASUREMENT Dfp_FrmMngDSP2TO_mp "Messpunkt fuer Fehlerpfad  Dfp_FrmMngDSP2TO" UWORD OneToOne 1 100 0.00 65535.00 FORMAT "%8.2" ECU_ADDRESS 0x8024FE /end MEASUREMENT
/begin MEASUREMENT Dfp_FrmMngESCUNpl_mp "Messpunkt für Fehlerpfad FrmMngESCUNpl (DLC-Fehler)" UWORD OneToOne 1 100 0.00 65535.00 FORMAT "%8.2" ECU_ADDRESS 0x802500 /end MEASUREMENT
/begin MEASUREMENT Dfp_FrmMngESCUTO_mp "Messpunkt fuer Fehlerpfad  Dfp_FrmMngESCUTO" UWORD OneToOne 1 100 0.00 65535.00 FORMAT "%8.2" ECU_ADDRESS 0x802502 /end MEASUREMENT
/begin MEASUREMENT Dfp_FrmMngGW1Npl_mp "Messpunkt für Fehlerpfad FrmMngGW1Npl (DLC-Fehler)" UWORD OneToOne 1 100 0.00 65535.00 FORMAT "%8.2" ECU_ADDRESS 0x802504 /end MEASUREMENT
/begin MEASUREMENT Dfp_FrmMngGW1TO_mp "Fehlerpfad für Timeout-Fehler von Gateway (GW1)-Botschaft" UWORD OneToOne 1 100 0.00 65535.00 FORMAT "%8.2" ECU_ADDRESS 0x802506 /end MEASUREMENT
/begin MEASUREMENT Dfp_FrmMngILMNpl_mp "Messpunkt für Fehlerpfad FrmMngILMNpl (Botschaftszähler Fehler)" UWORD OneToOne 1 100 0.00 65535.00 FORMAT "%8.2" ECU_ADDRESS 0x802508 /end MEASUREMENT
/begin MEASUREMENT Dfp_FrmMngILMTO_mp "Timeout-Fehlerpfad Botschaft ILM" UWORD OneToOne 1 100 0.00 65535.00 FORMAT "%8.2" ECU_ADDRESS 0x80250A /end MEASUREMENT
/begin MEASUREMENT Dfp_FrmMngNIV1WrngCod_mp "Fehlerpfad für falsch codiertes NIVEAU Steuergerät" UWORD OneToOne 1 100 0.00 65535.00 FORMAT "%8.2" ECU_ADDRESS 0x80250C /end MEASUREMENT
/begin MEASUREMENT Dfp_FrmMngNIVEAU1Npl_mp "Messpunkt für Fehlerpfad FrmMngNIVEAU1Npl (Botschaftszähler und Checksummen Fehler)" UWORD OneToOne 1 100 0.00 65535.00 FORMAT "%8.2" ECU_ADDRESS 0x80250E /end MEASUREMENT
/begin MEASUREMENT Dfp_FrmMngNIVEAU1TO_mp "Messpunkt fuer Fehlerpfad  Dfp_FrmMngNIVEAU1TO" UWORD OneToOne 1 100 0.00 65535.00 FORMAT "%8.2" ECU_ADDRESS 0x802510 /end MEASUREMENT
/begin MEASUREMENT Dfp_FrmMngSTIGNNpl_mp "Messpunkt für Fehlerpfad FrmMngSTIGNNpl (DLC-Fehler)" UWORD OneToOne 1 100 0.00 65535.00 FORMAT "%8.2" ECU_ADDRESS 0x802512 /end MEASUREMENT
/begin MEASUREMENT Dfp_FrmMngStIgnTO_mp "Messpunkt fuer Fehlerpfad  Dfp_FrmMngStIgnTO" UWORD OneToOne 1 100 0.00 65535.00 FORMAT "%8.2" ECU_ADDRESS 0x802514 /end MEASUREMENT
/begin MEASUREMENT Dfp_FrmMngTOSNpl_mp "Messpunkt für Fehlerpfad FrmMngTOSNpl (DLC-Fehler)" UWORD OneToOne 1 100 0.00 65535.00 FORMAT "%8.2" ECU_ADDRESS 0x802516 /end MEASUREMENT
/begin MEASUREMENT Dfp_FrmMngTOSTO_mp "Fehlerpfad für Timeout-Fehler von TOG(TOS)-Botschaft" UWORD OneToOne 1 100 0.00 65535.00 FORMAT "%8.2" ECU_ADDRESS 0x802518 /end MEASUREMENT
/begin MEASUREMENT Dfp_FrmMngTSC1Npl_mp "Messpunkt für Fehlerpfad FrmMngTSC1Npl (Botschaftszähler Fehler)" UWORD OneToOne 1 100 0.00 65535.00 FORMAT "%8.2" ECU_ADDRESS 0x80251A /end MEASUREMENT
/begin MEASUREMENT Dfp_FrmMngTSC1TO_mp "Messpunkt fuer Fehlerpfad  Dfp_FrmMngTSC1TO" UWORD OneToOne 1 100 0.00 65535.00 FORMAT "%8.2" ECU_ADDRESS 0x80251C /end MEASUREMENT
/begin MEASUREMENT Dfp_FrmMngTSC2Npl_mp "Messpunkt für Fehlerpfad FrmMngTSC2Npl (Botschaftszähler Fehler)" UWORD OneToOne 1 100 0.00 65535.00 FORMAT "%8.2" ECU_ADDRESS 0x80251E /end MEASUREMENT
/begin MEASUREMENT Dfp_FrmMngTSC2TO_mp "Messpunkt fuer Fehlerpfad  Dfp_FrmMngTSC2TO" UWORD OneToOne 1 100 0.00 65535.00 FORMAT "%8.2" ECU_ADDRESS 0x802520 /end MEASUREMENT
/begin MEASUREMENT Dfp_FrmMngTSC3Npl_mp "Messpunkt für Fehlerpfad FrmMngTSC3Npl (Botschaftszähler und Checksummen Fehler)" UWORD OneToOne 1 100 0.00 65535.00 FORMAT "%8.2" ECU_ADDRESS 0x802522 /end MEASUREMENT
/begin MEASUREMENT Dfp_FrmMngTSC3TO_mp "Messpunkt fuer Fehlerpfad Dfp_FrmMngTSC3TO" UWORD OneToOne 1 100 0.00 65535.00 FORMAT "%8.2" ECU_ADDRESS 0x802524 /end MEASUREMENT
/begin MEASUREMENT Dfp_FTSCDNpl_mp "Messpunkt fuer Fehlerpfad  Dfp_FTSCDNpl" UWORD OneToOne 1 100 0.00 65535.00 FORMAT "%8.2" ECU_ADDRESS 0x802526 /end MEASUREMENT
/begin MEASUREMENT Dfp_FTSCD_mp "Messpunkt fuer Fehlerpfad  Dfp_FTSCD" UWORD OneToOne 1 100 0.00 65535.00 FORMAT "%8.2" ECU_ADDRESS 0x802528 /end MEASUREMENT
/begin MEASUREMENT Dfp_GearbxASTh_mp "Fehlerpfad für Integralmoment zu hoch (Tasse Diesel)" UWORD OneToOne 1 100 0.00 65535.00 FORMAT "%8.2" ECU_ADDRESS 0x80252A /end MEASUREMENT
/begin MEASUREMENT Dfp_GearbxASTl_mp "Fehlerpfad für Kupplungsplausibilität" UWORD OneToOne 1 100 0.00 65535.00 FORMAT "%8.2" ECU_ADDRESS 0x80252C /end MEASUREMENT
/begin MEASUREMENT Dfp_GearbxTSC_mp "Status des Fehlerpfades Elektronische Getriebesteuerung zeitliche Begrenzung" UWORD OneToOne 1 100 0.00 65535.00 FORMAT "%8.2" ECU_ADDRESS 0x80252E /end MEASUREMENT
/begin MEASUREMENT Dfp_GearbxTypeMTErr_mp "Fehlerpfad für Getriebetypwert MT" UWORD OneToOne 1 100 0.00 65535.00 FORMAT "%8.2" ECU_ADDRESS 0x802530 /end MEASUREMENT
/begin MEASUREMENT Dfp_GlwCD_Actr_mp "Messpunkt fuer Fehlerpfad  Dfp_GlwCD_Actr" UWORD OneToOne 1 100 0.00 65535.00 FORMAT "%8.2" ECU_ADDRESS 0x802532 /end MEASUREMENT
/begin MEASUREMENT Dfp_GlwCD_DIAG_mp "Fehlerpfad für GSK3-Protokollfehler" UWORD OneToOne 1 100 0.00 65535.00 FORMAT "%8.2" ECU_ADDRESS 0x802534 /end MEASUREMENT
/begin MEASUREMENT Dfp_GlwCD_Error1_mp "Fehlerpfad  für Überstrom (GSK3)" UWORD OneToOne 1 100 0.00 65535.00 FORMAT "%8.2" ECU_ADDRESS 0x802536 /end MEASUREMENT
/begin MEASUREMENT Dfp_GlwCD_Error2_mp "Fehlerpfad für Summenfehler (GSK3)" UWORD OneToOne 1 100 0.00 65535.00 FORMAT "%8.2" ECU_ADDRESS 0x802538 /end MEASUREMENT
/begin MEASUREMENT Dfp_GlwCD_EvalCod_mp "Fehlerpfad Auswertung der Codierung" UWORD OneToOne 1 100 0.00 65535.00 FORMAT "%8.2" ECU_ADDRESS 0x80253A /end MEASUREMENT
/begin MEASUREMENT Dfp_GlwCD_GSK_mp "Fehlerpfad des physiaklischen GSK3-Ausgangs" UWORD OneToOne 1 100 0.00 65535.00 FORMAT "%8.2" ECU_ADDRESS 0x80253C /end MEASUREMENT
/begin MEASUREMENT Dfp_GlwCD_LampCan_mp "Messpunkt fuer Fehlerpfad  Dfp_GlwCD_LampCan" UWORD OneToOne 1 100 0.00 65535.00 FORMAT "%8.2" ECU_ADDRESS 0x80253E /end MEASUREMENT
/begin MEASUREMENT Dfp_GlwCD_Lamp_mp "Messpunkt fuer Fehlerpfad  Dfp_GlwCD_Lamp" UWORD OneToOne 1 100 0.00 65535.00 FORMAT "%8.2" ECU_ADDRESS 0x802540 /end MEASUREMENT
/begin MEASUREMENT Dfp_GlwCD_PLUG0_mp "Fehlerpfad für GSK3-Glühkerze 0" UWORD OneToOne 1 100 0.00 65535.00 FORMAT "%8.2" ECU_ADDRESS 0x802542 /end MEASUREMENT
/begin MEASUREMENT Dfp_GlwCD_PLUG1_mp "Fehlerpfad für GSK3-Glühkerze 1" UWORD OneToOne 1 100 0.00 65535.00 FORMAT "%8.2" ECU_ADDRESS 0x802544 /end MEASUREMENT
/begin MEASUREMENT Dfp_GlwCD_PLUG2_mp "Fehlerpfad für GSK3-Glühkerze 2" UWORD OneToOne 1 100 0.00 65535.00 FORMAT "%8.2" ECU_ADDRESS 0x802546 /end MEASUREMENT
/begin MEASUREMENT Dfp_GlwCD_PLUG3_mp "Fehlerpfad für GSK3-Glühkerze 3" UWORD OneToOne 1 100 0.00 65535.00 FORMAT "%8.2" ECU_ADDRESS 0x802548 /end MEASUREMENT
/begin MEASUREMENT Dfp_GlwCD_PLUG4_mp "Messpunkt fuer Fehlerpfad  Dfp_GlwCD_PLUG4" UWORD OneToOne 1 100 0.00 65535.00 FORMAT "%8.2" ECU_ADDRESS 0x80254A /end MEASUREMENT
/begin MEASUREMENT Dfp_GlwCD_PLUG5_mp "Fehlerpfad für GSK3-Glühkerze 5" UWORD OneToOne 1 100 0.00 65535.00 FORMAT "%8.2" ECU_ADDRESS 0x80254C /end MEASUREMENT
/begin MEASUREMENT Dfp_GlwCD_SFD_mp "Fehlerpfad für Summenfehler (GSK2)" UWORD OneToOne 1 100 0.00 65535.00 FORMAT "%8.2" ECU_ADDRESS 0x80254E /end MEASUREMENT
/begin MEASUREMENT Dfp_HDSCD_mp "Messpunkt fuer Fehlerpfad  Dfp_HDSCD" UWORD OneToOne 1 100 0.00 65535.00 FORMAT "%8.2" ECU_ADDRESS 0x802550 /end MEASUREMENT
/begin MEASUREMENT Dfp_HWEMonCom_mp "Messpunkt fuer Fehlerpfad  Dfp_HWEMonCom" UWORD OneToOne 1 100 0.00 65535.00 FORMAT "%8.2" ECU_ADDRESS 0x802552 /end MEASUREMENT
/begin MEASUREMENT Dfp_HWEMonEEPROM_mp "Messpunkt fuer Fehlerpfad  Dfp_HWEMonEEPROM" UWORD OneToOne 1 100 0.00 65535.00 FORMAT "%8.2" ECU_ADDRESS 0x802554 /end MEASUREMENT
/begin MEASUREMENT Dfp_HWEMonRcyLocked_mp "Messpunkt fuer Fehlerpfad  Dfp_HWEMonRcyLocked" UWORD OneToOne 1 100 0.00 65535.00 FORMAT "%8.2" ECU_ADDRESS 0x802556 /end MEASUREMENT
/begin MEASUREMENT Dfp_HWEMonRcySuppressed_mp "Messpunkt fuer Fehlerpfad  Dfp_HWEMonRcySuppressed" UWORD OneToOne 1 100 0.00 65535.00 FORMAT "%8.2" ECU_ADDRESS 0x802558 /end MEASUREMENT
/begin MEASUREMENT Dfp_HWEMonRcyVisible_mp "Messpunkt fuer Fehlerpfad  Dfp_HWEMonRcyVisible" UWORD OneToOne 1 100 0.00 65535.00 FORMAT "%8.2" ECU_ADDRESS 0x80255A /end MEASUREMENT
/begin MEASUREMENT Dfp_HWEMonUMaxSupply_mp "Messpunkt fuer Fehlerpfad  Dfp_HWEMonUMaxSupply" UWORD OneToOne 1 100 0.00 65535.00 FORMAT "%8.2" ECU_ADDRESS 0x80255C /end MEASUREMENT
/begin MEASUREMENT Dfp_HWEMonUMinSupply_mp "Messpunkt fuer Fehlerpfad  Dfp_HWEMonUMinSupply" UWORD OneToOne 1 100 0.00 65535.00 FORMAT "%8.2" ECU_ADDRESS 0x80255E /end MEASUREMENT
/begin MEASUREMENT Dfp_IATSCD_mp "Messpunkt fuer Fehlerpfad  Dfp_IATSCD" UWORD OneToOne 1 100 0.00 65535.00 FORMAT "%8.2" ECU_ADDRESS 0x802560 /end MEASUREMENT
/begin MEASUREMENT Dfp_IFCD_mp "Fehlerpfadmesspunkt der Endstufenüberwachnung des Ladeluftkühler-Lüfter Komponententreibers" UWORD OneToOne 1 100 0.00 65535.00 FORMAT "%8.2" ECU_ADDRESS 0x802562 /end MEASUREMENT
/begin MEASUREMENT Dfp_ImmCtl_mp "Messpunkt fuer Fehlerpfad  Dfp_ImmCtl" UWORD OneToOne 1 100 0.00 65535.00 FORMAT "%8.2" ECU_ADDRESS 0x802564 /end MEASUREMENT
/begin MEASUREMENT Dfp_InjCrv_InjLim_mp "Messpunkt fuer Fehlerpfad Dfp_InjCrv_InjLim" UWORD OneToOne 1 100 0.00 65535.00 FORMAT "%8.2" ECU_ADDRESS 0x802566 /end MEASUREMENT
/begin MEASUREMENT Dfp_InjVCDActrChrg_mp "Messpunkt fuer Fehlerpfad  Dfp_InjVCDActrChrg" UWORD OneToOne 1 100 0.00 65535.00 FORMAT "%8.2" ECU_ADDRESS 0x802568 /end MEASUREMENT
/begin MEASUREMENT Dfp_InjVCDActrVolt_mp "Messpunkt fuer Fehlerpfad  Dfp_InjVCDActrVolt" UWORD OneToOne 1 100 0.00 65535.00 FORMAT "%8.2" ECU_ADDRESS 0x80256A /end MEASUREMENT
/begin MEASUREMENT Dfp_InjVCDClsBank1_mp "Messpunkt fuer Fehlerpfad  Dfp_InjVCDClsBank1" UWORD OneToOne 1 100 0.00 65535.00 FORMAT "%8.2" ECU_ADDRESS 0x80256C /end MEASUREMENT
/begin MEASUREMENT Dfp_InjVCDClsBank2_mp "Messpunkt fuer Fehlerpfad  Dfp_InjVCDClsBank2" UWORD OneToOne 1 100 0.00 65535.00 FORMAT "%8.2" ECU_ADDRESS 0x80256E /end MEASUREMENT
/begin MEASUREMENT Dfp_InjVCDMonCab_mp "Messpunkt fuer Fehlerpfad  Dfp_InjVCDMonCab" UWORD OneToOne 1 100 0.00 65535.00 FORMAT "%8.2" ECU_ADDRESS 0x802570 /end MEASUREMENT
/begin MEASUREMENT Dfp_InjVCDMonSwt_mp "Messpunkt fuer Fehlerpfad  Dfp_InjVCDMonSwt" UWORD OneToOne 1 100 0.00 65535.00 FORMAT "%8.2" ECU_ADDRESS 0x802572 /end MEASUREMENT
/begin MEASUREMENT Dfp_InjVCDShOffDCDC_mp "Fehlerpfad ""Ladeschalterkurzschluss""" UWORD OneToOne 1 100 0.00 65535.00 FORMAT "%8.2" ECU_ADDRESS 0x802574 /end MEASUREMENT
/begin MEASUREMENT Dfp_InjVCDUBuf_mp "Messpunkt fuer Fehlerpfad  Dfp_InjVCDUBuf" UWORD OneToOne 1 100 0.00 65535.00 FORMAT "%8.2" ECU_ADDRESS 0x802576 /end MEASUREMENT
/begin MEASUREMENT Dfp_InjVCD_CY370Ampl_mp "Fehlerpfad für Verstärkerabgleich vom CY370" UWORD OneToOne 1 100 0.00 65535.00 FORMAT "%8.2" ECU_ADDRESS 0x802578 /end MEASUREMENT
/begin MEASUREMENT Dfp_InjVlvBnk1A_mp "A Fehlerpfad für Bank 1" UWORD OneToOne 1 100 0.00 65535.00 FORMAT "%8.2" ECU_ADDRESS 0x80257A /end MEASUREMENT
/begin MEASUREMENT Dfp_InjVlvBnk1B_mp "B Fehlerpfad für Bank 1" UWORD OneToOne 1 100 0.00 65535.00 FORMAT "%8.2" ECU_ADDRESS 0x80257C /end MEASUREMENT
/begin MEASUREMENT Dfp_InjVlvBnk2A_mp "A Fehlerpfad für Bank 2" UWORD OneToOne 1 100 0.00 65535.00 FORMAT "%8.2" ECU_ADDRESS 0x80257E /end MEASUREMENT
/begin MEASUREMENT Dfp_InjVlvBnk2B_mp "B Fehlerpfad für Bank 2" UWORD OneToOne 1 100 0.00 65535.00 FORMAT "%8.2" ECU_ADDRESS 0x802580 /end MEASUREMENT
/begin MEASUREMENT Dfp_InjVlvChipA_mp "A Fehlerpfad  für Baustein" UWORD OneToOne 1 100 0.00 65535.00 FORMAT "%8.2" ECU_ADDRESS 0x802582 /end MEASUREMENT
/begin MEASUREMENT Dfp_InjVlvChipB_mp "B Fehlerpfad für Baustein" UWORD OneToOne 1 100 0.00 65535.00 FORMAT "%8.2" ECU_ADDRESS 0x802584 /end MEASUREMENT
/begin MEASUREMENT Dfp_InjVlvCyl1A_mp "A Fehlerpfad  für Zylinder 1" UWORD OneToOne 1 100 0.00 65535.00 FORMAT "%8.2" ECU_ADDRESS 0x802586 /end MEASUREMENT
/begin MEASUREMENT Dfp_InjVlvCyl1B_mp "B Fehlerpfad  für Zylinder 1" UWORD OneToOne 1 100 0.00 65535.00 FORMAT "%8.2" ECU_ADDRESS 0x802588 /end MEASUREMENT
/begin MEASUREMENT Dfp_InjVlvCyl1C_mp "Messpunkt fuer Fehlerpfad  Dfp_InjVlvCyl1C" UWORD OneToOne 1 100 0.00 65535.00 FORMAT "%8.2" ECU_ADDRESS 0x80258A /end MEASUREMENT
/begin MEASUREMENT Dfp_InjVlvCyl2A_mp "A Fehlerpfad  für Zylinder 2" UWORD OneToOne 1 100 0.00 65535.00 FORMAT "%8.2" ECU_ADDRESS 0x80258C /end MEASUREMENT
/begin MEASUREMENT Dfp_InjVlvCyl2B_mp "B Fehlerpfad  für Zylinder 2" UWORD OneToOne 1 100 0.00 65535.00 FORMAT "%8.2" ECU_ADDRESS 0x80258E /end MEASUREMENT
/begin MEASUREMENT Dfp_InjVlvCyl2C_mp "Messpunkt fuer Fehlerpfad  Dfp_InjVlvCyl2C" UWORD OneToOne 1 100 0.00 65535.00 FORMAT "%8.2" ECU_ADDRESS 0x802590 /end MEASUREMENT
/begin MEASUREMENT Dfp_InjVlvCyl3A_mp "A Fehlerpfad  für Zylinder 3" UWORD OneToOne 1 100 0.00 65535.00 FORMAT "%8.2" ECU_ADDRESS 0x802592 /end MEASUREMENT
/begin MEASUREMENT Dfp_InjVlvCyl3B_mp "B Fehlerpfad  für Zylinder 3" UWORD OneToOne 1 100 0.00 65535.00 FORMAT "%8.2" ECU_ADDRESS 0x802594 /end MEASUREMENT
/begin MEASUREMENT Dfp_InjVlvCyl3C_mp "Messpunkt fuer Fehlerpfad  Dfp_InjVlvCyl3C" UWORD OneToOne 1 100 0.00 65535.00 FORMAT "%8.2" ECU_ADDRESS 0x802596 /end MEASUREMENT
/begin MEASUREMENT Dfp_InjVlvCyl4A_mp "A Fehlerpfad  für Zylinder 4" UWORD OneToOne 1 100 0.00 65535.00 FORMAT "%8.2" ECU_ADDRESS 0x802598 /end MEASUREMENT
/begin MEASUREMENT Dfp_InjVlvCyl4B_mp "B Fehlerpfad  für Zylinder 4" UWORD OneToOne 1 100 0.00 65535.00 FORMAT "%8.2" ECU_ADDRESS 0x80259A /end MEASUREMENT
/begin MEASUREMENT Dfp_InjVlvCyl4C_mp "Messpunkt fuer Fehlerpfad  Dfp_InjVlvCyl4C" UWORD OneToOne 1 100 0.00 65535.00 FORMAT "%8.2" ECU_ADDRESS 0x80259C /end MEASUREMENT
/begin MEASUREMENT Dfp_InjVlvCyl5A_mp "A Fehlerpfad  für Zylinder 5" UWORD OneToOne 1 100 0.00 65535.00 FORMAT "%8.2" ECU_ADDRESS 0x80259E /end MEASUREMENT
/begin MEASUREMENT Dfp_InjVlvCyl5B_mp "B Fehlerpfad  für Zylinder 5" UWORD OneToOne 1 100 0.00 65535.00 FORMAT "%8.2" ECU_ADDRESS 0x8025A0 /end MEASUREMENT
/begin MEASUREMENT Dfp_InjVlvCyl5C_mp "Messpunkt fuer Fehlerpfad  Dfp_InjVlvCyl5C" UWORD OneToOne 1 100 0.00 65535.00 FORMAT "%8.2" ECU_ADDRESS 0x8025A2 /end MEASUREMENT
/begin MEASUREMENT Dfp_InjVlvCyl6A_mp "A Fehlerpfad  für Zylinder 6" UWORD OneToOne 1 100 0.00 65535.00 FORMAT "%8.2" ECU_ADDRESS 0x8025A4 /end MEASUREMENT
/begin MEASUREMENT Dfp_InjVlvCyl6B_mp "B Fehlerpfad  für Zylinder 6" UWORD OneToOne 1 100 0.00 65535.00 FORMAT "%8.2" ECU_ADDRESS 0x8025A6 /end MEASUREMENT
/begin MEASUREMENT Dfp_InjVlvCyl6C_mp "Messpunkt fuer Fehlerpfad  Dfp_InjVlvCyl6C" UWORD OneToOne 1 100 0.00 65535.00 FORMAT "%8.2" ECU_ADDRESS 0x8025A8 /end MEASUREMENT
/begin MEASUREMENT Dfp_InjVlvCyl7A_mp "A Fehlerpfad  für Zylinder 7" UWORD OneToOne 1 100 0.00 65535.00 FORMAT "%8.2" ECU_ADDRESS 0x8025AA /end MEASUREMENT
/begin MEASUREMENT Dfp_InjVlvCyl7B_mp "B Fehlerpfad  für Zylinder 7" UWORD OneToOne 1 100 0.00 65535.00 FORMAT "%8.2" ECU_ADDRESS 0x8025AC /end MEASUREMENT
/begin MEASUREMENT Dfp_InjVlvCyl7C_mp "Messpunkt fuer Fehlerpfad  Dfp_InjVlvCyl7C" UWORD OneToOne 1 100 0.00 65535.00 FORMAT "%8.2" ECU_ADDRESS 0x8025AE /end MEASUREMENT
/begin MEASUREMENT Dfp_InjVlvCyl8A_mp "A Fehlerpfad  für Zylinder 8" UWORD OneToOne 1 100 0.00 65535.00 FORMAT "%8.2" ECU_ADDRESS 0x8025B0 /end MEASUREMENT
/begin MEASUREMENT Dfp_InjVlvCyl8B_mp "B Fehlerpfad  für Zylinder 8" UWORD OneToOne 1 100 0.00 65535.00 FORMAT "%8.2" ECU_ADDRESS 0x8025B2 /end MEASUREMENT
/begin MEASUREMENT Dfp_InjVlvCyl8C_mp "Messpunkt fuer Fehlerpfad  Dfp_InjVlvCyl8C" UWORD OneToOne 1 100 0.00 65535.00 FORMAT "%8.2" ECU_ADDRESS 0x8025B4 /end MEASUREMENT
/begin MEASUREMENT Dfp_LSUCDCircNernst0_mp "Messpunkt fuer Fehlerpfad  Dfp_LSUCDCircNernst0" UWORD OneToOne 1 100 0.00 65535.00 FORMAT "%8.2" ECU_ADDRESS 0x8025B6 /end MEASUREMENT
/begin MEASUREMENT Dfp_LSUCDCircPumpCur0_mp "Messpunkt fuer Fehlerpfad  Dfp_LSUCDCircPumpCur0" UWORD OneToOne 1 100 0.00 65535.00 FORMAT "%8.2" ECU_ADDRESS 0x8025B8 /end MEASUREMENT
/begin MEASUREMENT Dfp_LSUCDCircVirtGnd0_mp "Messpunkt fuer Fehlerpfad  Dfp_LSUCDCircVirtGnd0" UWORD OneToOne 1 100 0.00 65535.00 FORMAT "%8.2" ECU_ADDRESS 0x8025BA /end MEASUREMENT
/begin MEASUREMENT Dfp_LSUCDHeater0_mp "Messpunkt fuer Fehlerpfad  Dfp_LSUCDHeater0" UWORD OneToOne 1 100 0.00 65535.00 FORMAT "%8.2" ECU_ADDRESS 0x8025BC /end MEASUREMENT
/begin MEASUREMENT Dfp_LSUCDHtCoup0_mp "Messpunkt fuer Fehlerpfad  Dfp_LSUCDHtCoup0" UWORD OneToOne 1 100 0.00 65535.00 FORMAT "%8.2" ECU_ADDRESS 0x8025BE /end MEASUREMENT
/begin MEASUREMENT Dfp_LSUCDO20_mp "Messpunkt fuer Fehlerpfad  Dfp_LSUCDO20" UWORD OneToOne 1 100 0.00 65535.00 FORMAT "%8.2" ECU_ADDRESS 0x8025C0 /end MEASUREMENT
/begin MEASUREMENT Dfp_LSUCDO2Clb0_mp "Messpunkt fuer Fehlerpfad  Dfp_LSUCDO2Clb0" UWORD OneToOne 1 100 0.00 65535.00 FORMAT "%8.2" ECU_ADDRESS 0x8025C2 /end MEASUREMENT
/begin MEASUREMENT Dfp_LSUCDRiClb0_mp "Messpunkt fuer Fehlerpfad  Dfp_LSUCDRiClb0" UWORD OneToOne 1 100 0.00 65535.00 FORMAT "%8.2" ECU_ADDRESS 0x8025C4 /end MEASUREMENT
/begin MEASUREMENT Dfp_LSUCDSPI0_mp "Messpunkt fuer Fehlerpfad  Dfp_LSUCDSPI0" UWORD OneToOne 1 100 0.00 65535.00 FORMAT "%8.2" ECU_ADDRESS 0x8025C6 /end MEASUREMENT
/begin MEASUREMENT Dfp_LSUCDSPIBattLow0_mp "Fehlerpfad für niedrige Batteriespannung" UWORD OneToOne 1 100 0.00 65535.00 FORMAT "%8.2" ECU_ADDRESS 0x8025C8 /end MEASUREMENT
/begin MEASUREMENT Dfp_LSUCDWireIP0_mp "Messpunkt fuer Fehlerpfad  Dfp_LSUCDWireIP0" UWORD OneToOne 1 100 0.00 65535.00 FORMAT "%8.2" ECU_ADDRESS 0x8025CA /end MEASUREMENT
/begin MEASUREMENT Dfp_LSUCtlRiExc0_mp "Messpunkt fuer Fehlerpfad  Dfp_LSUCtlRiExc0" UWORD OneToOne 1 100 0.00 65535.00 FORMAT "%8.2" ECU_ADDRESS 0x8025CC /end MEASUREMENT
/begin MEASUREMENT Dfp_LSUMon1Sens_mp "Messpunkt fuer Fehlerpfad  Dfp_LSUMon1Sens" UWORD OneToOne 1 100 0.00 65535.00 FORMAT "%8.2" ECU_ADDRESS 0x8025CE /end MEASUREMENT
/begin MEASUREMENT Dfp_LSUMon2Sens_mp "Messpunkt fuer Fehlerpfad  Dfp_LSUMon2Sens" UWORD OneToOne 1 100 0.00 65535.00 FORMAT "%8.2" ECU_ADDRESS 0x8025D0 /end MEASUREMENT
/begin MEASUREMENT Dfp_MeUnCDNoLoad_mp "Fehlerpfad für Lastabfall der Zumesseinheit" UWORD OneToOne 1 100 0.00 65535.00 FORMAT "%8.2" ECU_ADDRESS 0x8025D2 /end MEASUREMENT
/begin MEASUREMENT Dfp_MeUnCDSCBat_mp "Fehlerpfad für Kurzschluss zur Batteriespannung der Zumesseinheit" UWORD OneToOne 1 100 0.00 65535.00 FORMAT "%8.2" ECU_ADDRESS 0x8025D4 /end MEASUREMENT
/begin MEASUREMENT Dfp_MeUnCDSCGnd_mp "Fehlerpfad für Kurzschluss nach Masse der Zumesseinheit" UWORD OneToOne 1 100 0.00 65535.00 FORMAT "%8.2" ECU_ADDRESS 0x8025D6 /end MEASUREMENT
/begin MEASUREMENT Dfp_MeUnCD_ADC_mp "Fehlerpfad für die Signalerfassung des Stroms durch die Zumesseinheit" UWORD OneToOne 1 100 0.00 65535.00 FORMAT "%8.2" ECU_ADDRESS 0x8025D8 /end MEASUREMENT
/begin MEASUREMENT Dfp_MIL_mp "Messpunkt fuer Fehlerpfad  Dfp_MIL" UWORD OneToOne 1 100 0.00 65535.00 FORMAT "%8.2" ECU_ADDRESS 0x8025DA /end MEASUREMENT
/begin MEASUREMENT Dfp_Montr_mp "Messpunkt fuer Fehlerpfad  Dfp_Montr" UWORD OneToOne 1 100 0.00 65535.00 FORMAT "%8.2" ECU_ADDRESS 0x8025DC /end MEASUREMENT
/begin MEASUREMENT Dfp_MRlyCD_mp "Messpunkt fuer Fehlerpfad  Dfp_MRlyCD" UWORD OneToOne 1 100 0.00 65535.00 FORMAT "%8.2" ECU_ADDRESS 0x8025DE /end MEASUREMENT
/begin MEASUREMENT Dfp_OTSCDCanInac_mp "Messpunkt fuer Fehlerpfad  Dfp_OTSCDCanInac" UWORD OneToOne 1 100 0.00 65535.00 FORMAT "%8.2" ECU_ADDRESS 0x8025E0 /end MEASUREMENT
/begin MEASUREMENT Dfp_OTSCDCanSig_mp "Messpunkt fuer Fehlerpfad  Dfp_OTSCDCanSig" UWORD OneToOne 1 100 0.00 65535.00 FORMAT "%8.2" ECU_ADDRESS 0x8025E2 /end MEASUREMENT
/begin MEASUREMENT Dfp_OTSCD_mp "Fehlerpfad Öltemperaturwert" UWORD OneToOne 1 100 0.00 65535.00 FORMAT "%8.2" ECU_ADDRESS 0x8025E4 /end MEASUREMENT
/begin MEASUREMENT Dfp_OvRMonCrCtlP_mp "Fehlerpfad für die Cruise Control Plus: Allgemeine Überwachung, Überreiten und Verzögerungsbegrenzung" UWORD OneToOne 1 100 0.00 65535.00 FORMAT "%8.2" ECU_ADDRESS 0x8025E6 /end MEASUREMENT
/begin MEASUREMENT Dfp_OvRMonSigA_mp "Fehlerpfad für Drehzahlplausibilisierung in der Schubüberwachung" UWORD OneToOne 1 100 0.00 65535.00 FORMAT "%8.2" ECU_ADDRESS 0x8025E8 /end MEASUREMENT
/begin MEASUREMENT Dfp_OvRMon_mp "Messpunkt fuer Fehlerpfad  Dfp_OvRMon" UWORD OneToOne 1 100 0.00 65535.00 FORMAT "%8.2" ECU_ADDRESS 0x8025EA /end MEASUREMENT
/begin MEASUREMENT Dfp_OxiCCDTPre1_mp "Fehlerpfad für Abgastemperatur vor Abgasturbolader [-]" UWORD OneToOne 1 100 0.00 65535.00 FORMAT "%8.2" ECU_ADDRESS 0x8025EC /end MEASUREMENT
/begin MEASUREMENT Dfp_OxiCCDTPre_mp "Messpunkt fuer Fehlerpfad  Dfp_OxiCCDTPre" UWORD OneToOne 1 100 0.00 65535.00 FORMAT "%8.2" ECU_ADDRESS 0x8025EE /end MEASUREMENT
/begin MEASUREMENT Dfp_PCR_BalGovDev_mp "Messpunkt fuer Fehlerpfad Dfp_PCR_BalGovDev" UWORD OneToOne 1 100 0.00 65535.00 FORMAT "%8.2" ECU_ADDRESS 0x8025F0 /end MEASUREMENT
/begin MEASUREMENT Dfp_PCR_GovDev_mp "Messpunkt fuer Fehlerpfad  Dfp_PCR_GovDev" UWORD OneToOne 1 100 0.00 65535.00 FORMAT "%8.2" ECU_ADDRESS 0x8025F2 /end MEASUREMENT
/begin MEASUREMENT Dfp_PCVCDNoLoad_mp "Messpunkt fuer Fehlerpfad Lastabfall des Druckregelventils" UWORD OneToOne 1 100 0.00 65535.00 FORMAT "%8.2" ECU_ADDRESS 0x8025F4 /end MEASUREMENT
/begin MEASUREMENT Dfp_PCVCDSCBat_mp "Messpunkt für Fehlerpfad Kurzschluss zur Batteriespannung des Druckregelventils" UWORD OneToOne 1 100 0.00 65535.00 FORMAT "%8.2" ECU_ADDRESS 0x8025F6 /end MEASUREMENT
/begin MEASUREMENT Dfp_PCVCDSCGnd_mp "Messpunkt für Fehlerpfad Kurzschluss nach Masse des Druckregelventils" UWORD OneToOne 1 100 0.00 65535.00 FORMAT "%8.2" ECU_ADDRESS 0x8025F8 /end MEASUREMENT
/begin MEASUREMENT Dfp_PCVCD_ADC_mp "Messpunkt fuer Fehlerpfad  Dfp_PCVCD_ADC" UWORD OneToOne 1 100 0.00 65535.00 FORMAT "%8.2" ECU_ADDRESS 0x8025FA /end MEASUREMENT
/begin MEASUREMENT Dfp_PFltCDHtg1_mp "Messpunkt fuer Fehlerpfad  Dfp_PFltCDHtg1" UWORD OneToOne 1 100 0.00 65535.00 FORMAT "%8.2" ECU_ADDRESS 0x8025FC /end MEASUREMENT
/begin MEASUREMENT Dfp_PFltCDHtg_mp "Messpunkt fuer Fehlerpfad  Dfp_PFltCDHtg" UWORD OneToOne 1 100 0.00 65535.00 FORMAT "%8.2" ECU_ADDRESS 0x8025FE /end MEASUREMENT
/begin MEASUREMENT Dfp_PFltCDPDiff1_mp "Messpunkt fuer Fehlerpfad  Dfp_PFltCDPDiff1" UWORD OneToOne 1 100 0.00 65535.00 FORMAT "%8.2" ECU_ADDRESS 0x802600 /end MEASUREMENT
/begin MEASUREMENT Dfp_PFltCDPDiff_mp "Messpunkt fuer Fehlerpfad  Dfp_PFltCDPDiff" UWORD OneToOne 1 100 0.00 65535.00 FORMAT "%8.2" ECU_ADDRESS 0x802602 /end MEASUREMENT
/begin MEASUREMENT Dfp_PFltCDTempPre1_mp "Fehlerpfad der Abgastemperatur vor dem Partikelfilter" UWORD OneToOne 1 100 0.00 65535.00 FORMAT "%8.2" ECU_ADDRESS 0x802604 /end MEASUREMENT
/begin MEASUREMENT Dfp_PFltCDTempPre_mp "Fehlerpfad der Abgastemperatur vor dem Partikelfilter [-]" UWORD OneToOne 1 100 0.00 65535.00 FORMAT "%8.2" ECU_ADDRESS 0x802606 /end MEASUREMENT
/begin MEASUREMENT Dfp_PFltCDTPre_mp "Fehlerpfad der Abgastemperatur vor dem Partikelfilter [-]" UWORD OneToOne 1 100 0.00 65535.00 FORMAT "%8.2" ECU_ADDRESS 0x802608 /end MEASUREMENT
/begin MEASUREMENT Dfp_PFltCDTPst_mp "Messpunkt fuer Fehlerpfad  Dfp_PFltCDTPst" UWORD OneToOne 1 100 0.00 65535.00 FORMAT "%8.2" ECU_ADDRESS 0x80260A /end MEASUREMENT
/begin MEASUREMENT Dfp_PFltChar_mp "Digitaler Fehlerpfad für Fliesswiderstand Partikelfilter" UWORD OneToOne 1 100 0.00 65535.00 FORMAT "%8.2" ECU_ADDRESS 0x80260C /end MEASUREMENT
/begin MEASUREMENT Dfp_PFltEngPrt_mp "Messpunkt fuer Fehlerpfad  Dfp_PFltEngPrt" UWORD OneToOne 1 100 0.00 65535.00 FORMAT "%8.2" ECU_ADDRESS 0x80260E /end MEASUREMENT
/begin MEASUREMENT Dfp_PFltPresDynPlaus_mp "Messpunkt fuer Fehlerpfad  Dfp_PFltPresDynPlaus" UWORD OneToOne 1 100 0.00 65535.00 FORMAT "%8.2" ECU_ADDRESS 0x802610 /end MEASUREMENT
/begin MEASUREMENT Dfp_PFltPresSensHsLn_mp "Messpunkt fuer Fehlerpfad  Dfp_PFltPresSensHsLn" UWORD OneToOne 1 100 0.00 65535.00 FORMAT "%8.2" ECU_ADDRESS 0x802612 /end MEASUREMENT
/begin MEASUREMENT Dfp_PFltPresSensSot_mp "Messpunkt fuer Fehlerpfad  Dfp_PFltPresSensSot" UWORD OneToOne 1 100 0.00 65535.00 FORMAT "%8.2" ECU_ADDRESS 0x802614 /end MEASUREMENT
/begin MEASUREMENT Dfp_PFltPresSens_mp "Messpunkt fuer Fehlerpfad  Dfp_PFltPresSens" UWORD OneToOne 1 100 0.00 65535.00 FORMAT "%8.2" ECU_ADDRESS 0x802616 /end MEASUREMENT
/begin MEASUREMENT Dfp_PFltRgnPerm_mp "Messpunkt fuer Fehlerpfad  Dfp_PFltRgnPerm" UWORD OneToOne 1 100 0.00 65535.00 FORMAT "%8.2" ECU_ADDRESS 0x802618 /end MEASUREMENT
/begin MEASUREMENT Dfp_PFltTempDwnStrm_mp "Digitaler Fehlerpfad für zweiten Abgastemperatursensor" UWORD OneToOne 1 100 0.00 65535.00 FORMAT "%8.2" ECU_ADDRESS 0x80261A /end MEASUREMENT
/begin MEASUREMENT Dfp_PFltTempSens_mp "Messpunkt fuer Fehlerpfad  Dfp_PFltTempSens" UWORD OneToOne 1 100 0.00 65535.00 FORMAT "%8.2" ECU_ADDRESS 0x80261C /end MEASUREMENT
/begin MEASUREMENT Dfp_PFltTempUpStrm_mp "Digitaler Fehlerpfad für ersten Abgastemperatursensor" UWORD OneToOne 1 100 0.00 65535.00 FORMAT "%8.2" ECU_ADDRESS 0x80261E /end MEASUREMENT
/begin MEASUREMENT Dfp_PrpCtlvLimErrPat_mp "Fehlerpfad für physikalisches Fehlermuster bei der Geschwindigkeitsbegrenzung" UWORD OneToOne 1 100 0.00 65535.00 FORMAT "%8.2" ECU_ADDRESS 0x802620 /end MEASUREMENT
/begin MEASUREMENT Dfp_PSPCD_Actr_mp "Messpunkt fuer Fehlerpfad  Dfp_PSPCD_Actr" UWORD OneToOne 1 100 0.00 65535.00 FORMAT "%8.2" ECU_ADDRESS 0x802622 /end MEASUREMENT
/begin MEASUREMENT Dfp_RailCDOfsTst_mp "Fehlerpfad für Offset-Überwachung des Raildrucksensors" UWORD OneToOne 1 100 0.00 65535.00 FORMAT "%8.2" ECU_ADDRESS 0x802624 /end MEASUREMENT
/begin MEASUREMENT Dfp_RailCD_mp "Messpunkt fuer Fehlerpfad  Dfp_RailCD" UWORD OneToOne 1 100 0.00 65535.00 FORMAT "%8.2" ECU_ADDRESS 0x802626 /end MEASUREMENT
/begin MEASUREMENT Dfp_RailMeUn0_mp "Fehlerpfad für Überwachung auf positive Regelabweichung" UWORD OneToOne 1 100 0.00 65535.00 FORMAT "%8.2" ECU_ADDRESS 0x802628 /end MEASUREMENT
/begin MEASUREMENT Dfp_RailMeUn1_mp "Fehlerpfad für Überwachung auf positive Regelabweichung und Sollwert des Volumenstroms durch die Zumesseinheit" UWORD OneToOne 1 100 0.00 65535.00 FORMAT "%8.2" ECU_ADDRESS 0x80262A /end MEASUREMENT
/begin MEASUREMENT Dfp_RailMeUn2_mp "Fehlerpfad für Überwachung auf negative Regelabweichung bei Nullförderung" UWORD OneToOne 1 100 0.00 65535.00 FORMAT "%8.2" ECU_ADDRESS 0x80262C /end MEASUREMENT
/begin MEASUREMENT Dfp_RailMeUn3_mp "Fehlerpfad für Überwachung auf minimalen Raildruck" UWORD OneToOne 1 100 0.00 65535.00 FORMAT "%8.2" ECU_ADDRESS 0x80262E /end MEASUREMENT
/begin MEASUREMENT Dfp_RailMeUn4_mp "Fehlerpfad für Überwachung auf maximalen Raildruck" UWORD OneToOne 1 100 0.00 65535.00 FORMAT "%8.2" ECU_ADDRESS 0x802630 /end MEASUREMENT
/begin MEASUREMENT Dfp_RailPCV0_mp "Fehlerpfad für Überwachung auf positive Regelabweichung" UWORD OneToOne 1 100 0.00 65535.00 FORMAT "%8.2" ECU_ADDRESS 0x802632 /end MEASUREMENT
/begin MEASUREMENT Dfp_RailPCV1_mp "Fehlerpfad für Überwachung auf positive Regelabweichung kombiniert mit Stellgröße des Druckregelventils" UWORD OneToOne 1 100 0.00 65535.00 FORMAT "%8.2" ECU_ADDRESS 0x802634 /end MEASUREMENT
/begin MEASUREMENT Dfp_RailPCV2_mp "Fehlerpfad für Überwachung auf negative Regelabweichung kombiniert mit Stellgröße des Druckregelventils" UWORD OneToOne 1 100 0.00 65535.00 FORMAT "%8.2" ECU_ADDRESS 0x802636 /end MEASUREMENT
/begin MEASUREMENT Dfp_RailPCV3_mp "Fehlerpfad für Überwachung auf minimalen Raildruck" UWORD OneToOne 1 100 0.00 65535.00 FORMAT "%8.2" ECU_ADDRESS 0x802638 /end MEASUREMENT
/begin MEASUREMENT Dfp_RailPCV4_mp "Fehlerpfad für Überwachung auf maximalen Raildruck" UWORD OneToOne 1 100 0.00 65535.00 FORMAT "%8.2" ECU_ADDRESS 0x80263A /end MEASUREMENT
/begin MEASUREMENT Dfp_RailPCV5_mp "Fehlerpfad für Plausibilisierung des Raildrucks mit dem Strom durch das Druckregelventil" UWORD OneToOne 1 100 0.00 65535.00 FORMAT "%8.2" ECU_ADDRESS 0x80263C /end MEASUREMENT
/begin MEASUREMENT Dfp_SOPTst_mp "Messpunkt fuer Fehlerpfad  Dfp_SOPTst" UWORD OneToOne 1 100 0.00 65535.00 FORMAT "%8.2" ECU_ADDRESS 0x80263E /end MEASUREMENT
/begin MEASUREMENT Dfp_SSpMon1_mp "Meßpunkt des Fehlerpfades für Sensorversorgungsspannung 1" UWORD OneToOne 1 100 0.00 65535.00 FORMAT "%8.2" ECU_ADDRESS 0x802640 /end MEASUREMENT
/begin MEASUREMENT Dfp_SSpMon2_mp "Meßpunkt des Fehlerpfades für Sensorversorgungsspannung 2" UWORD OneToOne 1 100 0.00 65535.00 FORMAT "%8.2" ECU_ADDRESS 0x802642 /end MEASUREMENT
/begin MEASUREMENT Dfp_SSpMon3_mp "Meßpunkt des Fehlerpfades für Sensorversorgungsspannung 3" UWORD OneToOne 1 100 0.00 65535.00 FORMAT "%8.2" ECU_ADDRESS 0x802644 /end MEASUREMENT
/begin MEASUREMENT Dfp_StrtCDOffRly_mp "Meßpunkt für Fehlerpfad Dfp_StrtCDOffRly" UWORD OneToOne 1 100 0.00 65535.00 FORMAT "%8.2" ECU_ADDRESS 0x802646 /end MEASUREMENT
/begin MEASUREMENT Dfp_StrtCDOnRly_mp "Meßpunkt des Fehlerpfads Dfp_StrtCDOnRly" UWORD OneToOne 1 100 0.00 65535.00 FORMAT "%8.2" ECU_ADDRESS 0x802648 /end MEASUREMENT
/begin MEASUREMENT Dfp_StrtCtlIlsNotPlaus_mp "Messpunkt für Fehlerpfad Dfp_StrtCtlIlsNotPlaus" UWORD OneToOne 1 100 0.00 65535.00 FORMAT "%8.2" ECU_ADDRESS 0x80264A /end MEASUREMENT
/begin MEASUREMENT Dfp_StrtCtlT50ROneRly1_mp "Messpunkt fuer Fehlerpfad  Dfp_StrtCtlT50ROneRly1" UWORD OneToOne 1 100 0.00 65535.00 FORMAT "%8.2" ECU_ADDRESS 0x80264C /end MEASUREMENT
/begin MEASUREMENT Dfp_StrtCtlT50ROneRly2_mp "Messpunkt fuer Fehlerpfad  Dfp_StrtCtlT50ROneRly2" UWORD OneToOne 1 100 0.00 65535.00 FORMAT "%8.2" ECU_ADDRESS 0x80264E /end MEASUREMENT
/begin MEASUREMENT Dfp_StrtCtlT50RZero_mp "Messpunkt fuer Fehlerpfad  Dfp_StrtCtlT50RZero" UWORD OneToOne 1 100 0.00 65535.00 FORMAT "%8.2" ECU_ADDRESS 0x802650 /end MEASUREMENT
/begin MEASUREMENT Dfp_SysLamp_mp "Messpunkt fuer Fehlerpfad  Dfp_SysLamp" UWORD OneToOne 1 100 0.00 65535.00 FORMAT "%8.2" ECU_ADDRESS 0x802652 /end MEASUREMENT
/begin MEASUREMENT Dfp_T15CD_mp "Messpunkt fuer Fehlerpfad  Dfp_T15CD" UWORD OneToOne 1 100 0.00 65535.00 FORMAT "%8.2" ECU_ADDRESS 0x802654 /end MEASUREMENT
/begin MEASUREMENT Dfp_TPUMon_mp "Messpunkt fuer Fehlerpfad  Dfp_TPUMon" UWORD OneToOne 1 100 0.00 65535.00 FORMAT "%8.2" ECU_ADDRESS 0x802656 /end MEASUREMENT
/begin MEASUREMENT Dfp_TTSCD_mp "Messpunkt fuer Fehlerpfad Tanktemperaturwert" UWORD OneToOne 1 100 0.00 65535.00 FORMAT "%8.2" ECU_ADDRESS 0x802658 /end MEASUREMENT
/begin MEASUREMENT Dfp_TVACD_Max_mp "Fehlerpfad für Kurzschluss nach Batteriespannung des Drosselklappenstellers" UWORD OneToOne 1 100 0.00 65535.00 FORMAT "%8.2" ECU_ADDRESS 0x80265A /end MEASUREMENT
/begin MEASUREMENT Dfp_TVACD_Min_mp "Fehlerpfad für Kurzschluss nach Masse des Drosselklappenstellers" UWORD OneToOne 1 100 0.00 65535.00 FORMAT "%8.2" ECU_ADDRESS 0x80265C /end MEASUREMENT
/begin MEASUREMENT Dfp_TVACD_SigNpl_mp "Fehlerpfad für Lastabfall und Übertemperatur des Drosselklappenstellers" UWORD OneToOne 1 100 0.00 65535.00 FORMAT "%8.2" ECU_ADDRESS 0x80265E /end MEASUREMENT
/begin MEASUREMENT Dfp_TVACD_stLineDef_mp "Messpunkt fuer Fehlerpfad  Dfp_TVACD_stLineDef" UWORD OneToOne 1 100 0.00 65535.00 FORMAT "%8.2" ECU_ADDRESS 0x802660 /end MEASUREMENT
/begin MEASUREMENT Dfp_UAcc_CodeBitErr_mp "Messpunkt fuer Fehlerpfad  Dfp_UAcc_CodeBitErr" UWORD OneToOne 1 100 0.00 65535.00 FORMAT "%8.2" ECU_ADDRESS 0x802662 /end MEASUREMENT
/begin MEASUREMENT Dfp_USAp_DataVariant_mp "Messpunkt fuer Fehlerpfad  Dfp_USAp_DataVariant" UWORD OneToOne 1 100 0.00 65535.00 FORMAT "%8.2" ECU_ADDRESS 0x802664 /end MEASUREMENT
/begin MEASUREMENT Dfp_USAp_FuncCodeRead_mp "Funktionkodierung gültig" UWORD OneToOne 1 100 0.00 65535.00 FORMAT "%8.2" ECU_ADDRESS 0x802666 /end MEASUREMENT
/begin MEASUREMENT Dfp_VSACD1_Max_mp "Fehlerpfad für Kurzschluss nach Batteriespannung des Drallniveaustellers eins" UWORD OneToOne 1 100 0.00 65535.00 FORMAT "%8.2" ECU_ADDRESS 0x802668 /end MEASUREMENT
/begin MEASUREMENT Dfp_VSACD1_Min_mp "Fehlerpfad für Kurzschluss nach Masse des Drallniveaustellers eins" UWORD OneToOne 1 100 0.00 65535.00 FORMAT "%8.2" ECU_ADDRESS 0x80266A /end MEASUREMENT
/begin MEASUREMENT Dfp_VSACD1_SigNpl_mp "Fehlerpfad für Lastabfall und Übertemperatur des Drallniveaustellers eins" UWORD OneToOne 1 100 0.00 65535.00 FORMAT "%8.2" ECU_ADDRESS 0x80266C /end MEASUREMENT
/begin MEASUREMENT Dfp_VSACD2_Max_mp "Fehlerpfad für Kurzschluss nach Batteriespannung des Drallniveaustellers zwei" UWORD OneToOne 1 100 0.00 65535.00 FORMAT "%8.2" ECU_ADDRESS 0x80266E /end MEASUREMENT
/begin MEASUREMENT Dfp_VSACD2_Min_mp "Fehlerpfad für Kurzschluss nach Masse des Drallniveaustellers zwei" UWORD OneToOne 1 100 0.00 65535.00 FORMAT "%8.2" ECU_ADDRESS 0x802670 /end MEASUREMENT
/begin MEASUREMENT Dfp_VSACD2_SigNpl_mp "Fehlerpfad für Lastabfall und Übertemperatur des Drallniveaustellers zwei" UWORD OneToOne 1 100 0.00 65535.00 FORMAT "%8.2" ECU_ADDRESS 0x802672 /end MEASUREMENT
/begin MEASUREMENT Dfp_VSAExcSensTemp1_mp "Messpunkt fuer Fehlerpfad  Dfp_VSAExcSensTemp1" UWORD OneToOne 1 100 0.00 65535.00 FORMAT "%8.2" ECU_ADDRESS 0x802674 /end MEASUREMENT
/begin MEASUREMENT Dfp_VSAExcSensTemp2_mp "Messpunkt fuer Fehlerpfad  Dfp_VSAExcSensTemp2" UWORD OneToOne 1 100 0.00 65535.00 FORMAT "%8.2" ECU_ADDRESS 0x802676 /end MEASUREMENT
/begin MEASUREMENT Dfp_VSANotLrn1_mp "Fehlerpfad für Defekt beim Anlernen der mechanischen Anschläge Drallniveausteller eins" UWORD OneToOne 1 100 0.00 65535.00 FORMAT "%8.2" ECU_ADDRESS 0x802678 /end MEASUREMENT
/begin MEASUREMENT Dfp_VSANotLrn2_mp "Fehlerpfad für Defekt beim Anlernen der mechanischen Anschläge Drallniveausteller zwei" UWORD OneToOne 1 100 0.00 65535.00 FORMAT "%8.2" ECU_ADDRESS 0x80267A /end MEASUREMENT
/begin MEASUREMENT Dfp_VSASCDDcyc1_mp "Messpunkt für Fehlerpfad Dfp_VSASCDDcyc1" UWORD OneToOne 1 100 0.00 65535.00 FORMAT "%8.2" ECU_ADDRESS 0x80267C /end MEASUREMENT
/begin MEASUREMENT Dfp_VSASCDDcyc2_mp "Messpunkt für Fehlerpfad Dfp_VSASCDDcyc2" UWORD OneToOne 1 100 0.00 65535.00 FORMAT "%8.2" ECU_ADDRESS 0x80267E /end MEASUREMENT
/begin MEASUREMENT Dfp_VSASCDPeriod1_mp "Messpunkt für Fehlerpfad Dfp_VSASCDPeriod1" UWORD OneToOne 1 100 0.00 65535.00 FORMAT "%8.2" ECU_ADDRESS 0x802680 /end MEASUREMENT
/begin MEASUREMENT Dfp_VSASCDPeriod2_mp "Messpunkt für Fehlerpfad Dfp_VSASCDPeriod2" UWORD OneToOne 1 100 0.00 65535.00 FORMAT "%8.2" ECU_ADDRESS 0x802682 /end MEASUREMENT
/begin MEASUREMENT Dfp_VSSCD1_mp "Messpunkt fuer Fehlerpfad  Dfp_VSSCD1" UWORD OneToOne 1 100 0.00 65535.00 FORMAT "%8.2" ECU_ADDRESS 0x802684 /end MEASUREMENT
/begin MEASUREMENT Dfp_VSSCD2_mp "Messpunkt fuer Fehlerpfad  Dfp_VSSCD2" UWORD OneToOne 1 100 0.00 65535.00 FORMAT "%8.2" ECU_ADDRESS 0x802686 /end MEASUREMENT
/begin MEASUREMENT Dfp_VSSCD4_mp "Messpunkt fuer Fehlerpfad Dfp_VSSCD4" UWORD OneToOne 1 100 0.00 65535.00 FORMAT "%8.2" ECU_ADDRESS 0x802688 /end MEASUREMENT
/begin MEASUREMENT Dfp_VSSCDBrkLowVltg_mp "Fehlerpfad für Gschwindigkeitssensorunterspannung in BRK1" UWORD OneToOne 1 100 0.00 65535.00 FORMAT "%8.2" ECU_ADDRESS 0x80268A /end MEASUREMENT
/begin MEASUREMENT Dfp_VSSCDCAN_mp "Messpunt für Fehlerpfad Dfp_VSSCDCAN (wenn Geschwindigkeit über CAN: wird gesetzt wenn CAN-spez. Fehler auftritt)" UWORD OneToOne 1 100 0.00 65535.00 FORMAT "%8.2" ECU_ADDRESS 0x80268C /end MEASUREMENT
/begin MEASUREMENT Dfp_VSSCDNpl_mp "Messpunkt fuer Fehlerpfad  Dfp_VSSCDNpl" UWORD OneToOne 1 100 0.00 65535.00 FORMAT "%8.2" ECU_ADDRESS 0x80268E /end MEASUREMENT
/begin MEASUREMENT Dfp_WdCom_mp "Messpunkt fuer Fehlerpfad  Dfp_WdCom" UWORD OneToOne 1 100 0.00 65535.00 FORMAT "%8.2" ECU_ADDRESS 0x802690 /end MEASUREMENT
/begin FUNCTION dsm_auto_dfpmp ""
 /begin OUT_MEASUREMENT Dfp_ACCCDWrongCoded_mp Dfp_ACCD_mp Dfp_ACCD_PAC_mp Dfp_ACCD_pCAN_mp Dfp_ACCD_trqCAN_mp Dfp_ACCnotPlaus_mp Dfp_AccPedPlausBrk_mp Dfp_ADCMon_mp Dfp_AddPCDTnkLvlDef_mp Dfp_AddPCDTnkLvl_mp Dfp_AddPCD_mp Dfp_AFSCD_AirTempDcyc_mp Dfp_AFSCD_Plaus_mp Dfp_AFSCD_PlOffsDrft_mp Dfp_AFSCD_PlSetyDrft_mp Dfp_AFSCD_SRCAirm2_mp Dfp_AFSCD_SRCAirm_mp Dfp_AFSCD_SRCAirTemp_mp Dfp_AFSCD_SRCBatt_mp Dfp_AFSCD_SRCCorrAirm_mp Dfp_AFSCD_SRCRawAirm_mp Dfp_AFSCD_SRCRefSigPer_mp Dfp_AFVCD_Actr_mp Dfp_AirbCDCrashCrCtl_mp Dfp_AirbCDCrashPSP_mp Dfp_AirbCDCrash_mp Dfp_AirCtl_GovDev_mp Dfp_AltCDExc_mp Dfp_AltCD_Load_mp Dfp_AltPwrCan_mp Dfp_AOHtCDHt1_mp Dfp_AOHtCDHt2_mp Dfp_AOHtCDHt3_mp Dfp_APP1_mp Dfp_APP2_mp Dfp_APPCD_KickDown_mp Dfp_APPSync_mp Dfp_APP_Npl_mp Dfp_APSCD_mp Dfp_BattCD_mp Dfp_BPACD_Max_mp Dfp_BPACD_Min_mp Dfp_BPACD_SigNpl_mp Dfp_BPAExcSensTemp_mp Dfp_BPANotLrn_mp Dfp_BPASCDDcyc_mp Dfp_BPASCDPeriod_mp Dfp_BPSCDPlaus_mp Dfp_BPSCD_mp Dfp_BrkCDdynPl_mp Dfp_BrkCD_mp Dfp_CANA_mp Dfp_CANBus1_mp Dfp_CANBus2_mp Dfp_CANBus3_mp Dfp_CANB_mp Dfp_CANC_mp Dfp_CANErrActA_mp Dfp_CANErrActB_mp Dfp_CANErrActC_mp Dfp_Clg_DynTst_mp Dfp_CmbChbMisfire1_mp Dfp_CmbChbMisfire2_mp Dfp_CmbChbMisfire3_mp Dfp_CmbChbMisfire4_mp Dfp_CmbChbMisfire5_mp Dfp_CmbChbMisfire6_mp Dfp_CmbChbMisfireMul_mp Dfp_ConvCD_ConvErr_mp Dfp_ConvCD_mp Dfp_COTSCD_mp Dfp_CoVehEcoErr_mp Dfp_CoVehLvl2_mp Dfp_CoVMDCSh_mp Dfp_CoVMDCSp_mp Dfp_CrCtlPanErr_mp Dfp_CrCtlPanSwtErr_mp Dfp_CrCtlPLmpDef_mp Dfp_CrCtlPShutOff_mp Dfp_CrCtlPTlrDef_mp Dfp_CtApCD_mp Dfp_CTSCDCanInac_mp Dfp_CTSCDCanSig_mp Dfp_CTSCD_mp Dfp_CtTCD_mp Dfp_CtT_Mon_mp Dfp_DifftrqLimErrPat_mp Dfp_EATSCDCanInac_mp Dfp_EATSCDCanSig_mp Dfp_EATSCD_mp Dfp_EEPCDVarMng_mp Dfp_EGPpCDTPreTrbn1_mp Dfp_EGPpCDTPreTrbn_mp Dfp_EGRCD_CBV_mp Dfp_EGRCD_Max_mp Dfp_EGRCD_Min_mp Dfp_EGRCD_SigNpl_mp Dfp_EMCCD_GTL1_mp Dfp_EMCCD_GTL2_mp Dfp_EMCCD_MLS1_mp Dfp_EMCCD_MLS2_mp Dfp_EngMCaS1_mp Dfp_EngMCrS1_mp Dfp_EngMOfsCaSCrS_mp Dfp_EngMonIrrCmb_mp Dfp_EngPrt_mp Dfp_ErLpCDMILReqON_mp Dfp_ETClbInj1_mp Dfp_ETClbInj2_mp Dfp_ETClbInj3_mp Dfp_ETClbInj4_mp Dfp_ETClbInj5_mp Dfp_ETClbInj6_mp Dfp_FanCD_Fan1Ctlr1_mp Dfp_FanCD_Fan1Ctlr2_mp Dfp_FanCD_Fan2Ctlr1_mp Dfp_FanCD_Fan2Ctlr2_mp Dfp_FanCD_FanCtlr1_mp Dfp_FanCD_FanCtlr2_mp Dfp_FanCD_OutFanCtlr1_mp Dfp_FanCD_OutFanCtlr2_mp Dfp_FlPpCD_mp Dfp_FlSCDT1_mp Dfp_FMTC_NonMonotonMap_mp Dfp_FQlSCD_mp Dfp_FrmMngAAGNpl_mp Dfp_FrmMngAAGTO_mp Dfp_FrmMngAC1Npl_mp Dfp_FrmMngAC1TO_mp Dfp_FrmMngACCNpl_mp Dfp_FrmMngACCTO_mp Dfp_FrmMngAIRBGNpl_mp Dfp_FrmMngAIRBGTO_mp Dfp_FrmMngAWD1Npl_mp Dfp_FrmMngAWD1TO_mp Dfp_FrmMngBEM1Npl_mp Dfp_FrmMngBEM1TO_mp Dfp_FrmMngBRK1Npl_mp Dfp_FrmMngBRK1TO_mp Dfp_FrmMngBRK2Npl_mp Dfp_FrmMngBRK2TO_mp Dfp_FrmMngBRK8Npl_mp Dfp_FrmMngBRK8TO_mp Dfp_FrmMngCANVerErr_mp Dfp_FrmMngCCSel_mp Dfp_FrmMngCCTLNpl_mp Dfp_FrmMngCCTLTO_mp Dfp_FrmMngChrgr1A_mp Dfp_FrmMngChrgr1C_mp Dfp_FrmMngCHRGR1Npl_mp Dfp_FrmMngChrgr1N_mp Dfp_FrmMngCHRGR1TO_mp Dfp_FrmMngChrgr1T_mp Dfp_FrmMngChrgr1V_mp Dfp_FrmMngChrgr2A_mp Dfp_FrmMngChrgr2C_mp Dfp_FrmMngCHRGR2Npl_mp Dfp_FrmMngChrgr2N_mp Dfp_FrmMngCHRGR2TO_mp Dfp_FrmMngChrgr2T_mp Dfp_FrmMngChrgr2V_mp Dfp_FrmMngDIA1Npl_mp Dfp_FrmMngDIA1TO_mp Dfp_FrmMngDSP1Npl_mp Dfp_FrmMngDSP1TO_mp Dfp_FrmMngDSP2Npl_mp Dfp_FrmMngDSP2TO_mp Dfp_FrmMngESCUNpl_mp Dfp_FrmMngESCUTO_mp Dfp_FrmMngGW1Npl_mp Dfp_FrmMngGW1TO_mp Dfp_FrmMngILMNpl_mp Dfp_FrmMngILMTO_mp Dfp_FrmMngNIV1WrngCod_mp Dfp_FrmMngNIVEAU1Npl_mp Dfp_FrmMngNIVEAU1TO_mp Dfp_FrmMngSTIGNNpl_mp Dfp_FrmMngStIgnTO_mp Dfp_FrmMngTOSNpl_mp Dfp_FrmMngTOSTO_mp Dfp_FrmMngTSC1Npl_mp Dfp_FrmMngTSC1TO_mp Dfp_FrmMngTSC2Npl_mp Dfp_FrmMngTSC2TO_mp Dfp_FrmMngTSC3Npl_mp Dfp_FrmMngTSC3TO_mp Dfp_FTSCDNpl_mp Dfp_FTSCD_mp Dfp_GearbxASTh_mp Dfp_GearbxASTl_mp Dfp_GearbxTSC_mp Dfp_GearbxTypeMTErr_mp Dfp_GlwCD_Actr_mp Dfp_GlwCD_DIAG_mp Dfp_GlwCD_Error1_mp Dfp_GlwCD_Error2_mp Dfp_GlwCD_EvalCod_mp Dfp_GlwCD_GSK_mp Dfp_GlwCD_LampCan_mp Dfp_GlwCD_Lamp_mp Dfp_GlwCD_PLUG0_mp Dfp_GlwCD_PLUG1_mp Dfp_GlwCD_PLUG2_mp Dfp_GlwCD_PLUG3_mp Dfp_GlwCD_PLUG4_mp Dfp_GlwCD_PLUG5_mp Dfp_GlwCD_SFD_mp Dfp_HDSCD_mp Dfp_HWEMonCom_mp Dfp_HWEMonEEPROM_mp Dfp_HWEMonRcyLocked_mp Dfp_HWEMonRcySuppressed_mp Dfp_HWEMonRcyVisible_mp Dfp_HWEMonUMaxSupply_mp Dfp_HWEMonUMinSupply_mp Dfp_IATSCD_mp Dfp_IFCD_mp Dfp_ImmCtl_mp Dfp_InjCrv_InjLim_mp Dfp_InjVCDActrChrg_mp Dfp_InjVCDActrVolt_mp Dfp_InjVCDClsBank1_mp Dfp_InjVCDClsBank2_mp Dfp_InjVCDMonCab_mp Dfp_InjVCDMonSwt_mp Dfp_InjVCDShOffDCDC_mp Dfp_InjVCDUBuf_mp Dfp_InjVCD_CY370Ampl_mp Dfp_InjVlvBnk1A_mp Dfp_InjVlvBnk1B_mp Dfp_InjVlvBnk2A_mp Dfp_InjVlvBnk2B_mp Dfp_InjVlvChipA_mp Dfp_InjVlvChipB_mp Dfp_InjVlvCyl1A_mp Dfp_InjVlvCyl1B_mp Dfp_InjVlvCyl1C_mp Dfp_InjVlvCyl2A_mp Dfp_InjVlvCyl2B_mp Dfp_InjVlvCyl2C_mp Dfp_InjVlvCyl3A_mp Dfp_InjVlvCyl3B_mp Dfp_InjVlvCyl3C_mp Dfp_InjVlvCyl4A_mp Dfp_InjVlvCyl4B_mp Dfp_InjVlvCyl4C_mp Dfp_InjVlvCyl5A_mp Dfp_InjVlvCyl5B_mp Dfp_InjVlvCyl5C_mp Dfp_InjVlvCyl6A_mp Dfp_InjVlvCyl6B_mp Dfp_InjVlvCyl6C_mp Dfp_InjVlvCyl7A_mp Dfp_InjVlvCyl7B_mp Dfp_InjVlvCyl7C_mp Dfp_InjVlvCyl8A_mp Dfp_InjVlvCyl8B_mp Dfp_InjVlvCyl8C_mp Dfp_LSUCDCircNernst0_mp Dfp_LSUCDCircPumpCur0_mp Dfp_LSUCDCircVirtGnd0_mp Dfp_LSUCDHeater0_mp Dfp_LSUCDHtCoup0_mp Dfp_LSUCDO20_mp Dfp_LSUCDO2Clb0_mp Dfp_LSUCDRiClb0_mp Dfp_LSUCDSPI0_mp Dfp_LSUCDSPIBattLow0_mp Dfp_LSUCDWireIP0_mp Dfp_LSUCtlRiExc0_mp Dfp_LSUMon1Sens_mp Dfp_LSUMon2Sens_mp Dfp_MeUnCDNoLoad_mp Dfp_MeUnCDSCBat_mp Dfp_MeUnCDSCGnd_mp Dfp_MeUnCD_ADC_mp Dfp_MIL_mp Dfp_Montr_mp Dfp_MRlyCD_mp Dfp_OTSCDCanInac_mp Dfp_OTSCDCanSig_mp Dfp_OTSCD_mp Dfp_OvRMonCrCtlP_mp Dfp_OvRMonSigA_mp Dfp_OvRMon_mp Dfp_OxiCCDTPre1_mp Dfp_OxiCCDTPre_mp Dfp_PCR_BalGovDev_mp Dfp_PCR_GovDev_mp Dfp_PCVCDNoLoad_mp Dfp_PCVCDSCBat_mp Dfp_PCVCDSCGnd_mp Dfp_PCVCD_ADC_mp Dfp_PFltCDHtg1_mp Dfp_PFltCDHtg_mp Dfp_PFltCDPDiff1_mp Dfp_PFltCDPDiff_mp Dfp_PFltCDTempPre1_mp Dfp_PFltCDTempPre_mp Dfp_PFltCDTPre_mp Dfp_PFltCDTPst_mp Dfp_PFltChar_mp Dfp_PFltEngPrt_mp Dfp_PFltPresDynPlaus_mp Dfp_PFltPresSensHsLn_mp Dfp_PFltPresSensSot_mp Dfp_PFltPresSens_mp Dfp_PFltRgnPerm_mp Dfp_PFltTempDwnStrm_mp Dfp_PFltTempSens_mp Dfp_PFltTempUpStrm_mp Dfp_PrpCtlvLimErrPat_mp Dfp_PSPCD_Actr_mp Dfp_RailCDOfsTst_mp Dfp_RailCD_mp Dfp_RailMeUn0_mp Dfp_RailMeUn1_mp Dfp_RailMeUn2_mp Dfp_RailMeUn3_mp Dfp_RailMeUn4_mp Dfp_RailPCV0_mp Dfp_RailPCV1_mp Dfp_RailPCV2_mp Dfp_RailPCV3_mp Dfp_RailPCV4_mp Dfp_RailPCV5_mp Dfp_SOPTst_mp Dfp_SSpMon1_mp Dfp_SSpMon2_mp Dfp_SSpMon3_mp Dfp_StrtCDOffRly_mp Dfp_StrtCDOnRly_mp Dfp_StrtCtlIlsNotPlaus_mp Dfp_StrtCtlT50ROneRly1_mp Dfp_StrtCtlT50ROneRly2_mp Dfp_StrtCtlT50RZero_mp Dfp_SysLamp_mp Dfp_T15CD_mp Dfp_TPUMon_mp Dfp_TTSCD_mp Dfp_TVACD_Max_mp Dfp_TVACD_Min_mp Dfp_TVACD_SigNpl_mp Dfp_TVACD_stLineDef_mp Dfp_UAcc_CodeBitErr_mp Dfp_USAp_DataVariant_mp Dfp_USAp_FuncCodeRead_mp Dfp_VSACD1_Max_mp Dfp_VSACD1_Min_mp Dfp_VSACD1_SigNpl_mp Dfp_VSACD2_Max_mp Dfp_VSACD2_Min_mp Dfp_VSACD2_SigNpl_mp Dfp_VSAExcSensTemp1_mp Dfp_VSAExcSensTemp2_mp Dfp_VSANotLrn1_mp Dfp_VSANotLrn2_mp Dfp_VSASCDDcyc1_mp Dfp_VSASCDDcyc2_mp Dfp_VSASCDPeriod1_mp Dfp_VSASCDPeriod2_mp Dfp_VSSCD1_mp Dfp_VSSCD2_mp Dfp_VSSCD4_mp Dfp_VSSCDBrkLowVltg_mp Dfp_VSSCDCAN_mp Dfp_VSSCDNpl_mp Dfp_WdCom_mp /end OUT_MEASUREMENT
/end FUNCTION
/begin FUNCTION dsm_auto_env16 ""
 /begin DEF_CHARACTERISTIC DSM_EnvDfp_ACCCDWrongCoded_C DSM_EnvDfp_ACCD_C DSM_EnvDfp_ACCD_PAC_C DSM_EnvDfp_ACCD_pCAN_C DSM_EnvDfp_ACCD_trqCAN_C DSM_EnvDfp_ACCnotPlaus_C DSM_EnvDfp_ADCMon_C DSM_EnvDfp_AFSCD_AirTempDcyc_C DSM_EnvDfp_AFSCD_PlOffsDrft_C DSM_EnvDfp_AFSCD_PlSetyDrft_C DSM_EnvDfp_AFSCD_Plaus_C DSM_EnvDfp_AFSCD_SRCAirTemp_C DSM_EnvDfp_AFSCD_SRCAirm_C DSM_EnvDfp_AFSCD_SRCAirm2_C DSM_EnvDfp_AFSCD_SRCBatt_C DSM_EnvDfp_AFSCD_SRCCorrAirm_C DSM_EnvDfp_AFSCD_SRCRawAirm_C DSM_EnvDfp_AFSCD_SRCRefSigPer_C DSM_EnvDfp_AFVCD_Actr_C DSM_EnvDfp_AOHtCDHt1_C DSM_EnvDfp_AOHtCDHt2_C DSM_EnvDfp_AOHtCDHt3_C DSM_EnvDfp_APP1_C DSM_EnvDfp_APP2_C DSM_EnvDfp_APPCD_KickDown_C DSM_EnvDfp_APPSync_C DSM_EnvDfp_APP_Npl_C DSM_EnvDfp_APSCD_C DSM_EnvDfp_AccPedPlausBrk_C DSM_EnvDfp_AddPCD_C DSM_EnvDfp_AddPCDTnkLvl_C DSM_EnvDfp_AddPCDTnkLvlDef_C DSM_EnvDfp_AirCtl_GovDev_C DSM_EnvDfp_AirbCDCrash_C DSM_EnvDfp_AirbCDCrashCrCtl_C DSM_EnvDfp_AirbCDCrashPSP_C DSM_EnvDfp_AltCDExc_C DSM_EnvDfp_AltCD_Load_C DSM_EnvDfp_AltPwrCan_C DSM_EnvDfp_BPACD_Max_C DSM_EnvDfp_BPACD_Min_C DSM_EnvDfp_BPACD_SigNpl_C DSM_EnvDfp_BPAExcSensTemp_C DSM_EnvDfp_BPANotLrn_C DSM_EnvDfp_BPASCDDcyc_C DSM_EnvDfp_BPASCDPeriod_C DSM_EnvDfp_BPSCD_C DSM_EnvDfp_BPSCDPlaus_C DSM_EnvDfp_BattCD_C DSM_EnvDfp_BrkCD_C DSM_EnvDfp_BrkCDdynPl_C DSM_EnvDfp_CANA_C DSM_EnvDfp_CANB_C DSM_EnvDfp_CANBus1_C DSM_EnvDfp_CANBus2_C DSM_EnvDfp_CANBus3_C DSM_EnvDfp_CANC_C DSM_EnvDfp_CANErrActA_C DSM_EnvDfp_CANErrActB_C DSM_EnvDfp_CANErrActC_C DSM_EnvDfp_COTSCD_C DSM_EnvDfp_CTSCD_C DSM_EnvDfp_CTSCDCanInac_C DSM_EnvDfp_CTSCDCanSig_C DSM_EnvDfp_Clg_DynTst_C DSM_EnvDfp_CmbChbMisfire1_C DSM_EnvDfp_CmbChbMisfire2_C DSM_EnvDfp_CmbChbMisfire3_C DSM_EnvDfp_CmbChbMisfire4_C DSM_EnvDfp_CmbChbMisfire5_C DSM_EnvDfp_CmbChbMisfire6_C DSM_EnvDfp_CmbChbMisfireMul_C DSM_EnvDfp_CoVMDCSh_C DSM_EnvDfp_CoVMDCSp_C DSM_EnvDfp_CoVehEcoErr_C DSM_EnvDfp_CoVehLvl2_C DSM_EnvDfp_ConvCD_C DSM_EnvDfp_ConvCD_ConvErr_C DSM_EnvDfp_CrCtlPLmpDef_C DSM_EnvDfp_CrCtlPShutOff_C DSM_EnvDfp_CrCtlPTlrDef_C DSM_EnvDfp_CrCtlPanErr_C DSM_EnvDfp_CrCtlPanSwtErr_C DSM_EnvDfp_CtApCD_C DSM_EnvDfp_CtTCD_C DSM_EnvDfp_CtT_Mon_C DSM_EnvDfp_DifftrqLimErrPat_C DSM_EnvDfp_EATSCD_C DSM_EnvDfp_EATSCDCanInac_C DSM_EnvDfp_EATSCDCanSig_C DSM_EnvDfp_EEPCDVarMng_C DSM_EnvDfp_EGPpCDTPreTrbn_C DSM_EnvDfp_EGPpCDTPreTrbn1_C DSM_EnvDfp_EGRCD_CBV_C DSM_EnvDfp_EGRCD_Max_C DSM_EnvDfp_EGRCD_Min_C DSM_EnvDfp_EGRCD_SigNpl_C DSM_EnvDfp_EMCCD_GTL1_C DSM_EnvDfp_EMCCD_GTL2_C DSM_EnvDfp_EMCCD_MLS1_C DSM_EnvDfp_EMCCD_MLS2_C DSM_EnvDfp_ETClbInj1_C DSM_EnvDfp_ETClbInj2_C DSM_EnvDfp_ETClbInj3_C DSM_EnvDfp_ETClbInj4_C DSM_EnvDfp_ETClbInj5_C DSM_EnvDfp_ETClbInj6_C DSM_EnvDfp_EngMCaS1_C DSM_EnvDfp_EngMCrS1_C DSM_EnvDfp_EngMOfsCaSCrS_C DSM_EnvDfp_EngMonIrrCmb_C DSM_EnvDfp_EngPrt_C DSM_EnvDfp_ErLpCDMILReqON_C DSM_EnvDfp_FMTC_NonMonotonMap_C DSM_EnvDfp_FQlSCD_C DSM_EnvDfp_FTSCD_C DSM_EnvDfp_FTSCDNpl_C DSM_EnvDfp_FanCD_Fan1Ctlr1_C DSM_EnvDfp_FanCD_Fan1Ctlr2_C DSM_EnvDfp_FanCD_Fan2Ctlr1_C DSM_EnvDfp_FanCD_Fan2Ctlr2_C DSM_EnvDfp_FanCD_FanCtlr1_C DSM_EnvDfp_FanCD_FanCtlr2_C DSM_EnvDfp_FanCD_OutFanCtlr1_C DSM_EnvDfp_FanCD_OutFanCtlr2_C DSM_EnvDfp_FlPpCD_C DSM_EnvDfp_FlSCDT1_C DSM_EnvDfp_FrmMngAAGNpl_C DSM_EnvDfp_FrmMngAAGTO_C DSM_EnvDfp_FrmMngAC1Npl_C DSM_EnvDfp_FrmMngAC1TO_C DSM_EnvDfp_FrmMngACCNpl_C DSM_EnvDfp_FrmMngACCTO_C DSM_EnvDfp_FrmMngAIRBGNpl_C DSM_EnvDfp_FrmMngAIRBGTO_C DSM_EnvDfp_FrmMngAWD1Npl_C DSM_EnvDfp_FrmMngAWD1TO_C DSM_EnvDfp_FrmMngBEM1Npl_C DSM_EnvDfp_FrmMngBEM1TO_C DSM_EnvDfp_FrmMngBRK1Npl_C DSM_EnvDfp_FrmMngBRK1TO_C DSM_EnvDfp_FrmMngBRK2Npl_C DSM_EnvDfp_FrmMngBRK2TO_C DSM_EnvDfp_FrmMngBRK8Npl_C DSM_EnvDfp_FrmMngBRK8TO_C DSM_EnvDfp_FrmMngCANVerErr_C DSM_EnvDfp_FrmMngCCSel_C DSM_EnvDfp_FrmMngCCTLNpl_C DSM_EnvDfp_FrmMngCCTLTO_C DSM_EnvDfp_FrmMngCHRGR1Npl_C DSM_EnvDfp_FrmMngCHRGR1TO_C DSM_EnvDfp_FrmMngCHRGR2Npl_C DSM_EnvDfp_FrmMngCHRGR2TO_C DSM_EnvDfp_FrmMngChrgr1A_C DSM_EnvDfp_FrmMngChrgr1C_C DSM_EnvDfp_FrmMngChrgr1N_C DSM_EnvDfp_FrmMngChrgr1T_C DSM_EnvDfp_FrmMngChrgr1V_C DSM_EnvDfp_FrmMngChrgr2A_C DSM_EnvDfp_FrmMngChrgr2C_C DSM_EnvDfp_FrmMngChrgr2N_C DSM_EnvDfp_FrmMngChrgr2T_C DSM_EnvDfp_FrmMngChrgr2V_C DSM_EnvDfp_FrmMngDIA1Npl_C DSM_EnvDfp_FrmMngDIA1TO_C DSM_EnvDfp_FrmMngDSP1Npl_C DSM_EnvDfp_FrmMngDSP1TO_C DSM_EnvDfp_FrmMngDSP2Npl_C DSM_EnvDfp_FrmMngDSP2TO_C DSM_EnvDfp_FrmMngESCUNpl_C DSM_EnvDfp_FrmMngESCUTO_C DSM_EnvDfp_FrmMngGW1Npl_C DSM_EnvDfp_FrmMngGW1TO_C DSM_EnvDfp_FrmMngILMNpl_C DSM_EnvDfp_FrmMngILMTO_C DSM_EnvDfp_FrmMngNIV1WrngCod_C DSM_EnvDfp_FrmMngNIVEAU1Npl_C DSM_EnvDfp_FrmMngNIVEAU1TO_C DSM_EnvDfp_FrmMngSTIGNNpl_C DSM_EnvDfp_FrmMngStIgnTO_C DSM_EnvDfp_FrmMngTOSNpl_C DSM_EnvDfp_FrmMngTOSTO_C DSM_EnvDfp_FrmMngTSC1Npl_C DSM_EnvDfp_FrmMngTSC1TO_C DSM_EnvDfp_FrmMngTSC2Npl_C DSM_EnvDfp_FrmMngTSC2TO_C DSM_EnvDfp_FrmMngTSC3Npl_C DSM_EnvDfp_FrmMngTSC3TO_C DSM_EnvDfp_GearbxASTh_C DSM_EnvDfp_GearbxASTl_C DSM_EnvDfp_GearbxTSC_C DSM_EnvDfp_GearbxTypeMTErr_C DSM_EnvDfp_GlwCD_Actr_C DSM_EnvDfp_GlwCD_DIAG_C DSM_EnvDfp_GlwCD_Error1_C DSM_EnvDfp_GlwCD_Error2_C DSM_EnvDfp_GlwCD_EvalCod_C DSM_EnvDfp_GlwCD_GSK_C DSM_EnvDfp_GlwCD_Lamp_C DSM_EnvDfp_GlwCD_LampCan_C DSM_EnvDfp_GlwCD_PLUG0_C DSM_EnvDfp_GlwCD_PLUG1_C DSM_EnvDfp_GlwCD_PLUG2_C DSM_EnvDfp_GlwCD_PLUG3_C DSM_EnvDfp_GlwCD_PLUG4_C DSM_EnvDfp_GlwCD_PLUG5_C DSM_EnvDfp_GlwCD_SFD_C DSM_EnvDfp_HDSCD_C DSM_EnvDfp_HWEMonCom_C DSM_EnvDfp_HWEMonEEPROM_C DSM_EnvDfp_HWEMonRcyLocked_C DSM_EnvDfp_HWEMonRcySuppressed_C DSM_EnvDfp_HWEMonRcyVisible_C DSM_EnvDfp_HWEMonUMaxSupply_C DSM_EnvDfp_HWEMonUMinSupply_C DSM_EnvDfp_IATSCD_C DSM_EnvDfp_IFCD_C DSM_EnvDfp_ImmCtl_C DSM_EnvDfp_InjCrv_InjLim_C DSM_EnvDfp_InjVCDActrChrg_C DSM_EnvDfp_InjVCDActrVolt_C DSM_EnvDfp_InjVCDClsBank1_C DSM_EnvDfp_InjVCDClsBank2_C DSM_EnvDfp_InjVCDMonCab_C DSM_EnvDfp_InjVCDMonSwt_C DSM_EnvDfp_InjVCDShOffDCDC_C DSM_EnvDfp_InjVCDUBuf_C DSM_EnvDfp_InjVCD_CY370Ampl_C DSM_EnvDfp_InjVlvBnk1A_C DSM_EnvDfp_InjVlvBnk1B_C DSM_EnvDfp_InjVlvBnk2A_C DSM_EnvDfp_InjVlvBnk2B_C DSM_EnvDfp_InjVlvChipA_C DSM_EnvDfp_InjVlvChipB_C DSM_EnvDfp_InjVlvCyl1A_C DSM_EnvDfp_InjVlvCyl1B_C DSM_EnvDfp_InjVlvCyl1C_C DSM_EnvDfp_InjVlvCyl2A_C DSM_EnvDfp_InjVlvCyl2B_C DSM_EnvDfp_InjVlvCyl2C_C DSM_EnvDfp_InjVlvCyl3A_C DSM_EnvDfp_InjVlvCyl3B_C DSM_EnvDfp_InjVlvCyl3C_C DSM_EnvDfp_InjVlvCyl4A_C DSM_EnvDfp_InjVlvCyl4B_C DSM_EnvDfp_InjVlvCyl4C_C DSM_EnvDfp_InjVlvCyl5A_C DSM_EnvDfp_InjVlvCyl5B_C DSM_EnvDfp_InjVlvCyl5C_C DSM_EnvDfp_InjVlvCyl6A_C DSM_EnvDfp_InjVlvCyl6B_C DSM_EnvDfp_InjVlvCyl6C_C DSM_EnvDfp_InjVlvCyl7A_C DSM_EnvDfp_InjVlvCyl7B_C DSM_EnvDfp_InjVlvCyl7C_C DSM_EnvDfp_InjVlvCyl8A_C DSM_EnvDfp_InjVlvCyl8B_C DSM_EnvDfp_InjVlvCyl8C_C DSM_EnvDfp_LSUCDCircNernst0_C DSM_EnvDfp_LSUCDCircPumpCur0_C DSM_EnvDfp_LSUCDCircVirtGnd0_C DSM_EnvDfp_LSUCDHeater0_C DSM_EnvDfp_LSUCDHtCoup0_C DSM_EnvDfp_LSUCDO20_C DSM_EnvDfp_LSUCDO2Clb0_C DSM_EnvDfp_LSUCDRiClb0_C DSM_EnvDfp_LSUCDSPI0_C DSM_EnvDfp_LSUCDSPIBattLow0_C DSM_EnvDfp_LSUCDWireIP0_C DSM_EnvDfp_LSUCtlRiExc0_C DSM_EnvDfp_LSUMon1Sens_C DSM_EnvDfp_LSUMon2Sens_C DSM_EnvDfp_MIL_C DSM_EnvDfp_MRlyCD_C DSM_EnvDfp_MeUnCDNoLoad_C DSM_EnvDfp_MeUnCDSCBat_C DSM_EnvDfp_MeUnCDSCGnd_C DSM_EnvDfp_MeUnCD_ADC_C DSM_EnvDfp_Montr_C DSM_EnvDfp_OTSCD_C DSM_EnvDfp_OTSCDCanInac_C DSM_EnvDfp_OTSCDCanSig_C DSM_EnvDfp_OvRMon_C DSM_EnvDfp_OvRMonCrCtlP_C DSM_EnvDfp_OvRMonSigA_C DSM_EnvDfp_OxiCCDTPre_C DSM_EnvDfp_OxiCCDTPre1_C DSM_EnvDfp_PCR_BalGovDev_C DSM_EnvDfp_PCR_GovDev_C DSM_EnvDfp_PCVCDNoLoad_C DSM_EnvDfp_PCVCDSCBat_C DSM_EnvDfp_PCVCDSCGnd_C DSM_EnvDfp_PCVCD_ADC_C DSM_EnvDfp_PFltCDHtg_C DSM_EnvDfp_PFltCDHtg1_C DSM_EnvDfp_PFltCDPDiff_C DSM_EnvDfp_PFltCDPDiff1_C DSM_EnvDfp_PFltCDTPre_C DSM_EnvDfp_PFltCDTPst_C DSM_EnvDfp_PFltCDTempPre_C DSM_EnvDfp_PFltCDTempPre1_C DSM_EnvDfp_PFltChar_C DSM_EnvDfp_PFltEngPrt_C DSM_EnvDfp_PFltPresDynPlaus_C DSM_EnvDfp_PFltPresSens_C DSM_EnvDfp_PFltPresSensHsLn_C DSM_EnvDfp_PFltPresSensSot_C DSM_EnvDfp_PFltRgnPerm_C DSM_EnvDfp_PFltTempDwnStrm_C DSM_EnvDfp_PFltTempSens_C DSM_EnvDfp_PFltTempUpStrm_C DSM_EnvDfp_PSPCD_Actr_C DSM_EnvDfp_PrpCtlvLimErrPat_C DSM_EnvDfp_RailCD_C DSM_EnvDfp_RailCDOfsTst_C DSM_EnvDfp_RailMeUn0_C DSM_EnvDfp_RailMeUn1_C DSM_EnvDfp_RailMeUn2_C DSM_EnvDfp_RailMeUn3_C DSM_EnvDfp_RailMeUn4_C DSM_EnvDfp_RailPCV0_C DSM_EnvDfp_RailPCV1_C DSM_EnvDfp_RailPCV2_C DSM_EnvDfp_RailPCV3_C DSM_EnvDfp_RailPCV4_C DSM_EnvDfp_RailPCV5_C DSM_EnvDfp_SOPTst_C DSM_EnvDfp_SSpMon1_C DSM_EnvDfp_SSpMon2_C DSM_EnvDfp_SSpMon3_C DSM_EnvDfp_StrtCDOffRly_C DSM_EnvDfp_StrtCDOnRly_C DSM_EnvDfp_StrtCtlIlsNotPlaus_C DSM_EnvDfp_StrtCtlT50ROneRly1_C DSM_EnvDfp_StrtCtlT50ROneRly2_C DSM_EnvDfp_StrtCtlT50RZero_C DSM_EnvDfp_SysLamp_C DSM_EnvDfp_T15CD_C DSM_EnvDfp_TPUMon_C DSM_EnvDfp_TTSCD_C DSM_EnvDfp_TVACD_Max_C DSM_EnvDfp_TVACD_Min_C DSM_EnvDfp_TVACD_SigNpl_C DSM_EnvDfp_TVACD_stLineDef_C DSM_EnvDfp_UAcc_CodeBitErr_C DSM_EnvDfp_USAp_DataVariant_C DSM_EnvDfp_USAp_FuncCodeRead_C DSM_EnvDfp_VSACD1_Max_C DSM_EnvDfp_VSACD1_Min_C DSM_EnvDfp_VSACD1_SigNpl_C DSM_EnvDfp_VSACD2_Max_C DSM_EnvDfp_VSACD2_Min_C DSM_EnvDfp_VSACD2_SigNpl_C DSM_EnvDfp_VSAExcSensTemp1_C DSM_EnvDfp_VSAExcSensTemp2_C DSM_EnvDfp_VSANotLrn1_C DSM_EnvDfp_VSANotLrn2_C DSM_EnvDfp_VSASCDDcyc1_C DSM_EnvDfp_VSASCDDcyc2_C DSM_EnvDfp_VSASCDPeriod1_C DSM_EnvDfp_VSASCDPeriod2_C DSM_EnvDfp_VSSCD1_C DSM_EnvDfp_VSSCD2_C DSM_EnvDfp_VSSCD4_C DSM_EnvDfp_VSSCDBrkLowVltg_C DSM_EnvDfp_VSSCDCAN_C DSM_EnvDfp_VSSCDNpl_C DSM_EnvDfp_WdCom_C /end DEF_CHARACTERISTIC
/end FUNCTION
/begin FUNCTION dsm_auto_env8 "" /end FUNCTION
/begin FUNCTION dsm_auto_fid_scd "" /end FUNCTION
/begin FUNCTION dsm_auto_fid_scd_msg "" /end FUNCTION
/begin COMPU_METHOD OneToOne "eins zu eins (physikalischer Wert ist gleich dem internen Wert)" RAT_FUNC "%6.2" "[-]" COEFFS 0 1 0 0 0 1 /end COMPU_METHOD
/begin COMPU_METHOD SigName "Verbale Umrechnung für Signal Referenz Nummern" TAB_VERB "%6.3" "[-]" COMPU_TAB_REF SigName /end COMPU_METHOD
/begin COMPU_VTAB SigName "Verbale Umrechnung für Signal Referenz Nummern" TAB_VERB 333 0 "Sig_unused" 4 "CoEng_rTrq__Carb_r_DLen1" 5 "CTSCD_tClntLin__Carb_t_DLen1" 11 "BPSCD_pLin__Carb_p_DLen1" 12 "Eng_nAvrg__Carb_n_DLen2" 13 "VSSCD_vCarb1__Carb_v_DLen1" 15 "IATSCD_tAirLin__Carb_t_DLen1" 16 "AFSCD_dmAirRawPerTime__Carb_mAirTim_DLen2" 17 "TVACD_rOut__Carb_r_DLen1" 28 "Signals_PID0x1C_C__OneToOne_DLen1" 33 "DSMDur_ctDfctDur1__Carb_l_DLen2" 71 "ACCtl_stLogicOut__OneToOne_DLen1" 72 "AOHt_stHt1Out__OneToOne_DLen1" 73 "APPCD_stSwitchSig__OneToOne_DLen1" 74 "APSCD_pVal__p_DLen1" 75 "APSCD_uRaw__u_DLen1" 76 "IATSCD_tAirLin__t_DLen1" 77 "AFSCD_dmAirRawPerTime__mAirTim_DLen1" 78 "BattCD_uRaw__uBatt_DLen1" 79 "InjCtl_qSetUnBal__q_DLen1" 80 "BPACD_rOut__dcyc_DLen1" 81 "AFSCD_uRaw__u_DLen1" 82 "EGRCD_rOut__dcyc_DLen1" 85 "InjCtl_qCurr__q_DLen1" 88 "IndSys_rVSA__dcyc_DLen1" 90 "OTSCD_tEngOil__t_DLen1" 91 "FTSCD_tFuel__t_DLen1" 92 "BrkCD_stMnSwtRawVal__OneToOne_DLen1" 93 "BrkCD_stRedSwtRawVal__OneToOne_DLen1" 94 "ConvCD_stRawVal__OneToOne_DLen1" 95 "T15CD_stRawVal__OneToOne_DLen1" 97 "GlwCtl_stLampOut__OneToOne_DLen1" 98 "GlwCtl_stActrOut__OneToOne_DLen1" 100 "APPCD_uRawAPP1__u_DLen1" 101 "APPCD_uRawAPP2__u_DLen1" 103 "APPCD_rAPP1UnFlt__r_DLen1" 143 "CTSCD_uRaw__u_DLen1" 144 "CTSCD_tClnt__t_DLen1" 145 "Eng_nAvrg__n_DLen1" 146 "AFSCD_dmAirPerTime__mAirTim_DLen1" 150 "VSSCD_v__v_DLen1" 155 "IATSCD_uRaw__u_DLen1" 157 "BPSCD_uRawVal__u_DLen1" 158 "BPSCD_pOutVal__p_DLen1" 161 "T50CD_stRxDebVal__OneToOne_DLen1" 162 "CoEng_stEng__OneToOne_DLen1" 163 "StSysCtl_stStrtCncl__OneToOne_DLen1" 164 "PrpCtl_stSPTrack_mp__OneToOne_DLen1" 165 "ACCCD_stACC__OneToOne_DLen1" 166 "InjCrv_qLmbdCtl__q_DLen1" 167 "EGSys_stHtgLSU__OneToOne_DLen1" 168 "LSUCD_dcycHtCor__dcyc_DLen1" 169 "EGSys_pExhGas__p_DLen1" 170 "EGSys_dmEG__mAirTim_DLen1" 171 "LSUCD_drO2Adpt__OneToOne_DLen1" 172 "LSUCD_stCircModeNewLow__OneToOne_DLen1" 173 "LSU_stPlausChk_mp__OneToOne_DLen1" 174 "LSU_stO2Err_mp__OneToOne_DLen1" 175 "PFlt_pPre__p_DLen1" 176 "PFlt_pDiff__p_DLen1" 177 "PFlt_tPre__t_DLen1" 178 "PFlt_tFlt__t_DLen1" 179 "PFlt_mAshTrm_mp__m_DLen1" 180 "PFlt_mAshAdj_mp__m_DLen1" 181 "PFlt_rSotRatFlt_mp__r_DLen1" 182 "PFlt_stSucAftStrt_mp__OneToOne_DLen1" 183 "PFlt_pDiffOfsValAct_mp__p_DLen1" 184 "PFlt_qFl_mp__q_DLen1" 185 "PFlt_tiSnceRgn_mp__ti_DLen1" 186 "PFlt_lSnceRgn_mp__l_DLen1" 187 "PFlt_stSuc_mp__OneToOne_DLen1" 188 "PFlt_numEngPOp_mp__OneToOne_DLen1" 189 "FMA_qIC__q_DLen1" 190 "FMA_stSwtOff__OneToOne_DLen1" 192 "EEPCD_stErrSet__OneToOne_DLen1" 193 "EEPCD_stOptErrCodSet__OneToOne_DLen1" 194 "CtTCtl_dcycThst__dcyc_DLen1" 195 "CtTCtl_stCtl__OneToOne_DLen1" 196 "EATSCD_tAir__t_DLen1" 197 "HDSCD_prcAir__r_DLen1" 198 "TTSCD_tTnk__t_DLen1" 199 "LSUCD_uO2Raw__u_DLen1" 200 "LSUCD_rO2Adpt__r_DLen1" 230 "InjVlv_nCyl[0]__nCmpTst_DLen1" 231 "InjVlv_nCyl[1]__nCmpTst_DLen1" 232 "InjVlv_nCyl[2]__nCmpTst_DLen1" 233 "InjVlv_nCyl[3]__nCmpTst_DLen1" 234 "InjVlv_nCyl[4]__nCmpTst_DLen1" 235 "InjVlv_nCyl[5]__nCmpTst_DLen1" 236 "InjVlv_qFBCCyl[0]__q_DLen1" 237 "InjVlv_qFBCCyl[1]__q_DLen1" 238 "InjVlv_qFBCCyl[2]__q_DLen1" 239 "InjVlv_qFBCCyl[3]__q_DLen1" 240 "InjVlv_qFBCCyl[4]__q_DLen1" 241 "InjVlv_qFBCCyl[5]__q_DLen1" 242 "CaSCD_nPeriod__n_DLen1" 243 "FBC_qDvtCyl[0]__qdiff_DLen1" 244 "FBC_qDvtCyl[1]__qdiff_DLen1" 245 "FBC_qDvtCyl[2]__qdiff_DLen1" 246 "FBC_qDvtCyl[3]__qdiff_DLen1" 247 "FBC_qDvtCyl[4]__qdiff_DLen1" 248 "FBC_qDvtCyl[5]__qdiff_DLen1" 249 "FBC_qDvtCyl[6]__qdiff_DLen1" 250 "FBC_qDvtCyl[7]__qdiff_DLen1" 251 "FBC_qDvtCyl[8]__qdiff_DLen1" 252 "FBC_qDvtCyl[9]__qdiff_DLen1" 253 "InjCrv_phiMI1Des__phiHResol_DLen1" 254 "InjCrv_phiMI1EnvCor__phi_DLen1" 255 "PSP_stLogicOut__OneToOne_DLen1" 256 "ACCD_stMnSwtRawVal__OneToOne_DLen1" 257 "AOHt_stHt2Out__OneToOne_DLen1" 258 "AFSCD_mAirPerCyl__mAirCyl_DLen1" 259 "AFSCD_dmAirNorm__mAirTim_DLen1" 260 "AirCtl_mGovDev__mAirCyl_DLen1" 261 "AirCtl_rEGR__r_DLen1" 262 "PCR_rBPACD__r_DLen1" 263 "Dfp_LSUCDCircNernst0_Low__OneToOne_DLen1" 264 "GlwCD_stRawVal__OneToOne_DLen1" 265 "APPCD_rFlt__r_DLen1" 266 "HWEMon_numRecovery__OneToOne_DLen1" 267 "Clg_tiDynTstCARB__Carb_tiDyn_DLen4" 268 "Clg_dtDynTstCARB__Carb_dt_DLen2" 269 "Clg_tiMaxDynTstCARB__Carb_tiDyn_DLen4" 270 "Clg_tEndDynTstCARB__Carb_t_DLen2" 271 "Clg_dtMinDynTstCARB__Carb_dt_DLen2" 272 "Clg_tMinClntDynTstCARB__Carb_t_DLen2" 273 "FTSCD_tiTestCARB__Carb_ti_DLen4" 274 "FTSCD_tiMaxCARB__Carb_ti_DLen4" 275 "FTSCD_tDiffAbsCARB__Carb_dt_DLen2" 276 "FTSCD_tDiffMinCARB__Carb_dt_DLen2" 277 "FTSCD_tIntCARB__Carb_dt_DLen2" 278 "FTSCD_tIntMinCARB__Carb_dt_DLen2" 279 "BPSCD_pAvgDiff__Carb_p_DLen2" 280 "BPSCD_pDiffLim_mp__Carb_p_DLen2" 281 "DSM_stSysLamp__OneToOne_DLen1" 282 "DSM_stMIL__OneToOne_DLen1" 283 "BattCD_u__uBatt_DLen1" 284 "LIGov_nSetpoint__n_DLen1" 285 "VSSCD_a__a_DLen1" 286 "Tst_Zyklflag_SB5__OneToOne_DLen1" 287 "IATSCD_tAir__t_DLen1" 288 "AccPed_stPlaAPPBrk__OneToOne_DLen1" 289 "AccPed_trqDes__trqhigh_DLen1" 290 "COTSCD_tClnt__t_DLen1" 291 "AccPed_trqInrDesSig__trq_DLen1" 292 "Gearbx_stGear__OneToOne_DLen1" 293 "LSU_rLmbd[0]__OneToOne_DLen1" 294 "LSU_rLmbd[1]__OneToOne_DLen1" 295 "Tst_Zyklflag_SB1__OneToOne_DLen1" 296 "Tst_Zyklflag_SB2__OneToOne_DLen1" 297 "Tst_Zyklflag_SB3__OneToOne_DLen1" 298 "Tst_Zyklflag_SB4__OneToOne_DLen1" 299 "Tst_Zyklflag_SB6__OneToOne_DLen1" 300 "AirCtl_mDesVal__mAirCyl_DLen1" 301 "Tst_Zyklflag_SB7__OneToOne_DLen1" 302 "CtTCtl_tClntDes__t_DLen1" 303 "PCR_pBDes__p_DLen1" 304 "BPSCD_pFltVal__p_DLen1" 305 "FrmMng_lOil_mp__lLvl_DLen1" 306 "FlMng_stMon_mp__OneToOne_DLen1" 307 "FrmMng_stChrgr1Err1__OneToOne_DLen1" 308 "FrmMng_stChrgr1Err2__OneToOne_DLen1" 309 "FrmMng_stChrgr2Err1__OneToOne_DLen1" 310 "FrmMng_stChrgr2Err2__OneToOne_DLen1" 311 "FMTC_qStrt__q_DLen1" 312 "CrCtl_trqDes__trqhigh_DLen1" 313 "CoVM_trqInc__trqhigh_DLen1" 314 "CoEng_trqInrLim__trq_DLen1" 315 "FMTC_trqInrLimSmk__trq_DLen1" 316 "EngPrt_trqLim__trq_DLen1" 317 "CoVM_trqDec__trqhigh_DLen1" 318 "FlMng_qLimSmk__q_DLen1" 319 "CrCtl_vSetPointTrgt__v_DLen1" 320 "AltCD_rAltLoad__r_DLen1" 321 "CoEng_trqInrSet__trq_DLen1" 322 "CoEng_dvolFlConsum__Cnsmp_DLen1" 323 "AirCtl_stMonitor__OneToOne_DLen1" 324 "ACCtl_stLowByte_mp__OneToOne_DLen1" 325 "EngM_stSync__OneToOne_DLen1" 326 "NetMng_stCAN__OneToOne_DLen1" 327 "LSUCD_resRiClb__res_DLen1" 328 "LSUCD_uO2Clb__u_DLen1" 329 "FrmMng_stTSC__OneToOne_DLen1" 330 "FrmMng_stDCS__OneToOne_DLen1" 331 "LSUCD_stAdpt__OneToOne_DLen1" 332 "LSUCD_uRiRaw__u_DLen1" 333 "LSUCD_mAirAftOvrRun_mp__mAir_DLen1" 334 "GlwCtl_tiPost_mp__tiGlw_DLen1" 335 "PCR_stPCR_mp__OneToOne_DLen1" 336 "AOHt_stShutOff_mp__OneToOne_DLen1" 337 "FrmMng_stTCS__OneToOne_DLen1" 338 "FrmMng_trqTSC__trq_DLen1" 339 "FrmMng_trqDCS__trq_DLen1" 340 "CrCCD_stKeySig__OneToOne_DLen1" 341 "CrCtl_stKeyStateSig__OneToOne_DLen1" 342 "PrpCtl_vCurrTrack_mp__v_DLen1" 343 "CtApCD_rHWE_mp__dcyc_DLen1" 344 "Gearbx_trqDec__trq_DLen1" 345 "CrCtl_stShutOffrev__OneToOne_DLen1" 346 "AirCtl_stAirCtl_mp__OneToOne_DLen1" 347 "DSM_stRdyAB__OneToOne_DLen1" 348 "DSM_stRdyAB__HighByte_DLen1" 349 "DSM_stRdyCD__OneToOne_DLen1" 350 "DSM_stRdyCD__HighByte_DLen1" 351 "PrpBrk_trqDes__trq_DLen1" 352 "DSM_ctOBDPath__OneToOne_DLen1" 353 "DSM_ctRdyActCyc_mp__OneToOne_DLen1" 354 "GlwCtl_stLogic__OneToOne_DLen1" 355 "GlwCtl_tiPre__tiGlw_DLen1" 356 "FMTC_trqInr__trq_DLen1" 357 "ACCtl_stBitStructure__HighByte_DLen1" 358 "AOHt_stShutOff_mp__HighByte_DLen1" 359 "FrmMng_stTSC__HighByte_DLen1" 360 "FrmMng_stDCS__HighByte_DLen1" 361 "FrmMng_stTCS__HighByte_DLen1" 362 "CrCtl_stSwitchSig__OneToOne_DLen1" 363 "EGSys_tEGLSU__t_DLen1" 364 "AOHt_NumRly_mp__OneToOne_DLen1" 365 "DSM_ctFcmEntry__OneToOne_DLen1" 366 "ACCtl_stBitStructure__OneToOne_DLen2" 367 "AOHt_stShutOff_mp__OneToOne_DLen2" 368 "GlwCtl_stLogic__OneToOne_DLen2" 369 "Dfp_HWEMonUMinSupply_Low__OneToOne_DLen1" 370 "Dfp_HWEMonUMaxSupply_Low__OneToOne_DLen1" 371 "PCR_rBalGvnrDiff__r_DLen1" 372 "Dfp_SOPTst_Low__OneToOne_DLen1" 373 "UAcc_SWPartNum_cs__OneToOne_DLen1" 374 "UAcc_ECUIdentEep_cs__OneToOne_DLen1" 375 "Gearbx_stTSC__OneToOne_DLen1" 376 "CoVM_stActDem__OneToOne_DLen1" 377 "CrCCD_stKey__OneToOne_DLen1" 378 "CrCtl_stShutOff__OneToOne_DLen1" 379 "FanCtl_dcycFan1__dcyc_DLen1" 380 "FanCtl_dcycFan2__dcyc_DLen1" 381 "ACCD_p__pAC_DLen1" 382 "EngPrt_trqPrtLim__trq_DLen1" 383 "ImmCtl_tiLockCount__OneToOne_DLen1" 384 "UAcc_Vin_cs__OneToOne_DLen1" 385 "UAcc_dBGWVin_cs__OneToOne_DLen1" 386 "UAcc_SigBlk80_cs__OneToOne_DLen1" 387 "UAcc_SigBlk82_cs__OneToOne_DLen1" 388 "FlSys_stFlPp__OneToOne_DLen1" 389 "AOHtCD_volFlConsum__Cnsmp_DLen1" 390 "UAcc_MWB26sum_checksum_cs__OneToOne_DLen1" 391 "BPSCD_pLin__p_DLen1" 392 "CoEng_rTrq__r_DLen1" 393 "EngM_stEngMntCtl_MLS1__OneToOne_DLen1" 394 "EngM_stEngMntCtl_MLS2__OneToOne_DLen1" 395 "EngM_stEngMntCtl_GTL1__OneToOne_DLen1" 396 "EngM_stEngMntCtl_GTL2__OneToOne_DLen1" 397 "FanCD_rFan1HWE_mp__dcyc_DLen1" 398 "FanCD_rFan2HWE_mp__dcyc_DLen1" 399 "ACCD_trqCompr__trq_DLen1" 400 "TVACD_rOut__dcyc_DLen1" 401 "PFltCD_tPre__t_DLen1" 402 "PFltCD_pDiff__p_DLen1" 403 "EGPpCD_tPreTrbn__t_DLen1" 404 "AC_pwrDes__pwr_DLen1" 405 "Alt_pwrDes__pwr_DLen1" 406 "SrvPmp_pwrDes__pwr_DLen1" 407 "SvLp_dOilLoad__NoUnit_DLen1" 408 "SvLp_dSootLoad__NoUnit_DLen1" 409 "Dfp_LSUCDCircPumpCur0_Low__OneToOne_DLen1" 410 "Dfp_LSUCDCircVirtGnd0_Low__OneToOne_DLen1" 411 "Dfp_LSUCDHtCoup0_Low__OneToOne_DLen1" 412 "Dfp_LSUCDO20_Low__OneToOne_DLen1" 413 "Dfp_LSUCDHeater0_Low__OneToOne_DLen1" 414 "Dfp_LSUCDO2Clb0_Low__OneToOne_DLen1" 415 "Dfp_LSUCDRiClb0_Low__OneToOne_DLen1" 416 "Dfp_LSUCDSPI0_Low__OneToOne_DLen1" 417 "Dfp_LSUCDWireIP0_Low__OneToOne_DLen1" 418 "Dfp_LSUCtlRiExc0_Low__OneToOne_DLen1" 419 "Dfp_LSUMon1Sens_Low__OneToOne_DLen1" 420 "Dfp_LSUMon2Sens_Low__OneToOne_DLen1" 421 "Dfp_HWEMonEEPROM_Low__OneToOne_DLen1" 422 "Dfp_HWEMonCom_Low__OneToOne_DLen1" 423 "Ad_NumTyp_FreeApplic1_CSTR__FreeApplic1_DLen2" 424 "Ad_NumTyp_FreeApplic2_CSTR__FreeApplic2_DLen2" 425 "Ad_NumTyp_FreeApplic3_CSTR__FreeApplic3_DLen2" 426 "Ad_NumTyp_FreeApplic4_CSTR__FreeApplic4_DLen2" 427 "AFSCD_dmAirPerTime2__mAirTim_DLen1" 428 "AFSCD_mAirPerCyl1__mAirCyl_DLen1" 429 "AFSCD_mAirPerCyl2__mAirCyl_DLen1" 430 "AFSCD_uRaw2__u_DLen1" 431 "BPACD_rOut2__dcyc_DLen1" 468 "FrmMng_stNumTOOvrFlowECU[0]__OneToOne_DLen1" 469 "FrmMng_stNumTOOvrFlowECU[1]__OneToOne_DLen1" 470 "FrmMng_stNumTOOvrFlowECU[2]__OneToOne_DLen1" 471 "FrmMng_stNumTOOvrFlowECU[3]__OneToOne_DLen1" 472 "FrmMng_stNumTOOvrFlowECU[4]__OneToOne_DLen1" 473 "FrmMng_stNumTOOvrFlowECU[5]__OneToOne_DLen1" 474 "FrmMng_stNumTOOvrFlowECU[6]__OneToOne_DLen1" 475 "FrmMng_stNumTOOvrFlowECU[7]__OneToOne_DLen1" 476 "FrmMng_stNumTOOvrFlowECU[8]__OneToOne_DLen1" 477 "FrmMng_stNumTOOvrFlowECU[9]__OneToOne_DLen1" 478 "FrmMng_stNumTOOvrFlowECU[10]__OneToOne_DLen1" 479 "FrmMng_stNumTOOvrFlowECU[11]__OneToOne_DLen1" 480 "FrmMng_stNumTOOvrFlowECU[12]__OneToOne_DLen1" 481 "FrmMng_stNumTOOvrFlowECU[13]__OneToOne_DLen1" 482 "FrmMng_stNumTOOvrFlowECU[14]__OneToOne_DLen1" 483 "FrmMng_stNumTOOvrFlowECU[15]__OneToOne_DLen1" 484 "FrmMng_stNumTOOvrFlowECU[16]__OneToOne_DLen1" 485 "FrmMng_stNumTOOvrFlowECU[17]__OneToOne_DLen1" 486 "FrmMng_stNumTOOvrFlowECU[18]__OneToOne_DLen1" 487 "FrmMng_stNumTOOvrFlowECU[19]__OneToOne_DLen1" 488 "FrmMng_stNumTOOvrFlowECU[20]__OneToOne_DLen1" 489 "FrmMng_stNumTOOvrFlowECU[21]__OneToOne_DLen1" 490 "FrmMng_stNumTOOvrFlowECU[22]__OneToOne_DLen1" 491 "FrmMng_stNumTOOvrFlowECU[23]__OneToOne_DLen1" 492 "FrmMng_stNumTOOvrFlowECU[24]__OneToOne_DLen1" 493 "FrmMng_stNumTOOvrFlowECU[25]__OneToOne_DLen1" 494 "FrmMng_stNumTOOvrFlowECU[26]__OneToOne_DLen1" 495 "FrmMng_stNumTOOvrFlowECU[27]__OneToOne_DLen1" 496 "FrmMng_stNumTOOvrFlowECU[28]__OneToOne_DLen1" 497 "FrmMng_stNumTOOvrFlowECU[29]__OneToOne_DLen1" 498 "FrmMng_stNumTOOvrFlowECU[30]__OneToOne_DLen1" 499 "FrmMng_stNumTOOvrFlowECU[31]__OneToOne_DLen1" 515 "InjCrv_phiPiI1Des__phiHResol_DLen1" 518 "InjCrv_tiMI1ET__ti_DLen1" 519 "InjCrv_tiPiI1ET_mp__ti_DLen1" 520 "InjCrv_tiPiI2ET_mp__ti_DLen1" 521 "Rail_pSetPoint__pRail_DLen1" 522 "PCVCD_dcycOut_mp__dcyc_DLen1" 523 "MeUnCD_dcycOut_mp__dcyc_DLen1" 524 "RailCD_pPeak__pRail_DLen1" 525 "InjCrv_phiPiI2Des__phiHResol_DLen1" 532 "CaSCD_phiLstREdge_mp__phiCrS_DLen1" 533 "CaSCD_phiLstFEdge_mp__phiCrS_DLen1" 534 "VSASCD_dcycIn1__dcyc_DLen1" 535 "VSASCD_dcycIn2__dcyc_DLen1" 600 "AddPCD_numStrkRem_mp__stroke_DLen1" 601 "AddPmp_volAddTotDia_mp__vol_DLen1" 602 "AddPmp_volAddDia_mp__volHigh_DLen1" /end COMPU_VTAB
/begin RECORD_LAYOUT Kwb_Wu16 FNC_VALUES 1 UWORD COLUMN_DIR DIRECT /end RECORD_LAYOUT
/end MODULE
/end PROJECT
