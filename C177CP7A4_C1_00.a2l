ASAP2_VERSION 1 3
/begin PROJECT C177 "EDC16CP"
/begin HEADER "" VERSION "VCP7A3" PROJECT_NO C177 /end HEADER
/begin MODULE DIM ""
/begin MOD_COMMON "" BYTE_ORDER MSB_FIRST ALIGNMENT_BYTE 1 ALIGNMENT_WORD 2 ALIGNMENT_LONG 4 ALIGNMENT_FLOAT32_IEEE 4 /end MOD_COMMON
/begin CHARACTERISTIC InjCrv_phiPoI2_Vector "Bypass-Label, nicht editieren !" VALUE 0x1C0B0C Kw_Wu8 255.0 OneToOne 0.00 255.0 FORMAT "%5.1" /end CHARACTERISTIC
/begin CHARACTERISTIC InjCrv_phiPoI2_Channel "Bypass-Label, nicht editieren !" VALUE 0x1C0B0D Kw_Wu8 255.0 OneToOne 0.00 255.0 FORMAT "%5.1" /end CHARACTERISTIC
/begin CHARACTERISTIC InjCrv_qMin_CUR "Kennlinie für die Berechnung der Minimalmenge einer Einspritzung" CURVE 0x1DC4A2 Kl_Xs16_Ws16 327.6700 InjMassInj 0.00 327.6700 FORMAT "%8.4" EXTENDED_LIMITS -327.6800 327.6700
 /begin AXIS_DESCR STD_AXIS RailCD_pPeak Pres_Rail 16 0.00 1800000. FORMAT "%8.0" EXTENDED_LIMITS -3276800. 3276700. DEPOSIT ABSOLUTE /end AXIS_DESCR
/end CHARACTERISTIC
/begin CHARACTERISTIC InjCrv_qPoI2Eff_Vector "Bypass-Label, nicht editieren !" VALUE 0x1C0B0E Kw_Wu8 255.0 OneToOne 0.00 255.0 FORMAT "%5.1" /end CHARACTERISTIC
/begin CHARACTERISTIC InjCrv_qPoI2Eff_Channel "Bypass-Label, nicht editieren !" VALUE 0x1C0B0F Kw_Wu8 255.0 OneToOne 0.00 255.0 FORMAT "%5.1" /end CHARACTERISTIC
/begin CHARACTERISTIC InjCrv_qPoI2_Vector "Bypass-Label, nicht editieren !" VALUE 0x1C0B10 Kw_Wu8 255.0 OneToOne 0.00 255.0 FORMAT "%5.1" /end CHARACTERISTIC
/begin CHARACTERISTIC InjCrv_qPoI2_Channel "Bypass-Label, nicht editieren !" VALUE 0x1C0B11 Kw_Wu8 255.0 OneToOne 0.00 255.0 FORMAT "%5.1" /end CHARACTERISTIC
/begin CHARACTERISTIC InjCrv_stInjCharActVal_C "Fernsteuerwert des Istwertes Einspritzcharacteristik" VALUE 0x1DC4E4 Kw_Wu8 255.0 OneToOne 0.00 255.0 FORMAT "%5.1" /end CHARACTERISTIC
/begin CHARACTERISTIC InjCrv_swtStInjCharActVal_C "Schalter zur Fernsteuerung der Einspritzcharacteristik Istwert" VALUE 0x1DC4E5 Kw_Wu8 1.000 OneToOne 0.00 1.000 FORMAT "%5.3" EXTENDED_LIMITS 0.00 255.0 /end CHARACTERISTIC
/begin CHARACTERISTIC InjCrv_tiPoI2_Vector "Bypass-Label, nicht editieren !" VALUE 0x1C0B12 Kw_Wu8 255.0 OneToOne 0.00 255.0 FORMAT "%5.1" /end CHARACTERISTIC
/begin CHARACTERISTIC InjCrv_tiPoI2_Channel "Bypass-Label, nicht editieren !" VALUE 0x1C0B13 Kw_Wu8 255.0 OneToOne 0.00 255.0 FORMAT "%5.1" /end CHARACTERISTIC
/begin CHARACTERISTIC InjCtl_dqLimUp_C "Rampensteigung bei Wegfall des Systemfehlers" VALUE 0x1DC4E8 Kw_Wu32 655359.499817 RmpInjMass 0.500030517578 655359.999847 FORMAT "%13.6" EXTENDED_LIMITS 0.00 655359.999847 /end CHARACTERISTIC
/begin CHARACTERISTIC InjCtl_dqLimDwn_C "Rampensteigung bei Auftreten eines Systemfehlers" VALUE 0x1DC4EC Kw_Wu32 655359.499817 RmpInjMass 0.500030517578 655359.999847 FORMAT "%13.6" EXTENDED_LIMITS 0.00 655359.999847 /end CHARACTERISTIC
/begin CHARACTERISTIC InjCtl_qLimErr_CUR "Begrenzungsmeneg bei Systemfehler" CURVE 0x1DC4F0 Kl_Xs16_Ws16 327.6700 InjMass 0.00 327.6700 FORMAT "%8.4" EXTENDED_LIMITS -327.6800 327.6700
 /begin AXIS_DESCR STD_AXIS Eng_nAvrg EngN 25 0.00 6000.000 FORMAT "%8.3" EXTENDED_LIMITS -32768.00 32767.00 DEPOSIT ABSOLUTE /end AXIS_DESCR
/end CHARACTERISTIC
/begin CHARACTERISTIC InjCtl_swtFMACor_C "Schalter für FMA Korrektur" VALUE 0x1DC4E6 Kw_Wu8 1.000 OneToOne 0.00 1.000 FORMAT "%5.3" EXTENDED_LIMITS 0.00 255.0 /end CHARACTERISTIC
/begin CHARACTERISTIC InjUn_nInjLock_C "Kein Berechnung der Einspritzungen solange Überprüfung der Synchronisation nicht abgeschlossen" VALUE 0x1C0F1A Kw_Ws16 8000.000 EngN 0.00 8000.000 FORMAT "%8.3" EXTENDED_LIMITS -32768.00 32767.00 /end CHARACTERISTIC
/begin CHARACTERISTIC InjUn_phiTstShOffPathSet_C "Winkel zwischen Programmierung und Beginn der Einspritzung bei Abschaltpfadtest" VALUE 0x1DC558 Kw_Wu16 100.0078 AngleCrS 0.00 100.0078 FORMAT "%8.4" EXTENDED_LIMITS 0.00 1535.977 /end CHARACTERISTIC
/begin CHARACTERISTIC InjUn_tiTstShOffPathET_C "Ansteuerdauer bei Abschaltpfadtest" VALUE 0x1DC55A Kw_Wu16 65415.00 InjTime_us 120.0000 65535.00 FORMAT "%8.2" EXTENDED_LIMITS 0.00 65535.00 /end CHARACTERISTIC
/begin CHARACTERISTIC InjVCD_uChrgThrSRCLo_C "Untere Schwelle für die Plausibilisierung der CY370-Integrator-Ausgangsspannung" VALUE 0x1DC55E Kw_Ws16 5000.000 Volt 0.00 5000.000 FORMAT "%8.3" EXTENDED_LIMITS -160156.4 160151.5 /end CHARACTERISTIC
/begin CHARACTERISTIC InjVCD_uChrgThrSRCHi_C "Obere Schwelle für die Plausibilisierung der CY370-Integrator-Ausgangsspannung" VALUE 0x1DC560 Kw_Ws16 5000.000 Volt 0.00 5000.000 FORMAT "%8.3" EXTENDED_LIMITS -160156.4 160151.5 /end CHARACTERISTIC
/begin CHARACTERISTIC InjVCD_uChrgLin_CUR "Linearisierungskurve für die Ausgangsspannung des CY370-Integrators" CURVE 0x1DC562 Kl_Xs16_Ws16 320307.9 Volt -160156.4 160151.5 FORMAT "%8.1"
 /begin AXIS_DESCR STD_AXIS InjVCD_uRawChgUp_mp Volt 2 0.00 5200.391 FORMAT "%8.3" EXTENDED_LIMITS -160156.4 160151.5 DEPOSIT ABSOLUTE /end AXIS_DESCR
/end CHARACTERISTIC
/begin CHARACTERISTIC InjVCD_uActrThrSRCLo_C "untere Spannungsschwelle SRC - nicht verwendet" VALUE 0x1DC56C Kw_Ws16 5000.000 Volt 0.00 5000.000 FORMAT "%8.3" EXTENDED_LIMITS -160156.4 160151.5 /end CHARACTERISTIC
/begin CHARACTERISTIC InjVCD_uActrThrSRCHi_C "obere Spannungsschwelle SRC - nicht verwendet" VALUE 0x1DC56E Kw_Ws16 5000.000 Volt 0.00 5000.000 FORMAT "%8.3" EXTENDED_LIMITS -160156.4 160151.5 /end CHARACTERISTIC
/begin CHARACTERISTIC InjVCD_uActrLin_CUR "Linearisierungkurve ADC-Rohwert -> Aktorspannung" CURVE 0x1DC570 Kl_Xs16_Ws16 655.3500 Volt_PA -327.6800 327.6700 FORMAT "%8.4"
 /begin AXIS_DESCR STD_AXIS InjVCD_uRawUp_mp Volt 2 0.00 5200.391 FORMAT "%8.3" EXTENDED_LIMITS -160156.4 160151.5 DEPOSIT ABSOLUTE /end AXIS_DESCR
/end CHARACTERISTIC
/begin CHARACTERISTIC InjVCD_ctThresShOffDCDCEv_C "Zälerschwelle zu detektieren endlose ""single-event"" -Aufrufen" VALUE 0x1DCA50 Kw_Wu8 255.0 OneToOne 0.00 255.0 FORMAT "%5.1" READ_ONLY /end CHARACTERISTIC
/begin CHARACTERISTIC InjVCD_ctThres_C "Zähler-Schweller zur Detektion einer Verklemmung (nicht applizierbar)" VALUE 0x1DCA46 Kw_Wu16 65535.00 OneToOne 0.00 65535.00 FORMAT "%8.2" READ_ONLY /end CHARACTERISTIC
/begin CHARACTERISTIC InjVCD_uCY370ThrSRCLo_C "untere Spannungsschwelle für Integratorabgleich" VALUE 0x1DC5A6 Kw_Ws16 5000.000 Volt 0.00 5000.000 FORMAT "%8.3" EXTENDED_LIMITS -160156.4 160151.5 /end CHARACTERISTIC
/begin CHARACTERISTIC InjVCD_uCY370ThrSRCHi_C "obere Spannungsschwelle für Integratorabgleich" VALUE 0x1DC5A8 Kw_Ws16 5000.000 Volt 0.00 5000.000 FORMAT "%8.3" EXTENDED_LIMITS -160156.4 160151.5 /end CHARACTERISTIC
/begin CHARACTERISTIC InjVCD_uCY370Lin_CUR "Linearisierungskurve für Spannung vom Integratorabgleich" CURVE 0x1DC5AA Kl_Xs16_Ws16 320307.9 Volt -160156.4 160151.5 FORMAT "%8.1"
 /begin AXIS_DESCR STD_AXIS InjVCD_uRawCY370Int0_mp Volt 2 0.00 5200.391 FORMAT "%8.3" EXTENDED_LIMITS -160156.4 160151.5 DEPOSIT ABSOLUTE /end AXIS_DESCR
/end CHARACTERISTIC
/begin CHARACTERISTIC InjVCD_DebDCDCLowDef_C "Fehlerentprellung Zustandsdauerfehler DC_LOW" VALUE 0x1DC5B6 Kw_Ws16 327670.0 Time_ms 0.00 327670.0 FORMAT "%8.1" EXTENDED_LIMITS -327680.0 327670.0 /end CHARACTERISTIC
/begin CHARACTERISTIC InjVCD_DebDCDCStartDef_C "Fehlerentprellung Zustandsdauerfehler DC_STARTED" VALUE 0x1DC5B8 Kw_Ws16 327670.0 Time_ms 0.00 327670.0 FORMAT "%8.1" EXTENDED_LIMITS -327680.0 327670.0 /end CHARACTERISTIC
/begin CHARACTERISTIC InjVCD_DebUBufSRCHighDef_C "Defektentprellung für SRC-High-Fehler" VALUE 0x1DC9FE Kw_Wu16 65535.00 OneToOne 0.00 65535.00 FORMAT "%8.2" /end CHARACTERISTIC
/begin CHARACTERISTIC InjVCD_DebUBufSRCHighOk_C "Heilungsentprellung für SRC-High-Fehler" VALUE 0x1DCA00 Kw_Wu16 65535.00 OneToOne 0.00 65535.00 FORMAT "%8.2" /end CHARACTERISTIC
/begin CHARACTERISTIC InjVCD_DebUBufSRCLowDef_C "Defektentprellung für SRC-Low-Fehler" VALUE 0x1DCA02 Kw_Wu16 65535.00 OneToOne 0.00 65535.00 FORMAT "%8.2" /end CHARACTERISTIC
/begin CHARACTERISTIC InjVCD_DebUBufSRCLowOk_C "Heilungsentprellung für SRC-Low-Fehler" VALUE 0x1DCA04 Kw_Wu16 65535.00 OneToOne 0.00 65535.00 FORMAT "%8.2" /end CHARACTERISTIC
/begin CHARACTERISTIC InjVCD_duInt_C "Gradient zur Kompensation des Abfalls der Integrator-Ausgangsspannung" VALUE 0x1DC594 Kw_Ws16 30.00000 Delta_Volt_INT 0.00 30.00000 FORMAT "%8.5" EXTENDED_LIMITS -32768.00 32767.00 /end CHARACTERISTIC
/begin CHARACTERISTIC InjVCD_facMonUThresHiPl_CA "Faktor fuer Schwelle fuer Spannungsplausibilisierung, Verletzung oben (index : 0=BOTT, 1=UP)" VAL_BLK 0x1DCA18 Kwb_Ws16 10.00000 Fact1 0.00 10.00000 FORMAT "%8.5" EXTENDED_LIMITS -256.0000 255.9922 NUMBER 2 /end CHARACTERISTIC
/begin CHARACTERISTIC InjVCD_facMonUThresLoPl_CA "Faktor fuer Schwelle fuer Spannungsplausibilisierung, Verletzung unten (index : 0=BOTT, 1=UP)" VAL_BLK 0x1DCA1C Kwb_Ws16 20.00000 Fact1 -10.00000 10.00000 FORMAT "%8.5" EXTENDED_LIMITS -256.0000 255.9922 NUMBER 2 /end CHARACTERISTIC
/begin CHARACTERISTIC InjVCD_fPolar_C "Polarisationsfrequenz des Piezo-Aktors" VALUE 0x1DCA48 Kw_Ws16 2100.000 Frequency_PA 400.0000 2500.000 FORMAT "%8.3" EXTENDED_LIMITS -32768.00 32767.00 /end CHARACTERISTIC
/begin CHARACTERISTIC InjVCD_rCapUpTolc_C "Toleranzband für Kapazitätsverhältnis zur Erkennung von Kurzschlüssen der select-Schalter" VALUE 0x1DCA20 Kw_Ws16 7.999878 Fact -4.000000 3.999878 FORMAT "%8.6" /end CHARACTERISTIC
/begin CHARACTERISTIC InjVCD_rTiChrgUpTolc_C "Toleranzband fuer Aktorladezeitverhaeltnis zum Erkennen eines Lowside Schalter Kurzschlusses" VALUE 0x1DCA22 Kw_Ws16 7.999878 Fact -4.000000 3.999878 FORMAT "%8.6" /end CHARACTERISTIC
/begin CHARACTERISTIC InjVCD_nClsEng_C "Virtuelle Motordrehzahl während der Piezoaktor Klassifizierung im Steuergerätenachlauf" VALUE 0x1DC598 Kw_Ws16 5000.000 EngN 0.00 5000.000 FORMAT "%8.3" EXTENDED_LIMITS -32768.00 32767.00 /end CHARACTERISTIC
/begin CHARACTERISTIC InjVCD_nEngMonShCir_C "Virtuelle Drehzahl für die Ansteuerung im Nachlauf für Kurzschlussunterscheidung" VALUE 0x1DCA2C Kw_Ws16 5000.000 EngN 0.00 5000.000 FORMAT "%8.3" EXTENDED_LIMITS -32768.00 32767.00 /end CHARACTERISTIC
/begin CHARACTERISTIC InjVCD_numCollTyp_C "Nummer des Kollisionstyps" VALUE 0x1C0F24 Kw_Wu8 10.00 OneToOne 0.00 10.00 FORMAT "%5.2" EXTENDED_LIMITS 0.00 255.0 /end CHARACTERISTIC
/begin CHARACTERISTIC InjVCD_numCylTestBench_C "Aktornummer für den Testbankbetrieb" VALUE 0x1DC57A Kw_Wu8 255.0 OneToOne 0.00 255.0 FORMAT "%5.1" /end CHARACTERISTIC
/begin CHARACTERISTIC InjVCD_numPolar_C "Anzahl der Polarisierungen pro Piezo-Aktor" VALUE 0x1DCA4A Kw_Wu8 3.000 OneToOne 0.00 3.000 FORMAT "%5.3" EXTENDED_LIMITS 0.00 255.0 /end CHARACTERISTIC
/begin CHARACTERISTIC InjVCD_pClsRailMax_C "Maximal zulässiger Wert des Raildrucks während der Piezoaktor Klassifizierung im Steuergerätenachlauf" VALUE 0x1DC59A Kw_Ws16 1800000. Pres_Rail 0.00 1800000. FORMAT "%8.0" EXTENDED_LIMITS -3276800. 3276700. /end CHARACTERISTIC
/begin CHARACTERISTIC InjVCD_pRailMonShCirMax_C "Maximale zulässiger Raildruck für die Ansteuerung im Nachlauf für Kurzschlussunterscheidung" VALUE 0x1DCA2E Kw_Ws16 1800000. Pres_Rail 0.00 1800000. FORMAT "%8.0" EXTENDED_LIMITS -3276800. 3276700. /end CHARACTERISTIC
/begin AXIS_PTS InjVCD_pRailZFCETCor_AXIS "gemeinsame Raildruck-Achse fuer ZFC Ansteuerdauerkorrektur-Kennfelder" 0x1DCA54 RailCD_pAct_mp GSst_Xs16 600000.0 Pres_Rail 6 200000.0 800000.0 FORMAT "%8.1" EXTENDED_LIMITS -3276800. 3276700. DEPOSIT ABSOLUTE /end AXIS_PTS
/begin AXIS_PTS InjVCD_qZFCETCor_AXIS "Stuetzstellen der Menge fuer Korrekturfaktor-Gruppenkennfelder der Ansteuerdauerkorrektur der Nullmengenkalibrierung" 0x1DCA62 InjVCD_qInZFCETGMap_mp GSst_Xs16 3.000000 InjMassInj 6 0.00 3.000000 FORMAT "%8.6" EXTENDED_LIMITS -327.6800 327.6700 DEPOSIT ABSOLUTE /end AXIS_PTS
/begin CHARACTERISTIC InjVCD_rClsVoltMin_C "Min. erlaubtes Verhältniss von (Aktorspannung-Beginn)/(Aktorspannung-Ende)" VALUE 0x1DC59C Kw_Wu16 1.000000 Milli 1.000000 2.000000 FORMAT "%8.6" EXTENDED_LIMITS 0.00 2.621400 /end CHARACTERISTIC
/begin CHARACTERISTIC InjVCD_resCalcChrgShunt_C "Wert des Shunt-Widerstands zur Ladungsberechnung" VALUE 0x1DC596 Kw_Ws16 0.00 Resist_mOhm 20.00000 20.00000 FORMAT "%8.5" EXTENDED_LIMITS -3276.800 3276.700 /end CHARACTERISTIC
/begin CHARACTERISTIC InjVCD_rETTempCor_MAP "Kennfeld zur Umrechnung von Motortemperatur und Umdrehungszählerwert in Ansteuerdauer Korrekturfaktor" MAP 0x1DC5BC Kf_Xs16_Ys16_Ws16 4.000000 Fact 0.00 4.000000 FORMAT "%8.6" EXTENDED_LIMITS -4.000000 3.999878
 /begin AXIS_DESCR STD_AXIS EngM_ctRevSta OneToOne 8 0.00 32767.00 FORMAT "%8.2" EXTENDED_LIMITS -32768.00 32767.00 DEPOSIT ABSOLUTE /end AXIS_DESCR
 /begin AXIS_DESCR STD_AXIS InjVCD_tTempCor_mp Temp_Cels 8 -50.14000 199.8600 FORMAT "%8.4" EXTENDED_LIMITS -3549.940 3003.560 DEPOSIT ABSOLUTE /end AXIS_DESCR
/end CHARACTERISTIC
/begin CHARACTERISTIC InjVCD_rMonShCirTiChrgUpTolc_C "Toleranzfenster für das Ladezeitverhältnis" VALUE 0x1DCA30 Kw_Ws16 7.999878 Fact -4.000000 3.999878 FORMAT "%8.6" /end CHARACTERISTIC
/begin CHARACTERISTIC InjVCD_rZFCETDif0_GMAP "Gruppenkennfeld Bewertungsfaktor fuer Ansteuerdauerkorrektur durch Nullmengenkalibrierung am Raildruck-Kalibrierpunkt 0" MAP 0x1DCA70 Gkf_Ws16 100.0000 Prc 0.00 100.0000 FORMAT "%8.4" EXTENDED_LIMITS -327.6800 327.6700
 /begin AXIS_DESCR COM_AXIS RailCD_pAct_mp Pres_Rail 6 200000.0 800000.0 FORMAT "%8.1" EXTENDED_LIMITS -3276800. 3276700. AXIS_PTS_REF InjVCD_pRailZFCETCor_AXIS /end AXIS_DESCR
 /begin AXIS_DESCR COM_AXIS InjVCD_qInZFCETGMap_mp InjMassInj 6 0.00 3.000000 FORMAT "%8.6" EXTENDED_LIMITS -327.6800 327.6700 AXIS_PTS_REF InjVCD_qZFCETCor_AXIS /end AXIS_DESCR
/end CHARACTERISTIC
/begin CHARACTERISTIC InjVCD_rZFCETDif1_GMAP "Gruppenkennfeld Bewertungsfaktor fuer Ansteuerdauerkorrektur durch Nullmengenkalibrierung am Raildruck-Kalibrierpunkt 1" MAP 0x1DCAB8 Gkf_Ws16 100.0000 Prc 0.00 100.0000 FORMAT "%8.4" EXTENDED_LIMITS -327.6800 327.6700
 /begin AXIS_DESCR COM_AXIS RailCD_pAct_mp Pres_Rail 6 200000.0 800000.0 FORMAT "%8.1" EXTENDED_LIMITS -3276800. 3276700. AXIS_PTS_REF InjVCD_pRailZFCETCor_AXIS /end AXIS_DESCR
 /begin AXIS_DESCR COM_AXIS InjVCD_qInZFCETGMap_mp InjMassInj 6 0.00 3.000000 FORMAT "%8.6" EXTENDED_LIMITS -327.6800 327.6700 AXIS_PTS_REF InjVCD_qZFCETCor_AXIS /end AXIS_DESCR
/end CHARACTERISTIC
/begin CHARACTERISTIC InjVCD_rZFCETDif2_GMAP "Gruppenkennfeld Bewertungsfaktor fuer Ansteuerdauerkorrektur durch Nullmengenkalibrierung am Raildruck-Kalibrierpunkt 2" MAP 0x1DCB00 Gkf_Ws16 100.0000 Prc 0.00 100.0000 FORMAT "%8.4" EXTENDED_LIMITS -327.6800 327.6700
 /begin AXIS_DESCR COM_AXIS RailCD_pAct_mp Pres_Rail 6 200000.0 800000.0 FORMAT "%8.1" EXTENDED_LIMITS -3276800. 3276700. AXIS_PTS_REF InjVCD_pRailZFCETCor_AXIS /end AXIS_DESCR
 /begin AXIS_DESCR COM_AXIS InjVCD_qInZFCETGMap_mp InjMassInj 6 0.00 3.000000 FORMAT "%8.6" EXTENDED_LIMITS -327.6800 327.6700 AXIS_PTS_REF InjVCD_qZFCETCor_AXIS /end AXIS_DESCR
/end CHARACTERISTIC
/begin CHARACTERISTIC InjVCD_rZFCETMsk_GMAP "Gruppenkennfeld Gesamtbewertungsfaktor der Ansteuerdauerkorrektur durch Nullmengenkalibrierung" MAP 0x1DCB48 Gkf_Ws16 100.0000 Prc 0.00 100.0000 FORMAT "%8.4" EXTENDED_LIMITS -327.6800 327.6700
 /begin AXIS_DESCR COM_AXIS RailCD_pAct_mp Pres_Rail 6 200000.0 800000.0 FORMAT "%8.1" EXTENDED_LIMITS -3276800. 3276700. AXIS_PTS_REF InjVCD_pRailZFCETCor_AXIS /end AXIS_DESCR
 /begin AXIS_DESCR COM_AXIS InjVCD_qInZFCETGMap_mp InjMassInj 6 0.00 3.000000 FORMAT "%8.6" EXTENDED_LIMITS -327.6800 327.6700 AXIS_PTS_REF InjVCD_qZFCETCor_AXIS /end AXIS_DESCR
/end CHARACTERISTIC
/begin CHARACTERISTIC InjVCD_stAvrgEnaTiWarn_C "zylinderspezifischer Schalter, um die Message InjVCD_stAvrgEnaTiWarn für die NVC als Freigabekriterium zu aktivieren" VALUE 0x1DD2A8 Kw_Wu8 255.0 OneToOne 0.00 255.0 FORMAT "%5.1" /end CHARACTERISTIC
/begin CHARACTERISTIC InjVCD_stCY370RcyTst_C "Testlabel zum Testen der Recoveries im InjVCD_CY370-Prozess" VALUE 0x1DC5B4 Kw_Wu8 255.0 OneToOne 0.00 255.0 FORMAT "%5.1" /end CHARACTERISTIC
/begin CHARACTERISTIC InjVCD_stInjMode_C "Verhalten der Umschaltung von Anzugsphase auf Haltephase" VALUE 0x1C0F1C Kw_Wu8 3.000 OneToOne 0.00 3.000 FORMAT "%5.3" EXTENDED_LIMITS 0.00 255.0 /end CHARACTERISTIC
/begin CHARACTERISTIC InjVCD_stInputZFCETGMap_C "Auswahl der Menge fuer Anzeige der Gruppenkennfelder InjVCD_rZFCETDif0_GMAP, ...Dif1_GMAP, ...Msk_GMAP" VALUE 0x1DCB90 Kw_Wu8 255.0 OneToOne 0.00 255.0 FORMAT "%5.1" /end CHARACTERISTIC
/begin CHARACTERISTIC InjVCD_stZFCETCorActv_C "Aktivierungsstatus der ZFC Ansteuerdauerkorrektur (0 = keine Korrektur)" VALUE 0x1DCB91 Kw_Wu8 0.00 OneToOne 0.00 0.00 FORMAT "%5.2" EXTENDED_LIMITS 0.00 255.0 /end CHARACTERISTIC
/begin CHARACTERISTIC InjVCD_swtEnaAgDiff_C "Ein-/Ausschalter zur Berechnung des Differenzwinkels" VALUE 0x1DC55C Kw_Wu8 1.000 OneToOne 0.00 1.000 FORMAT "%5.3" EXTENDED_LIMITS 0.00 255.0 /end CHARACTERISTIC
/begin CHARACTERISTIC InjVCD_swtEvMgmt_C "Freigabeschalter des Flankenmanagements" VALUE 0x1C0F26 Kw_Ws16 1000.000 OneToOne 0.00 1000.000 FORMAT "%8.3" EXTENDED_LIMITS -32768.00 32767.00 /end CHARACTERISTIC
/begin CHARACTERISTIC InjVCD_swtInputETMAP_C "Auswahl der Eingangsgrössen zur Darstellung von InjVCD_tiET_MAP auf dem Applikationstool." VALUE 0x1DC706 Kw_Wu8 15.00 OneToOne 0.00 15.00 FORMAT "%5.2" EXTENDED_LIMITS 0.00 255.0 /end CHARACTERISTIC
/begin CHARACTERISTIC InjVCD_swtSelTempVal_C "Schalterstellung zur Auswahl der Aktortemperatur" VALUE 0x1DC57C Kw_Wu8 1.000 OneToOne 0.00 1.000 FORMAT "%5.3" EXTENDED_LIMITS 0.00 255.0 /end CHARACTERISTIC
/begin CHARACTERISTIC InjVCD_swtSelTempType_C "Schaltertyp für Aktortemperaturauswahl" VALUE 0x1DC57D Kw_Wu8 1.000 OneToOne 1.000 2.000 FORMAT "%5.3" EXTENDED_LIMITS 0.00 255.0 /end CHARACTERISTIC
/begin CHARACTERISTIC InjVCD_swtShOffDCDCTst_C "Testschalter zum Test des Ladeschalterkurzschlusses" VALUE 0x1DCA51 Kw_Wu8 255.0 OneToOne 0.00 255.0 FORMAT "%5.1" /end CHARACTERISTIC
/begin CHARACTERISTIC InjVCD_swtTempCor_C "Schalter zur Wahl der Quelle der Temperaturmessung" VALUE 0x1DC660 Kw_Ws16 1.000000 OneToOne 0.00 1.000000 FORMAT "%8.6" EXTENDED_LIMITS -32768.00 32767.00 /end CHARACTERISTIC
/begin CHARACTERISTIC InjVCD_swtTiMI1_C "Schalter zur Fernsteuerung der Ansteuerdauer von MI1" VALUE 0x1DCA14 Kw_Wu8 1.000 OneToOne 0.00 1.000 FORMAT "%5.3" EXTENDED_LIMITS 0.00 255.0 /end CHARACTERISTIC
/begin CHARACTERISTIC InjVCD_swtTiPiI1_C "Schalter zur Fernsteuerung der Ansteuerdauer von PiI1" VALUE 0x1DCA36 Kw_Wu8 1.000 OneToOne 0.00 1.000 FORMAT "%5.3" EXTENDED_LIMITS 0.00 255.0 /end CHARACTERISTIC
/begin CHARACTERISTIC InjVCD_swtTiPiI2_C "Schalter zur Fernsteuerung der Ansteuerdauer von PiI2" VALUE 0x1DCA3A Kw_Wu8 1.000 OneToOne 0.00 1.000 FORMAT "%5.3" EXTENDED_LIMITS 0.00 255.0 /end CHARACTERISTIC
/begin CHARACTERISTIC InjVCD_swtTiPoI1_C "Schalter zur Fernsteuerung der Ansteuerdauer von PoI1" VALUE 0x1DCA3E Kw_Wu8 1.000 OneToOne 0.00 1.000 FORMAT "%5.3" EXTENDED_LIMITS 0.00 255.0 /end CHARACTERISTIC
/begin CHARACTERISTIC InjVCD_swtTiPoI2_C "Fernsteuerung - Schalter für  InjVCD_tiPoI2_C nach InjVCD_tiPoI2ET_mp" VALUE 0x1DCA42 Kw_Wu8 1.000 OneToOne 0.00 1.000 FORMAT "%5.3" EXTENDED_LIMITS 0.00 255.0 /end CHARACTERISTIC
/begin CHARACTERISTIC InjVCD_tActrDfl_C "Vorgabetemperatur der Piezo-Aktoren" VALUE 0x1DC57E Kw_Ws16 6553.500 Temp_Cels -3549.940 3003.560 FORMAT "%8.3" /end CHARACTERISTIC
/begin CHARACTERISTIC InjVCD_tActr_CUR "Bestimmung der Aktortemperatur aus der Kühlwassertemperatur" CURVE 0x1DC580 Kl_Xs16_Ws16 220.0000 Temp_Cels -40.04000 179.9600 FORMAT "%8.4" EXTENDED_LIMITS -3549.940 3003.560
 /begin AXIS_DESCR STD_AXIS InjVCD_tActr_mp Temp_Cels 4 -3549.940 3003.560 FORMAT "%8.3" DEPOSIT ABSOLUTE /end AXIS_DESCR
/end CHARACTERISTIC
/begin CHARACTERISTIC InjVCD_tiClsLead_C "Vorhaltezeit für die Ansteuerung des Piezoaktors während der Klassifizierung im Steuergerätenachlauf" VALUE 0x1DC59E Kw_Wu16 5000.000 InjTime_us 0.00 5000.000 FORMAT "%8.3" EXTENDED_LIMITS 0.00 65535.00 /end CHARACTERISTIC
/begin CHARACTERISTIC InjVCD_tiClsMeasBeg_C "Aktorspannung am Beginn der Ansteuerung" VALUE 0x1DC5A0 Kw_Wu16 5000.000 InjTime_us 0.00 5000.000 FORMAT "%8.3" EXTENDED_LIMITS 0.00 65535.00 /end CHARACTERISTIC
/begin CHARACTERISTIC InjVCD_tiClsMeasEnd_C "Aktorspannung am Ende der Ansteuerung" VALUE 0x1DC5A2 Kw_Wu16 5000.000 InjTime_us 0.00 5000.000 FORMAT "%8.3" EXTENDED_LIMITS 0.00 65535.00 /end CHARACTERISTIC
/begin CHARACTERISTIC InjVCD_tiClsMeasure_C "Messzeit zwischen Begin- und Endspannung des Piezoaktors während der Klassifizierung im Steuergerätenachlauf" VALUE 0x1DC5A4 Kw_Wu16 6000.000 InjTime_us 0.00 6000.000 FORMAT "%8.3" EXTENDED_LIMITS 0.00 65535.00 /end CHARACTERISTIC
/begin CHARACTERISTIC InjVCD_tiETHydMin_C "Minimale Ansteuerdauer unter Berücksichtigung der Hydraulik" VALUE 0x1C0F22 Kw_Ws16 65535.00 InjTime_us -32768.00 32767.00 FORMAT "%8.2" /end CHARACTERISTIC
/begin CHARACTERISTIC InjVCD_tiETMinHigh_C "Obere Schwelle: minimale AD" VALUE 0x1DC592 Kw_Ws16 65535.00 InjTime_us -32768.00 32767.00 FORMAT "%8.2" /end CHARACTERISTIC
/begin CHARACTERISTIC InjVCD_tiETMinLow_C "Minimale Ansteuerdauer" VALUE 0x1C0F1E Kw_Ws16 65535.00 InjTime_us -32768.00 32767.00 FORMAT "%8.2" /end CHARACTERISTIC
/begin CHARACTERISTIC InjVCD_tiETTempCor_MAP "Raildruckabhängiges Ansteuerdauerkennfeld für temperaturabhängige Korrektur" MAP 0x1DC662 Kf_Xs16_Ys16_Ws16 3000.000 InjTime_us 0.00 3000.000 FORMAT "%8.3" EXTENDED_LIMITS -32768.00 32767.00
 /begin AXIS_DESCR STD_AXIS RailCD_pAct_mp Pres_Rail 8 0.00 1800000. FORMAT "%8.0" EXTENDED_LIMITS -3276800. 3276700. DEPOSIT ABSOLUTE /end AXIS_DESCR
 /begin AXIS_DESCR STD_AXIS InjVCD_volInTempCor_mp InjQntInj 8 0.00 327.6700 FORMAT "%8.4" EXTENDED_LIMITS -327.6800 327.6700 DEPOSIT ABSOLUTE /end AXIS_DESCR
/end CHARACTERISTIC
/begin CHARACTERISTIC InjVCD_tiET_MAP "Kennfeld zur Umrechnung von Einspritzmengen in Ansteuerdauer. Gilt für alle Einspritzungen." MAP 0x1DC708 Kf_Xs16_Ys16_Ws16 3000.000 InjTime_us 0.00 3000.000 FORMAT "%8.3" EXTENDED_LIMITS -32768.00 32767.00
 /begin AXIS_DESCR STD_AXIS InjVCD_pInET_mp Pres_Rail 17 0.00 1800000. FORMAT "%8.0" EXTENDED_LIMITS -3276800. 3276700. DEPOSIT ABSOLUTE /end AXIS_DESCR
 /begin AXIS_DESCR STD_AXIS InjVCD_volInET_mp InjQntInj 20 0.00 327.6700 FORMAT "%8.4" EXTENDED_LIMITS -327.6800 327.6700 DEPOSIT ABSOLUTE /end AXIS_DESCR
/end CHARACTERISTIC
/begin CHARACTERISTIC InjVCD_tiHoldMin_C "kleinste Dauer der Haltestromphase bei einer Einspritzung" VALUE 0x1C0F20 Kw_Ws16 1600.000 InjTime_us 0.00 1600.000 FORMAT "%8.3" EXTENDED_LIMITS -32768.00 32767.00 /end CHARACTERISTIC
/begin CHARACTERISTIC InjVCD_tiLeadJit_C "Dynamischer Vorhalt" VALUE 0x1C0F28 Kw_Wu32 1000.00000000 InjTime_us 0.00 1000.00000000 FORMAT "%13.8" EXTENDED_LIMITS 0.00 4294967295.00 /end CHARACTERISTIC
/begin CHARACTERISTIC InjVCD_tiLeadPost1_C "Strategischer Vorhalt" VALUE 0x1C0F2C Kw_Wu32 2000.00000000 InjTime_us 0.00 2000.00000000 FORMAT "%13.8" EXTENDED_LIMITS 0.00 4294967295.00 /end CHARACTERISTIC
/begin CHARACTERISTIC InjVCD_tiLeadPost2_C "Strategischer Vorhalt" VALUE 0x1C0F30 Kw_Wu32 2000.00000000 InjTime_us 0.00 2000.00000000 FORMAT "%13.8" EXTENDED_LIMITS 0.00 4294967295.00 /end CHARACTERISTIC
/begin CHARACTERISTIC InjVCD_tiLeadPost3_C "Strategischer Vorhalt" VALUE 0x1C0F34 Kw_Wu32 2000.00000000 InjTime_us 0.00 2000.00000000 FORMAT "%13.8" EXTENDED_LIMITS 0.00 4294967295.00 /end CHARACTERISTIC
/begin CHARACTERISTIC InjVCD_tiLeadPost4_C "Strategischer Vorhalt" VALUE 0x1C0F38 Kw_Wu32 2000.00000000 InjTime_us 0.00 2000.00000000 FORMAT "%13.8" EXTENDED_LIMITS 0.00 4294967295.00 /end CHARACTERISTIC
/begin CHARACTERISTIC InjVCD_tiLeadPre1_C "Strategischer Vorhalt" VALUE 0x1C0F3C Kw_Wu32 2000.00000000 InjTime_us 0.00 2000.00000000 FORMAT "%13.8" EXTENDED_LIMITS 0.00 4294967295.00 /end CHARACTERISTIC
/begin CHARACTERISTIC InjVCD_tiLeadPre2_C "Strategischer Vorhalt" VALUE 0x1C0F40 Kw_Wu32 2000.00000000 InjTime_us 0.00 2000.00000000 FORMAT "%13.8" EXTENDED_LIMITS 0.00 4294967295.00 /end CHARACTERISTIC
/begin CHARACTERISTIC InjVCD_tiLeadPre3_C "Strategischer Vorhalt" VALUE 0x1C0F44 Kw_Wu32 2000.00000000 InjTime_us 0.00 2000.00000000 FORMAT "%13.8" EXTENDED_LIMITS 0.00 4294967295.00 /end CHARACTERISTIC
/begin CHARACTERISTIC InjVCD_tiLeadPre4_C "Strategischer Vorhalt" VALUE 0x1C0F48 Kw_Wu32 2000.00000000 InjTime_us 0.00 2000.00000000 FORMAT "%13.8" EXTENDED_LIMITS 0.00 4294967295.00 /end CHARACTERISTIC
/begin CHARACTERISTIC InjVCD_tiMI1ET_Vector "Bypass-Label, nicht editieren !" VALUE 0x1C0B14 Kw_Wu8 255.0 OneToOne 0.00 255.0 FORMAT "%5.1" /end CHARACTERISTIC
/begin CHARACTERISTIC InjVCD_tiMI1ET_Channel "Bypass-Label, nicht editieren !" VALUE 0x1C0B15 Kw_Wu8 255.0 OneToOne 0.00 255.0 FORMAT "%5.1" /end CHARACTERISTIC
/begin CHARACTERISTIC InjVCD_tiMi1ThresLo_C "Schwelle zur Prüfung des Meßzeitpunkts der Aktorspannung" VALUE 0x1DCA24 Kw_Ws32 2147483647.00 InjTime_us 0.00 2147483647.00 FORMAT "%13.2" EXTENDED_LIMITS -2147483648.00 2147483647.00 /end CHARACTERISTIC
/begin CHARACTERISTIC InjVCD_tiMI1_C "Fernsteuerwert der Ansteuerdauer von MI1" VALUE 0x1DCA16 Kw_Ws16 3000.000 InjTime_us 0.00 3000.000 FORMAT "%8.3" EXTENDED_LIMITS -32768.00 32767.00 /end CHARACTERISTIC
/begin CHARACTERISTIC InjVCD_tiMonET_C "Ansteuerdauer für Kurzschlussunterscheidung" VALUE 0x1DCA32 Kw_Ws16 300.0000 InjTime_us 200.0000 500.0000 FORMAT "%8.4" EXTENDED_LIMITS -32768.00 32767.00 /end CHARACTERISTIC
/begin CHARACTERISTIC InjVCD_tiMonLead_C "Abstand zwischen Entlade- Ladezeit" VALUE 0x1DCA34 Kw_Ws16 1300.000 InjTime_us 700.0000 2000.000 FORMAT "%8.3" EXTENDED_LIMITS -32768.00 32767.00 /end CHARACTERISTIC
/begin CHARACTERISTIC InjVCD_tiMonThresHiPlaus_C "Maximalschwelle der Ladezeit" VALUE 0x1DCA28 Kw_Ws16 3276.700 Time_Busy 0.00 3276.700 FORMAT "%8.3" EXTENDED_LIMITS -3276.800 3276.700 /end CHARACTERISTIC
/begin CHARACTERISTIC InjVCD_tiMonThresLoPlaus_C "Minimalschwelle für Ladezeit" VALUE 0x1DCA2A Kw_Ws16 3276.700 Time_Busy 0.00 3276.700 FORMAT "%8.3" EXTENDED_LIMITS -3276.800 3276.700 /end CHARACTERISTIC
/begin CHARACTERISTIC InjVCD_tiPiI1ET_Vector "Bypass-Label, nicht editieren !" VALUE 0x1C0B16 Kw_Wu8 255.0 OneToOne 0.00 255.0 FORMAT "%5.1" /end CHARACTERISTIC
/begin CHARACTERISTIC InjVCD_tiPiI1ET_Channel "Bypass-Label, nicht editieren !" VALUE 0x1C0B17 Kw_Wu8 255.0 OneToOne 0.00 255.0 FORMAT "%5.1" /end CHARACTERISTIC
/begin CHARACTERISTIC InjVCD_tiPiI1_C "Fernsteuerwert der Ansteuerdauer von PiI1" VALUE 0x1DCA38 Kw_Ws16 3000.000 InjTime_us 0.00 3000.000 FORMAT "%8.3" EXTENDED_LIMITS -32768.00 32767.00 /end CHARACTERISTIC
/begin CHARACTERISTIC InjVCD_tiPiI2ET_Vector "Bypass-Label, nicht editieren !" VALUE 0x1C0B18 Kw_Wu8 255.0 OneToOne 0.00 255.0 FORMAT "%5.1" /end CHARACTERISTIC
/begin CHARACTERISTIC InjVCD_tiPiI2ET_Channel "Bypass-Label, nicht editieren !" VALUE 0x1C0B19 Kw_Wu8 255.0 OneToOne 0.00 255.0 FORMAT "%5.1" /end CHARACTERISTIC
/begin CHARACTERISTIC InjVCD_tiPiI2_C "Fernsteuerwert der Ansteuerdauer von PiI2" VALUE 0x1DCA3C Kw_Ws16 3000.000 InjTime_us 0.00 3000.000 FORMAT "%8.3" EXTENDED_LIMITS -32768.00 32767.00 /end CHARACTERISTIC
/begin CHARACTERISTIC InjVCD_tiPiI3ET_Vector "Bypass-Label, nicht editieren !" VALUE 0x1C0B1A Kw_Wu8 255.0 OneToOne 0.00 255.0 FORMAT "%5.1" /end CHARACTERISTIC
/begin CHARACTERISTIC InjVCD_tiPiI3ET_Channel "Bypass-Label, nicht editieren !" VALUE 0x1C0B1B Kw_Wu8 255.0 OneToOne 0.00 255.0 FORMAT "%5.1" /end CHARACTERISTIC
/begin CHARACTERISTIC InjVCD_tiPoI1ET_Vector "Bypass-Label, nicht editieren !" VALUE 0x1C0B1C Kw_Wu8 255.0 OneToOne 0.00 255.0 FORMAT "%5.1" /end CHARACTERISTIC
/begin CHARACTERISTIC InjVCD_tiPoI1ET_Channel "Bypass-Label, nicht editieren !" VALUE 0x1C0B1D Kw_Wu8 255.0 OneToOne 0.00 255.0 FORMAT "%5.1" /end CHARACTERISTIC
/begin CHARACTERISTIC InjVCD_tiPoI1_C "Fernsteuerwert der Ansteuerdauer von PoI1" VALUE 0x1DCA40 Kw_Ws16 3000.000 InjTime_us 0.00 3000.000 FORMAT "%8.3" EXTENDED_LIMITS -32768.00 32767.00 /end CHARACTERISTIC
/begin CHARACTERISTIC InjVCD_tiPoI2ET_Vector "Bypass-Label, nicht editieren !" VALUE 0x1C0B1E Kw_Wu8 255.0 OneToOne 0.00 255.0 FORMAT "%5.1" /end CHARACTERISTIC
/begin CHARACTERISTIC InjVCD_tiPoI2ET_Channel "Bypass-Label, nicht editieren !" VALUE 0x1C0B1F Kw_Wu8 255.0 OneToOne 0.00 255.0 FORMAT "%5.1" /end CHARACTERISTIC
/begin CHARACTERISTIC InjVCD_tiPoI2_C "Fernsteuerung - Wert für  InjVCD_tiPoI2ET_mp" VALUE 0x1DCA44 Kw_Ws16 3000.000 InjTime_us 0.00 3000.000 FORMAT "%8.3" EXTENDED_LIMITS -32768.00 32767.00 /end CHARACTERISTIC
/begin CHARACTERISTIC InjVCD_tiPolarET_C "Ansteuerzeit während Polarisierung von Piezo-Aktoren" VALUE 0x1DCA4C Kw_Ws16 300.0000 InjTime_us 200.0000 500.0000 FORMAT "%8.4" EXTENDED_LIMITS -32768.00 32767.00 /end CHARACTERISTIC
/begin CHARACTERISTIC InjVCD_tiPolarLead_C "Vorhaltezeit vor erster Ansteuerung in einer Task bei der Polarisierung von Piezo-Aktoren" VALUE 0x1DCA4E Kw_Ws16 1300.000 InjTime_us 700.0000 2000.000 FORMAT "%8.3" EXTENDED_LIMITS -32768.00 32767.00 /end CHARACTERISTIC
/begin CHARACTERISTIC InjVCD_tiZFCETCorMax_C "maximale ZFC Ansteuerdauerkorrektur" VALUE 0x1DCB92 Kw_Ws16 600.0000 InjTime_us -300.0000 300.0000 FORMAT "%8.4" EXTENDED_LIMITS -32768.00 32767.00 /end CHARACTERISTIC
/begin CHARACTERISTIC InjVCD_tiZFCETCorMin_C "minimale ZFC Ansteuerdauerkorrektur" VALUE 0x1DCB94 Kw_Ws16 600.0000 InjTime_us -300.0000 300.0000 FORMAT "%8.4" EXTENDED_LIMITS -32768.00 32767.00 /end CHARACTERISTIC
/begin CHARACTERISTIC InjVCD_uBufCLoLim_C "Untergrenze der Pufferspannung des DC/DC-Wandlers im Normalzustand" VALUE 0x1DC5BA Kw_Ws16 45.00000 Volt_BUFC 215.0000 260.0000 FORMAT "%8.4" EXTENDED_LIMITS -327.6800 327.6700 /end CHARACTERISTIC
/begin CHARACTERISTIC InjVCD_uBufSRCMin_C "SRC-low-Wert der Buffer-Spannung" VALUE 0x1DCA06 Kw_Ws16 5200.391 Volt 0.00 5200.391 FORMAT "%8.3" EXTENDED_LIMITS -160156.4 160151.5 /end CHARACTERISTIC
/begin CHARACTERISTIC InjVCD_uBufSRCMax_C "SRC-high-Wert der Buffer-Spannung" VALUE 0x1DCA08 Kw_Ws16 5200.391 Volt 0.00 5200.391 FORMAT "%8.3" EXTENDED_LIMITS -160156.4 160151.5 /end CHARACTERISTIC
/begin CHARACTERISTIC InjVCD_uBufLin_CUR "Kennlinie zur Linearisierung der Bufferspannung" CURVE 0x1DCA0A Kl_Xs16_Ws16 320.0000 Volt_BUFC 0.00 320.0000 FORMAT "%8.4" EXTENDED_LIMITS -327.6800 327.6700
 /begin AXIS_DESCR STD_AXIS InjVCD_uBufRaw_mp Volt 2 0.00 5200.391 FORMAT "%8.3" EXTENDED_LIMITS -160156.4 160151.5 DEPOSIT ABSOLUTE /end AXIS_DESCR
/end CHARACTERISTIC
/begin CHARACTERISTIC InjVCD_uShOffBufThres_C "Spannungsschwelle für Schutzsbschaltung des DC/DC-Wandlers bei Ladeschalterkurzschluss" VALUE 0x1DCA52 Kw_Ws16 60009.80 Volt_Batt 209993.7 270003.5 FORMAT "%8.1" EXTENDED_LIMITS -665674.1 665653.8 /end CHARACTERISTIC
/begin CHARACTERISTIC InjVlv_ctMonQckThresLo_C "Zählerschwelle für Schnell-Erkennung der Kurzschlüsse nach Batterie und Masse bei niedrigen Motordrehzahlen" VALUE 0x1DD12C Kw_Wu8 255.0 OneToOne 0.00 255.0 FORMAT "%5.1" /end CHARACTERISTIC
/begin CHARACTERISTIC InjVlv_ctMonQckThres_C "Zählerschwelle für Schnell-Erkennung der Kurzschlüsse nach Batterie und Masse" VALUE 0x1DD12D Kw_Wu8 255.0 OneToOne 0.00 255.0 FORMAT "%5.1" /end CHARACTERISTIC
/begin CHARACTERISTIC InjVlv_DebBnkA0Def_C "Defektentprellung für A Bankfehlerpfade Bit 0" VALUE 0x1DD12E Kw_Wu16 65535.00 OneToOne 0.00 65535.00 FORMAT "%8.2" /end CHARACTERISTIC
/begin CHARACTERISTIC InjVlv_DebBnkA0Ok_C "Heilungsentprellung für A Bankfehlerpfade Bit 0" VALUE 0x1DD130 Kw_Wu16 65535.00 OneToOne 0.00 65535.00 FORMAT "%8.2" /end CHARACTERISTIC
/begin CHARACTERISTIC InjVlv_DebBnkA1Def_C "Defektentprellung für A Bankfehlerpfade Bit 1" VALUE 0x1DD132 Kw_Wu16 65535.00 OneToOne 0.00 65535.00 FORMAT "%8.2" /end CHARACTERISTIC
/begin CHARACTERISTIC InjVlv_DebBnkA1Ok_C "Heilungsentprellung für A Bankfehlerpfade Bit 1" VALUE 0x1DD134 Kw_Wu16 65535.00 OneToOne 0.00 65535.00 FORMAT "%8.2" /end CHARACTERISTIC
/begin CHARACTERISTIC InjVlv_DebBnkA2Def_C "Defektentprellung für A Bankfehlerpfade Bit 2" VALUE 0x1DD136 Kw_Wu16 65535.00 OneToOne 0.00 65535.00 FORMAT "%8.2" /end CHARACTERISTIC
/begin CHARACTERISTIC InjVlv_DebBnkA2Ok_C "Heilungsentprellung für A Bankfehlerpfade Bit 2" VALUE 0x1DD138 Kw_Wu16 65535.00 OneToOne 0.00 65535.00 FORMAT "%8.2" /end CHARACTERISTIC
/begin CHARACTERISTIC InjVlv_DebBnkA3Def_C "Defektentprellung für A Bankfehlerpfade Bit 3" VALUE 0x1DD13A Kw_Wu16 65535.00 OneToOne 0.00 65535.00 FORMAT "%8.2" /end CHARACTERISTIC
/begin CHARACTERISTIC InjVlv_DebBnkA3Ok_C "Heilungsentprellung für A Bankfehlerpfade Bit 3" VALUE 0x1DD13C Kw_Wu16 65535.00 OneToOne 0.00 65535.00 FORMAT "%8.2" /end CHARACTERISTIC
/begin CHARACTERISTIC InjVlv_DebBnkB0Def_C "Defektentprellung für B Bankfehlerpfade Bit 0" VALUE 0x1DD13E Kw_Wu16 65535.00 OneToOne 0.00 65535.00 FORMAT "%8.2" /end CHARACTERISTIC
/begin CHARACTERISTIC InjVlv_DebBnkB0Ok_C "Heilungsentprellung für B Bankfehlerpfade Bit 0" VALUE 0x1DD140 Kw_Wu16 65535.00 OneToOne 0.00 65535.00 FORMAT "%8.2" /end CHARACTERISTIC
/begin CHARACTERISTIC InjVlv_DebBnkB1Def_C "Defektentprellung für B Bankfehlerpfade Bit 1" VALUE 0x1DD142 Kw_Wu16 65535.00 OneToOne 0.00 65535.00 FORMAT "%8.2" /end CHARACTERISTIC
/begin CHARACTERISTIC InjVlv_DebBnkB1Ok_C "Heilungsentprellung für B Bankfehlerpfade Bit 1" VALUE 0x1DD144 Kw_Wu16 65535.00 OneToOne 0.00 65535.00 FORMAT "%8.2" /end CHARACTERISTIC
/begin CHARACTERISTIC InjVlv_DebBnkB2Def_C "Defektentprellung für B Bankfehlerpfade Bit 2" VALUE 0x1DD146 Kw_Wu16 65535.00 OneToOne 0.00 65535.00 FORMAT "%8.2" /end CHARACTERISTIC
/begin CHARACTERISTIC InjVlv_DebBnkB2Ok_C "Heilungsentprellung für B Bankfehlerpfade Bit 2" VALUE 0x1DD148 Kw_Wu16 65535.00 OneToOne 0.00 65535.00 FORMAT "%8.2" /end CHARACTERISTIC
/begin CHARACTERISTIC InjVlv_DebBnkB3Def_C "Defektentprellung für B Bankfehlerpfade Bit 3" VALUE 0x1DD14A Kw_Wu16 65535.00 OneToOne 0.00 65535.00 FORMAT "%8.2" /end CHARACTERISTIC
/begin CHARACTERISTIC InjVlv_DebBnkB3Ok_C "Heilungsentprellung für B Bankfehlerpfade Bit 3" VALUE 0x1DD14C Kw_Wu16 65535.00 OneToOne 0.00 65535.00 FORMAT "%8.2" /end CHARACTERISTIC
/begin CHARACTERISTIC InjVlv_DebChipA0Def_C "Defektentprellung für  A Bausteinfehlerpfade Bit 0" VALUE 0x1DD14E Kw_Wu16 65535.00 OneToOne 0.00 65535.00 FORMAT "%8.2" /end CHARACTERISTIC
/begin CHARACTERISTIC InjVlv_DebChipA0Ok_C "Heilungsentprellung für  A Bausteinfehlerpfade Bit 0" VALUE 0x1DD150 Kw_Wu16 65535.00 OneToOne 0.00 65535.00 FORMAT "%8.2" /end CHARACTERISTIC
/begin CHARACTERISTIC InjVlv_DebChipA1Def_C "Defektentprellung für  A Bausteinfehlerpfade Bit 1" VALUE 0x1DD152 Kw_Wu16 65535.00 OneToOne 0.00 65535.00 FORMAT "%8.2" /end CHARACTERISTIC
/begin CHARACTERISTIC InjVlv_DebChipA1Ok_C "Heilungsentprellung für  A Bausteinfehlerpfade Bit 1" VALUE 0x1DD154 Kw_Wu16 65535.00 OneToOne 0.00 65535.00 FORMAT "%8.2" /end CHARACTERISTIC
/begin CHARACTERISTIC InjVlv_DebChipA2Def_C "Defektentprellung für  A Bausteinfehlerpfade Bit 2" VALUE 0x1DD156 Kw_Wu16 65535.00 OneToOne 0.00 65535.00 FORMAT "%8.2" /end CHARACTERISTIC
/begin CHARACTERISTIC InjVlv_DebChipA2Ok_C "Heilungsentprellung für  A Bausteinfehlerpfade Bit 2" VALUE 0x1DD158 Kw_Wu16 65535.00 OneToOne 0.00 65535.00 FORMAT "%8.2" /end CHARACTERISTIC
/begin CHARACTERISTIC InjVlv_DebChipA3Def_C "Defektentprellung für  A Bausteinfehlerpfade Bit 3" VALUE 0x1DD15A Kw_Wu16 65535.00 OneToOne 0.00 65535.00 FORMAT "%8.2" /end CHARACTERISTIC
/begin CHARACTERISTIC InjVlv_DebChipA3Ok_C "Heilungsentprellung für  A Bausteinfehlerpfade Bit 3" VALUE 0x1DD15C Kw_Wu16 65535.00 OneToOne 0.00 65535.00 FORMAT "%8.2" /end CHARACTERISTIC
/begin CHARACTERISTIC InjVlv_DebChipB0Def_C "Defektentprellung für  B Bausteinfehlerpfade Bit 0" VALUE 0x1DD15E Kw_Wu16 65535.00 OneToOne 0.00 65535.00 FORMAT "%8.2" /end CHARACTERISTIC
/begin CHARACTERISTIC InjVlv_DebChipB0Ok_C "Heilungsentprellung für  B Bausteinfehlerpfade Bit 0" VALUE 0x1DD160 Kw_Wu16 65535.00 OneToOne 0.00 65535.00 FORMAT "%8.2" /end CHARACTERISTIC
/begin CHARACTERISTIC InjVlv_DebChipB1Def_C "Defektentprellung für  B Bausteinfehlerpfade Bit 1" VALUE 0x1DD162 Kw_Wu16 65535.00 OneToOne 0.00 65535.00 FORMAT "%8.2" /end CHARACTERISTIC
/begin CHARACTERISTIC InjVlv_DebChipB1Ok_C "Heilungsentprellung für  B Bausteinfehlerpfade Bit 1" VALUE 0x1DD164 Kw_Wu16 65535.00 OneToOne 0.00 65535.00 FORMAT "%8.2" /end CHARACTERISTIC
/begin CHARACTERISTIC InjVlv_DebChipB2Def_C "Defektentprellung für  B Bausteinfehlerpfade Bit 2" VALUE 0x1DD166 Kw_Wu16 65535.00 OneToOne 0.00 65535.00 FORMAT "%8.2" /end CHARACTERISTIC
/begin CHARACTERISTIC InjVlv_DebChipB2Ok_C "Heilungsentprellung für  B Bausteinfehlerpfade Bit 2" VALUE 0x1DD168 Kw_Wu16 65535.00 OneToOne 0.00 65535.00 FORMAT "%8.2" /end CHARACTERISTIC
/begin CHARACTERISTIC InjVlv_DebChipB3Def_C "Defektentprellung für  B Bausteinfehlerpfade Bit 3" VALUE 0x1DD16A Kw_Wu16 65535.00 OneToOne 0.00 65535.00 FORMAT "%8.2" /end CHARACTERISTIC
/begin CHARACTERISTIC InjVlv_DebChipB3Ok_C "Heilungsentprellung für  B Bausteinfehlerpfade Bit 3" VALUE 0x1DD16C Kw_Wu16 65535.00 OneToOne 0.00 65535.00 FORMAT "%8.2" /end CHARACTERISTIC
/begin CHARACTERISTIC InjVlv_DebCylA0Def_C "Defektentprellung für A Zylinderfehlerpfade Bit 0" VALUE 0x1DD16E Kw_Wu16 65535.00 OneToOne 0.00 65535.00 FORMAT "%8.2" /end CHARACTERISTIC
/begin CHARACTERISTIC InjVlv_DebCylA0Ok_C "Heilungsentprellung für A Zylinderfehlerpfade Bit 0" VALUE 0x1DD170 Kw_Wu16 65535.00 OneToOne 0.00 65535.00 FORMAT "%8.2" /end CHARACTERISTIC
/begin CHARACTERISTIC InjVlv_DebCylA1Def_C "Defektentprellung für A Zylinderfehlerpfade Bit 1" VALUE 0x1DD172 Kw_Wu16 65535.00 OneToOne 0.00 65535.00 FORMAT "%8.2" /end CHARACTERISTIC
/begin CHARACTERISTIC InjVlv_DebCylA1Ok_C "Heilungsentprellung für A Zylinderfehlerpfade Bit 1" VALUE 0x1DD174 Kw_Wu16 65535.00 OneToOne 0.00 65535.00 FORMAT "%8.2" /end CHARACTERISTIC
/begin CHARACTERISTIC InjVlv_DebCylA2Def_C "Defektentprellung für A Zylinderfehlerpfade Bit 2" VALUE 0x1DD176 Kw_Wu16 65535.00 OneToOne 0.00 65535.00 FORMAT "%8.2" /end CHARACTERISTIC
/begin CHARACTERISTIC InjVlv_DebCylA2Ok_C "Heilungsentprellung für A Zylinderfehlerpfade Bit 2" VALUE 0x1DD178 Kw_Wu16 65535.00 OneToOne 0.00 65535.00 FORMAT "%8.2" /end CHARACTERISTIC
/begin CHARACTERISTIC InjVlv_DebCylA3Def_C "Defektentprellung für A Zylinderfehlerpfade Bit 3" VALUE 0x1DD17A Kw_Wu16 65535.00 OneToOne 0.00 65535.00 FORMAT "%8.2" /end CHARACTERISTIC
/begin CHARACTERISTIC InjVlv_DebCylA3Ok_C "Heilungsentprellung für A Zylinderfehlerpfade Bit 3" VALUE 0x1DD17C Kw_Wu16 65535.00 OneToOne 0.00 65535.00 FORMAT "%8.2" /end CHARACTERISTIC
/begin CHARACTERISTIC InjVlv_DebCylB0Def_C "Defektentprellung für B Zylinderfehlerpfade Bit 0" VALUE 0x1DD17E Kw_Wu16 65535.00 OneToOne 0.00 65535.00 FORMAT "%8.2" /end CHARACTERISTIC
/begin CHARACTERISTIC InjVlv_DebCylB0Ok_C "Heilungsentprellung für B Zylinderfehlerpfade Bit 0" VALUE 0x1DD180 Kw_Wu16 65535.00 OneToOne 0.00 65535.00 FORMAT "%8.2" /end CHARACTERISTIC
/begin CHARACTERISTIC InjVlv_DebCylB1Def_C "Heilungsentprellung für B Zylinderfehlerpfade Bit 1" VALUE 0x1DD182 Kw_Wu16 65535.00 OneToOne 0.00 65535.00 FORMAT "%8.2" /end CHARACTERISTIC
/begin CHARACTERISTIC InjVlv_DebCylB1Ok_C "Heilungsentprellung für B Zylinderfehlerpfade Bit 1" VALUE 0x1DD184 Kw_Wu16 65535.00 OneToOne 0.00 65535.00 FORMAT "%8.2" /end CHARACTERISTIC
/begin CHARACTERISTIC InjVlv_DebCylB2Def_C "Defektentprellung für B Zylinderfehlerpfade Bit 2" VALUE 0x1DD186 Kw_Wu16 65535.00 OneToOne 0.00 65535.00 FORMAT "%8.2" /end CHARACTERISTIC
/begin CHARACTERISTIC InjVlv_DebCylB2Ok_C "Heilungsentprellung für B Zylinderfehlerpfade Bit 2" VALUE 0x1DD188 Kw_Wu16 65535.00 OneToOne 0.00 65535.00 FORMAT "%8.2" /end CHARACTERISTIC
/begin CHARACTERISTIC InjVlv_DebCylB3Def_C "Defektentprellung für B Zylinderfehlerpfade Bit 3" VALUE 0x1DD18A Kw_Wu16 65535.00 OneToOne 0.00 65535.00 FORMAT "%8.2" /end CHARACTERISTIC
/begin CHARACTERISTIC InjVlv_DebCylB3Ok_C "Heilungsentprellung für B Zylinderfehlerpfade Bit 3" VALUE 0x1DD18C Kw_Wu16 65535.00 OneToOne 0.00 65535.00 FORMAT "%8.2" /end CHARACTERISTIC
/begin CHARACTERISTIC InjVlv_DebCylC0Def_C "Defekt-Entprellung von Bit 0 in C-Fehlerpfade der Zylinder" VALUE 0x1DD18E Kw_Wu16 65535.00 OneToOne 0.00 65535.00 FORMAT "%8.2" /end CHARACTERISTIC
/begin CHARACTERISTIC InjVlv_DebCylC0Ok_C "Heilungs-Entprellung von Bit 0 in C-Fehlerpfade der Zylinder" VALUE 0x1DD190 Kw_Wu16 65535.00 OneToOne 0.00 65535.00 FORMAT "%8.2" /end CHARACTERISTIC
/begin CHARACTERISTIC InjVlv_DebCylC1Def_C "Defekt-Entprellung von Bit 1 in C-Fehlerpfade der Zylinder" VALUE 0x1DD192 Kw_Wu16 65535.00 OneToOne 0.00 65535.00 FORMAT "%8.2" /end CHARACTERISTIC
/begin CHARACTERISTIC InjVlv_DebCylC1Ok_C "Heilungs-Entprellung von Bit 1 in C-Fehlerpfade der Zylinder" VALUE 0x1DD194 Kw_Wu16 65535.00 OneToOne 0.00 65535.00 FORMAT "%8.2" /end CHARACTERISTIC
/begin CHARACTERISTIC InjVlv_DebCylC2Def_C "Defekt-Entprellung von Bit 2 in C-Fehlerpfade der Zylinder" VALUE 0x1DD196 Kw_Wu16 65535.00 OneToOne 0.00 65535.00 FORMAT "%8.2" /end CHARACTERISTIC
/begin CHARACTERISTIC InjVlv_DebCylC2Ok_C "Heilungs-Entprellung von Bit 2 in C-Fehlerpfade der Zylinder" VALUE 0x1DD198 Kw_Wu16 65535.00 OneToOne 0.00 65535.00 FORMAT "%8.2" /end CHARACTERISTIC
/begin CHARACTERISTIC InjVlv_DebCylC3Def_C "Defekt-Entprellung von Bit 3 in C-Fehlerpfade der Zylinder" VALUE 0x1DD19A Kw_Wu16 65535.00 OneToOne 0.00 65535.00 FORMAT "%8.2" /end CHARACTERISTIC
/begin CHARACTERISTIC InjVlv_DebCylC3Ok_C "Heilungs-Entprellung von Bit 3 in C-Fehlerpfade der Zylinder" VALUE 0x1DD19C Kw_Wu16 65535.00 OneToOne 0.00 65535.00 FORMAT "%8.2" /end CHARACTERISTIC
/begin CHARACTERISTIC InjVlv_facAddBalRls_MAP "Freigabekennfeld zur Aufrechnung der Mengenkorrektur" MAP 0x1DCB96 Kf_Xs16_Ys16_Ws16 1.000000 Fact 0.00 1.000000 FORMAT "%8.6" EXTENDED_LIMITS -4.000000 3.999878
 /begin AXIS_DESCR STD_AXIS RailCD_pPeak Pres_Rail 4 0.00 1800000. FORMAT "%8.0" EXTENDED_LIMITS -3276800. 3276700. DEPOSIT ABSOLUTE /end AXIS_DESCR
 /begin AXIS_DESCR STD_AXIS InjCtl_qSetUnBal InjMass 4 0.00 327.6700 FORMAT "%8.4" EXTENDED_LIMITS -327.6800 327.6700 DEPOSIT ABSOLUTE /end AXIS_DESCR
/end CHARACTERISTIC
/begin CHARACTERISTIC InjVlv_facFTSWvCor_MAP "KF für die Berechnung des kraftstofftemperaturabhängigen Druckwellenkorrekturfaktors" MAP 0x1DD67C Kf_Xs16_Ys16_Ws16 2.000000 Fact 0.00 2.000000 FORMAT "%8.6" EXTENDED_LIMITS -4.000000 3.999878
 /begin AXIS_DESCR STD_AXIS RailCD_pPeak Pres_Rail 19 0.00 1800000. FORMAT "%8.0" EXTENDED_LIMITS -3276800. 3276700. DEPOSIT ABSOLUTE /end AXIS_DESCR
 /begin AXIS_DESCR STD_AXIS InjVlv_tWvCor_mp Temp_Cels 8 -40.04000 139.9600 FORMAT "%8.4" EXTENDED_LIMITS -3549.940 3003.560 DEPOSIT ABSOLUTE /end AXIS_DESCR
/end CHARACTERISTIC
/begin CHARACTERISTIC InjVlv_facNVCInitI_C "Initialisierungswert des NVC-Faktors" VALUE 0x1DD2AA Kw_Ws16 3.900024 Fact 0.00 3.900024 FORMAT "%8.6" EXTENDED_LIMITS -4.000000 3.999878 /end CHARACTERISTIC
/begin CHARACTERISTIC InjVlv_facNVCInPI_C "Korrekturfaktor für den NVC-Reglereingang" VALUE 0x1DD2AC Kw_Ws16 2.000000 Fact -1.000000 1.000000 FORMAT "%8.6" EXTENDED_LIMITS -4.000000 3.999878 /end CHARACTERISTIC
/begin CHARACTERISTIC InjVlv_facNVCMax_C "Obere Grenze für den NVC-Reglerausgang" VALUE 0x1DD2AE Kw_Ws16 3.900024 Fact 0.00 3.900024 FORMAT "%8.6" EXTENDED_LIMITS -4.000000 3.999878 /end CHARACTERISTIC
/begin CHARACTERISTIC InjVlv_facNVCMin_C "Untere Grenze  für den NVC-Reglerausgang" VALUE 0x1DD2B0 Kw_Ws16 3.900024 Fact 0.00 3.900024 FORMAT "%8.6" EXTENDED_LIMITS -4.000000 3.999878 /end CHARACTERISTIC
/begin CHARACTERISTIC InjVlv_facPCorQ_CUR "mengenabhängige Korrekturfaktor-Kennlinie für Druckwellenkorrektur" CURVE 0x1DCBCC Kl_Xs16_Ws16 20.00000 Fact -10.00000 10.00000 FORMAT "%8.5" EXTENDED_LIMITS -4.000000 3.999878
 /begin AXIS_DESCR STD_AXIS InjVlv_qDes_mp InjMassInj 8 -327.6800 327.6700 FORMAT "%8.4" DEPOSIT ABSOLUTE /end AXIS_DESCR
/end CHARACTERISTIC
/begin CHARACTERISTIC InjVlv_facPCorTi_CUR "einspritzabstandsabhängige Korrekturfaktor-Kennlinie für Druckwellenkorrektur" CURVE 0x1DCBEE Kl_Xs16_Ws16 20.00000 Fact -10.00000 10.00000 FORMAT "%8.5" EXTENDED_LIMITS -4.000000 3.999878
 /begin AXIS_DESCR STD_AXIS InjVlv_tiMI1PoI2Cor_mp InjTime_us 16 -32768.00 32767.00 FORMAT "%8.2" DEPOSIT ABSOLUTE /end AXIS_DESCR
/end CHARACTERISTIC
/begin CHARACTERISTIC InjVlv_facPiI2WvCor_C "Gewichtungsfaktor der Druckwellenkorrekturmenge der MI1 abhängig von PiI2" VALUE 0x1DDA7E Kw_Ws16 1.000000 Fact 0.00 1.000000 FORMAT "%8.6" EXTENDED_LIMITS -4.000000 3.999878 /end CHARACTERISTIC
/begin CHARACTERISTIC InjVlv_facVoltCorUp_MAP "temperaturabhängige Hubkorrektur für up-Niveau" MAP 0x1DCC30 Kf_Xs16_Ys16_Ws16 7.999878 Fact -4.000000 3.999878 FORMAT "%8.6"
 /begin AXIS_DESCR STD_AXIS InjVlv_pCalcVolt Pres_Rail 16 -3276800. 3276700. FORMAT "%8.0" DEPOSIT ABSOLUTE /end AXIS_DESCR
 /begin AXIS_DESCR STD_AXIS InjVlv_tActr_mp Temp_Cels 10 -3549.940 3003.560 FORMAT "%8.3" DEPOSIT ABSOLUTE /end AXIS_DESCR
/end CHARACTERISTIC
/begin CHARACTERISTIC InjVlv_facWvCor1_MAP "KF 1 für Gewichtungsfaktor der Druckwellenkorrektur" MAP 0x1DDA80 Kf_Xs16_Ys16_Ws16 10.00000 Fact1 0.00 10.00000 FORMAT "%8.5" EXTENDED_LIMITS -256.0000 255.9922
 /begin AXIS_DESCR STD_AXIS InjCrv_qMI1Des InjMassInj 20 0.00 327.6700 FORMAT "%8.4" EXTENDED_LIMITS -327.6800 327.6700 DEPOSIT ABSOLUTE /end AXIS_DESCR
 /begin AXIS_DESCR STD_AXIS RailCD_pAct_mp Pres_Rail 20 0.00 1800000. FORMAT "%8.0" EXTENDED_LIMITS -3276800. 3276700. DEPOSIT ABSOLUTE /end AXIS_DESCR
/end CHARACTERISTIC
/begin CHARACTERISTIC InjVlv_facWvCor2_MAP "KF 2 für Gewichtungsfaktor der Druckwellenkorrektur" MAP 0x1DDDF4 Kf_Xs16_Ys16_Ws16 10.00000 Fact1 0.00 10.00000 FORMAT "%8.5" EXTENDED_LIMITS -256.0000 255.9922
 /begin AXIS_DESCR STD_AXIS InjCrv_qPoI2Des_mp InjMassInj 20 0.00 327.6700 FORMAT "%8.4" EXTENDED_LIMITS -327.6800 327.6700 DEPOSIT ABSOLUTE /end AXIS_DESCR
 /begin AXIS_DESCR STD_AXIS RailCD_pAct_mp Pres_Rail 20 0.00 1800000. FORMAT "%8.0" EXTENDED_LIMITS -3276800. 3276700. DEPOSIT ABSOLUTE /end AXIS_DESCR
/end CHARACTERISTIC
/begin CHARACTERISTIC InjVlv_iDCDC_CUR "DCDC Strom-Kennlinie" CURVE 0x1DD106 Kl_Xs16_Ws16 14800.00 Curr 200.0000 15000.00 FORMAT "%8.2" EXTENDED_LIMITS -32768.00 32767.00
 /begin AXIS_DESCR STD_AXIS BattCD_u Volt_Batt 8 0.00 30004.90 FORMAT "%8.2" EXTENDED_LIMITS -665674.1 665653.8 DEPOSIT ABSOLUTE /end AXIS_DESCR
/end CHARACTERISTIC
/begin CHARACTERISTIC InjVlv_iMonDisChDwn_C "Schwelle des Entladestroms für Überwachung des bsh_err vom CY370" VALUE 0x1DD19E Kw_Ws16 30000.00 Curr -30000.00 0.00 FORMAT "%8.2" EXTENDED_LIMITS -32768.00 32767.00 /end CHARACTERISTIC
/begin CHARACTERISTIC InjVlv_NVCIKi_C "I-Parameter des Reglers, wenn der Eingang sich innerhalb des Kleinsignalfensters befindet" VALUE 0x1DD2B4 Kw_Wu32 12207.0312472 Ki_VOLTPA2FACT 0.00 12207.0312472 FORMAT "%13.7" /end CHARACTERISTIC
/begin CHARACTERISTIC InjVlv_NVCIKiPos_C "I-Parameter des Reglers, wenn sich der Wert des Eingangs oberhalb der Kleinsignalfensters befindet" VALUE 0x1DD2B8 Kw_Wu32 12207.0312472 Ki_VOLTPA2FACT 0.00 12207.0312472 FORMAT "%13.7" /end CHARACTERISTIC
/begin CHARACTERISTIC InjVlv_NVCIKiNeg_C "I-Parameter der Reglers, wenn sich der Wert des Eingangs unterhalb des Kleinsignalfensters befindet" VALUE 0x1DD2BC Kw_Wu32 12207.0312472 Ki_VOLTPA2FACT 0.00 12207.0312472 FORMAT "%13.7" /end CHARACTERISTIC
/begin CHARACTERISTIC InjVlv_uNVCIWinPos_C "obere Grenze des Kleinsignalfensters für den I-Anteil" VALUE 0x1DD2C0 Kw_Ws16 655.3500 Volt_PA -327.6800 327.6700 FORMAT "%8.4" /end CHARACTERISTIC
/begin CHARACTERISTIC InjVlv_uNVCIWinNeg_C "untere Grenze des Kleinsignalfensters für den I-Anteil" VALUE 0x1DD2C2 Kw_Ws16 655.3500 Volt_PA -327.6800 327.6700 FORMAT "%8.4" /end CHARACTERISTIC
/begin CHARACTERISTIC InjVlv_nMonQckThresLo_C "Motordrehzahl-Schwelle zur Auswahl von InjVlv_ctMonQckThres_C bzw. InjVlv_ctMonQckThresLo_C für Schnellerkennung" VALUE 0x1DD1A0 Kw_Ws16 65535.00 EngN -32768.00 32767.00 FORMAT "%8.2" /end CHARACTERISTIC
/begin CHARACTERISTIC InjVlv_numClsVltgAdjMax_C "Maximale Klasse für den Injektor Spannungsabgleich" VALUE 0x1DD35C Kw_Wu8 31.00 OneToOne 0.00 31.00 FORMAT "%5.2" EXTENDED_LIMITS 0.00 255.0 /end CHARACTERISTIC
/begin CHARACTERISTIC InjVlv_numClsVltgAdjMin_C "Minimale Klasse für den Injektor Spannungsabgleich" VALUE 0x1DD35D Kw_Wu8 31.00 OneToOne 0.00 31.00 FORMAT "%5.2" EXTENDED_LIMITS 0.00 255.0 /end CHARACTERISTIC
/begin CHARACTERISTIC InjVlv_numInjChrgBal_MAP "max. Anzahl an Einspritzungen aufgrund Ladungsbilanz Boosterkondensators" MAP 0x1DCEAC Kf_Xs16_Ys16_Ws16 6.000000 OneToOne 0.00 6.000000 FORMAT "%8.6" EXTENDED_LIMITS -32768.00 32767.00
 /begin AXIS_DESCR STD_AXIS InjVlv_pwrInjAvrg_mp Pwr_PA 16 0.00 32000.00 FORMAT "%8.2" EXTENDED_LIMITS -32768.00 32767.00 DEPOSIT ABSOLUTE /end AXIS_DESCR
 /begin AXIS_DESCR STD_AXIS BattCD_u Volt_Batt 16 0.00 28603.18 FORMAT "%8.2" EXTENDED_LIMITS -665674.1 665653.8 DEPOSIT ABSOLUTE /end AXIS_DESCR
/end CHARACTERISTIC
/begin CHARACTERISTIC InjVlv_numNoLoadCylMax_C "maximale zulässige Anzahl von Zylindern mit Lastabfall" VALUE 0x1DD1A2 Kw_Wu8 6.000 OneToOne 0.00 6.000 FORMAT "%5.3" EXTENDED_LIMITS 0.00 255.0 /end CHARACTERISTIC
/begin CHARACTERISTIC InjVlv_numSegOfs1_C "Semgentoffset für die Bestimmung der zylinderselektiven Drehzahlen für Testmodus a" VALUE 0x1DD128 Kw_Wu8 11.00 OneToOne 0.00 11.00 FORMAT "%5.2" EXTENDED_LIMITS 0.00 255.0 /end CHARACTERISTIC
/begin CHARACTERISTIC InjVlv_numSegOfs2_C "Semgentoffset für die Bestimmung der zylinderselektiven Drehzahlen für Testmodus b und c" VALUE 0x1DD129 Kw_Wu8 11.00 OneToOne 0.00 11.00 FORMAT "%5.2" EXTENDED_LIMITS 0.00 255.0 /end CHARACTERISTIC
/begin CHARACTERISTIC InjVlv_pCorBase_CUR "Raildruck-Korrekturgrundwert-Kennlinie für Druckwellenkorrektur" CURVE 0x1DCDA8 Kl_Xs16_Ws16 1800000. Pres_Rail 0.00 1800000. FORMAT "%8.0" EXTENDED_LIMITS -3276800. 3276700.
 /begin AXIS_DESCR STD_AXIS InjVlv_pAct_mp Pres_Rail 6 -3276800. 3276700. FORMAT "%8.0" DEPOSIT ABSOLUTE /end AXIS_DESCR
/end CHARACTERISTIC
/begin CHARACTERISTIC InjVlv_pMin_C "Injektorabhängige Druckschwelle zur Freigabe/Sperrung der Einspritzung" VALUE 0x1DD338 Kw_Ws16 1800000. Pres_Rail 0.00 1800000. FORMAT "%8.0" EXTENDED_LIMITS -3276800. 3276700. /end CHARACTERISTIC
/begin CHARACTERISTIC InjVlv_pMin_CUR "Kühlmitteltemperaturabhängige Druckschwelle zur Freigabe der Einspritzungen" CURVE 0x1DD33A Kl_Xs16_Ws16 1800000. Pres_Rail 0.00 1800000. FORMAT "%8.0" EXTENDED_LIMITS -3276800. 3276700.
 /begin AXIS_DESCR STD_AXIS InjCrv_tEng Temp_Cels 8 -50.14000 199.8600 FORMAT "%8.4" EXTENDED_LIMITS -3549.940 3003.560 DEPOSIT ABSOLUTE /end AXIS_DESCR
/end CHARACTERISTIC
/begin CHARACTERISTIC InjVlv_pNVCMax_C "Obere Grenze des Raildrucks für die Freigabe der NVC" VALUE 0x1DD2C4 Kw_Ws16 1800000. Pres_Rail 0.00 1800000. FORMAT "%8.0" EXTENDED_LIMITS -3276800. 3276700. /end CHARACTERISTIC
/begin CHARACTERISTIC InjVlv_pNVCMin_C "untere Grenze des Raildrucks für die Freigabe der NVC" VALUE 0x1DD2C6 Kw_Ws16 1800000. Pres_Rail 0.00 1800000. FORMAT "%8.0" EXTENDED_LIMITS -3276800. 3276700. /end CHARACTERISTIC
/begin CHARACTERISTIC InjVlv_pRailDfl_C "Raildruck-Ersatzwert für Sollspannungsberechnung" VALUE 0x1DCDC2 Kw_Ws16 6553500. Pres_Rail -3276800. 3276700. FORMAT "%8.0" /end CHARACTERISTIC
/begin CHARACTERISTIC InjVlv_NVCPKp_C "P-Parameter des Reglers, wenn sich der Wert des Eingangs innerhalb der Kleinsignalfensters befindet" VALUE 0x1DD2C8 Kw_Wu32 799.999999814 Kp_VOLTPA2FACT 0.00 799.999999814 FORMAT "%13.9" /end CHARACTERISTIC
/begin CHARACTERISTIC InjVlv_NVCPKpPos_C "P-Parameter des Reglers, wenn sich der Wert des Eingangs oberhalb des Kleinsignalfensters befindet" VALUE 0x1DD2CC Kw_Wu32 799.999999814 Kp_VOLTPA2FACT 0.00 799.999999814 FORMAT "%13.9" /end CHARACTERISTIC
/begin CHARACTERISTIC InjVlv_NVCPKpNeg_C "P-Parameter des Reglers, wenn sich der Wert des Eingangs unterhalb der Kleinsignalfensters befindet" VALUE 0x1DD2D0 Kw_Wu32 799.999999814 Kp_VOLTPA2FACT 0.00 799.999999814 FORMAT "%13.9" /end CHARACTERISTIC
/begin CHARACTERISTIC InjVlv_uNVCPWinPos_C "obere Grenze des Kleinsignalfensters für den P-Anteil" VALUE 0x1DD2D4 Kw_Ws16 655.3500 Volt_PA -327.6800 327.6700 FORMAT "%8.4" /end CHARACTERISTIC
/begin CHARACTERISTIC InjVlv_uNVCPWinNeg_C "untere Grenze der Kleinsignalfensters für den P-Anteil" VALUE 0x1DD2D6 Kw_Ws16 655.3500 Volt_PA -327.6800 327.6700 FORMAT "%8.4" /end CHARACTERISTIC
/begin CHARACTERISTIC InjVlv_qWvCor1_MAP "Grundwerte-KF 1 der Druckwellenkorrekturmenge" MAP 0x1DE168 Kf_Xs16_Ys16_Ws16 655.3400 InjMassInj -327.6700 327.6700 FORMAT "%8.4" EXTENDED_LIMITS -327.6800 327.6700
 /begin AXIS_DESCR STD_AXIS InjVlv_tiPiI1MI1Cor_mp InjTime_us 32 0.00 13000.00 FORMAT "%8.2" EXTENDED_LIMITS -32768.00 32767.00 DEPOSIT ABSOLUTE /end AXIS_DESCR
 /begin AXIS_DESCR STD_AXIS InjCrv_qPiI1Des InjMassInj 8 0.00 327.6700 FORMAT "%8.4" EXTENDED_LIMITS -327.6800 327.6700 DEPOSIT ABSOLUTE /end AXIS_DESCR
/end CHARACTERISTIC
/begin CHARACTERISTIC InjVlv_qWvCor2_MAP "Grundwerte-KF 2 der Druckwellenkorrekturmenge" MAP 0x1DE3BC Kf_Xs16_Ys16_Ws16 655.3400 InjMassInj -327.6700 327.6700 FORMAT "%8.4" EXTENDED_LIMITS -327.6800 327.6700
 /begin AXIS_DESCR STD_AXIS InjVlv_tiMI1PoI2Cor_mp InjTime_us 80 0.00 13000.00 FORMAT "%8.2" EXTENDED_LIMITS -32768.00 32767.00 DEPOSIT ABSOLUTE /end AXIS_DESCR
 /begin AXIS_DESCR STD_AXIS InjVlv_rMI1WvCorNorm_mp QntR 16 0.0009765625 24.00000 FORMAT "%8.5" EXTENDED_LIMITS -32.00000 31.99902 DEPOSIT ABSOLUTE /end AXIS_DESCR
/end CHARACTERISTIC
/begin CHARACTERISTIC InjVlv_qWvCorMax_C "maximale Begrenzungsmenge der Druckwellenkorrektur" VALUE 0x1DEE80 Kw_Ws16 20.00000 InjMassInj -10.00000 10.00000 FORMAT "%8.5" EXTENDED_LIMITS -327.6800 327.6700 /end CHARACTERISTIC
/begin CHARACTERISTIC InjVlv_qWvCorMin_C "minimale Begrenzungsmenge der Druckwellenkorrektur" VALUE 0x1DEE82 Kw_Ws16 20.00000 InjMassInj -10.00000 10.00000 FORMAT "%8.5" EXTENDED_LIMITS -327.6800 327.6700 /end CHARACTERISTIC
/begin CHARACTERISTIC InjVlv_qWvCorNorm_CUR "Kennlinie für die raildruckabhängige Einspritznormierungsmenge" CURVE 0x1DD7E6 Kl_Xs16_Ws16 327.6600 InjMassInj 0.01000000 327.6700 FORMAT "%8.4" EXTENDED_LIMITS -327.6800 327.6700
 /begin AXIS_DESCR STD_AXIS RailCD_pPeak Pres_Rail 20 0.00 1800000. FORMAT "%8.0" EXTENDED_LIMITS -3276800. 3276700. DEPOSIT ABSOLUTE /end AXIS_DESCR
/end CHARACTERISTIC
/begin CHARACTERISTIC InjVlv_rChrgBalPwrHys_C "Leistungs-Hystereseschwelle für max. Anzahl an Einspritzungen über Ladungsbilanz des Buffer-Kondensators" VALUE 0x1DD0F0 Kw_Wu16 100.0000 Prc 0.00 100.0000 FORMAT "%8.4" EXTENDED_LIMITS 0.00 655.3500 /end CHARACTERISTIC
/begin CHARACTERISTIC InjVlv_rChrgBalVltgHys_C "Batteriespannungs Hystereseschwelle für Auswahl der max. Anzahl an Einspritzungen aufgrund Ladungsbilanz Boosterkondensators" VALUE 0x1DD0F2 Kw_Wu16 100.0000 Prc 0.00 100.0000 FORMAT "%8.4" EXTENDED_LIMITS 0.00 655.3500 /end CHARACTERISTIC
/begin CHARACTERISTIC InjVlv_stErrDet_C "Status der Injektorfehlererkennung" VALUE 0x1DD12A Kw_Wu8 1.000 OneToOne 0.00 1.000 FORMAT "%5.3" EXTENDED_LIMITS 0.00 255.0 /end CHARACTERISTIC
/begin CHARACTERISTIC InjVlv_stErrMskPattern_C "Pattern-Matrix zur Mustererkennung" VAL_BLK 0x1DD1A4 Kwb_Wu32 4294967295.00 OneToOne 0.00 4294967295.00 FORMAT "%13.2" NUMBER 32 /end CHARACTERISTIC
/begin CHARACTERISTIC InjVlv_stErrMskSelect_C "Select-Matrix zur Mustererkennung" VAL_BLK 0x1DD224 Kwb_Wu32 4294967295.00 OneToOne 0.00 4294967295.00 FORMAT "%13.2" NUMBER 32 /end CHARACTERISTIC
/begin CHARACTERISTIC InjVlv_stInputAddBalMap_C "y-Eingang des Kennfelds InjVCD_facAddBalRls_MAP auf dem Applikationswerkzeug" VALUE 0x1DCBCA Kw_Wu8 255.0 OneToOne 0.00 255.0 FORMAT "%5.1" /end CHARACTERISTIC
/begin CHARACTERISTIC InjVlv_stMonQckEna_C "Schalter zur Freigabe der Schnell-Erkennung der Kurzschlüsse nach Batterie und Masse (0: gesperrt, 1: freigegeben)" VALUE 0x1DD2A4 Kw_Wu8 1.000 OneToOne 0.00 1.000 FORMAT "%5.3" EXTENDED_LIMITS 0.00 255.0 /end CHARACTERISTIC
/begin CHARACTERISTIC InjVlv_stPWvCorMsk_C "Freigabemaske für Druckwellenkorrekur des Raildrucks" VALUE 0x1DCDC4 Kw_Wu8 255.0 OneToOne 0.00 255.0 FORMAT "%5.1" /end CHARACTERISTIC
/begin CHARACTERISTIC InjVlv_stQntAdjRepl_C "Ersatzwerte für Injektormengenabgleich" VAL_BLK 0x1DD404 Kwb_Wu32 4294967295.00 OneToOne 0.00 4294967295.00 FORMAT "%13.2" NUMBER 12 /end CHARACTERISTIC
/begin CHARACTERISTIC InjVlv_stQntAdj_MAP "Statuskennfeld (Index und Gewichtungsfaktor) für den Injektor-Mengenabgleich" MAP 0x1DD35E Kf_Xs16_Ys16_Ws16 32767.00 OneToOne 0.00 32767.00 FORMAT "%8.2" EXTENDED_LIMITS -32768.00 32767.00
 /begin AXIS_DESCR STD_AXIS RailCD_pPeak Pres_Rail 8 0.00 1800000. FORMAT "%8.0" EXTENDED_LIMITS -3276800. 3276700. DEPOSIT ABSOLUTE /end AXIS_DESCR
 /begin AXIS_DESCR STD_AXIS InjUn_volMI1Cor_mp InjQntInj 8 0.00 100.0000 FORMAT "%8.4" EXTENDED_LIMITS -327.6800 327.6700 DEPOSIT ABSOLUTE /end AXIS_DESCR
/end CHARACTERISTIC
/begin CHARACTERISTIC InjVlv_stWvCorActv_C "Freigabe der Druckwellenkorrektur" VALUE 0x1DD838 Kw_Wu8 1.000 OneToOne 0.00 1.000 FORMAT "%5.3" EXTENDED_LIMITS 0.00 255.0 /end CHARACTERISTIC
/begin CHARACTERISTIC InjVlv_swtQntAdj_C "Schalter zum Ersetzen der Mengenabgleichwerte" VALUE 0x1DD434 Kw_Wu8 1.000 OneToOne 0.00 1.000 FORMAT "%5.3" EXTENDED_LIMITS 0.00 255.0 /end CHARACTERISTIC
/begin CHARACTERISTIC InjVlv_tActrDfl_C "Ersatzwert Aktortemperatur für Sollwertspannungsberechnung" VALUE 0x1DCDC6 Kw_Ws16 6553.500 Temp_Cels -3549.940 3003.560 FORMAT "%8.3" /end CHARACTERISTIC
/begin CHARACTERISTIC InjVlv_tiDiffHyd_MAP "Kennfeld mit Differenzzeiten zwischen hydraulischem Nadelschliessende und elektrischem Ansteuerende" MAP 0x1DD438 Kf_Xs16_Ys16_Ws16 13000.00 InjTime_us 0.00 13000.00 FORMAT "%8.2" EXTENDED_LIMITS -32768.00 32767.00
 /begin AXIS_DESCR STD_AXIS RailCD_pAct_mp Pres_Rail 16 0.00 1800000. FORMAT "%8.0" EXTENDED_LIMITS -3276800. 3276700. DEPOSIT ABSOLUTE /end AXIS_DESCR
 /begin AXIS_DESCR STD_AXIS InjCrv_qMI1Des InjMassInj 16 0.00 327.6700 FORMAT "%8.4" EXTENDED_LIMITS -327.6800 327.6700 DEPOSIT ABSOLUTE /end AXIS_DESCR
/end CHARACTERISTIC
/begin CHARACTERISTIC InjVlv_tiNVCDwnThres_C "Obere Grenze der Regelabweichung des Entladezeit-Reglers um die NVC freizugeben" VALUE 0x1DD2D8 Kw_Ws16 380.0000 Time_Busy 20.00000 400.0000 FORMAT "%8.4" EXTENDED_LIMITS -3276.800 3276.700 /end CHARACTERISTIC
/begin CHARACTERISTIC InjVlv_tiNVCUpThres_C "Obere Grenze der Regelabweichung des Ladezeitreglers, um die NVC freizugeben" VALUE 0x1DD2DA Kw_Ws16 380.0000 Time_Busy 20.00000 400.0000 FORMAT "%8.4" EXTENDED_LIMITS -3276.800 3276.700 /end CHARACTERISTIC
/begin CHARACTERISTIC InjVlv_tNVCEngMax_C "Obere Grenze der Motortemperatur zur Freigebe der NVC" VALUE 0x1DD2DC Kw_Ws16 250.0000 Temp_Cels -50.14000 199.8600 FORMAT "%8.4" EXTENDED_LIMITS -3549.940 3003.560 /end CHARACTERISTIC
/begin CHARACTERISTIC InjVlv_tNVCEngMin_C "untere Grenze der Motortemperatur zur Freigabe der NVC" VALUE 0x1DD2DE Kw_Ws16 250.0000 Temp_Cels -50.14000 199.8600 FORMAT "%8.4" EXTENDED_LIMITS -3549.940 3003.560 /end CHARACTERISTIC
/begin CHARACTERISTIC InjVlv_tWvCor_MAP "KF fuer die Eingangstemperatur der Druckwellenkorrektur" MAP 0x1DD83A Kf_Xs16_Ys16_Ws16 180.0000 Temp_Cels -40.04000 139.9600 FORMAT "%8.4" EXTENDED_LIMITS -3549.940 3003.560
 /begin AXIS_DESCR STD_AXIS FTSCD_tFuel Temp_Cels 16 -50.14000 149.8600 FORMAT "%8.4" EXTENDED_LIMITS -3549.940 3003.560 DEPOSIT ABSOLUTE /end AXIS_DESCR
 /begin AXIS_DESCR STD_AXIS CTSCD_tClnt Temp_Cels 16 -50.14000 149.8600 FORMAT "%8.4" EXTENDED_LIMITS -3549.940 3003.560 DEPOSIT ABSOLUTE /end AXIS_DESCR
/end CHARACTERISTIC
/begin CHARACTERISTIC InjVlv_uBufCInjLimXLow_C "Untere Hystereseschwelle für Bufferspannung" VALUE 0x1DD0F4 Kw_Ws16 260.0000 Volt_BUFC 0.00 260.0000 FORMAT "%8.4" EXTENDED_LIMITS -327.6800 327.6700 /end CHARACTERISTIC
/begin CHARACTERISTIC InjVlv_uBufCInjLimXHigh_C "Obere Hystereseschwelle für Bufferspannung" VALUE 0x1DD0F6 Kw_Ws16 260.0000 Volt_BUFC 0.00 260.0000 FORMAT "%8.4" EXTENDED_LIMITS -327.6800 327.6700 /end CHARACTERISTIC
/begin CHARACTERISTIC InjVlv_stBufCInjLimYLow_C "Konstante für Bufferspannung kleiner Hystereseschwelle" VALUE 0x1DD0F8 Kw_Ws16 65535.00 OneToOne -32768.00 32767.00 FORMAT "%8.2" READ_ONLY /end CHARACTERISTIC
/begin CHARACTERISTIC InjVlv_stBufCInjLimYHigh_C "Konstante für Bufferspannung größer Hystereseschwelle" VALUE 0x1DD0FA Kw_Ws16 65535.00 OneToOne -32768.00 32767.00 FORMAT "%8.2" READ_ONLY /end CHARACTERISTIC
/begin CHARACTERISTIC InjVlv_uDiffNVCSet_CUR "Kennlinie für die Spannungsdifferenz" CURVE 0x1DD2E0 Kl_Xs16_Ws16 250.0000 Volt_PA 0.00 250.0000 FORMAT "%8.4" EXTENDED_LIMITS -327.6800 327.6700
 /begin AXIS_DESCR STD_AXIS InjVCD_pActInj Pres_Rail 20 -3276800. 3276700. FORMAT "%8.0" DEPOSIT ABSOLUTE /end AXIS_DESCR
/end CHARACTERISTIC
/begin CHARACTERISTIC InjVlv_uMonBattThres_C "Schwelle zur Überwachung des DC_err von CY370" VALUE 0x1DD2A6 Kw_Ws16 23991.73 Volt_Batt 0.00 23991.73 FORMAT "%8.2" EXTENDED_LIMITS -665674.1 665653.8 /end CHARACTERISTIC
/begin CHARACTERISTIC InjVlv_uNVCThres_C "Obere Grenze des Wertes des Spannungsreglereingangs für die Freigabe der NVC" VALUE 0x1DD332 Kw_Ws16 500.0000 Volt_PA -250.0000 250.0000 FORMAT "%8.4" EXTENDED_LIMITS -327.6800 327.6700 /end CHARACTERISTIC
/begin CHARACTERISTIC InjVlv_uOfs_C "Spannungsoffset" VALUE 0x1DCEAA Kw_Ws16 15.00000 Volt_PA 0.00 15.00000 FORMAT "%8.5" EXTENDED_LIMITS -327.6800 327.6700 /end CHARACTERISTIC
/begin CHARACTERISTIC InjVlv_uSetBott_C "Vorgabewert für Piezo-Aktor bottom-level" VALUE 0x1DCDC8 Kw_Ws16 250.0000 Volt_PA 0.00 250.0000 FORMAT "%8.4" EXTENDED_LIMITS -327.6800 327.6700 /end CHARACTERISTIC
/begin CHARACTERISTIC InjVlv_uSetUpNVCActrMax_C "obere Grenze der Stellspannung nach der NVC" VALUE 0x1DD334 Kw_Ws16 250.0000 Volt_PA 0.00 250.0000 FORMAT "%8.4" EXTENDED_LIMITS -327.6800 327.6700 /end CHARACTERISTIC
/begin CHARACTERISTIC InjVlv_uSetUpNVCActrMin_C "untere Grenze der Stellspannung nach der NVC" VALUE 0x1DD336 Kw_Ws16 250.0000 Volt_PA 0.00 250.0000 FORMAT "%8.4" EXTENDED_LIMITS -327.6800 327.6700 /end CHARACTERISTIC
/begin CHARACTERISTIC InjVlv_uSetUpPress0_CUR "Kennlinie zur raildruckabh. Sollspannungsbestimmung für ISA-Klasse 0" CURVE 0x1DCDCA Kl_Xs16_Ws16 250.0000 Volt_PA 0.00 250.0000 FORMAT "%8.4" EXTENDED_LIMITS -327.6800 327.6700
 /begin AXIS_DESCR STD_AXIS InjVlv_pCalcVolt Pres_Rail 3 -3276800. 3276700. FORMAT "%8.0" DEPOSIT ABSOLUTE /end AXIS_DESCR
/end CHARACTERISTIC
/begin CHARACTERISTIC InjVlv_uSetUpPress10_CUR "Kennlinie zur raildruckabh. Sollspannungsbestimmung für ISA-Klasse 10" CURVE 0x1DCDD8 Kl_Xs16_Ws16 250.0000 Volt_PA 0.00 250.0000 FORMAT "%8.4" EXTENDED_LIMITS -327.6800 327.6700
 /begin AXIS_DESCR STD_AXIS InjVlv_pCalcVolt Pres_Rail 3 -3276800. 3276700. FORMAT "%8.0" DEPOSIT ABSOLUTE /end AXIS_DESCR
/end CHARACTERISTIC
/begin CHARACTERISTIC InjVlv_uSetUpPress11_CUR "Kennlinie zur raildruckabh. Sollspannungsbestimmung für ISA-Klasse 11" CURVE 0x1DCDE6 Kl_Xs16_Ws16 250.0000 Volt_PA 0.00 250.0000 FORMAT "%8.4" EXTENDED_LIMITS -327.6800 327.6700
 /begin AXIS_DESCR STD_AXIS InjVlv_pCalcVolt Pres_Rail 3 -3276800. 3276700. FORMAT "%8.0" DEPOSIT ABSOLUTE /end AXIS_DESCR
/end CHARACTERISTIC
/begin CHARACTERISTIC InjVlv_uSetUpPress12_CUR "Kennlinie zur raildruckabh. Sollspannungsbestimmung für ISA-Klasse 12" CURVE 0x1DCDF4 Kl_Xs16_Ws16 250.0000 Volt_PA 0.00 250.0000 FORMAT "%8.4" EXTENDED_LIMITS -327.6800 327.6700
 /begin AXIS_DESCR STD_AXIS InjVlv_pCalcVolt Pres_Rail 3 -3276800. 3276700. FORMAT "%8.0" DEPOSIT ABSOLUTE /end AXIS_DESCR
/end CHARACTERISTIC
/begin CHARACTERISTIC InjVlv_uSetUpPress13_CUR "Kennlinie zur raildruckabh. Sollspannungsbestimmung für ISA-Klasse 13" CURVE 0x1DCE02 Kl_Xs16_Ws16 250.0000 Volt_PA 0.00 250.0000 FORMAT "%8.4" EXTENDED_LIMITS -327.6800 327.6700
 /begin AXIS_DESCR STD_AXIS InjVlv_pCalcVolt Pres_Rail 3 -3276800. 3276700. FORMAT "%8.0" DEPOSIT ABSOLUTE /end AXIS_DESCR
/end CHARACTERISTIC
/begin CHARACTERISTIC InjVlv_uSetUpPress14_CUR "Kennlinie zur raildruckabh. Sollspannungsbestimmung für ISA-Klasse 14" CURVE 0x1DCE10 Kl_Xs16_Ws16 250.0000 Volt_PA 0.00 250.0000 FORMAT "%8.4" EXTENDED_LIMITS -327.6800 327.6700
 /begin AXIS_DESCR STD_AXIS InjVlv_pCalcVolt Pres_Rail 3 -3276800. 3276700. FORMAT "%8.0" DEPOSIT ABSOLUTE /end AXIS_DESCR
/end CHARACTERISTIC
/begin CHARACTERISTIC InjVlv_uSetUpPress15_CUR "Kennlinie zur raildruckabh. Sollspannungsbestimmung für ISA-Klasse 15" CURVE 0x1DCE1E Kl_Xs16_Ws16 250.0000 Volt_PA 0.00 250.0000 FORMAT "%8.4" EXTENDED_LIMITS -327.6800 327.6700
 /begin AXIS_DESCR STD_AXIS InjVlv_pCalcVolt Pres_Rail 3 -3276800. 3276700. FORMAT "%8.0" DEPOSIT ABSOLUTE /end AXIS_DESCR
/end CHARACTERISTIC
/begin CHARACTERISTIC InjVlv_uSetUpPress1_CUR "Kennlinie zur raildruckabh. Sollspannungsbestimmung für ISA-Klasse 1" CURVE 0x1DCE2C Kl_Xs16_Ws16 250.0000 Volt_PA 0.00 250.0000 FORMAT "%8.4" EXTENDED_LIMITS -327.6800 327.6700
 /begin AXIS_DESCR STD_AXIS InjVlv_pCalcVolt Pres_Rail 3 -3276800. 3276700. FORMAT "%8.0" DEPOSIT ABSOLUTE /end AXIS_DESCR
/end CHARACTERISTIC
/begin CHARACTERISTIC InjVlv_uSetUpPress2_CUR "Kennlinie zur raildruckabh. Sollspannungsbestimmung für ISA-Klasse 2" CURVE 0x1DCE3A Kl_Xs16_Ws16 250.0000 Volt_PA 0.00 250.0000 FORMAT "%8.4" EXTENDED_LIMITS -327.6800 327.6700
 /begin AXIS_DESCR STD_AXIS InjVlv_pCalcVolt Pres_Rail 3 -3276800. 3276700. FORMAT "%8.0" DEPOSIT ABSOLUTE /end AXIS_DESCR
/end CHARACTERISTIC
/begin CHARACTERISTIC InjVlv_uSetUpPress3_CUR "Kennlinie zur raildruckabh. Sollspannungsbestimmung für ISA-Klasse 3" CURVE 0x1DCE48 Kl_Xs16_Ws16 250.0000 Volt_PA 0.00 250.0000 FORMAT "%8.4" EXTENDED_LIMITS -327.6800 327.6700
 /begin AXIS_DESCR STD_AXIS InjVlv_pCalcVolt Pres_Rail 3 -3276800. 3276700. FORMAT "%8.0" DEPOSIT ABSOLUTE /end AXIS_DESCR
/end CHARACTERISTIC
/begin CHARACTERISTIC InjVlv_uSetUpPress4_CUR "Kennlinie zur raildruckabh. Sollspannungsbestimmung für ISA-Klasse 4" CURVE 0x1DCE56 Kl_Xs16_Ws16 250.0000 Volt_PA 0.00 250.0000 FORMAT "%8.4" EXTENDED_LIMITS -327.6800 327.6700
 /begin AXIS_DESCR STD_AXIS InjVlv_pCalcVolt Pres_Rail 3 -3276800. 3276700. FORMAT "%8.0" DEPOSIT ABSOLUTE /end AXIS_DESCR
/end CHARACTERISTIC
/begin CHARACTERISTIC InjVlv_uSetUpPress5_CUR "Kennlinie zur raildruckabh. Sollspannungsbestimmung für ISA-Klasse 5" CURVE 0x1DCE64 Kl_Xs16_Ws16 250.0000 Volt_PA 0.00 250.0000 FORMAT "%8.4" EXTENDED_LIMITS -327.6800 327.6700
 /begin AXIS_DESCR STD_AXIS InjVlv_pCalcVolt Pres_Rail 3 -3276800. 3276700. FORMAT "%8.0" DEPOSIT ABSOLUTE /end AXIS_DESCR
/end CHARACTERISTIC
/begin CHARACTERISTIC InjVlv_uSetUpPress6_CUR "Kennlinie zur raildruckabh. Sollspannungsbestimmung für ISA-Klasse 6" CURVE 0x1DCE72 Kl_Xs16_Ws16 250.0000 Volt_PA 0.00 250.0000 FORMAT "%8.4" EXTENDED_LIMITS -327.6800 327.6700
 /begin AXIS_DESCR STD_AXIS InjVlv_pCalcVolt Pres_Rail 3 -3276800. 3276700. FORMAT "%8.0" DEPOSIT ABSOLUTE /end AXIS_DESCR
/end CHARACTERISTIC
/begin CHARACTERISTIC InjVlv_uSetUpPress7_CUR "Kennlinie zur raildruckabh. Sollspannungsbestimmung für ISA-Klasse 7" CURVE 0x1DCE80 Kl_Xs16_Ws16 250.0000 Volt_PA 0.00 250.0000 FORMAT "%8.4" EXTENDED_LIMITS -327.6800 327.6700
 /begin AXIS_DESCR STD_AXIS InjVlv_pCalcVolt Pres_Rail 3 -3276800. 3276700. FORMAT "%8.0" DEPOSIT ABSOLUTE /end AXIS_DESCR
/end CHARACTERISTIC
/begin CHARACTERISTIC InjVlv_uSetUpPress8_CUR "Kennlinie zur raildruckabh. Sollspannungsbestimmung für ISA-Klasse 8" CURVE 0x1DCE8E Kl_Xs16_Ws16 250.0000 Volt_PA 0.00 250.0000 FORMAT "%8.4" EXTENDED_LIMITS -327.6800 327.6700
 /begin AXIS_DESCR STD_AXIS InjVlv_pCalcVolt Pres_Rail 3 -3276800. 3276700. FORMAT "%8.0" DEPOSIT ABSOLUTE /end AXIS_DESCR
/end CHARACTERISTIC
/begin CHARACTERISTIC InjVlv_uSetUpPress9_CUR "Kennlinie zur raildruckabh. Sollspannungsbestimmung für ISA-Klasse 9" CURVE 0x1DCE9C Kl_Xs16_Ws16 250.0000 Volt_PA 0.00 250.0000 FORMAT "%8.4" EXTENDED_LIMITS -327.6800 327.6700
 /begin AXIS_DESCR STD_AXIS InjVlv_pCalcVolt Pres_Rail 3 -3276800. 3276700. FORMAT "%8.0" DEPOSIT ABSOLUTE /end AXIS_DESCR
/end CHARACTERISTIC
/begin CHARACTERISTIC InjVlv_volQntAdjLim_C "symmetrische Begrenzung des Mengen-Abgleichwertes" VALUE 0x1DD402 Kw_Ws16 128.0000 InjQntInj 0.00 128.0000 FORMAT "%8.4" EXTENDED_LIMITS -327.6800 327.6700 /end CHARACTERISTIC
/begin CHARACTERISTIC InjVlv_volQntAdjMax0_C "obere Grenzwerte der Mengen-Abgleichwerte für die ""0""-Quantisierungsschrittweite (0d=00b)" VAL_BLK 0x1C0F4C Kwb_Ws16 6.300000 InjQntInj 0.00 6.300000 FORMAT "%8.6" EXTENDED_LIMITS -327.6800 327.6700 NUMBER 4 /end CHARACTERISTIC
/begin CHARACTERISTIC InjVlv_volQntAdjMax1_C "obere Grenzwerte der Mengen-Abgleichwerte für die ""1""-Quantisierungsschrittweite (1d=01b)" VAL_BLK 0x1C0F54 Kwb_Ws16 9.450000 InjQntInj 0.00 9.450000 FORMAT "%8.6" EXTENDED_LIMITS -327.6800 327.6700 NUMBER 4 /end CHARACTERISTIC
/begin CHARACTERISTIC InjVlv_volQntAdjMax2_C "obere Grenzwerte der Mengen-Abgleichwerte für die ""2""-Quantisierungsschrittweite (2d=10b)" VAL_BLK 0x1C0F5C Kwb_Ws16 15.75000 InjQntInj 0.00 15.75000 FORMAT "%8.5" EXTENDED_LIMITS -327.6800 327.6700 NUMBER 4 /end CHARACTERISTIC
/begin CHARACTERISTIC InjVlv_volQntAdjMax3_C "obere Grenzwerte der Mengen-Abgleichwerte für die ""3""-Quantisierungsschrittweite (3d=11b)" VAL_BLK 0x1C0F64 Kwb_Ws16 31.50000 InjQntInj 0.00 31.50000 FORMAT "%8.5" EXTENDED_LIMITS -327.6800 327.6700 NUMBER 4 /end CHARACTERISTIC
/begin CHARACTERISTIC InjVlv_volQntAdjMin0_C "untere Grenzwerte der Mengen-Abgleichwerte für die ""0""-Quantisierungsschrittweite (0d=00b)" VAL_BLK 0x1C0F6C Kwb_Ws16 6.400000 InjQntInj -6.400000 0.00 FORMAT "%8.6" EXTENDED_LIMITS -327.6800 327.6700 NUMBER 4 /end CHARACTERISTIC
/begin CHARACTERISTIC InjVlv_volQntAdjMin1_C "untere Grenzwerte der Mengen-Abgleichwerte für die ""1""-Quantisierungsschrittweite (1d=01b)" VAL_BLK 0x1C0F74 Kwb_Ws16 9.600000 InjQntInj -9.600000 0.00 FORMAT "%8.6" EXTENDED_LIMITS -327.6800 327.6700 NUMBER 4 /end CHARACTERISTIC
/begin CHARACTERISTIC InjVlv_volQntAdjMin2_C "untere Grenzwerte der Mengen-Abgleichwerte für die ""2""-Quantisierungsschrittweite (2d=10b)" VAL_BLK 0x1C0F7C Kwb_Ws16 16.00000 InjQntInj -16.00000 0.00 FORMAT "%8.5" EXTENDED_LIMITS -327.6800 327.6700 NUMBER 4 /end CHARACTERISTIC
/begin CHARACTERISTIC InjVlv_volQntAdjMin3_C "untere Grenzwerte der Mengen-Abgleichwerte für die ""3""-Quantisierungsschrittweite (3d=11b)" VAL_BLK 0x1C0F84 Kwb_Ws16 32.00000 InjQntInj -32.00000 0.00 FORMAT "%8.5" EXTENDED_LIMITS -327.6800 327.6700 NUMBER 4 /end CHARACTERISTIC
/begin CHARACTERISTIC InjVlv_wInj_CUR "Kennlinie für Energieverbrauch einer Piezo-Aktor-Ansteuerung" CURVE 0x1DD0FC Kl_Xs16_Ws16 100.0000 W_PA 0.00 100.0000 FORMAT "%8.4" EXTENDED_LIMITS -32768.00 32767.00
 /begin AXIS_DESCR STD_AXIS InjVlv_uSetUpAvrg_mp Volt_PA 2 -327.6800 327.6700 FORMAT "%8.4" DEPOSIT ABSOLUTE /end AXIS_DESCR
/end CHARACTERISTIC
/begin CHARACTERISTIC IVCtl_ChrgUpIKi_C "Kleinsignalverstärkung für I-Glied (Laden)" VALUE 0x1DEE84 Kw_Wu32 9999999.99767 Ki_us2mA 0.00 9999999.99767 FORMAT "%13.5" /end CHARACTERISTIC
/begin CHARACTERISTIC IVCtl_ChrgUpIKiPos_C "Positive Großsignalverstärkung für I-Glied (Laden)" VALUE 0x1DEE88 Kw_Wu32 9999999.99767 Ki_us2mA 0.00 9999999.99767 FORMAT "%13.5" /end CHARACTERISTIC
/begin CHARACTERISTIC IVCtl_ChrgUpIKiNeg_C "Negative Großsignalverstärkung für I-Glied (Laden)" VALUE 0x1DEE8C Kw_Wu32 9999999.99767 Ki_us2mA 0.00 9999999.99767 FORMAT "%13.5" /end CHARACTERISTIC
/begin CHARACTERISTIC IVCtl_tiChrgUpIWinPos_C "Positives Kleinsignalfenster für I-Glied (Laden)" VALUE 0x1DEE90 Kw_Ws16 200.0000 Time_Busy -100.0000 100.0000 FORMAT "%8.4" EXTENDED_LIMITS -3276.800 3276.700 /end CHARACTERISTIC
/begin CHARACTERISTIC IVCtl_tiChrgUpIWinNeg_C "Negatives Kleinsignalfenster für I-Glied (Laden)" VALUE 0x1DEE92 Kw_Ws16 200.0000 Time_Busy -100.0000 100.0000 FORMAT "%8.4" EXTENDED_LIMITS -3276.800 3276.700 /end CHARACTERISTIC
/begin CHARACTERISTIC IVCtl_ChrgUpPKp_C "Kleinsignalverstärkung für P-Glied (Laden)" VALUE 0x1DEE94 Kw_Wu32 655359.999847 Kp_us2mA 0.00 655359.999847 FORMAT "%13.6" /end CHARACTERISTIC
/begin CHARACTERISTIC IVCtl_ChrgUpPKpPos_C "Positive Großsignalverstärkung für P-Glied (Laden)" VALUE 0x1DEE98 Kw_Wu32 655359.999847 Kp_us2mA 0.00 655359.999847 FORMAT "%13.6" /end CHARACTERISTIC
/begin CHARACTERISTIC IVCtl_ChrgUpPKpNeg_C "Negative Großsignalverstärkung für P-Glied (Laden)" VALUE 0x1DEE9C Kw_Wu32 655359.999847 Kp_us2mA 0.00 655359.999847 FORMAT "%13.6" /end CHARACTERISTIC
/begin CHARACTERISTIC IVCtl_tiChrgUpPWinPos_C "Positives Kleinsignalfenster für P-Glied (Laden)" VALUE 0x1DEEA0 Kw_Ws16 200.0000 Time_Busy -100.0000 100.0000 FORMAT "%8.4" EXTENDED_LIMITS -3276.800 3276.700 /end CHARACTERISTIC
/begin CHARACTERISTIC IVCtl_tiChrgUpPWinNeg_C "Negatives Kleinsignalfenster für P-Glied (Laden)" VALUE 0x1DEEA2 Kw_Ws16 200.0000 Time_Busy -100.0000 100.0000 FORMAT "%8.4" EXTENDED_LIMITS -3276.800 3276.700 /end CHARACTERISTIC
/begin CHARACTERISTIC IVCtl_DisChDwnIKi_C "Kleinsignalverstärkung für I-Glied (Entladen)" VALUE 0x1DEEA4 Kw_Wu32 9999999.99767 Ki_us2mA 0.00 9999999.99767 FORMAT "%13.5" /end CHARACTERISTIC
/begin CHARACTERISTIC IVCtl_DisChDwnIKiPos_C "Positive Großsignalverstärkung für I-Glied (Entladen)" VALUE 0x1DEEA8 Kw_Wu32 9999999.99767 Ki_us2mA 0.00 9999999.99767 FORMAT "%13.5" /end CHARACTERISTIC
/begin CHARACTERISTIC IVCtl_DisChDwnIKiNeg_C "Negative Großsignalverstärkung für I-Glied (Entladen)" VALUE 0x1DEEAC Kw_Wu32 9999999.99767 Ki_us2mA 0.00 9999999.99767 FORMAT "%13.5" /end CHARACTERISTIC
/begin CHARACTERISTIC IVCtl_tiDisChDwnIWinPos_C "Positives Kleinsignalfenster für I-Glied (Entladen)" VALUE 0x1DEEB0 Kw_Ws16 200.0000 Time_Busy -100.0000 100.0000 FORMAT "%8.4" EXTENDED_LIMITS -3276.800 3276.700 /end CHARACTERISTIC
/begin CHARACTERISTIC IVCtl_tiDisChDwnIWinNeg_C "Negatives Kleinsignalfenster für I-Glied (Entladen)" VALUE 0x1DEEB2 Kw_Ws16 200.0000 Time_Busy -100.0000 100.0000 FORMAT "%8.4" EXTENDED_LIMITS -3276.800 3276.700 /end CHARACTERISTIC
/begin CHARACTERISTIC IVCtl_DisChDwnPKp_C "Kleinsignalverstärkung für P-Glied (Entladen)" VALUE 0x1DEEB4 Kw_Wu32 655359.999847 Kp_us2mA 0.00 655359.999847 FORMAT "%13.6" /end CHARACTERISTIC
/begin CHARACTERISTIC IVCtl_DisChDwnPKpPos_C "Positive Großsignalverstärkung für P-Glied (Entladen)" VALUE 0x1DEEB8 Kw_Wu32 655359.999847 Kp_us2mA 0.00 655359.999847 FORMAT "%13.6" /end CHARACTERISTIC
/begin CHARACTERISTIC IVCtl_DisChDwnPKpNeg_C "Negative Großsignalverstärkung für P-Glied (Entladen)" VALUE 0x1DEEBC Kw_Wu32 655359.999847 Kp_us2mA 0.00 655359.999847 FORMAT "%13.6" /end CHARACTERISTIC
/begin CHARACTERISTIC IVCtl_tiDisChDwnPWinPos_C "Positives Kleinsignalfenster für P-Glied (Entladen)" VALUE 0x1DEEC0 Kw_Ws16 200.0000 Time_Busy -100.0000 100.0000 FORMAT "%8.4" EXTENDED_LIMITS -3276.800 3276.700 /end CHARACTERISTIC
/begin CHARACTERISTIC IVCtl_tiDisChDwnPWinNeg_C "Negatives Kleinsignalfenster für P-Glied (Entladen)" VALUE 0x1DEEC2 Kw_Ws16 200.0000 Time_Busy -100.0000 100.0000 FORMAT "%8.4" EXTENDED_LIMITS -3276.800 3276.700 /end CHARACTERISTIC
/begin CHARACTERISTIC IVCtl_iChrgUpCls_C "Vorgabewert für obere Stromgrenze (Klassifizierung)" VALUE 0x1DEEC4 Kw_Ws16 30000.00 Curr 0.00 30000.00 FORMAT "%8.2" EXTENDED_LIMITS -32768.00 32767.00 /end CHARACTERISTIC
/begin CHARACTERISTIC IVCtl_iChrgUpGovMax_C "Maximaler Strom für Ausgang Ladezeitregler" VALUE 0x1DEEC6 Kw_Ws16 6000.000 Curr -3000.000 3000.000 FORMAT "%8.3" EXTENDED_LIMITS -32768.00 32767.00 /end CHARACTERISTIC
/begin CHARACTERISTIC IVCtl_iChrgUpGovMin_C "Minimaler Strom für Ausgang Ladezeitregler" VALUE 0x1DEEC8 Kw_Ws16 6000.000 Curr -3000.000 3000.000 FORMAT "%8.3" EXTENDED_LIMITS -32768.00 32767.00 /end CHARACTERISTIC
/begin CHARACTERISTIC IVCtl_iChrgUpInitI_C "Initialisierungswert für Ladezeitregler" VALUE 0x1DEECA Kw_Ws16 6000.000 Curr -3000.000 3000.000 FORMAT "%8.3" EXTENDED_LIMITS -32768.00 32767.00 /end CHARACTERISTIC
/begin CHARACTERISTIC IVCtl_iChrgUpMax_C "Maximaler Ladestrom für Aktor" VALUE 0x1DEECC Kw_Ws16 30000.00 Curr 0.00 30000.00 FORMAT "%8.2" EXTENDED_LIMITS -32768.00 32767.00 /end CHARACTERISTIC
/begin CHARACTERISTIC IVCtl_iChrgUpMin_C "Minimaler Ladestrom für Aktor" VALUE 0x1DEECE Kw_Ws16 30000.00 Curr 0.00 30000.00 FORMAT "%8.2" EXTENDED_LIMITS -32768.00 32767.00 /end CHARACTERISTIC
/begin CHARACTERISTIC IVCtl_iChrgUp_CUR "KL für Ladestromgrenze Aktor" CURVE 0x1DEED0 Kl_Xs16_Ws16 30000.00 Curr 0.00 30000.00 FORMAT "%8.2" EXTENDED_LIMITS -32768.00 32767.00
 /begin AXIS_DESCR STD_AXIS IVCtl_uSetUpAvrg_mp Volt_PA 25 0.00 250.0000 FORMAT "%8.4" EXTENDED_LIMITS -327.6800 327.6700 DEPOSIT ABSOLUTE /end AXIS_DESCR
/end CHARACTERISTIC
/begin CHARACTERISTIC IVCtl_iDisChDwnCls_C "Vorgabewert für untere Stromgrenze (Klassifizierung)" VALUE 0x1DEF36 Kw_Ws16 30000.00 Curr -30000.00 0.00 FORMAT "%8.2" EXTENDED_LIMITS -32768.00 32767.00 /end CHARACTERISTIC
/begin CHARACTERISTIC IVCtl_iDisChDwnGovMax_C "Maximaler Strom für Ausgang Entladezeitregler" VALUE 0x1DEF38 Kw_Ws16 6000.000 Curr -3000.000 3000.000 FORMAT "%8.3" EXTENDED_LIMITS -32768.00 32767.00 /end CHARACTERISTIC
/begin CHARACTERISTIC IVCtl_iDisChDwnGovMin_C "Minimaler Strom für Ausgang Entladezeitregler" VALUE 0x1DEF3A Kw_Ws16 6000.000 Curr -3000.000 3000.000 FORMAT "%8.3" EXTENDED_LIMITS -32768.00 32767.00 /end CHARACTERISTIC
/begin CHARACTERISTIC IVCtl_iDisChDwnInitI_C "Initialisierungswert für Entladezeitregler" VALUE 0x1DEF3C Kw_Ws16 6000.000 Curr -3000.000 3000.000 FORMAT "%8.3" EXTENDED_LIMITS -32768.00 32767.00 /end CHARACTERISTIC
/begin CHARACTERISTIC IVCtl_iDisChDwnMax_C "Maximaler Entladestrom" VALUE 0x1DEF3E Kw_Ws16 30000.00 Curr -30000.00 0.00 FORMAT "%8.2" EXTENDED_LIMITS -32768.00 32767.00 /end CHARACTERISTIC
/begin CHARACTERISTIC IVCtl_iDisChDwnMin_C "Minimaler Entladestrom" VALUE 0x1DEF40 Kw_Ws16 30000.00 Curr -30000.00 0.00 FORMAT "%8.2" EXTENDED_LIMITS -32768.00 32767.00 /end CHARACTERISTIC
/begin CHARACTERISTIC IVCtl_iDisChDwn_CUR "KL für Entladestromgrenze" CURVE 0x1DEF42 Kl_Xs16_Ws16 30000.00 Curr -30000.00 0.00 FORMAT "%8.2" EXTENDED_LIMITS -32768.00 32767.00
 /begin AXIS_DESCR STD_AXIS IVCtl_uSetUpAvrg_mp Volt_PA 25 0.00 250.0000 FORMAT "%8.4" EXTENDED_LIMITS -327.6800 327.6700 DEPOSIT ABSOLUTE /end AXIS_DESCR
/end CHARACTERISTIC
/begin CHARACTERISTIC IVCtl_swtTiChrgMinMaxActr_C "Schalter zur Aktivierung der Berechnung der Min.-/Max.-Regelabweichung der Lade-/Entladezeit (aktorspezifisch)" VALUE 0x1DEFA8 Kw_Wu8 1.000 OneToOne 0.00 1.000 FORMAT "%5.3" EXTENDED_LIMITS 0.00 255.0 /end CHARACTERISTIC
/begin CHARACTERISTIC IVCtl_swtTiChrgMinMaxRst_C "Schalter zum Rücksetzen der Berechnung Min.-/Max.-Regelabweichung von Lade-/Entladezeit" VALUE 0x1DEFA9 Kw_Wu8 1.000 OneToOne 0.00 1.000 FORMAT "%5.3" EXTENDED_LIMITS 0.00 255.0 /end CHARACTERISTIC
/begin CHARACTERISTIC IVCtl_swtTiChrgMinMax_C "Schalter zur Aktivierung der Berechnung der Min.-/Max.-Regelabweichung der Lade-/Entladezeit (gemittelt)" VALUE 0x1DEFAA Kw_Wu8 1.000 OneToOne 0.00 1.000 FORMAT "%5.3" EXTENDED_LIMITS 0.00 255.0 /end CHARACTERISTIC
/begin CHARACTERISTIC IVCtl_tiChrgSetUp_CUR "Kennlinie zur spannungsabhängigen Sollwertvorgabe der Ladezeit" CURVE 0x1DEFAC Kl_Xs16_Ws16 400.0000 Time_Busy 0.00 400.0000 FORMAT "%8.4" EXTENDED_LIMITS -3276.800 3276.700
 /begin AXIS_DESCR STD_AXIS IVCtl_uSetUpAvrg_mp Volt_PA 4 -250.0000 250.0000 FORMAT "%8.4" EXTENDED_LIMITS -327.6800 327.6700 DEPOSIT ABSOLUTE /end AXIS_DESCR
/end CHARACTERISTIC
/begin CHARACTERISTIC IVCtl_tiChrgUpPse_C "Vorgabewert der Pausezeit für Ladezeitregelung" VALUE 0x1DEFBE Kw_Ws16 400.0000 Time_Busy 0.00 400.0000 FORMAT "%8.4" EXTENDED_LIMITS -3276.800 3276.700 /end CHARACTERISTIC
/begin CHARACTERISTIC IVCtl_tiDisChDwnPse_C "Vorgabewert der Pausezeit für Entladezeitregelung" VALUE 0x1DEFC0 Kw_Ws16 400.0000 Time_Busy 0.00 400.0000 FORMAT "%8.4" EXTENDED_LIMITS -3276.800 3276.700 /end CHARACTERISTIC
/begin CHARACTERISTIC IVCtl_tiDisChSetDwn_CUR "Kennlinie zur spannungsabhängigen Sollwertvorgabe der Entladezeit" CURVE 0x1DEFC2 Kl_Xs16_Ws16 400.0000 Time_Busy 0.00 400.0000 FORMAT "%8.4" EXTENDED_LIMITS -3276.800 3276.700
 /begin AXIS_DESCR STD_AXIS IVCtl_uSetUpAvrg_mp Volt_PA 4 -250.0000 250.0000 FORMAT "%8.4" EXTENDED_LIMITS -327.6800 327.6700 DEPOSIT ABSOLUTE /end AXIS_DESCR
/end CHARACTERISTIC
/begin MEASUREMENT InjCrv_phiPoI2AbsTot_mp "absoluter Ansteuerbeginn PoI2 aus Winkel- und Zeitkomponente" SWORD AngleCrS 1 100 -768.0000 767.9766 FORMAT "%8.4" ECU_ADDRESS 0x8030E6 /end MEASUREMENT
/begin MEASUREMENT InjCrv_phiPoI2Abs_mp "Sollwert, Winkelkomponente Ansteuerbeginn PoI2 relativ zum oberen Totpunkt" SWORD AngleCrS 1 100 -768.0000 767.9766 FORMAT "%8.4" ECU_ADDRESS 0x8030E8 /end MEASUREMENT
/begin MEASUREMENT InjCrv_phiPoI2Cor_mp "korrigierter Grundwert der Winkelkomponente Ansteuerbeginn PoI2" SWORD AngleCrS 1 100 -768.0000 767.9766 FORMAT "%8.4" ECU_ADDRESS 0x8030EA /end MEASUREMENT
/begin MEASUREMENT InjCrv_phiPoI2Rel_mp "Winkelkomponente Ansteuerbeginn PoI2 relativ zur Haupteinspritzung" SWORD AngleCrS 1 100 -768.0000 767.9766 FORMAT "%8.4" ECU_ADDRESS 0x8030EC /end MEASUREMENT
/begin MEASUREMENT InjCrv_qPiI1MinWv_mp "Minimalmenge der PiI1 mit Wellenlorrektur" SWORD InjMassInj 1 100 -327.6800 327.6700 FORMAT "%8.4" ECU_ADDRESS 0x8030FC /end MEASUREMENT
/begin MEASUREMENT InjCrv_swtPoI2AgAbsTDC_mp "Status des Betriebsmodus Ansteuerbeginn PoI2 (entweder Winkel absolut zum TDC oder Winkel bzw. Zeit relativ zur MI)" UBYTE OneToOne 1 100 0.00 255.0 FORMAT "%5.1" ECU_ADDRESS 0x8030EE /end MEASUREMENT
/begin MEASUREMENT InjCrv_tiPoI2Cor_mp "korrigierter Grundwert der Zeitkomponente Ansteuerbeginn PoI2" SWORD InjTime_us 1 100 -32768.00 32767.00 FORMAT "%8.2" ECU_ADDRESS 0x8030F0 /end MEASUREMENT
/begin MEASUREMENT InjCrv_tiPoI2Max_mp "maximaler Ansteuerbeginn PoI2 relativ zur Haupteinspritzung" SWORD InjTime_us 1 100 -32768.00 32767.00 FORMAT "%8.2" ECU_ADDRESS 0x8030F2 /end MEASUREMENT
/begin MEASUREMENT InjCrv_tiPoI2RelTot_mp "Ansteuerbeginnabstand PoI2 aus Winkel- und Zeitkomponente" SWORD InjTime_us 1 100 -32768.00 32767.00 FORMAT "%8.2" ECU_ADDRESS 0x8030F4 /end MEASUREMENT
/begin MEASUREMENT InjCrv_tiPoI2Rel_mp "Zeitkomponente Ansteuerbeginn PoI2 relativ zur Haupteinspritzung" SWORD InjTime_us 1 100 -32768.00 32767.00 FORMAT "%8.2" ECU_ADDRESS 0x8030F6 /end MEASUREMENT
/begin MEASUREMENT InjCrv_tiPse "feste oder gemessene Mindestzeit zwischen 2 Einspritzungen" SWORD InjTime_us 1 100 -32768.00 32767.00 FORMAT "%8.2" ECU_ADDRESS 0x7F99F8 /end MEASUREMENT
/begin MEASUREMENT InjCtl_qAct "Fahrerwunschmenge inklusive Leerlaufregler ohne Ruckeldämpfer" SWORD InjMass 1 100 -327.6800 327.6700 FORMAT "%8.4" ECU_ADDRESS 0x7F99FA /end MEASUREMENT
/begin MEASUREMENT InjCtl_qCurr "Einspritzmenge aktueller Wert" SWORD InjMass 1 100 -327.6800 327.6700 FORMAT "%8.4" ECU_ADDRESS 0x7F99FC /end MEASUREMENT
/begin MEASUREMENT InjCtl_qCurrUnCor "aktuelle Menge ohne Korrektur durch Mengenmittelwertadaption (FMA)" SWORD InjMass 1 100 -327.6800 327.6700 FORMAT "%8.4" ECU_ADDRESS 0x7F99FE /end MEASUREMENT
/begin MEASUREMENT InjCtl_qDes "Einspritzmenge Wunschwert" SWORD InjMass 1 100 -327.6800 327.6700 FORMAT "%8.4" ECU_ADDRESS 0x7F9A00 /end MEASUREMENT
/begin MEASUREMENT InjCtl_qLim "Begrenzungsmenge" SWORD InjMass 1 100 -327.6800 327.6700 FORMAT "%8.4" ECU_ADDRESS 0x7F9A02 /end MEASUREMENT
/begin MEASUREMENT InjCtl_qLimErr "Begrenzungsmenge im Falle eines Systemfehlers" SWORD InjMass 1 100 -327.6800 327.6700 FORMAT "%8.4" ECU_ADDRESS 0x7F9A04 /end MEASUREMENT
/begin MEASUREMENT InjCtl_qLimNorm_mp "Begrenzungsmenge im Normalbetrieb (kein Systemfehler)" SWORD InjMass 1 100 -327.6800 327.6700 FORMAT "%8.4" ECU_ADDRESS 0x8030FE /end MEASUREMENT
/begin MEASUREMENT InjCtl_qLimSwt "Ausgang RampSwitch-Block für Begrenzungsmenge im Systemfehlerfall" SWORD InjMass 1 100 -327.6800 327.6700 FORMAT "%8.4" ECU_ADDRESS 0x7F9A06 /end MEASUREMENT
/begin MEASUREMENT InjCtl_qRaw "Einspritzmenge Rohwert" SWORD InjMass 1 100 -327.6800 327.6700 FORMAT "%8.4" ECU_ADDRESS 0x7F9A08 /end MEASUREMENT
/begin MEASUREMENT InjCtl_qSetUnBal "Einspritzmenge Sollwert ohne Mengenausgleichsregelung" SWORD InjMass 1 100 -327.6800 327.6700 FORMAT "%8.4" ECU_ADDRESS 0x7F9A0A /end MEASUREMENT
/begin MEASUREMENT InjCtl_stNoInj "Status für keine Einspritzung (0 -> Einspritzung, 1 -> InjCtl_qSetUnBal == 0)" UBYTE OneToOne 1 100 0.00 255.0 FORMAT "%5.1" ECU_ADDRESS 0x7F9486 /end MEASUREMENT
/begin MEASUREMENT InjCtl_stQLimErr "Status Begrenzungsmenge im Falle eines Systemfehlers (soll verwendet werden)" UBYTE OneToOne 1 100 0.00 255.0 FORMAT "%5.1" ECU_ADDRESS 0x7F9487 /end MEASUREMENT
/begin MEASUREMENT InjCtl_trqInrLim "Begrenzungsmoment (als inneres Moment) resultierend aus der Begrenzungsmenge InjCtl_qLim" SWORD Trq 1 100 -3276.800 3276.700 FORMAT "%8.3" ECU_ADDRESS 0x7F9A0C /end MEASUREMENT
/begin MEASUREMENT InjUn_numCylMI1_mp "Zylinder aktuell benutzt für 1. Haupteinspritzung" UBYTE OneToOne 1 100 0.00 255.0 FORMAT "%5.1" ECU_ADDRESS 0x7FCFE1 /end MEASUREMENT
/begin MEASUREMENT InjUn_numCylMI2_mp "Zylinder aktuell benutzt für 2. Haupteinspritzung" UBYTE OneToOne 1 100 0.00 255.0 FORMAT "%5.1" ECU_ADDRESS 0x7FCFE2 /end MEASUREMENT
/begin MEASUREMENT InjUn_numCylPiI1_mp "Zylindernummer zugehörend zur  Voreinspritzung 1" UBYTE OneToOne 1 100 0.00 255.0 FORMAT "%5.1" ECU_ADDRESS 0x7FCFE3 /end MEASUREMENT
/begin MEASUREMENT InjUn_numCylPiI2_mp "Zylindernummer zugehörend zur Voreinspritzung 2" UBYTE OneToOne 1 100 0.00 255.0 FORMAT "%5.1" ECU_ADDRESS 0x7FCFE4 /end MEASUREMENT
/begin MEASUREMENT InjUn_numCylPoI1_mp "Zylindernummer zugehörend zur Nacheinspritzung 1" UBYTE OneToOne 1 100 0.00 255.0 FORMAT "%5.1" ECU_ADDRESS 0x7FCFE5 /end MEASUREMENT
/begin MEASUREMENT InjUn_numCylPoI2_mp "Zylindernummer zugehörend zur Nacheinspritzung 2" UBYTE OneToOne 1 100 0.00 255.0 FORMAT "%5.1" ECU_ADDRESS 0x7FCFE6 /end MEASUREMENT
/begin MEASUREMENT InjUn_pAct_mp "aktueller Raildruck ermittelt in InjUn_Sched" SWORD Pres_Rail 1 100 -3276800. 3276700. FORMAT "%8.0" ECU_ADDRESS 0x80311E /end MEASUREMENT
/begin MEASUREMENT InjUn_qMI1Cor_mp "Korrigierte Menge der Haupteinspritzung 1" SWORD InjMassInj 1 100 -327.6800 327.6700 FORMAT "%8.4" ECU_ADDRESS 0x803100 /end MEASUREMENT
/begin MEASUREMENT InjUn_qPiI1Cor_mp "Korrigierte Menge der Voreinspritzung 1" SWORD InjMassInj 1 100 -327.6800 327.6700 FORMAT "%8.4" ECU_ADDRESS 0x803106 /end MEASUREMENT
/begin MEASUREMENT InjUn_qPiI2Cor_mp "Korrigierte Menge der Voreinspritzung 2" SWORD InjMassInj 1 100 -327.6800 327.6700 FORMAT "%8.4" ECU_ADDRESS 0x80310C /end MEASUREMENT
/begin MEASUREMENT InjUn_qPoI1Cor_mp "Korrigierte Menge der Nacheinspritzung 1" SWORD InjMassInj 1 100 -327.6800 327.6700 FORMAT "%8.4" ECU_ADDRESS 0x803112 /end MEASUREMENT
/begin MEASUREMENT InjUn_qPoI2Cor_mp "Korrigierte Menge der Nacheinspritzung 2" SWORD InjMassInj 1 100 -327.6800 327.6700 FORMAT "%8.4" ECU_ADDRESS 0x803118 /end MEASUREMENT
/begin MEASUREMENT InjUn_qTotInj "Gesamteinspritzmenge für die Schubüberwachung" SWORD InjMass 1 100 -327.6800 327.6700 FORMAT "%8.4" ECU_ADDRESS 0x7F9A0E /end MEASUREMENT
/begin MEASUREMENT InjUn_stInjValve "Abschaltanforderungen für Injektor" UBYTE OneToOne 1 100 0.00 255.0 FORMAT "%5.1" ECU_ADDRESS 0x7F9488 /end MEASUREMENT
/begin MEASUREMENT InjUn_stMIOffs_mp "gewählter Spannungsoffset für MI" UBYTE OneToOne 1 100 0.00 255.0 FORMAT "%5.1" ECU_ADDRESS 0x803120 /end MEASUREMENT
/begin MEASUREMENT InjUn_stPiI1Offs_mp "gewählter Spannungsoffset für PI1" UBYTE OneToOne 1 100 0.00 255.0 FORMAT "%5.1" ECU_ADDRESS 0x803121 /end MEASUREMENT
/begin MEASUREMENT InjUn_stPiI2Offs_mp "gewählter Spannungsoffset für PI2" UBYTE OneToOne 1 100 0.00 255.0 FORMAT "%5.1" ECU_ADDRESS 0x803122 /end MEASUREMENT
/begin MEASUREMENT InjUn_stPiI3Offs_mp "gewählter Spannungsoffset für PI3" UBYTE OneToOne 1 100 0.00 255.0 FORMAT "%5.1" ECU_ADDRESS 0x803123 /end MEASUREMENT
/begin MEASUREMENT InjUn_stShutOffReq "Abschaltanforderungen aus dem Einspritzsystem" UBYTE OneToOne 1 100 0.00 255.0 FORMAT "%5.1" ECU_ADDRESS 0x7F9489 /end MEASUREMENT
/begin MEASUREMENT InjUn_stSOPTstInjBeg_mp "Status Einspritzbeginn (0 = kein Fehler)" UBYTE OneToOne 1 100 0.00 255.0 FORMAT "%5.1" ECU_ADDRESS 0x803124 /end MEASUREMENT
/begin MEASUREMENT InjUn_stSOPTstInjDur_mp "Status Ansteuerdauer (0 = kein Fehler)" UBYTE OneToOne 1 100 0.00 255.0 FORMAT "%5.1" ECU_ADDRESS 0x803125 /end MEASUREMENT
/begin MEASUREMENT InjUn_stSysErr "systemspezifische Fehler" UWORD OneToOne 1 100 0.00 65535.00 FORMAT "%8.2" ECU_ADDRESS 0x7F9A10 /end MEASUREMENT
/begin MEASUREMENT InjUn_stTst "allgemeiner Status der Tests, die im Einspritzsystem durchgeführt werden" UWORD OneToOne 1 100 0.00 65535.00 FORMAT "%8.2" ECU_ADDRESS 0x7F9A12 /end MEASUREMENT
/begin MEASUREMENT InjUn_volMI1CorCyc "zylinderspezifisches Korrekturvolumen aus Mengenausgleichsregelung und Injektor-Abgleichmenge für MI1" SWORD InjQntInj 1 100 -327.6800 327.6700 FORMAT "%8.4" ARRAY_SIZE 6 ECU_ADDRESS 0x7F9D7A /end MEASUREMENT
/begin MEASUREMENT InjUn_volMI1Cor_mp "Korrigiertes Volumen der Haupteinspritzung 1" SWORD InjQntInj 1 100 -327.6800 327.6700 FORMAT "%8.4" ECU_ADDRESS 0x803102 /end MEASUREMENT
/begin MEASUREMENT InjUn_volMI1_mp "Einspritzvolumen der Haupteinspritzung 1 nach Mengenabgleich" SWORD InjQntInj 1 100 -327.6800 327.6700 FORMAT "%8.4" ECU_ADDRESS 0x803104 /end MEASUREMENT
/begin MEASUREMENT InjUn_volPiI1CorCyc "zylinderspezifisches Korrekturvolumen aus Mengenausgleichsregelung und Injektor-Abgleichmenge für PiI1" SWORD InjQntInj 1 100 -327.6800 327.6700 FORMAT "%8.4" ARRAY_SIZE 6 ECU_ADDRESS 0x7F9D86 /end MEASUREMENT
/begin MEASUREMENT InjUn_volPiI1Cor_mp "Korrigiertes Volumen der Voreinspritzung 1" SWORD InjQntInj 1 100 -327.6800 327.6700 FORMAT "%8.4" ECU_ADDRESS 0x803108 /end MEASUREMENT
/begin MEASUREMENT InjUn_volPiI1_mp "Einspritzvolumen der Voreinspritzung 1 nach Mengenabgleich" SWORD InjQntInj 1 100 -327.6800 327.6700 FORMAT "%8.4" ECU_ADDRESS 0x80310A /end MEASUREMENT
/begin MEASUREMENT InjUn_volPiI2CorCyc "zylinderspezifisches Korrekturvolumen aus Mengenausgleichsregelung und Injektor-Abgleichmenge für PiI2" SWORD InjQntInj 1 100 -327.6800 327.6700 FORMAT "%8.4" ARRAY_SIZE 6 ECU_ADDRESS 0x7F9D92 /end MEASUREMENT
/begin MEASUREMENT InjUn_volPiI2Cor_mp "Korrigiertes Volumen der Voreinspritzung 2" SWORD InjQntInj 1 100 -327.6800 327.6700 FORMAT "%8.4" ECU_ADDRESS 0x80310E /end MEASUREMENT
/begin MEASUREMENT InjUn_volPiI2_mp "Einspritzvolumen der Voreinspritzung 2 nach Mengenabgleich" SWORD InjQntInj 1 100 -327.6800 327.6700 FORMAT "%8.4" ECU_ADDRESS 0x803110 /end MEASUREMENT
/begin MEASUREMENT InjUn_volPoI1Cor_mp "Korrigiertes Volumen der Nacheinspritzung 1" SWORD InjQntInj 1 100 -327.6800 327.6700 FORMAT "%8.4" ECU_ADDRESS 0x803114 /end MEASUREMENT
/begin MEASUREMENT InjUn_volPoI1_mp "Einspritzvolumen der Nacheinspritzung 1 nach Mengenabgleich" SWORD InjQntInj 1 100 -327.6800 327.6700 FORMAT "%8.4" ECU_ADDRESS 0x803116 /end MEASUREMENT
/begin MEASUREMENT InjUn_volPoI2Cor_mp "Korrigiertes Volumen der Nacheinspritzung 2" SWORD InjQntInj 1 100 -327.6800 327.6700 FORMAT "%8.4" ECU_ADDRESS 0x80311A /end MEASUREMENT
/begin MEASUREMENT InjUn_volPoI2_mp "Einspritzvolumen der Nacheinspritzung 2 nach Mengenabgleich" SWORD InjQntInj 1 100 -327.6800 327.6700 FORMAT "%8.4" ECU_ADDRESS 0x80311C /end MEASUREMENT
/begin MEASUREMENT InjVCD_chgUpActrCurr "geflossene Ladung beim Laden des Aktors von Bottom- auf Up-Niveau" SWORD Charge_PA 1 100 -32768.00 32767.00 FORMAT "%8.2" ARRAY_SIZE 6 ECU_ADDRESS 0x7F9DC2 /end MEASUREMENT
/begin MEASUREMENT InjVCD_ctUBufTrig_mp "Zähler für Anzahl der QADC-Trigger" UBYTE OneToOne 1 100 0.00 255.0 FORMAT "%5.1" ECU_ADDRESS 0x8031B4 /end MEASUREMENT
/begin MEASUREMENT InjVCD_cUpActrCurr "aktuelle Aktorkapazität (Laden)" SWORD Capacity_PA 1 100 -32.76800 32.76700 FORMAT "%8.5" ARRAY_SIZE 6 ECU_ADDRESS 0x7F9DAA /end MEASUREMENT
/begin MEASUREMENT InjVCD_cUpActrOld "Vorletzte Aktorkapazitaet nach Laden von Bottom nach Up Niveau" SWORD Capacity_PA 1 100 -32.76800 32.76700 FORMAT "%8.5" ARRAY_SIZE 6 ECU_ADDRESS 0x7F9DB6 /end MEASUREMENT
/begin MEASUREMENT InjVCD_facAmp_mp "Stromverstärkungsfaktor des CY370-Integrators" SWORD Fact_IntAmp 1 100 -32.76800 32.76700 FORMAT "%8.5" ECU_ADDRESS 0x803126 /end MEASUREMENT
/begin MEASUREMENT InjVCD_numCollPrim_mp "Beschreibung der Primärkollision" UBYTE OneToOne 1 100 0.00 255.0 FORMAT "%5.1" ECU_ADDRESS 0x803170 /end MEASUREMENT
/begin MEASUREMENT InjVCD_numCollScnd_mp "Beschreibung der Sekundärkollision" UBYTE OneToOne 1 100 0.00 255.0 FORMAT "%5.1" ECU_ADDRESS 0x803171 /end MEASUREMENT
/begin MEASUREMENT InjVCD_numCollThrd_mp "Beschreibung der Tertiärkollision" UBYTE OneToOne 1 100 0.00 255.0 FORMAT "%5.1" ECU_ADDRESS 0x803172 /end MEASUREMENT
/begin MEASUREMENT InjVCD_numCrntLvl_mp "ausgewähltes Stromband" SBYTE OneToOne 1 100 -128.0 127.0 FORMAT "%5.1" ECU_ADDRESS 0x803219 /end MEASUREMENT
/begin MEASUREMENT InjVCD_numEvMgmtStat_mp "Statusinformation des Flankenmanagement" ULONG OneToOne 1 100 0.00 4294967295.00 FORMAT "%13.2" ARRAY_SIZE 8 ECU_ADDRESS 0x803174 /end MEASUREMENT
/begin MEASUREMENT InjVCD_numHandle "Handle of the TPU channel which holds the injection to be measured" UBYTE OneToOne 1 100 0.00 255.0 FORMAT "%5.1" ECU_ADDRESS 0x7F948A /end MEASUREMENT
/begin MEASUREMENT InjVCD_numMeas "Nummer des Aktors der gerade vermessen wird" UBYTE OneToOne 1 100 0.00 255.0 FORMAT "%5.1" ECU_ADDRESS 0x7F948B /end MEASUREMENT
/begin MEASUREMENT InjVCD_numOfsSelect "ausgewählter Spannungsoffset" SWORD OneToOne 1 100 -32768.00 32767.00 FORMAT "%8.2" ECU_ADDRESS 0x7F9A16 /end MEASUREMENT
/begin MEASUREMENT InjVCD_numOfsSelect_mp "zuletzt verwendeter Spannungsoffset" UBYTE OneToOne 1 100 0.00 255.0 FORMAT "%5.1" ECU_ADDRESS 0x803128 /end MEASUREMENT
/begin MEASUREMENT InjVCD_numReacPrim_mp "Beschreibung der Primärreaktion" UBYTE OneToOne 1 100 0.00 255.0 FORMAT "%5.1" ECU_ADDRESS 0x803194 /end MEASUREMENT
/begin MEASUREMENT InjVCD_numReacScnd_mp "Beschreibung der Sekundärreaktion" UBYTE OneToOne 1 100 0.00 255.0 FORMAT "%5.1" ECU_ADDRESS 0x803195 /end MEASUREMENT
/begin MEASUREMENT InjVCD_pActInj "verwendeter Raildruck der bei letzter Aktormessung gültig war" SWORD Pres_Rail 1 100 -3276800. 3276700. FORMAT "%8.0" ECU_ADDRESS 0x7F9A18 /end MEASUREMENT
/begin MEASUREMENT InjVCD_phiMI1Diff_mp "Winkeldifferenz zwischen dem gewünschten Ansteuerbeginn und dem systembed. frühesten Ansteuerbeginn der MI1" SWORD AngleCrS 1 100 -768.0000 767.9766 FORMAT "%8.4" ECU_ADDRESS 0x80320C /end MEASUREMENT
/begin MEASUREMENT InjVCD_phiPiI1Diff_mp "Winkeldifferenz zwischen dem gewünschten Ansteuerbeginn und dem systembed. frühesten Ansteuerbeginn der PiI1" SWORD AngleCrS 1 100 -768.0000 767.9766 FORMAT "%8.4" ECU_ADDRESS 0x803210 /end MEASUREMENT
/begin MEASUREMENT InjVCD_phiPiI2Diff_mp "Winkeldifferenz zwischen dem gewünschten Ansteuerbeginn und dem systembed. frühesten Ansteuerbeginn der PiI2" SWORD AngleCrS 1 100 -768.0000 767.9766 FORMAT "%8.4" ECU_ADDRESS 0x803214 /end MEASUREMENT
/begin MEASUREMENT InjVCD_pInET_mp "X-Eingang des Kennfeldes InjVCD_tiET_MAP auf dem Appplikationswerkzeug" SWORD Pres_Rail 1 100 -3276800. 3276700. FORMAT "%8.0" ECU_ADDRESS 0x8031B0 /end MEASUREMENT
/begin MEASUREMENT InjVCD_PZOSWType "SW-Identifikation" ULONG OneToOne 1 100 0.00 4294967295.00 FORMAT "%13.2" ECU_ADDRESS 0x7F9CE8 /end MEASUREMENT
/begin MEASUREMENT InjVCD_qInZFCETGMap_mp "Menge fuer Eingangsanzeige der Gruppenkennfelder InjVCD_rZFCETMsk_GMAP, ...Dif0_GMAP, ...Dif1_GMAP" SWORD InjMassInj 1 100 -327.6800 327.6700 FORMAT "%8.4" ECU_ADDRESS 0x803246 /end MEASUREMENT
/begin MEASUREMENT InjVCD_rCapThresHigh_mp "berechnetes Kapazitätsverhältnis der überwachten Aktoren (Schwelle high)" SWORD Fact 1 100 -4.000000 3.999878 FORMAT "%8.6" ECU_ADDRESS 0x8031D8 /end MEASUREMENT
/begin MEASUREMENT InjVCD_rCapThresLow_mp "berechnetes Kapazitätsverhältnis der überwachten Aktoren (Schwelle low)" SWORD Fact 1 100 -4.000000 3.999878 FORMAT "%8.6" ECU_ADDRESS 0x8031DA /end MEASUREMENT
/begin MEASUREMENT InjVCD_rCapUpCurrToKx_mp "berechnetes Verhältnis der Aktorkapazitäten (aktuell zu alt)" SWORD Fact 1 100 -4.000000 3.999878 FORMAT "%8.6" ECU_ADDRESS 0x8031DC /end MEASUREMENT
/begin MEASUREMENT InjVCD_rCapUpKxToCurr_mp "berechnetes Verhältnis der Aktorkapazitäten (alt zu aktuell)" SWORD Fact 1 100 -4.000000 3.999878 FORMAT "%8.6" ECU_ADDRESS 0x8031DE /end MEASUREMENT
/begin MEASUREMENT InjVCD_rClsVolt_mp "Quotient aus Beginn- und Ende-Spannung" SWORD Milli 1 100 -1.310720 1.310680 FORMAT "%8.6" ARRAY_SIZE 6 ECU_ADDRESS 0x803136 /end MEASUREMENT
/begin MEASUREMENT InjVCD_regCY370Bank "Bank-selektives Register des CY370" UBYTE OneToOne 1 100 0.00 255.0 FORMAT "%5.1" ECU_ADDRESS 0x7F948C /end MEASUREMENT
/begin MEASUREMENT InjVCD_regCY370CylISel "Zylinder-selektives Register des CY370 (ISel)" UBYTE OneToOne 1 100 0.00 255.0 FORMAT "%5.1" ECU_ADDRESS 0x7F948D /end MEASUREMENT
/begin MEASUREMENT InjVCD_regCY370Global "Globales Register des CY370" UBYTE OneToOne 1 100 0.00 255.0 FORMAT "%5.1" ECU_ADDRESS 0x7F948E /end MEASUREMENT
/begin MEASUREMENT InjVCD_regCY370ID_mp "Chip-ID des CY370" UBYTE OneToOne 1 100 0.00 255.0 FORMAT "%5.1" ECU_ADDRESS 0x80315C /end MEASUREMENT
/begin MEASUREMENT InjVCD_regCY370Status "Status-Register des CY370" UBYTE OneToOne 1 100 0.00 255.0 FORMAT "%5.1" ECU_ADDRESS 0x7F948F /end MEASUREMENT
/begin MEASUREMENT InjVCD_rTiChrgUpCurrToKx_mp "Verhaeltnis vo aktueller Ladezeit zu vorletzter Ladezeit" SWORD Fact 1 100 -4.000000 3.999878 FORMAT "%8.6" ECU_ADDRESS 0x8031E0 /end MEASUREMENT
/begin MEASUREMENT InjVCD_rTiChrgUpKxToCurr_mp "Verhaeltnis von vorletzter Aktorladezeit zu aktueller Aktorladezeit" SWORD Fact 1 100 -4.000000 3.999878 FORMAT "%8.6" ECU_ADDRESS 0x8031E2 /end MEASUREMENT
/begin MEASUREMENT InjVCD_rTiChrgUpThresHigh_mp "Oberes Verhaeltnis der Aktorladezeit aktuell/alt zur Erkennung eines Lowside Schalter Kurzschlusses" SWORD Fact 1 100 -4.000000 3.999878 FORMAT "%8.6" ECU_ADDRESS 0x8031E4 /end MEASUREMENT
/begin MEASUREMENT InjVCD_rTiChrgUpThresLow_mp "Unteres Verhaeltnis der Aktorladezeit aktuell/alt zur Erkennung eines Lowside Schalter Kurzschlusses" SWORD Fact 1 100 -4.000000 3.999878 FORMAT "%8.6" ECU_ADDRESS 0x8031E6 /end MEASUREMENT
/begin MEASUREMENT InjVCD_rZFCETCoeffDif_mp "Bewertungsfaktoren fuer Ansteuerdauerkorrektur durch Nullmengenkalibrierung" SWORD Prc 1 100 -327.6800 327.6700 FORMAT "%8.4" ARRAY_SIZE 3 ECU_ADDRESS 0x80321A /end MEASUREMENT
/begin MEASUREMENT InjVCD_rZFCETCoeffMsk_mp "Gesamtbewertungsfaktor der Ansteuerdauerkorrektur durch Nullmengenkalibrierung" SWORD Prc 1 100 -327.6800 327.6700 FORMAT "%8.4" ECU_ADDRESS 0x803220 /end MEASUREMENT
/begin MEASUREMENT InjVCD_stAvrgEna "freigegebene Zylinder zur Mittelwertsberechnung" UBYTE OneToOne 1 100 0.00 255.0 FORMAT "%5.1" ECU_ADDRESS 0x7F9490 /end MEASUREMENT
/begin MEASUREMENT InjVCD_stAvrgEnaTiWarn "Warnung für geringe Zeitdifferenz" UBYTE OneToOne 1 100 0.00 255.0 FORMAT "%5.1" ECU_ADDRESS 0x7F9491 /end MEASUREMENT
/begin MEASUREMENT InjVCD_stBufC "Status des DC/DC-Wandler Komponententreibers" UBYTE OneToOne 1 100 0.00 255.0 FORMAT "%5.1" ECU_ADDRESS 0x7F9492 /end MEASUREMENT
/begin MEASUREMENT InjVCD_stCalcChrgActr "Zustand der Ladungsberechnung" UBYTE OneToOne 1 100 0.00 255.0 FORMAT "%5.1" ECU_ADDRESS 0x7F9494 /end MEASUREMENT
/begin MEASUREMENT InjVCD_stClsActr "Status der Piezoaktor-Klassifizierung" UBYTE Actr_Cls_State 1 100 0.00 4.00000000000 FORMAT "%13.11" ECU_ADDRESS 0x7F9495 /end MEASUREMENT
/begin MEASUREMENT InjVCD_stCY370Buf "Buffer(kondensator)status" UBYTE OneToOne 1 100 0.00 255.0 FORMAT "%5.1" ECU_ADDRESS 0x7F9493 /end MEASUREMENT
/begin MEASUREMENT InjVCD_stCY370Event_mp "Rueckgabewert des single event (0 = kein Fehler)" UBYTE OneToOne 1 100 0.00 255.0 FORMAT "%5.1" ECU_ADDRESS 0x80315D /end MEASUREMENT
/begin MEASUREMENT InjVCD_stInjBegMI1_mp "Status der Beginnprogrammierung der Haupteinspritzung" UBYTE OneToOne 1 100 0.00 255.0 FORMAT "%5.1" ECU_ADDRESS 0x80320A /end MEASUREMENT
/begin MEASUREMENT InjVCD_stInjBegPiI1_mp "Status der Förderbeginnprogrammierung für die Voreinspritzung" UBYTE OneToOne 1 100 0.00 255.0 FORMAT "%5.1" ECU_ADDRESS 0x80320E /end MEASUREMENT
/begin MEASUREMENT InjVCD_stInjBegPiI2_mp "Status der Einspritzbeginnprogrammierung für PiI2" UBYTE OneToOne 1 100 0.00 255.0 FORMAT "%5.1" ECU_ADDRESS 0x803212 /end MEASUREMENT
/begin MEASUREMENT InjVCD_stInjBegPiI3_mp "Status der Einspritzbeginnprogrammierung PiI3" UBYTE OneToOne 1 100 0.00 255.0 FORMAT "%5.1" ECU_ADDRESS 0x803216 /end MEASUREMENT
/begin MEASUREMENT InjVCD_stInjBegPoI1_mp "Status der Einspritzbeginnprogrammierung PoI1" UBYTE OneToOne 1 100 0.00 255.0 FORMAT "%5.1" ECU_ADDRESS 0x803217 /end MEASUREMENT
/begin MEASUREMENT InjVCD_stInjBegPoI2_mp "Status der Förderbeginnprogrammierung der Nacheinspritzung" UBYTE OneToOne 1 100 0.00 255.0 FORMAT "%5.1" ECU_ADDRESS 0x803218 /end MEASUREMENT
/begin MEASUREMENT InjVCD_stInjMI1_mp "Status der Haupteinspritzung-1-Programmierung" UBYTE OneToOne 1 100 0.00 255.0 FORMAT "%5.1" ECU_ADDRESS 0x803202 /end MEASUREMENT
/begin MEASUREMENT InjVCD_stInjMI2_mp "Status der Haupteinspritzung-2-Programmierung" UBYTE OneToOne 1 100 0.00 255.0 FORMAT "%5.1" ECU_ADDRESS 0x803203 /end MEASUREMENT
/begin MEASUREMENT InjVCD_stInjPiI1_mp "Status der Voreinspritzung-1-Programmierung" UBYTE OneToOne 1 100 0.00 255.0 FORMAT "%5.1" ECU_ADDRESS 0x803204 /end MEASUREMENT
/begin MEASUREMENT InjVCD_stInjPiI2_mp "Status der Voreinspritzung-2-Programmierung" UBYTE OneToOne 1 100 0.00 255.0 FORMAT "%5.1" ECU_ADDRESS 0x803205 /end MEASUREMENT
/begin MEASUREMENT InjVCD_stInjPiI3_mp "Status der Voreinspritzung-3-Programmierung" UBYTE OneToOne 1 100 0.00 255.0 FORMAT "%5.1" ECU_ADDRESS 0x803206 /end MEASUREMENT
/begin MEASUREMENT InjVCD_stInjPoI1_mp "Status der Nacheinspritzung-1-Programmierung" UBYTE OneToOne 1 100 0.00 255.0 FORMAT "%5.1" ECU_ADDRESS 0x803207 /end MEASUREMENT
/begin MEASUREMENT InjVCD_stInjPoI2_mp "Status der Nacheinspritzung-2-Programmierung" UBYTE OneToOne 1 100 0.00 255.0 FORMAT "%5.1" ECU_ADDRESS 0x803208 /end MEASUREMENT
/begin MEASUREMENT InjVCD_stInjZFC_mp "Status der ZFC Programmierung" UBYTE OneToOne 1 100 0.00 255.0 FORMAT "%5.1" ECU_ADDRESS 0x803209 /end MEASUREMENT
/begin MEASUREMENT InjVCD_stMeas "Zustand des Messkoordinators" UBYTE OneToOne 1 100 0.00 255.0 FORMAT "%5.1" ECU_ADDRESS 0x7F9496 /end MEASUREMENT
/begin MEASUREMENT InjVCD_stMeasLvl "Status des aufgetretenen Spannungsniveaus des Piezoaktors" UBYTE OneToOne 1 100 0.00 255.0 FORMAT "%5.1" ECU_ADDRESS 0x7F9498 /end MEASUREMENT
/begin MEASUREMENT InjVCD_stMeasLvlFirst "Status des aufgetretenen ersten Spannungsniveaus des Piezoaktors" UBYTE OneToOne 1 100 0.00 255.0 FORMAT "%5.1" ECU_ADDRESS 0x7F9499 /end MEASUREMENT
/begin MEASUREMENT InjVCD_stMonShCir "Status der Kurzschlussunterscheidung im Nachlauf" UBYTE stMonShCir 1 100 0.00 4.00000000000 FORMAT "%13.11" ECU_ADDRESS 0x7F949A /end MEASUREMENT
/begin MEASUREMENT InjVCD_stMonTiPlaus "Status der einspritzspezifisch gemessenen Ladezeit" UBYTE OneToOne 1 100 0.00 255.0 FORMAT "%5.1" ARRAY_SIZE 2 ECU_ADDRESS 0x7F9A1A /end MEASUREMENT
/begin MEASUREMENT InjVCD_stMonUBnkPlaus "Status der gemessenen Aktorspannung des Ansteuerverlaufs (Bank-spezifisch)" UBYTE OneToOne 1 100 0.00 255.0 FORMAT "%5.1" ARRAY_SIZE 2 ECU_ADDRESS 0x7F9A1C /end MEASUREMENT
/begin MEASUREMENT InjVCD_stMonUCylPlaus "Status der gemessenen Aktorspannung des Ansteuerverlaufs (zylinder-spezifisch)" UBYTE OneToOne 1 100 0.00 255.0 FORMAT "%5.1" ARRAY_SIZE 6 ECU_ADDRESS 0x7F9D28 /end MEASUREMENT
/begin MEASUREMENT InjVCD_stPolar "Status der Polarisierung der Piezo-Aktoren" UBYTE OneToOne 1 100 0.00 255.0 FORMAT "%5.1" ECU_ADDRESS 0x7F949B /end MEASUREMENT
/begin MEASUREMENT InjVCD_stPolarInjBeg_mp "Status nach Schreiben des Ansteuerbeginns bei der Polarisierung von Piezo-Aktoren" UBYTE OneToOne 1 100 0.00 255.0 FORMAT "%5.1" ECU_ADDRESS 0x803200 /end MEASUREMENT
/begin MEASUREMENT InjVCD_stPolarInjDur_mp "Status nach Schreiben der Ansteuerdauer bei der Polarisierung von Piezo-Aktoren" UBYTE OneToOne 1 100 0.00 255.0 FORMAT "%5.1" ECU_ADDRESS 0x803201 /end MEASUREMENT
/begin MEASUREMENT InjVCD_stShCirSelSwtCab "Status ""Cylinder-Select Schalter Kurzschluss"" und ""Kurzschluss zweier Injektorleitungen (lowside)""" UBYTE OneToOne 1 100 0.00 255.0 FORMAT "%5.1" ECU_ADDRESS 0x7F949C /end MEASUREMENT
/begin MEASUREMENT InjVCD_stShOffDCDC "Status der Schutzabschaltung des DC/DC-Wandlers" UBYTE OneToOne 1 100 0.00 255.0 FORMAT "%5.1" ECU_ADDRESS 0x7F949D /end MEASUREMENT
/begin MEASUREMENT InjVCD_stUBuf "Status der Bufferspannungsmessung" UBYTE OneToOne 1 100 0.00 255.0 FORMAT "%5.1" ECU_ADDRESS 0x7F949E /end MEASUREMENT
/begin MEASUREMENT InjVCD_stWaitPRailLow_mp "Status Raildruck" UBYTE OneToOne 1 100 0.00 255.0 FORMAT "%5.1" ECU_ADDRESS 0x803142 /end MEASUREMENT
/begin MEASUREMENT InjVCD_swtClsActr "Schalter zur Bestimmung der Aktorspannung für Piezoaktor-Klassifizierung" UBYTE Actr_Calc 1 100 0.00 1.00000000000 FORMAT "%13.11" ECU_ADDRESS 0x7F9A1E /end MEASUREMENT
/begin MEASUREMENT InjVCD_swtSelTemp "Message zum Zeigen der aktuellen Schalterstellung" UBYTE Actr_Temp_Sel 1 100 0.00 1.00000000000 FORMAT "%13.11" ECU_ADDRESS 0x7F949F /end MEASUREMENT
/begin MEASUREMENT InjVCD_tActr "Aktortemperatur" SWORD Temp_Cels 1 100 -3549.940 3003.560 FORMAT "%8.3" ECU_ADDRESS 0x7F9A20 /end MEASUREMENT
/begin MEASUREMENT InjVCD_tActr_mp "Basistemperatur zur Berechnung der Piezo-Aktortemperatur" SWORD Temp_Cels 1 100 -3549.940 3003.560 FORMAT "%8.3" ECU_ADDRESS 0x803132 /end MEASUREMENT
/begin MEASUREMENT InjVCD_tiChrgUpActr "Ladezeit vom Bottom zum Up Level" SWORD Time_Busy 1 100 -3276.800 3276.700 FORMAT "%8.3" ARRAY_SIZE 6 ECU_ADDRESS 0x7F9DCE /end MEASUREMENT
/begin MEASUREMENT InjVCD_tiChrgUpActrOld "Vorletzte Aktorladezeit nach Laden von bottom nach up Niveau" SWORD Time_Busy 1 100 -3276.800 3276.700 FORMAT "%8.3" ARRAY_SIZE 6 ECU_ADDRESS 0x7F9DDA /end MEASUREMENT
/begin MEASUREMENT InjVCD_tiCutAll_mp "Verkürzungszeit aller Kollisionen" SLONG InjTime_us 1 100 -2147483648.00 2147483647.00 FORMAT "%13.2" ECU_ADDRESS 0x803198 /end MEASUREMENT
/begin MEASUREMENT InjVCD_tiCutPrim_mp "Verkürzungszeit der Primärkollision" SLONG InjTime_us 1 100 -2147483648.00 2147483647.00 FORMAT "%13.2" ECU_ADDRESS 0x80319C /end MEASUREMENT
/begin MEASUREMENT InjVCD_tiCutScnd_mp "Verkürzungszeit der Sekundärkollision" SLONG InjTime_us 1 100 -2147483648.00 2147483647.00 FORMAT "%13.2" ECU_ADDRESS 0x8031A0 /end MEASUREMENT
/begin MEASUREMENT InjVCD_tiCY370ChrgRC "RC-Zeitkonstante vom CY370-Integrator für Ladungsberechnung" SWORD Time_Busy 1 100 -3276.800 3276.700 FORMAT "%8.3" ECU_ADDRESS 0x7F9A22 /end MEASUREMENT
/begin MEASUREMENT InjVCD_tiDisChBottActr "Entladezeit vom Up zum Bottom Level" SWORD Time_Busy 1 100 -3276.800 3276.700 FORMAT "%8.3" ARRAY_SIZE 6 ECU_ADDRESS 0x7F9DE6 /end MEASUREMENT
/begin MEASUREMENT InjVCD_tiETcalcMI1_mp "Berechnete Ansteuerdauer der Haupteinspritzung" SWORD InjTime_us 1 100 -32768.00 32767.00 FORMAT "%8.2" ECU_ADDRESS 0x7FD018 /end MEASUREMENT
/begin MEASUREMENT InjVCD_tiETcalcPiI1_mp "Berechnete Ansteuerdauer der Voreinspritzung 1" SWORD InjTime_us 1 100 -32768.00 32767.00 FORMAT "%8.2" ECU_ADDRESS 0x7FD01A /end MEASUREMENT
/begin MEASUREMENT InjVCD_tiETcalcPiI2_mp "Berechnete Ansteuerdauer der Voreinspritzung 2" SWORD InjTime_us 1 100 -32768.00 32767.00 FORMAT "%8.2" ECU_ADDRESS 0x7FD01C /end MEASUREMENT
/begin MEASUREMENT InjVCD_tiETcalcPiI3_mp "Berechnete Ansteuerdauer der Voreinspritzung 3" SWORD InjTime_us 1 100 -32768.00 32767.00 FORMAT "%8.2" ECU_ADDRESS 0x7FD01E /end MEASUREMENT
/begin MEASUREMENT InjVCD_tiETcalcPoI1_mp "Berechnete Ansteuerdauer der 1. Nacheinspritzung" SWORD InjTime_us 1 100 -32768.00 32767.00 FORMAT "%8.2" ECU_ADDRESS 0x7FD020 /end MEASUREMENT
/begin MEASUREMENT InjVCD_tiETcalcPoI2_mp "Berechnete Ansteuerdauer der 2. Nacheinspritzung" SWORD InjTime_us 1 100 -32768.00 32767.00 FORMAT "%8.2" ECU_ADDRESS 0x7FD022 /end MEASUREMENT
/begin MEASUREMENT InjVCD_tiETTempCorMI1_mp "Ansteuerdauerkorrektur der Haupteinspritzung durch Temperaturkorrektur" SWORD InjTime_us 1 100 -32768.00 32767.00 FORMAT "%8.2" ECU_ADDRESS 0x7FD024 /end MEASUREMENT
/begin MEASUREMENT InjVCD_tiETTempCorPiI1_mp "Ansteuerdauerkorrektur der Voreinspritzung 1 durch Temperaturkorrektur" SWORD InjTime_us 1 100 -32768.00 32767.00 FORMAT "%8.2" ECU_ADDRESS 0x7FD026 /end MEASUREMENT
/begin MEASUREMENT InjVCD_tiETTempCorPiI2_mp "Ansteuerdauerkorrektur der Voreinspritzung 2 durch Temperaturkorrektur" SWORD InjTime_us 1 100 -32768.00 32767.00 FORMAT "%8.2" ECU_ADDRESS 0x7FD028 /end MEASUREMENT
/begin MEASUREMENT InjVCD_tiETTempCorPiI3_mp "Ansteuerdauerkorrektur der Voreinspritzung 3 durch Temperaturkorrektur" SWORD InjTime_us 1 100 -32768.00 32767.00 FORMAT "%8.2" ECU_ADDRESS 0x7FD02A /end MEASUREMENT
/begin MEASUREMENT InjVCD_tiETTempCorPoI1_mp "Ansteuerdauerkorrektur der 1. Nacheinspritzung durch Temperaturkorrektur" SWORD InjTime_us 1 100 -32768.00 32767.00 FORMAT "%8.2" ECU_ADDRESS 0x7FD02C /end MEASUREMENT
/begin MEASUREMENT InjVCD_tiETTempCorPoI2_mp "Ansteuerdauerkorrektur der 2. Nacheinspritzung durch Temperaturkorrektur" SWORD InjTime_us 1 100 -32768.00 32767.00 FORMAT "%8.2" ECU_ADDRESS 0x7FD02E /end MEASUREMENT
/begin MEASUREMENT InjVCD_tiInjDurMi_mp "Ansteuerdauer der Haupteinspritzung" SLONG InjTime_us 1 100 -2147483648.00 2147483647.00 FORMAT "%13.2" ECU_ADDRESS 0x7FCFE8 /end MEASUREMENT
/begin MEASUREMENT InjVCD_tiInjDur_mp "Einspritztyp spezifische Ansteuerdauern" SLONG InjTime_us 1 100 -2147483648.00 2147483647.00 FORMAT "%13.2" ARRAY_SIZE 8 ECU_ADDRESS 0x7FCFEC /end MEASUREMENT
/begin MEASUREMENT InjVCD_tiMeasCycl "Abtastzeit der Aktormeßwerte" ULONG TimeDT 1 100 0.00 4294967295.00 FORMAT "%13.2" ECU_ADDRESS 0x7F9CEC /end MEASUREMENT
/begin MEASUREMENT InjVCD_tiMeasCyclCyl "Periodendauer der Messung aktorspezifischer Werte" ULONG TimeDT 1 100 0.00 4294967295.00 FORMAT "%13.2" ARRAY_SIZE 6 ECU_ADDRESS 0x7F9EA8 /end MEASUREMENT
/begin MEASUREMENT InjVCD_tiMI1ET_mp "Ansteuerdauer der Haupteinspritzung 1" SWORD InjTime_us 1 100 -32768.00 32767.00 FORMAT "%8.2" ECU_ADDRESS 0x7FD030 /end MEASUREMENT
/begin MEASUREMENT InjVCD_tiMonActrThresLo_mp "Zeitdifferenz zwischen Ladevorgang und Meßzeitpunkt" SLONG InjTime_us 1 100 -2147483648.00 2147483647.00 FORMAT "%13.2" ARRAY_SIZE 6 ECU_ADDRESS 0x8031B8 /end MEASUREMENT
/begin MEASUREMENT InjVCD_tiMonChrgUp_mp "Aktorladezeit im Nachlauf für Kurzschlussunterscheidung" SWORD Time_Busy 1 100 -3276.800 3276.700 FORMAT "%8.3" ARRAY_SIZE 6 ECU_ADDRESS 0x8031E8 /end MEASUREMENT
/begin MEASUREMENT InjVCD_tiMonShCirSort_mp "sortierte Aktorladezeiten" SWORD Time_Busy 1 100 -3276.800 3276.700 FORMAT "%8.3" ARRAY_SIZE 6 ECU_ADDRESS 0x8031F4 /end MEASUREMENT
/begin MEASUREMENT InjVCD_tiPiI1ET_mp "Ansteuerdauer der Voreinspritzung 1" SWORD InjTime_us 1 100 -32768.00 32767.00 FORMAT "%8.2" ECU_ADDRESS 0x7FD032 /end MEASUREMENT
/begin MEASUREMENT InjVCD_tiPiI1ZFCETCor_mp "Ansteuerdauerkorrektur der ZFC für Voreinspritzung 1 und jeden Zylinder" SWORD InjTime_us 1 100 -32768.00 32767.00 FORMAT "%8.2" ARRAY_SIZE 6 ECU_ADDRESS 0x803222 /end MEASUREMENT
/begin MEASUREMENT InjVCD_tiPiI2ET_mp "Ansteuerdauer der Voreinspritzung 2" SWORD InjTime_us 1 100 -32768.00 32767.00 FORMAT "%8.2" ECU_ADDRESS 0x7FD034 /end MEASUREMENT
/begin MEASUREMENT InjVCD_tiPiI2ZFCETCor_mp "Ansteuerdauerkorrektur der ZFC für Voreinspritzung 2 und jeden Zylinder" SWORD InjTime_us 1 100 -32768.00 32767.00 FORMAT "%8.2" ARRAY_SIZE 6 ECU_ADDRESS 0x80322E /end MEASUREMENT
/begin MEASUREMENT InjVCD_tiPiI3ET_mp "Ansteuerdauer der Voreinspritzung 3" SWORD InjTime_us 1 100 -32768.00 32767.00 FORMAT "%8.2" ECU_ADDRESS 0x7FD036 /end MEASUREMENT
/begin MEASUREMENT InjVCD_tiPiI3ZFCETCor_mp "Ansteuerdauerkorrektur der ZFC für Voreinspritzung 3 und jeden Zylinder" SWORD InjTime_us 1 100 -32768.00 32767.00 FORMAT "%8.2" ARRAY_SIZE 6 ECU_ADDRESS 0x80323A /end MEASUREMENT
/begin MEASUREMENT InjVCD_tiPoI1ET_mp "Ansteuerdauer Nacheinspritzung 1" SWORD InjTime_us 1 100 -32768.00 32767.00 FORMAT "%8.2" ECU_ADDRESS 0x7FD038 /end MEASUREMENT
/begin MEASUREMENT InjVCD_tiPoI2ET_mp "Ansteuerdauer der Nacheinspritzung 2" SWORD InjTime_us 1 100 -32768.00 32767.00 FORMAT "%8.2" ECU_ADDRESS 0x7FD03A /end MEASUREMENT
/begin MEASUREMENT InjVCD_tiShiftAll_mp "Verschiebezeit aller Kollisionen" SLONG InjTime_us 1 100 -2147483648.00 2147483647.00 FORMAT "%13.2" ECU_ADDRESS 0x8031A4 /end MEASUREMENT
/begin MEASUREMENT InjVCD_tiShiftPrim_mp "Verschiebezeit der Primärkollision" SLONG InjTime_us 1 100 -2147483648.00 2147483647.00 FORMAT "%13.2" ECU_ADDRESS 0x8031A8 /end MEASUREMENT
/begin MEASUREMENT InjVCD_tiShiftScnd_mp "Verschiebezeit der Sekundärkollision" SLONG InjTime_us 1 100 -2147483648.00 2147483647.00 FORMAT "%13.2" ECU_ADDRESS 0x8031AC /end MEASUREMENT
/begin MEASUREMENT InjVCD_tiUpOri_mp "Busy-Zeit des CY370 - Einspritzbeginn-Typ  0:VE2, 1:VE1, 2:HE, 3:NE" SWORD Time_Busy 1 100 -3276.800 3276.700 FORMAT "%8.3" ARRAY_SIZE 6 ECU_ADDRESS 0x7FD00C /end MEASUREMENT
/begin MEASUREMENT InjVCD_tiZFCPiI1ETCor_mp "ZFC Ansteuerdauerkorrektur fuer Voreinspritzung 1" SWORD InjTime_us 1 100 -32768.00 32767.00 FORMAT "%8.2" ECU_ADDRESS 0x7FD03C /end MEASUREMENT
/begin MEASUREMENT InjVCD_tiZFCPiI2ETCor_mp "ZFC Ansteuerdauerkorrektur fuer Voreinspritzung 2" SWORD InjTime_us 1 100 -32768.00 32767.00 FORMAT "%8.2" ECU_ADDRESS 0x7FD03E /end MEASUREMENT
/begin MEASUREMENT InjVCD_tiZFCPiI3ETCor_mp "ZFC Ansteuerdauerkorrektur fuer Voreinspritzung 3" SWORD InjTime_us 1 100 -32768.00 32767.00 FORMAT "%8.2" ECU_ADDRESS 0x7FD040 /end MEASUREMENT
/begin MEASUREMENT InjVCD_tTempCor_mp "Eingangstemperatur am Kennfeld InjVCD_rETTempCor_mp" SWORD Temp_Cels 1 100 -3549.940 3003.560 FORMAT "%8.3" ECU_ADDRESS 0x7FD042 /end MEASUREMENT
/begin MEASUREMENT InjVCD_uBottActr "Spannung - Bottom Position - Ventil geschlossen" SWORD Volt_PA 1 100 -327.6800 327.6700 FORMAT "%8.4" ARRAY_SIZE 6 ECU_ADDRESS 0x7F9DF2 /end MEASUREMENT
/begin MEASUREMENT InjVCD_uBuf "Wert der Bufferspannung" SWORD Volt_BUFC 1 100 -327.6800 327.6700 FORMAT "%8.4" ECU_ADDRESS 0x7F9A24 /end MEASUREMENT
/begin MEASUREMENT InjVCD_uBufRaw_mp "Rohwert der Bufferspannung" SWORD Volt 1 100 -160156.4 160151.5 FORMAT "%8.1" ECU_ADDRESS 0x8031B6 /end MEASUREMENT
/begin MEASUREMENT InjVCD_uChgUp_mp "Spannung vom Integrator für die Injektor Ladung zum UP NIveau" SWORD Volt 1 100 -160156.4 160151.5 FORMAT "%8.1" ECU_ADDRESS 0x80312A /end MEASUREMENT
/begin MEASUREMENT InjVCD_uClsBegin_mp "Aktorspezifisch gemessene Beginnspannung während der Piezoaktor Klassifizierung" SWORD Volt_PA 1 100 -327.6800 327.6700 FORMAT "%8.4" ARRAY_SIZE 6 ECU_ADDRESS 0x803144 /end MEASUREMENT
/begin MEASUREMENT InjVCD_uClsEnd_mp "Aktorspezifisch gemessene Endspannung während der Piezoaktor Klassifizierung" SWORD Volt_PA 1 100 -327.6800 327.6700 FORMAT "%8.4" ARRAY_SIZE 6 ECU_ADDRESS 0x803150 /end MEASUREMENT
/begin MEASUREMENT InjVCD_uCY370ChrgIntWp "Spannungs-Arbeitspunkt vom CY370-Integrator zur Ladungsberechnung" SWORD Volt 1 100 -160156.4 160151.5 FORMAT "%8.1" ECU_ADDRESS 0x7F9A26 /end MEASUREMENT
/begin MEASUREMENT InjVCD_uCY370ChrgOff "Spannungsoffset vom CY370-Integrator zur Ladungsberechnung" SWORD VoltInt 1 100 -160.1564 160.1515 FORMAT "%8.4" ECU_ADDRESS 0x7F9A28 /end MEASUREMENT
/begin MEASUREMENT InjVCD_uIntComp_mp "Kompensationsspannung für Abfall der Integrator-Ausgangsspannung" SWORD Volt 1 100 -160156.4 160151.5 FORMAT "%8.1" ECU_ADDRESS 0x803134 /end MEASUREMENT
/begin MEASUREMENT InjVCD_uMonThresHi_mp "Schwelle fuer Spannungsplausibilisierung, Verletzung oben (index : 0=BOTT, 1=UP)" SWORD Volt_PA 1 100 -327.6800 327.6700 FORMAT "%8.4" ARRAY_SIZE 2 ECU_ADDRESS 0x8031D0 /end MEASUREMENT
/begin MEASUREMENT InjVCD_uMonThresLo_mp "Schwelle fuer Spannungsplausibilisierung, Verletzung unten (index : 0=BOTT, 1=UP)" SWORD Volt_PA 1 100 -327.6800 327.6700 FORMAT "%8.4" ARRAY_SIZE 2 ECU_ADDRESS 0x8031D4 /end MEASUREMENT
/begin MEASUREMENT InjVCD_uRawBott_mp "Aktor - Rohspannung (ADC)  - Ansteuerende (Messreihe)" SWORD Volt 1 100 -160156.4 160151.5 FORMAT "%8.1" ECU_ADDRESS 0x80312C /end MEASUREMENT
/begin MEASUREMENT InjVCD_uRawChgUp_mp "Rohspannung vom Integrator für die Injektorladung zum UP Niveau" SWORD Volt 1 100 -160156.4 160151.5 FORMAT "%8.1" ECU_ADDRESS 0x80312E /end MEASUREMENT
/begin MEASUREMENT InjVCD_uRawCY370Int0_mp "gemessene Roh-Spannung von Integratorabgleich (für INCA)" SWORD Volt 1 100 -160156.4 160151.5 FORMAT "%8.1" ECU_ADDRESS 0x80315E /end MEASUREMENT
/begin MEASUREMENT InjVCD_uRawCY370Int_mp "gemessene Roh-Spannungen vom Integratorabgleich" SWORD Volt 1 100 -160156.4 160151.5 FORMAT "%8.1" ARRAY_SIZE 3 ECU_ADDRESS 0x803160 /end MEASUREMENT
/begin MEASUREMENT InjVCD_uRawUp_mp "Aktor - Rohspannung (ADC)  - Ansteuerbeginn (Messreihe)" SWORD Volt 1 100 -160156.4 160151.5 FORMAT "%8.1" ECU_ADDRESS 0x803130 /end MEASUREMENT
/begin MEASUREMENT InjVCD_uSetThresActr "verwendete Spannungsschwelle die bei letzter Aktormessung gültig war" SWORD Volt_PA 1 100 -327.6800 327.6700 FORMAT "%8.4" ARRAY_SIZE 6 ECU_ADDRESS 0x7F9DFE /end MEASUREMENT
/begin MEASUREMENT InjVCD_uSetUpActr "Spannungssollwert für Regler" SWORD Volt_PA 1 100 -327.6800 327.6700 FORMAT "%8.4" ARRAY_SIZE 6 ECU_ADDRESS 0x7F9E0A /end MEASUREMENT
/begin MEASUREMENT InjVCD_uUpActr "Spannung - Up Position - Ventil geöffnet" SWORD Volt_PA 1 100 -327.6800 327.6700 FORMAT "%8.4" ARRAY_SIZE 6 ECU_ADDRESS 0x7F9E16 /end MEASUREMENT
/begin MEASUREMENT InjVCD_uValCY370Int_mp "linearisierte Spannungen von Integratorabgleich" SWORD Volt 1 100 -160156.4 160151.5 FORMAT "%8.1" ARRAY_SIZE 3 ECU_ADDRESS 0x803166 /end MEASUREMENT
/begin MEASUREMENT InjVCD_volInET_mp "Y-Eingang des Kennfeldes InjVCD_tiET_MAP auf dem Applikationswerkzeug" SWORD InjQntInj 1 100 -327.6800 327.6700 FORMAT "%8.4" ECU_ADDRESS 0x8031B2 /end MEASUREMENT
/begin MEASUREMENT InjVCD_volInTempCor_mp "Einspritzvolumen, das fuer die temperaturabh. AD-Korrektur verwendet wird" SWORD InjQntInj 1 100 -327.6800 327.6700 FORMAT "%8.4" ECU_ADDRESS 0x80316C /end MEASUREMENT
/begin MEASUREMENT InjVlv_ctMonActrMeas "Zaehler für gemessene Aktoren" UBYTE OneToOne 1 100 0.00 255.0 FORMAT "%5.1" ECU_ADDRESS 0x7F94A0 /end MEASUREMENT
/begin MEASUREMENT InjVlv_ctMonQckIDiff_mp "Anzahl der IDiff-Fehler zur Schnell-Erkennung der Kurzschlüsse nach Batterie und Masse" UBYTE OneToOne 1 100 0.00 255.0 FORMAT "%5.1" ECU_ADDRESS 0x803292 /end MEASUREMENT
/begin MEASUREMENT InjVlv_ctMonQckISel_mp "Anzahl der ISel-Fehler zur Schnell-Erkennung der Kurzschlüsse nach Batterie und Masse" UBYTE OneToOne 1 100 0.00 255.0 FORMAT "%5.1" ECU_ADDRESS 0x803293 /end MEASUREMENT
/begin MEASUREMENT InjVlv_facAddBalRls "Ergebniss aus Freigabekennfeld zur Aufrechnung der Mengenkorrektur als Array (zylinderspezifisch)" SWORD Fact 1 100 -4.000000 3.999878 FORMAT "%8.6" ARRAY_SIZE 6 ECU_ADDRESS 0x7F9E22 /end MEASUREMENT
/begin MEASUREMENT InjVlv_facFTSWvCor "Faktor der Druckwellenkorrektur abhängig von der Kraftstofftemperatur" SWORD Fact 1 100 -4.000000 3.999878 FORMAT "%8.6" ECU_ADDRESS 0x7F9A2A /end MEASUREMENT
/begin MEASUREMENT InjVlv_facMI1PoI2WvCor_mp "Druckwellenkorrekturfaktor für PoI2" SWORD Fact1 1 100 -256.0000 255.9922 FORMAT "%8.4" ECU_ADDRESS 0x803324 /end MEASUREMENT
/begin MEASUREMENT InjVlv_facNVCActr "NVC-Faktor" SWORD Fact 1 100 -4.000000 3.999878 FORMAT "%8.6" ARRAY_SIZE 6 ECU_ADDRESS 0x7F9E2E /end MEASUREMENT
/begin MEASUREMENT InjVlv_facPCorQ_mp "mengenabhängiger Korrekturfaktor für Druckwellenkorrektur" SWORD Fact 1 100 -4.000000 3.999878 FORMAT "%8.6" ECU_ADDRESS 0x803256 /end MEASUREMENT
/begin MEASUREMENT InjVlv_facPCorTi_mp "einspritzabstandsabhängiger Korrekturfaktor für Druckwellenkorrektur" SWORD Fact 1 100 -4.000000 3.999878 FORMAT "%8.6" ECU_ADDRESS 0x803258 /end MEASUREMENT
/begin MEASUREMENT InjVlv_facPCor_mp "Korrekturfaktor für Druckwellenkorrektur" SWORD Fact 1 100 -4.000000 3.999878 FORMAT "%8.6" ECU_ADDRESS 0x80325A /end MEASUREMENT
/begin MEASUREMENT InjVlv_facPiI2PiI1WvCor_mp "Druckwellenkorrekturfaktor der PiI1" SWORD Fact1 1 100 -256.0000 255.9922 FORMAT "%8.4" ECU_ADDRESS 0x803326 /end MEASUREMENT
/begin MEASUREMENT InjVlv_facPiIMI1WvCor_mp "Druckwellenkorrekturfaktor der MI1" SWORD Fact1 1 100 -256.0000 255.9922 FORMAT "%8.4" ECU_ADDRESS 0x803328 /end MEASUREMENT
/begin MEASUREMENT InjVlv_facVoltCorUp "temperaturabhängiger Korrekturfaktor für Spannungssollwert" SWORD Fact 1 100 -4.000000 3.999878 FORMAT "%8.6" ECU_ADDRESS 0x7F9A2C /end MEASUREMENT
/begin MEASUREMENT InjVlv_iDCDC_mp "DCDC Strom" SWORD Curr 1 100 -32768.00 32767.00 FORMAT "%8.2" ECU_ADDRESS 0x803290 /end MEASUREMENT
/begin MEASUREMENT InjVlv_nCyl "Zylinderspezifische Drehzahl für alle Zylinder" SWORD EngN 1 100 -32768.00 32767.00 FORMAT "%8.2" ARRAY_SIZE 6 ECU_ADDRESS 0x7F9E3A /end MEASUREMENT
/begin MEASUREMENT InjVlv_numClsVltgAdjActr "zylinderspezifische ISA-Klasse" SWORD OneToOne 1 100 -32768.00 32767.00 FORMAT "%8.2" ARRAY_SIZE 6 ECU_ADDRESS 0x7F9E46 /end MEASUREMENT
/begin MEASUREMENT InjVlv_numCodeVltgAdj_mp "Injektorspannungsabgleich Codes" UBYTE ISA_Code 1 100 0.00 31.0000000000 FORMAT "%13.10" ARRAY_SIZE 6 ECU_ADDRESS 0x803304 /end MEASUREMENT
/begin MEASUREMENT InjVlv_numIdxErrCyl1_mp "Indizes erkannter Muster für Zylinder 1" ULONG OneToOne 1 100 0.00 4294967295.00 FORMAT "%13.2" ECU_ADDRESS 0x803298 /end MEASUREMENT
/begin MEASUREMENT InjVlv_numIdxErrCyl2_mp "Indizes erkannter Muster für Zylinder 2" ULONG OneToOne 1 100 0.00 4294967295.00 FORMAT "%13.2" ECU_ADDRESS 0x80329C /end MEASUREMENT
/begin MEASUREMENT InjVlv_numIdxErrCyl3_mp "Indizes erkannter Muster für Zylinder 3" ULONG OneToOne 1 100 0.00 4294967295.00 FORMAT "%13.2" ECU_ADDRESS 0x8032A0 /end MEASUREMENT
/begin MEASUREMENT InjVlv_numIdxErrCyl4_mp "Indizes erkannter Muster für Zylinder 4" ULONG OneToOne 1 100 0.00 4294967295.00 FORMAT "%13.2" ECU_ADDRESS 0x8032A4 /end MEASUREMENT
/begin MEASUREMENT InjVlv_numIdxErrCyl5_mp "Indizes erkannter Muster für Zylinder 5" ULONG OneToOne 1 100 0.00 4294967295.00 FORMAT "%13.2" ECU_ADDRESS 0x8032A8 /end MEASUREMENT
/begin MEASUREMENT InjVlv_numIdxErrCyl6_mp "Indizes erkannter Muster für Zylinder 6" ULONG OneToOne 1 100 0.00 4294967295.00 FORMAT "%13.2" ECU_ADDRESS 0x8032AC /end MEASUREMENT
/begin MEASUREMENT InjVlv_numIdxErrCyl7_mp "Indizes erkannter Muster für Zylinder 7" ULONG OneToOne 1 100 0.00 4294967295.00 FORMAT "%13.2" ECU_ADDRESS 0x8032B0 /end MEASUREMENT
/begin MEASUREMENT InjVlv_numIdxErrCyl8_mp "Indizes erkannter Muster für Zylinder 8" ULONG OneToOne 1 100 0.00 4294967295.00 FORMAT "%13.2" ECU_ADDRESS 0x8032B4 /end MEASUREMENT
/begin MEASUREMENT InjVlv_numInjChrgBal_mp "Maximale Anzahl an Einspritzungen aufgrund der Ladungsbilanz des Boosterkondensators" UBYTE OneToOne 1 100 0.00 255.0 FORMAT "%5.1" ECU_ADDRESS 0x80328E /end MEASUREMENT
/begin MEASUREMENT InjVlv_pAct_mp "aktueller Raildruck ermittelt in InjVlv" SWORD Pres_Rail 1 100 -3276800. 3276700. FORMAT "%8.0" ECU_ADDRESS 0x803322 /end MEASUREMENT
/begin MEASUREMENT InjVlv_pCalcVolt "für die Aktorspannungsberechnung relevanter Raildruck" SWORD Pres_Rail 1 100 -3276800. 3276700. FORMAT "%8.0" ECU_ADDRESS 0x7F9A2E /end MEASUREMENT
/begin MEASUREMENT InjVlv_pCorBase_mp "Raildruck-Korrekturgrundwert für Druckwellenkorrektur" SWORD Pres_Rail 1 100 -3276800. 3276700. FORMAT "%8.0" ECU_ADDRESS 0x80325C /end MEASUREMENT
/begin MEASUREMENT InjVlv_pPoI2WvCorOfsActr_mp "zyl. spezifischer Raildruck-Offset für Druckwellenkorrektur von PoI2" SWORD Pres_Rail 1 100 -3276800. 3276700. FORMAT "%8.0" ARRAY_SIZE 6 ECU_ADDRESS 0x80325E /end MEASUREMENT
/begin MEASUREMENT InjVlv_pRailCorPoI2Actr_mp "zyl. spezifischer druckwellenkorrigierter Raildruck für PoI2" SWORD Pres_Rail 1 100 -3276800. 3276700. FORMAT "%8.0" ARRAY_SIZE 6 ECU_ADDRESS 0x80326A /end MEASUREMENT
/begin MEASUREMENT InjVlv_pwrInjAvrg_mp "durchschnittliche Ansteuer-Verlustleistung bei einer Ansteuerung pro Zylinder und Arbeitshub" SWORD Pwr_PA 1 100 -32768.00 32767.00 FORMAT "%8.2" ECU_ADDRESS 0x803288 /end MEASUREMENT
/begin MEASUREMENT InjVlv_qDes_mp "Einspritzmenge für Druckwellenkorrektur" SWORD InjMassInj 1 100 -327.6800 327.6700 FORMAT "%8.4" ECU_ADDRESS 0x803276 /end MEASUREMENT
/begin MEASUREMENT InjVlv_qFBCCyl "Zylinderselektive FBC-Mengenkorrektur für alle Zylinder" SWORD InjMass 1 100 -327.6800 327.6700 FORMAT "%8.4" ARRAY_SIZE 6 ECU_ADDRESS 0x7F9E52 /end MEASUREMENT
/begin MEASUREMENT InjVlv_qMI1Bal_mp "Korrekturmenge Haupteinspritung 1" SWORD InjMassInj 1 100 -327.6800 327.6700 FORMAT "%8.4" ECU_ADDRESS 0x803248 /end MEASUREMENT
/begin MEASUREMENT InjVlv_qMI1PoI2WvCor_mp "Grundwert der Druckwellenkorrekturmenge der PoI2" SWORD InjMassInj 1 100 -327.6800 327.6700 FORMAT "%8.4" ECU_ADDRESS 0x80332A /end MEASUREMENT
/begin MEASUREMENT InjVlv_qMI1WvCor_mp "Druckwellenkorrekturmenge der MI1" SWORD InjMassInj 1 100 -327.6800 327.6700 FORMAT "%8.4" ECU_ADDRESS 0x80332C /end MEASUREMENT
/begin MEASUREMENT InjVlv_qPiI1Bal_mp "Korrekturmenge Voreinspritzung 1" SWORD InjMassInj 1 100 -327.6800 327.6700 FORMAT "%8.4" ECU_ADDRESS 0x80324A /end MEASUREMENT
/begin MEASUREMENT InjVlv_qPiI1MI1WvCor_mp "Grundwert der Druckwellenkorrekturmenge der MI1 abhängig von PiI1" SWORD InjMassInj 1 100 -327.6800 327.6700 FORMAT "%8.4" ECU_ADDRESS 0x80332E /end MEASUREMENT
/begin MEASUREMENT InjVlv_qPiI1WvCor_mp "Druckwellenkorrekturmenge der PiI1" SWORD InjMassInj 1 100 -327.6800 327.6700 FORMAT "%8.4" ECU_ADDRESS 0x803330 /end MEASUREMENT
/begin MEASUREMENT InjVlv_qPiI2Bal_mp "Korrekturmenge Voreinspritzung 2" SWORD InjMassInj 1 100 -327.6800 327.6700 FORMAT "%8.4" ECU_ADDRESS 0x80324C /end MEASUREMENT
/begin MEASUREMENT InjVlv_qPiI2MI1WvCor_mp "Grundwert der Druckwellenkorrekturmenge der MI1 abhängig von PiI2" SWORD InjMassInj 1 100 -327.6800 327.6700 FORMAT "%8.4" ECU_ADDRESS 0x803332 /end MEASUREMENT
/begin MEASUREMENT InjVlv_qPiI2PiI1WvCor_mp "Grundwert der Druckwellenkorrekturmenge der PiI1" SWORD InjMassInj 1 100 -327.6800 327.6700 FORMAT "%8.4" ECU_ADDRESS 0x803334 /end MEASUREMENT
/begin MEASUREMENT InjVlv_qPiI3Bal_mp "Korrekturmenge Voreinspritzung 3" SWORD InjMassInj 1 100 -327.6800 327.6700 FORMAT "%8.4" ECU_ADDRESS 0x80324E /end MEASUREMENT
/begin MEASUREMENT InjVlv_qPoI1Bal_mp "Korrekturmenge Nacheinspritzung 1" SWORD InjMassInj 1 100 -327.6800 327.6700 FORMAT "%8.4" ECU_ADDRESS 0x803250 /end MEASUREMENT
/begin MEASUREMENT InjVlv_qPoI2BalEff_mp "Korrekturmenge für Nacheinspritzung 2, Moment bildender Teil" SWORD InjMassInj 1 100 -327.6800 327.6700 FORMAT "%8.4" ECU_ADDRESS 0x803252 /end MEASUREMENT
/begin MEASUREMENT InjVlv_qPoI2Bal_mp "Korrekturmenge Nacheinspritzung 2" SWORD InjMassInj 1 100 -327.6800 327.6700 FORMAT "%8.4" ECU_ADDRESS 0x803254 /end MEASUREMENT
/begin MEASUREMENT InjVlv_qPoI2WvCor_mp "Druckwellenkorrekturmenge der PoI2" SWORD InjMassInj 1 100 -327.6800 327.6700 FORMAT "%8.4" ECU_ADDRESS 0x803336 /end MEASUREMENT
/begin MEASUREMENT InjVlv_qWvCorNorm "Einspritznormierungsmenge" SWORD InjMassInj 1 100 -327.6800 327.6700 FORMAT "%8.4" ECU_ADDRESS 0x7F9A30 /end MEASUREMENT
/begin MEASUREMENT InjVlv_rMI1WvCorNorm_mp "Raildruckabhängiges normiertes MI1 Einspritzverhältnis für Druckwellenkorrektur" SWORD QntR 1 100 -32.00000 31.99902 FORMAT "%8.5" ECU_ADDRESS 0x803338 /end MEASUREMENT
/begin MEASUREMENT InjVlv_stAdj_mp "Zustand der Codes für den Injektorspannungsabgleich" UBYTE VltgAdj 1 100 0.00 8.00000000000 FORMAT "%13.11" ECU_ADDRESS 0x80330A /end MEASUREMENT
/begin MEASUREMENT InjVlv_stCheckSumErrVltgAdj_mp "Ckecksummenfehler der Abgleichwerte" UBYTE OneToOne 1 100 0.00 255.0 FORMAT "%5.1" ECU_ADDRESS 0x80330B /end MEASUREMENT
/begin MEASUREMENT InjVlv_stErrClctCyl1_mp "gesammelte Fehlermeldungen für Zylinder 1" ULONG OneToOne 1 100 0.00 4294967295.00 FORMAT "%13.2" ECU_ADDRESS 0x8032B8 /end MEASUREMENT
/begin MEASUREMENT InjVlv_stErrClctCyl2_mp "gesammelte Fehlermeldungen für Zylinder 2" ULONG OneToOne 1 100 0.00 4294967295.00 FORMAT "%13.2" ECU_ADDRESS 0x8032BC /end MEASUREMENT
/begin MEASUREMENT InjVlv_stErrClctCyl3_mp "gesammelte Fehlermeldungen für Zylinder 3" ULONG OneToOne 1 100 0.00 4294967295.00 FORMAT "%13.2" ECU_ADDRESS 0x8032C0 /end MEASUREMENT
/begin MEASUREMENT InjVlv_stErrClctCyl4_mp "gesammelte Fehlermeldungen für Zylinder 4" ULONG OneToOne 1 100 0.00 4294967295.00 FORMAT "%13.2" ECU_ADDRESS 0x8032C4 /end MEASUREMENT
/begin MEASUREMENT InjVlv_stErrClctCyl5_mp "gesammelte Fehlermeldungen für Zylinder 5" ULONG OneToOne 1 100 0.00 4294967295.00 FORMAT "%13.2" ECU_ADDRESS 0x8032C8 /end MEASUREMENT
/begin MEASUREMENT InjVlv_stErrClctCyl6_mp "gesammelte Fehlermeldungen für Zylinder 6" ULONG OneToOne 1 100 0.00 4294967295.00 FORMAT "%13.2" ECU_ADDRESS 0x8032CC /end MEASUREMENT
/begin MEASUREMENT InjVlv_stErrClctCyl7_mp "gesammelte Fehlermeldungen für Zylinder 7" ULONG OneToOne 1 100 0.00 4294967295.00 FORMAT "%13.2" ECU_ADDRESS 0x8032D0 /end MEASUREMENT
/begin MEASUREMENT InjVlv_stErrClctCyl8_mp "gesammelte Fehlermeldungen für Zylinder 8" ULONG OneToOne 1 100 0.00 4294967295.00 FORMAT "%13.2" ECU_ADDRESS 0x8032D4 /end MEASUREMENT
/begin MEASUREMENT InjVlv_stErrUnknown_mp "Fehlermuster des letzten nicht klassifizierbaren Fehlers" ULONG OneToOne 1 100 0.00 4294967295.00 FORMAT "%13.2" ECU_ADDRESS 0x8032D8 /end MEASUREMENT
/begin MEASUREMENT InjVlv_stInjValve "Anfrage an den Abschaltkoordinator bei ""multiple No Load""." UBYTE OneToOne 1 100 0.00 255.0 FORMAT "%5.1" ECU_ADDRESS 0x7F94A1 /end MEASUREMENT
/begin MEASUREMENT InjVlv_stMaxErrVltgAdj_mp "Aktorspezifischer Maximum Fehler im Code für den Injektorspannungsabgleich" UBYTE OneToOne 1 100 0.00 255.0 FORMAT "%5.1" ECU_ADDRESS 0x80330C /end MEASUREMENT
/begin MEASUREMENT InjVlv_stMonDiag "Zustand Diagnose (0 : gesperrt, 1 : freigegeben)" UBYTE OneToOne 1 100 0.00 255.0 FORMAT "%5.1" ECU_ADDRESS 0x7F94A2 /end MEASUREMENT
/begin MEASUREMENT InjVlv_stMonQckErr_mp "Status der Schnell-Erkennung der Kurzschlüsse nach Batterie und Masse" UBYTE OneToOne 1 100 0.00 255.0 FORMAT "%5.1" ECU_ADDRESS 0x803294 /end MEASUREMENT
/begin MEASUREMENT InjVlv_stNVCCrit_mp "Statusanzeige der Kriterien für die Freigabe der NVC" UBYTE OneToOne 1 100 0.00 255.0 FORMAT "%5.1" ECU_ADDRESS 0x8032DC /end MEASUREMENT
/begin MEASUREMENT InjVlv_stNVCEna "zylinderspezifische Anzeige, ob die NVC aktiv ist" UBYTE OneToOne 1 100 0.00 255.0 FORMAT "%5.1" ECU_ADDRESS 0x7F94A3 /end MEASUREMENT
/begin MEASUREMENT InjVlv_stNVCPI "Statusanzeige des NVC-Reglers" UBYTE OneToOne 1 100 0.00 255.0 FORMAT "%5.1" ARRAY_SIZE 6 ECU_ADDRESS 0x7F9D2E /end MEASUREMENT
/begin MEASUREMENT InjVlv_stWvCor "Status der Druckwellenkorrektur" UBYTE OneToOne 1 100 0.00 255.0 FORMAT "%5.1" ECU_ADDRESS 0x7F94A4 /end MEASUREMENT
/begin MEASUREMENT InjVlv_tActr_mp "Temperatur des Piezo-Aktors" SWORD Temp_Cels 1 100 -3549.940 3003.560 FORMAT "%8.3" ECU_ADDRESS 0x803278 /end MEASUREMENT
/begin MEASUREMENT InjVlv_tiMI1DiffHydCor_mp "Differenz zwischen hydraulischem Nadelschliessende und elektrischem Ansteuerende des Injektors für die MI1" SWORD InjTime_us 1 100 -32768.00 32767.00 FORMAT "%8.2" ECU_ADDRESS 0x80331A /end MEASUREMENT
/begin MEASUREMENT InjVlv_tiMI1PoI2Cor_mp "korrigierter Zeitabstand Ende MI1 bis Beginn PoI2" SWORD InjTime_us 1 100 -32768.00 32767.00 FORMAT "%8.2" ECU_ADDRESS 0x80333A /end MEASUREMENT
/begin MEASUREMENT InjVlv_tiMI1PoI2_mp "Zeitabstand ende MI1 bis Beginn PoI2" UWORD InjTime_us 1 100 0.00 65535.00 FORMAT "%8.2" ECU_ADDRESS 0x80333C /end MEASUREMENT
/begin MEASUREMENT InjVlv_tiPiI1DiffHydCor_mp "Differenz zwischen hydraulischem Nadelschliessende und elektrischem Ansteuerende des Injektors für die PiI1" SWORD InjTime_us 1 100 -32768.00 32767.00 FORMAT "%8.2" ECU_ADDRESS 0x80331C /end MEASUREMENT
/begin MEASUREMENT InjVlv_tiPiI1MI1Cor_mp "korrigierter Zeitabstand Ende PiI1 bis Beginn MI1" SWORD InjTime_us 1 100 -32768.00 32767.00 FORMAT "%8.2" ECU_ADDRESS 0x80333E /end MEASUREMENT
/begin MEASUREMENT InjVlv_tiPiI1MI1_mp "korrigierter Zeitabstand Ende PiI1 bis Beginn MI1" UWORD InjTime_us 1 100 0.00 65535.00 FORMAT "%8.2" ECU_ADDRESS 0x803340 /end MEASUREMENT
/begin MEASUREMENT InjVlv_tiPiI2DiffHydCor_mp "Differenz zwischen hydraulischem Nadelschliessende und elektrischem Ansteuerende des Injektors für die PiI2" SWORD InjTime_us 1 100 -32768.00 32767.00 FORMAT "%8.2" ECU_ADDRESS 0x80331E /end MEASUREMENT
/begin MEASUREMENT InjVlv_tiPiI2MI1Cor_mp "korrigierter Zeitabstand Ende PiI2 bis Beginn MI1" SWORD InjTime_us 1 100 -32768.00 32767.00 FORMAT "%8.2" ECU_ADDRESS 0x803342 /end MEASUREMENT
/begin MEASUREMENT InjVlv_tiPiI2MI1_mp "Zeitabstand Ende PiI2 bis Beginn MI1" UWORD InjTime_us 1 100 0.00 65535.00 FORMAT "%8.2" ECU_ADDRESS 0x803344 /end MEASUREMENT
/begin MEASUREMENT InjVlv_tiPiI2PiI1Cor_mp "korrigierter Zeitabstand Ende PiI2 bis Beginn PiI1" SWORD InjTime_us 1 100 -32768.00 32767.00 FORMAT "%8.2" ECU_ADDRESS 0x803346 /end MEASUREMENT
/begin MEASUREMENT InjVlv_tiPiI2PiI1_mp "Zeitabstand Ende PiI2 bis Beginn PiI1" UWORD InjTime_us 1 100 0.00 65535.00 FORMAT "%8.2" ECU_ADDRESS 0x803348 /end MEASUREMENT
/begin MEASUREMENT InjVlv_tWvCor_mp "Eingangstemperatur fuer die Druckwellenkorrektur" SWORD Temp_Cels 1 100 -3549.940 3003.560 FORMAT "%8.3" ECU_ADDRESS 0x803320 /end MEASUREMENT
/begin MEASUREMENT InjVlv_uDiffNVCActrInPI_mp "Eingangswert der NVC-Reglers" SWORD Volt_PA 1 100 -327.6800 327.6700 FORMAT "%8.4" ARRAY_SIZE 6 ECU_ADDRESS 0x8032DE /end MEASUREMENT
/begin MEASUREMENT InjVlv_uDiffNVCActr_mp "aktuelle Spannungsdifferenz" SWORD Volt_PA 1 100 -327.6800 327.6700 FORMAT "%8.4" ARRAY_SIZE 6 ECU_ADDRESS 0x8032EA /end MEASUREMENT
/begin MEASUREMENT InjVlv_uDiffNVCSet_mp "Spannungssolldifferenz" SWORD Volt_PA 1 100 -327.6800 327.6700 FORMAT "%8.4" ECU_ADDRESS 0x8032F6 /end MEASUREMENT
/begin MEASUREMENT InjVlv_uOfsBand "Band aus Sollspannungswerten" SWORD Volt_PA 1 100 -327.6800 327.6700 FORMAT "%8.4" ARRAY_SIZE 11 ECU_ADDRESS 0x7F9E90 /end MEASUREMENT
/begin MEASUREMENT InjVlv_uSetBase_mp "Basiswert zur Ermittlung der Spannungsbänder" SWORD Volt_PA 1 100 -327.6800 327.6700 FORMAT "%8.4" ECU_ADDRESS 0x803286 /end MEASUREMENT
/begin MEASUREMENT InjVlv_uSetBott "Minimaler Spannungssollwert für Piezo-Aktor bottom-level" SWORD Volt_PA 1 100 -327.6800 327.6700 FORMAT "%8.4" ECU_ADDRESS 0x7F9A32 /end MEASUREMENT
/begin MEASUREMENT InjVlv_uSetUpActr "Mittlerer zylinderspezifischer Spannungssollwert für Piezo-Aktor (up-level)" SWORD Volt_PA 1 100 -327.6800 327.6700 FORMAT "%8.4" ARRAY_SIZE 6 ECU_ADDRESS 0x7F9E5E /end MEASUREMENT
/begin MEASUREMENT InjVlv_uSetUpActrPoI2_mp "zyl. spezifischer Piezoaktor-Spannungssollwert für PoI2 (Up-Niveau)" SWORD Volt_PA 1 100 -327.6800 327.6700 FORMAT "%8.4" ARRAY_SIZE 6 ECU_ADDRESS 0x80327A /end MEASUREMENT
/begin MEASUREMENT InjVlv_uSetUpAvrg_mp "Gemittelter Spannungssollwert" SWORD Volt_PA 1 100 -327.6800 327.6700 FORMAT "%8.4" ECU_ADDRESS 0x80328A /end MEASUREMENT
/begin MEASUREMENT InjVlv_uSetUpNVCActr "Stellspannung nach der NVC" SWORD Volt_PA 1 100 -327.6800 327.6700 FORMAT "%8.4" ARRAY_SIZE 6 ECU_ADDRESS 0x7F9E6A /end MEASUREMENT
/begin MEASUREMENT InjVlv_uSetUpNVCActrUnLim_mp "unbegrenzte Stellspannung nach der NVC" SWORD Volt_PA 1 100 -327.6800 327.6700 FORMAT "%8.4" ARRAY_SIZE 6 ECU_ADDRESS 0x8032F8 /end MEASUREMENT
/begin MEASUREMENT InjVlv_uSetUpTiChrgActr "Spannungssollwert für Ladezeitberechnung" SWORD Volt_PA 1 100 -327.6800 327.6700 FORMAT "%8.4" ARRAY_SIZE 6 ECU_ADDRESS 0x7F9E76 /end MEASUREMENT
/begin MEASUREMENT InjVlv_volMI1QntAdj_mp "Injektor-Abgleichmenge der Haupteinspritzung 1" SWORD InjQntInj 1 100 -327.6800 327.6700 FORMAT "%8.4" ECU_ADDRESS 0x80330E /end MEASUREMENT
/begin MEASUREMENT InjVlv_volPiI1QntAdj_mp "Injektor-Abgleichmenge der Voreinspritzung 1" SWORD InjQntInj 1 100 -327.6800 327.6700 FORMAT "%8.4" ECU_ADDRESS 0x803310 /end MEASUREMENT
/begin MEASUREMENT InjVlv_volPiI2QntAdj_mp "Injektor-Abgleichmenge der Voreinspritzung 2" SWORD InjQntInj 1 100 -327.6800 327.6700 FORMAT "%8.4" ECU_ADDRESS 0x803312 /end MEASUREMENT
/begin MEASUREMENT InjVlv_volPiI3QntAdj_mp "Injektor-Abgleichmenge der Voreinspritzung 3" SWORD InjQntInj 1 100 -327.6800 327.6700 FORMAT "%8.4" ECU_ADDRESS 0x803314 /end MEASUREMENT
/begin MEASUREMENT InjVlv_volPoI1QntAdj_mp "Injektor-Abgleichmenge der Nacheinspritzung 1" SWORD InjQntInj 1 100 -327.6800 327.6700 FORMAT "%8.4" ECU_ADDRESS 0x803316 /end MEASUREMENT
/begin MEASUREMENT InjVlv_volPoI2QntAdj_mp "Injektor-Abgleichmenge der Nacheinspritzung 2" SWORD InjQntInj 1 100 -327.6800 327.6700 FORMAT "%8.4" ECU_ADDRESS 0x803318 /end MEASUREMENT
/begin MEASUREMENT InjVlv_wInj_mp "Energieverbrauch einer Ansteuerung" SWORD W_PA 1 100 -32768.00 32767.00 FORMAT "%8.2" ECU_ADDRESS 0x80328C /end MEASUREMENT
/begin MEASUREMENT IVCtl_iChrgUp2_mp "zweite Stromgrenze für Piezoaktor Laden" SWORD Curr 1 100 -32768.00 32767.00 FORMAT "%8.2" ECU_ADDRESS 0x80334A /end MEASUREMENT
/begin MEASUREMENT IVCtl_iChrgUpPI_mp "Reglerausgang Ladezeitregler" SWORD Curr 1 100 -32768.00 32767.00 FORMAT "%8.2" ECU_ADDRESS 0x80334C /end MEASUREMENT
/begin MEASUREMENT IVCtl_iChrgUp_mp "Ladestrom für Aktor" SWORD Curr 1 100 -32768.00 32767.00 FORMAT "%8.2" ECU_ADDRESS 0x80334E /end MEASUREMENT
/begin MEASUREMENT IVCtl_iDisChDwn "Entladestrom für Piezoaktor" SWORD Curr 1 100 -32768.00 32767.00 FORMAT "%8.2" ECU_ADDRESS 0x7F992E /end MEASUREMENT
/begin MEASUREMENT IVCtl_iDisChDwn2 "zweite Stromgrenze für Piezoaktor entladen" SWORD Curr 1 100 -32768.00 32767.00 FORMAT "%8.2" ECU_ADDRESS 0x7F9930 /end MEASUREMENT
/begin MEASUREMENT IVCtl_iDisChDwnPI_mp "Ausgang Entladezeitregler" SWORD Curr 1 100 -32768.00 32767.00 FORMAT "%8.2" ECU_ADDRESS 0x803350 /end MEASUREMENT
/begin MEASUREMENT IVCtl_stTiChrgPI "Status der Ladezeitregler (geregelt = FALSE, eingefroren = 1)" UBYTE OneToOne 1 100 0.00 255.0 FORMAT "%5.1" ECU_ADDRESS 0x7F9474 /end MEASUREMENT
/begin MEASUREMENT IVCtl_tiChrgSetUp_mp "Ausgang von IVCtl_tiChrgSetUp_CUR" SWORD Time_Busy 1 100 -3276.800 3276.700 FORMAT "%8.3" ECU_ADDRESS 0x803352 /end MEASUREMENT
/begin MEASUREMENT IVCtl_tiChrgUpAvrg_mp "Mittelwert der gemessenen Ladezeiten" SWORD Time_Busy 1 100 -3276.800 3276.700 FORMAT "%8.3" ECU_ADDRESS 0x803354 /end MEASUREMENT
/begin MEASUREMENT IVCtl_tiChrgUpInPI "Eingangsgröße für den Ladezeitregler" SWORD Time_Busy 1 100 -3276.800 3276.700 FORMAT "%8.3" ECU_ADDRESS 0x7F9932 /end MEASUREMENT
/begin MEASUREMENT IVCtl_tiChrgUpInPIActr_mp "Regelabweichung der Ladezeit (aktorspezifisch)" SWORD Time_Busy 1 100 -3276.800 3276.700 FORMAT "%8.3" ARRAY_SIZE 6 ECU_ADDRESS 0x803356 /end MEASUREMENT
/begin MEASUREMENT IVCtl_tiChrgUpMaxActr_mp "Maximale Regelabweichung der Ladezeit (aktorspezifisch)" SWORD Time_Busy 1 100 -3276.800 3276.700 FORMAT "%8.3" ARRAY_SIZE 6 ECU_ADDRESS 0x803362 /end MEASUREMENT
/begin MEASUREMENT IVCtl_tiChrgUpMax_mp "Maximale Regelabweichung der Ladezeit (gemittelt)" SWORD Time_Busy 1 100 -3276.800 3276.700 FORMAT "%8.3" ECU_ADDRESS 0x80336E /end MEASUREMENT
/begin MEASUREMENT IVCtl_tiChrgUpMinActr_mp "Minimale Regelabweichung der Ladezeit (aktorspezifisch)" SWORD Time_Busy 1 100 -3276.800 3276.700 FORMAT "%8.3" ARRAY_SIZE 6 ECU_ADDRESS 0x803370 /end MEASUREMENT
/begin MEASUREMENT IVCtl_tiChrgUpMin_mp "Minimale Regelabweichung der Ladezeit (gemittelt)" SWORD Time_Busy 1 100 -3276.800 3276.700 FORMAT "%8.3" ECU_ADDRESS 0x80337C /end MEASUREMENT
/begin MEASUREMENT IVCtl_tiChrgUpPse_mp "Pausezeit für Ladezeitregler" SWORD Time_Busy 1 100 -3276.800 3276.700 FORMAT "%8.3" ECU_ADDRESS 0x80337E /end MEASUREMENT
/begin MEASUREMENT IVCtl_tiDisChBottAvrg_mp "Mittelwert der gemessenen Entladezeiten" SWORD Time_Busy 1 100 -3276.800 3276.700 FORMAT "%8.3" ECU_ADDRESS 0x803380 /end MEASUREMENT
/begin MEASUREMENT IVCtl_tiDisChDwnInPI "Eingangsgröße des Entladezeitreglers" SWORD Time_Busy 1 100 -3276.800 3276.700 FORMAT "%8.3" ECU_ADDRESS 0x7F9934 /end MEASUREMENT
/begin MEASUREMENT IVCtl_tiDisChDwnInPIActr_mp "Regelabweichung der Entladezeit (zylinderspezifisch)" SWORD Time_Busy 1 100 -3276.800 3276.700 FORMAT "%8.3" ARRAY_SIZE 6 ECU_ADDRESS 0x803382 /end MEASUREMENT
/begin MEASUREMENT IVCtl_tiDisChDwnMaxActr_mp "Maximale Regelabweichung der Entladezeit (aktorspezifisch)" SWORD Time_Busy 1 100 -3276.800 3276.700 FORMAT "%8.3" ARRAY_SIZE 6 ECU_ADDRESS 0x80338E /end MEASUREMENT
/begin MEASUREMENT IVCtl_tiDisChDwnMax_mp "Maximale Regelabweichung der Entladezeit (gemittelt)" SWORD Time_Busy 1 100 -3276.800 3276.700 FORMAT "%8.3" ECU_ADDRESS 0x80339A /end MEASUREMENT
/begin MEASUREMENT IVCtl_tiDisChDwnMinActr_mp "Minimale Regelabweichung der Entladezeit (aktorspezifisch)" SWORD Time_Busy 1 100 -3276.800 3276.700 FORMAT "%8.3" ARRAY_SIZE 6 ECU_ADDRESS 0x80339C /end MEASUREMENT
/begin MEASUREMENT IVCtl_tiDisChDwnMin_mp "Minimale Regelabweichung der Entlladezeit (gemittelt)" SWORD Time_Busy 1 100 -3276.800 3276.700 FORMAT "%8.3" ECU_ADDRESS 0x8033A8 /end MEASUREMENT
/begin MEASUREMENT IVCtl_tiDisChDwnPse_mp "Pausezeit für Entladezeitregler" SWORD Time_Busy 1 100 -3276.800 3276.700 FORMAT "%8.3" ECU_ADDRESS 0x8033AA /end MEASUREMENT
/begin MEASUREMENT IVCtl_tiDisChSetDwn_mp "Ausgang von IVCtl_tiDisChSetDwn_CUR" SWORD Time_Busy 1 100 -3276.800 3276.700 FORMAT "%8.3" ECU_ADDRESS 0x8033AC /end MEASUREMENT
/begin MEASUREMENT IVCtl_uSetUp2Avrg_mp "Piezoaktorspannung gemittelt (Differenz Bottom zu Up Niveau minus Offset)" SWORD Volt_PA 1 100 -327.6800 327.6700 FORMAT "%8.4" ECU_ADDRESS 0x8033AE /end MEASUREMENT
/begin MEASUREMENT IVCtl_uSetUpAvrg_mp "Gemittelter Spannungswert" SWORD Volt_PA 1 100 -327.6800 327.6700 FORMAT "%8.4" ECU_ADDRESS 0x8033B0 /end MEASUREMENT
/begin FUNCTION injcrv_poi2soe_uic ""
 /begin DEF_CHARACTERISTIC InjCrv_phiPoI2_Vector InjCrv_phiPoI2_Channel InjCrv_qPoI2Eff_Vector InjCrv_qPoI2Eff_Channel InjCrv_qPoI2_Vector InjCrv_qPoI2_Channel InjCrv_tiPoI2_Vector InjCrv_tiPoI2_Channel /end DEF_CHARACTERISTIC
 /begin OUT_MEASUREMENT InjCrv_phiPoI2AbsTot_mp InjCrv_phiPoI2Abs_mp InjCrv_phiPoI2Cor_mp InjCrv_phiPoI2Rel_mp InjCrv_swtPoI2AgAbsTDC_mp InjCrv_tiPoI2Cor_mp InjCrv_tiPoI2Max_mp InjCrv_tiPoI2RelTot_mp InjCrv_tiPoI2Rel_mp /end OUT_MEASUREMENT
/end FUNCTION
/begin FUNCTION injcrv_qntminlib "Berechnung minimale Einspritzmenge" /begin DEF_CHARACTERISTIC InjCrv_qMin_CUR /end DEF_CHARACTERISTIC /begin IN_MEASUREMENT RailCD_pPeak /end IN_MEASUREMENT /end FUNCTION
/begin FUNCTION injcrv_qntminlib_uic "" /begin OUT_MEASUREMENT InjCrv_qPiI1MinWv_mp /end OUT_MEASUREMENT /end FUNCTION
/begin FUNCTION injcrv_rmtctl_uic "" /begin DEF_CHARACTERISTIC InjCrv_stInjCharActVal_C InjCrv_swtStInjCharActVal_C /end DEF_CHARACTERISTIC /end FUNCTION
/begin FUNCTION injcrv_settipse "" /end FUNCTION
/begin FUNCTION injcrv_settipse_msg "" /begin OUT_MEASUREMENT InjCrv_tiPse /end OUT_MEASUREMENT /end FUNCTION
/begin FUNCTION injcrv_settipse_uic "" /end FUNCTION
/begin FUNCTION injctl_msg ""
 /begin OUT_MEASUREMENT InjCtl_qAct InjCtl_qCurr InjCtl_qCurrUnCor InjCtl_qDes InjCtl_qLim InjCtl_qLimErr InjCtl_qLimSwt InjCtl_qRaw InjCtl_qSetUnBal InjCtl_stNoInj InjCtl_stQLimErr InjCtl_trqInrLim /end OUT_MEASUREMENT
/end FUNCTION
/begin FUNCTION injctl_qco "Mengenkoordination" /begin DEF_CHARACTERISTIC InjCtl_swtFMACor_C /end DEF_CHARACTERISTIC /end FUNCTION
/begin FUNCTION injctl_qlim "Begrenzungsmenge" /begin DEF_CHARACTERISTIC InjCtl_dqLimUp_C InjCtl_dqLimDwn_C InjCtl_qLimErr_CUR /end DEF_CHARACTERISTIC /begin IN_MEASUREMENT Eng_nAvrg /end IN_MEASUREMENT /end FUNCTION
/begin FUNCTION injctl_uic "" /begin OUT_MEASUREMENT InjCtl_qLimNorm_mp /end OUT_MEASUREMENT /end FUNCTION
/begin FUNCTION injun "Einspritzsystem" /end FUNCTION
/begin FUNCTION injun_masscnv "Umrechnung von Kraftstoffmenge nach Kraftstoffvolumen" /end FUNCTION
/begin FUNCTION injun_masscnv_uic "" /end FUNCTION
/begin FUNCTION injun_mi1dynqntcor_uic ""
 /begin OUT_MEASUREMENT InjUn_numCylMI1_mp InjUn_qMI1Cor_mp InjUn_volMI1Cor_mp InjUn_volMI1_mp /end OUT_MEASUREMENT
/end FUNCTION
/begin FUNCTION injun_mi2dynqntcor_uic "" /begin OUT_MEASUREMENT InjUn_numCylMI2_mp /end OUT_MEASUREMENT /end FUNCTION
/begin FUNCTION injun_msg ""
 /begin OUT_MEASUREMENT InjUn_qTotInj InjUn_stInjValve InjUn_stShutOffReq InjUn_stTst /end OUT_MEASUREMENT
/end FUNCTION
/begin FUNCTION injun_pii1dynqntcor_uic ""
 /begin OUT_MEASUREMENT InjUn_numCylPiI1_mp InjUn_qPiI1Cor_mp InjUn_volPiI1Cor_mp InjUn_volPiI1_mp /end OUT_MEASUREMENT
/end FUNCTION
/begin FUNCTION injun_pii2dynqntcor_uic ""
 /begin OUT_MEASUREMENT InjUn_numCylPiI2_mp InjUn_qPiI2Cor_mp InjUn_volPiI2Cor_mp InjUn_volPiI2_mp /end OUT_MEASUREMENT
/end FUNCTION
/begin FUNCTION injun_pii3dynqntcor_uic "" /end FUNCTION
/begin FUNCTION injun_poi1dynqntcor_uic ""
 /begin OUT_MEASUREMENT InjUn_numCylPoI1_mp InjUn_qPoI1Cor_mp InjUn_volPoI1Cor_mp InjUn_volPoI1_mp /end OUT_MEASUREMENT
/end FUNCTION
/begin FUNCTION injun_poi2dynqntcor_uic ""
 /begin OUT_MEASUREMENT InjUn_numCylPoI2_mp InjUn_qPoI2Cor_mp InjUn_volPoI2Cor_mp InjUn_volPoI2_mp /end OUT_MEASUREMENT
/end FUNCTION
/begin FUNCTION injun_sched "" /begin DEF_CHARACTERISTIC InjUn_nInjLock_C /end DEF_CHARACTERISTIC /end FUNCTION
/begin FUNCTION injun_sched_msg "" /begin OUT_MEASUREMENT InjUn_volMI1CorCyc InjUn_volPiI1CorCyc InjUn_volPiI2CorCyc /end OUT_MEASUREMENT /end FUNCTION
/begin FUNCTION injun_sched_uic "" /end FUNCTION
/begin FUNCTION injun_sched_var ""
 /begin OUT_MEASUREMENT InjUn_pAct_mp InjUn_stMIOffs_mp InjUn_stPiI1Offs_mp InjUn_stPiI2Offs_mp InjUn_stPiI3Offs_mp /end OUT_MEASUREMENT
/end FUNCTION
/begin FUNCTION injun_soptst "" /begin DEF_CHARACTERISTIC InjUn_phiTstShOffPathSet_C InjUn_tiTstShOffPathET_C /end DEF_CHARACTERISTIC /begin OUT_MEASUREMENT InjUn_stSOPTstInjBeg_mp InjUn_stSOPTstInjDur_mp /end OUT_MEASUREMENT /end FUNCTION
/begin FUNCTION injun_syserr_msg "" /begin OUT_MEASUREMENT InjUn_stSysErr /end OUT_MEASUREMENT /end FUNCTION
/begin FUNCTION injun_uic "" /end FUNCTION
/begin FUNCTION injvcd "injection valve component driver" /begin DEF_CHARACTERISTIC InjVCD_swtEnaAgDiff_C /end DEF_CHARACTERISTIC /end FUNCTION
/begin FUNCTION injvcd_actr "Erfassung der Piezo-Aktordaten"
 /begin DEF_CHARACTERISTIC InjVCD_uChrgThrSRCLo_C InjVCD_uChrgThrSRCHi_C InjVCD_uChrgLin_CUR InjVCD_uActrThrSRCLo_C InjVCD_uActrThrSRCHi_C InjVCD_uActrLin_CUR InjVCD_numCylTestBench_C /end DEF_CHARACTERISTIC
 /begin OUT_MEASUREMENT InjVCD_facAmp_mp InjVCD_numOfsSelect_mp InjVCD_tiInjDurMi_mp InjVCD_tiInjDur_mp InjVCD_tiUpOri_mp InjVCD_uChgUp_mp InjVCD_uRawBott_mp InjVCD_uRawChgUp_mp InjVCD_uRawUp_mp /end OUT_MEASUREMENT
/end FUNCTION
/begin FUNCTION injvcd_actrtemp "Berechnung der Piezoaktortemperatur"
 /begin DEF_CHARACTERISTIC InjVCD_swtSelTempVal_C InjVCD_swtSelTempType_C InjVCD_tActrDfl_C InjVCD_tActr_CUR /end DEF_CHARACTERISTIC
 /begin OUT_MEASUREMENT InjVCD_tActr_mp /end OUT_MEASUREMENT
/end FUNCTION
/begin FUNCTION injvcd_actrtemp_msg "" /begin OUT_MEASUREMENT InjVCD_swtSelTemp InjVCD_tActr /end OUT_MEASUREMENT /end FUNCTION
/begin FUNCTION injvcd_actr_msg ""
 /begin OUT_MEASUREMENT InjVCD_chgUpActrCurr InjVCD_cUpActrCurr InjVCD_cUpActrOld InjVCD_numHandle InjVCD_numMeas InjVCD_pActInj InjVCD_stAvrgEna InjVCD_stAvrgEnaTiWarn InjVCD_stCalcChrgActr InjVCD_stMeas InjVCD_stMeasLvl InjVCD_stMeasLvlFirst InjVCD_stMonTiPlaus InjVCD_stMonUBnkPlaus InjVCD_stMonUCylPlaus InjVCD_stShCirSelSwtCab InjVCD_tiChrgUpActr InjVCD_tiChrgUpActrOld InjVCD_tiDisChBottActr InjVCD_tiMeasCycl InjVCD_tiMeasCyclCyl InjVCD_uBottActr InjVCD_uSetThresActr InjVCD_uSetUpActr InjVCD_uUpActr /end OUT_MEASUREMENT
/end FUNCTION
/begin FUNCTION injvcd_calcetlib ""
 /begin DEF_CHARACTERISTIC InjVCD_stInjMode_C InjVCD_tiETMinHigh_C InjVCD_tiETMinLow_C InjVCD_tiHoldMin_C /end DEF_CHARACTERISTIC
/end FUNCTION
/begin FUNCTION injvcd_calcetlib_uic ""
 /begin DEF_CHARACTERISTIC InjVCD_tiMI1ET_Vector InjVCD_tiMI1ET_Channel InjVCD_tiPiI1ET_Vector InjVCD_tiPiI1ET_Channel InjVCD_tiPiI2ET_Vector InjVCD_tiPiI2ET_Channel InjVCD_tiPiI3ET_Vector InjVCD_tiPiI3ET_Channel InjVCD_tiPoI1ET_Vector InjVCD_tiPoI1ET_Channel InjVCD_tiPoI2ET_Vector InjVCD_tiPoI2ET_Channel /end DEF_CHARACTERISTIC
 /begin OUT_MEASUREMENT InjVCD_tiETcalcMI1_mp InjVCD_tiETcalcPiI1_mp InjVCD_tiETcalcPiI2_mp InjVCD_tiETcalcPiI3_mp InjVCD_tiETcalcPoI1_mp InjVCD_tiETcalcPoI2_mp InjVCD_tiETTempCorMI1_mp InjVCD_tiETTempCorPiI1_mp InjVCD_tiETTempCorPiI2_mp InjVCD_tiETTempCorPiI3_mp InjVCD_tiETTempCorPoI1_mp InjVCD_tiETTempCorPoI2_mp InjVCD_tiMI1ET_mp InjVCD_tiPiI1ET_mp InjVCD_tiPiI2ET_mp InjVCD_tiPiI3ET_mp InjVCD_tiPoI1ET_mp InjVCD_tiPoI2ET_mp InjVCD_tiZFCPiI1ETCor_mp InjVCD_tiZFCPiI2ETCor_mp InjVCD_tiZFCPiI3ETCor_mp /end OUT_MEASUREMENT
/end FUNCTION
/begin FUNCTION injvcd_chrg "Berechnung der Aktor-Ladung" /begin DEF_CHARACTERISTIC InjVCD_duInt_C InjVCD_resCalcChrgShunt_C /end DEF_CHARACTERISTIC /begin OUT_MEASUREMENT InjVCD_uIntComp_mp /end OUT_MEASUREMENT /end FUNCTION
/begin FUNCTION injvcd_cls "Klassifizierung des Piezoaktuators"
 /begin DEF_CHARACTERISTIC InjVCD_nClsEng_C InjVCD_pClsRailMax_C InjVCD_rClsVoltMin_C InjVCD_tiClsLead_C InjVCD_tiClsMeasBeg_C InjVCD_tiClsMeasEnd_C InjVCD_tiClsMeasure_C /end DEF_CHARACTERISTIC
 /begin OUT_MEASUREMENT InjVCD_rClsVolt_mp InjVCD_stWaitPRailLow_mp InjVCD_uClsBegin_mp InjVCD_uClsEnd_mp /end OUT_MEASUREMENT
/end FUNCTION
/begin FUNCTION injvcd_cls_msg "" /begin OUT_MEASUREMENT InjVCD_stClsActr InjVCD_swtClsActr /end OUT_MEASUREMENT /end FUNCTION
/begin FUNCTION injvcd_cls_uic "" /end FUNCTION
/begin FUNCTION injvcd_cy370 "spezielle Funktionen fuer CY370"
 /begin DEF_CHARACTERISTIC InjVCD_uCY370ThrSRCLo_C InjVCD_uCY370ThrSRCHi_C InjVCD_uCY370Lin_CUR InjVCD_stCY370RcyTst_C /end DEF_CHARACTERISTIC
 /begin OUT_MEASUREMENT InjVCD_regCY370ID_mp InjVCD_stCY370Event_mp InjVCD_uRawCY370Int0_mp InjVCD_uRawCY370Int_mp InjVCD_uValCY370Int_mp /end OUT_MEASUREMENT
/end FUNCTION
/begin FUNCTION injvcd_cy370_msg ""
 /begin OUT_MEASUREMENT InjVCD_PZOSWType InjVCD_regCY370Bank InjVCD_regCY370CylISel InjVCD_regCY370Global InjVCD_regCY370Status InjVCD_stCY370Buf InjVCD_tiCY370ChrgRC InjVCD_uCY370ChrgIntWp InjVCD_uCY370ChrgOff /end OUT_MEASUREMENT
/end FUNCTION
/begin FUNCTION injvcd_cy370_uic "" /end FUNCTION
/begin FUNCTION injvcd_dcdc "Komponententreiber für DCDC-Wandler"
 /begin DEF_CHARACTERISTIC InjVCD_DebDCDCLowDef_C InjVCD_DebDCDCStartDef_C InjVCD_uBufCLoLim_C /end DEF_CHARACTERISTIC
/end FUNCTION
/begin FUNCTION injvcd_dcdc_msg "" /begin OUT_MEASUREMENT InjVCD_stBufC /end OUT_MEASUREMENT /end FUNCTION
/begin FUNCTION injvcd_dcdc_uic "" /end FUNCTION
/begin FUNCTION injvcd_estet "" /end FUNCTION
/begin FUNCTION injvcd_estet_uic "" /end FUNCTION
/begin FUNCTION injvcd_ettempcor "Temperaturabhängige Ansteuerdauerkorrektur"
 /begin DEF_CHARACTERISTIC InjVCD_rETTempCor_MAP InjVCD_swtTempCor_C InjVCD_tiETHydMin_C InjVCD_tiETTempCor_MAP /end DEF_CHARACTERISTIC
 /begin IN_MEASUREMENT EngM_ctRevSta InjVCD_tTempCor_mp InjVCD_volInTempCor_mp RailCD_pAct_mp /end IN_MEASUREMENT
/end FUNCTION
/begin FUNCTION injvcd_ettempcor_msg "" /end FUNCTION
/begin FUNCTION injvcd_ettempcor_uic "" /begin OUT_MEASUREMENT InjVCD_tTempCor_mp InjVCD_volInTempCor_mp /end OUT_MEASUREMENT /end FUNCTION
/begin FUNCTION injvcd_evmgmt ""
 /begin DEF_CHARACTERISTIC InjVCD_numCollTyp_C InjVCD_swtEvMgmt_C InjVCD_tiLeadJit_C InjVCD_tiLeadPost1_C InjVCD_tiLeadPost2_C InjVCD_tiLeadPost3_C InjVCD_tiLeadPost4_C InjVCD_tiLeadPre1_C InjVCD_tiLeadPre2_C InjVCD_tiLeadPre3_C InjVCD_tiLeadPre4_C /end DEF_CHARACTERISTIC
 /begin OUT_MEASUREMENT InjVCD_numCollPrim_mp InjVCD_numCollScnd_mp InjVCD_numCollThrd_mp InjVCD_numEvMgmtStat_mp InjVCD_numReacPrim_mp InjVCD_numReacScnd_mp InjVCD_tiCutAll_mp InjVCD_tiCutPrim_mp InjVCD_tiCutScnd_mp InjVCD_tiShiftAll_mp InjVCD_tiShiftPrim_mp InjVCD_tiShiftScnd_mp /end OUT_MEASUREMENT
/end FUNCTION
/begin FUNCTION injvcd_getet "Ansteuerdauerberechnung" /begin DEF_CHARACTERISTIC InjVCD_swtInputETMAP_C InjVCD_tiET_MAP /end DEF_CHARACTERISTIC /begin IN_MEASUREMENT InjVCD_pInET_mp InjVCD_volInET_mp /end IN_MEASUREMENT /end FUNCTION
/begin FUNCTION injvcd_getet_uic "" /begin OUT_MEASUREMENT InjVCD_pInET_mp InjVCD_volInET_mp /end OUT_MEASUREMENT /end FUNCTION
/begin FUNCTION injvcd_measubuf "Messung der Bufferspannung"
 /begin DEF_CHARACTERISTIC InjVCD_DebUBufSRCHighDef_C InjVCD_DebUBufSRCHighOk_C InjVCD_DebUBufSRCLowDef_C InjVCD_DebUBufSRCLowOk_C InjVCD_uBufSRCMin_C InjVCD_uBufSRCMax_C InjVCD_uBufLin_CUR /end DEF_CHARACTERISTIC
 /begin OUT_MEASUREMENT InjVCD_ctUBufTrig_mp InjVCD_uBufRaw_mp /end OUT_MEASUREMENT
/end FUNCTION
/begin FUNCTION injvcd_measubuf_msg "" /begin OUT_MEASUREMENT InjVCD_stUBuf InjVCD_uBuf /end OUT_MEASUREMENT /end FUNCTION
/begin FUNCTION injvcd_measubuf_uic "" /end FUNCTION
/begin FUNCTION injvcd_mirmtctl_uic "" /begin DEF_CHARACTERISTIC InjVCD_swtTiMI1_C InjVCD_tiMI1_C /end DEF_CHARACTERISTIC /end FUNCTION
/begin FUNCTION injvcd_mon "Überwachung des Einspritzventils im Komponententreibers"
 /begin DEF_CHARACTERISTIC InjVCD_facMonUThresHiPl_CA InjVCD_facMonUThresLoPl_CA InjVCD_rCapUpTolc_C InjVCD_rTiChrgUpTolc_C InjVCD_tiMi1ThresLo_C InjVCD_tiMonThresHiPlaus_C InjVCD_tiMonThresLoPlaus_C /end DEF_CHARACTERISTIC
 /begin OUT_MEASUREMENT InjVCD_tiMonActrThresLo_mp InjVCD_uMonThresHi_mp InjVCD_uMonThresLo_mp /end OUT_MEASUREMENT
/end FUNCTION
/begin FUNCTION injvcd_monshcir "Kurzschlussunterscheidung"
 /begin DEF_CHARACTERISTIC InjVCD_nEngMonShCir_C InjVCD_pRailMonShCirMax_C InjVCD_rMonShCirTiChrgUpTolc_C InjVCD_tiMonET_C InjVCD_tiMonLead_C /end DEF_CHARACTERISTIC
 /begin OUT_MEASUREMENT InjVCD_tiMonChrgUp_mp InjVCD_tiMonShCirSort_mp /end OUT_MEASUREMENT
/end FUNCTION
/begin FUNCTION injvcd_monshcir_msg "" /begin OUT_MEASUREMENT InjVCD_stMonShCir /end OUT_MEASUREMENT /end FUNCTION
/begin FUNCTION injvcd_monshcir_uic "" /end FUNCTION
/begin FUNCTION injvcd_mon_uic ""
 /begin OUT_MEASUREMENT InjVCD_rCapThresHigh_mp InjVCD_rCapThresLow_mp InjVCD_rCapUpCurrToKx_mp InjVCD_rCapUpKxToCurr_mp InjVCD_rTiChrgUpCurrToKx_mp InjVCD_rTiChrgUpKxToCurr_mp InjVCD_rTiChrgUpThresHigh_mp InjVCD_rTiChrgUpThresLow_mp /end OUT_MEASUREMENT
/end FUNCTION
/begin FUNCTION injvcd_pii1rmtctl_uic "" /begin DEF_CHARACTERISTIC InjVCD_swtTiPiI1_C InjVCD_tiPiI1_C /end DEF_CHARACTERISTIC /end FUNCTION
/begin FUNCTION injvcd_pii2rmtctl_uic "" /begin DEF_CHARACTERISTIC InjVCD_swtTiPiI2_C InjVCD_tiPiI2_C /end DEF_CHARACTERISTIC /end FUNCTION
/begin FUNCTION injvcd_pii3rmtctl_uic "" /end FUNCTION
/begin FUNCTION injvcd_poi1rmtctl_uic "" /begin DEF_CHARACTERISTIC InjVCD_swtTiPoI1_C InjVCD_tiPoI1_C /end DEF_CHARACTERISTIC /end FUNCTION
/begin FUNCTION injvcd_poi2rmtctl_uic "" /begin DEF_CHARACTERISTIC InjVCD_swtTiPoI2_C InjVCD_tiPoI2_C /end DEF_CHARACTERISTIC /end FUNCTION
/begin FUNCTION injvcd_polar "Polarisation des Piezo-Aktors während des Systemhochlaufs"
 /begin DEF_CHARACTERISTIC InjVCD_ctThres_C InjVCD_fPolar_C InjVCD_numPolar_C InjVCD_tiPolarET_C InjVCD_tiPolarLead_C /end DEF_CHARACTERISTIC
 /begin OUT_MEASUREMENT InjVCD_stPolarInjBeg_mp InjVCD_stPolarInjDur_mp /end OUT_MEASUREMENT
/end FUNCTION
/begin FUNCTION injvcd_polar_msg "" /begin OUT_MEASUREMENT InjVCD_stPolar /end OUT_MEASUREMENT /end FUNCTION
/begin FUNCTION injvcd_polar_uic "" /end FUNCTION
/begin FUNCTION injvcd_progetlib "" /end FUNCTION
/begin FUNCTION injvcd_progetlib_uic ""
 /begin OUT_MEASUREMENT InjVCD_stInjMI1_mp InjVCD_stInjMI2_mp InjVCD_stInjPiI1_mp InjVCD_stInjPiI2_mp InjVCD_stInjPiI3_mp InjVCD_stInjPoI1_mp InjVCD_stInjPoI2_mp /end OUT_MEASUREMENT
/end FUNCTION
/begin FUNCTION injvcd_progetzfc "" /end FUNCTION
/begin FUNCTION injvcd_progetzfc_uic "" /begin OUT_MEASUREMENT InjVCD_stInjZFC_mp /end OUT_MEASUREMENT /end FUNCTION
/begin FUNCTION injvcd_progmi "Programmierung der MI1, Initialisierung von Schnelllöschung und Haltestrom" /begin OUT_MEASUREMENT InjVCD_stInjBegMI1_mp /end OUT_MEASUREMENT /end FUNCTION
/begin FUNCTION injvcd_progmi_uic "" /begin OUT_MEASUREMENT InjVCD_phiMI1Diff_mp /end OUT_MEASUREMENT /end FUNCTION
/begin FUNCTION injvcd_progpii "Programmierung der Voreinspritzung" /end FUNCTION
/begin FUNCTION injvcd_progpii1 "" /begin OUT_MEASUREMENT InjVCD_stInjBegPiI1_mp /end OUT_MEASUREMENT /end FUNCTION
/begin FUNCTION injvcd_progpii1_uic "" /begin OUT_MEASUREMENT InjVCD_phiPiI1Diff_mp /end OUT_MEASUREMENT /end FUNCTION
/begin FUNCTION injvcd_progpii2 "" /begin OUT_MEASUREMENT InjVCD_stInjBegPiI2_mp /end OUT_MEASUREMENT /end FUNCTION
/begin FUNCTION injvcd_progpii2_uic "" /begin OUT_MEASUREMENT InjVCD_phiPiI2Diff_mp /end OUT_MEASUREMENT /end FUNCTION
/begin FUNCTION injvcd_progpii3 "" /begin OUT_MEASUREMENT InjVCD_stInjBegPiI3_mp /end OUT_MEASUREMENT /end FUNCTION
/begin FUNCTION injvcd_progpii3_uic "" /end FUNCTION
/begin FUNCTION injvcd_progpii_uic "" /end FUNCTION
/begin FUNCTION injvcd_progpoi1 "" /begin OUT_MEASUREMENT InjVCD_stInjBegPoI1_mp /end OUT_MEASUREMENT /end FUNCTION
/begin FUNCTION injvcd_progpoi1_uic "" /end FUNCTION
/begin FUNCTION injvcd_progpoi2 "" /begin OUT_MEASUREMENT InjVCD_stInjBegPoI2_mp /end OUT_MEASUREMENT /end FUNCTION
/begin FUNCTION injvcd_progpoi2_uic "" /end FUNCTION
/begin FUNCTION injvcd_progzfc "" /end FUNCTION
/begin FUNCTION injvcd_progzfc_uic "" /end FUNCTION
/begin FUNCTION injvcd_selcrnt "" /begin OUT_MEASUREMENT InjVCD_numCrntLvl_mp /end OUT_MEASUREMENT /end FUNCTION
/begin FUNCTION injvcd_selvoltoffs "" /end FUNCTION
/begin FUNCTION injvcd_selvoltoffs_msg "" /begin OUT_MEASUREMENT InjVCD_numOfsSelect /end OUT_MEASUREMENT /end FUNCTION
/begin FUNCTION injvcd_shoffdcdc "Schutzabschaltung DC/DC-Wandler bei festgestelltem Ladeschalterkurzschluss"
 /begin DEF_CHARACTERISTIC InjVCD_ctThresShOffDCDCEv_C InjVCD_swtShOffDCDCTst_C InjVCD_uShOffBufThres_C /end DEF_CHARACTERISTIC
/end FUNCTION
/begin FUNCTION injvcd_shoffdcdc_msg "" /begin OUT_MEASUREMENT InjVCD_stShOffDCDC /end OUT_MEASUREMENT /end FUNCTION
/begin FUNCTION injvcd_shoffdcdc_uic "" /end FUNCTION
/begin FUNCTION injvcd_zfcetcor "Ansteuerdauerkorrektur durch Nullmengenkalibrierung"
 /begin DEF_CHARACTERISTIC InjVCD_pRailZFCETCor_AXIS InjVCD_qZFCETCor_AXIS InjVCD_rZFCETDif0_GMAP InjVCD_rZFCETDif1_GMAP InjVCD_rZFCETDif2_GMAP InjVCD_rZFCETMsk_GMAP InjVCD_stInputZFCETGMap_C InjVCD_stZFCETCorActv_C InjVCD_tiZFCETCorMax_C InjVCD_tiZFCETCorMin_C /end DEF_CHARACTERISTIC
 /begin IN_MEASUREMENT InjVCD_qInZFCETGMap_mp RailCD_pAct_mp /end IN_MEASUREMENT
 /begin OUT_MEASUREMENT InjVCD_rZFCETCoeffDif_mp InjVCD_rZFCETCoeffMsk_mp InjVCD_tiPiI1ZFCETCor_mp InjVCD_tiPiI2ZFCETCor_mp InjVCD_tiPiI3ZFCETCor_mp /end OUT_MEASUREMENT
/end FUNCTION
/begin FUNCTION injvcd_zfcetcor_uic "" /begin OUT_MEASUREMENT InjVCD_qInZFCETGMap_mp /end OUT_MEASUREMENT /end FUNCTION
/begin FUNCTION injvlv_addbal "Korrektur Einspritzmenge aus Laufruheregler" /begin DEF_CHARACTERISTIC InjVlv_facAddBalRls_MAP /end DEF_CHARACTERISTIC /begin IN_MEASUREMENT InjCtl_qSetUnBal RailCD_pPeak /end IN_MEASUREMENT /end FUNCTION
/begin FUNCTION injvlv_addballib "" /begin DEF_CHARACTERISTIC InjVlv_stInputAddBalMap_C /end DEF_CHARACTERISTIC /end FUNCTION
/begin FUNCTION injvlv_addballib_uic ""
 /begin OUT_MEASUREMENT InjVlv_qMI1Bal_mp InjVlv_qPiI1Bal_mp InjVlv_qPiI2Bal_mp InjVlv_qPiI3Bal_mp InjVlv_qPoI1Bal_mp InjVlv_qPoI2BalEff_mp InjVlv_qPoI2Bal_mp /end OUT_MEASUREMENT
/end FUNCTION
/begin FUNCTION injvlv_addbalzfc "" /end FUNCTION
/begin FUNCTION injvlv_addbalzfc_uic "" /end FUNCTION
/begin FUNCTION injvlv_addbal_msg "" /begin OUT_MEASUREMENT InjVlv_facAddBalRls /end OUT_MEASUREMENT /end FUNCTION
/begin FUNCTION injvlv_addbal_uic "" /end FUNCTION
/begin FUNCTION injvlv_calcvolt "Spannungsberechnung für Piezo-Aktuator"
 /begin DEF_CHARACTERISTIC InjVlv_facPCorQ_CUR InjVlv_facPCorTi_CUR InjVlv_facVoltCorUp_MAP InjVlv_pCorBase_CUR InjVlv_pRailDfl_C InjVlv_stPWvCorMsk_C InjVlv_tActrDfl_C InjVlv_uSetBott_C InjVlv_uSetUpPress0_CUR InjVlv_uSetUpPress10_CUR InjVlv_uSetUpPress11_CUR InjVlv_uSetUpPress12_CUR InjVlv_uSetUpPress13_CUR InjVlv_uSetUpPress14_CUR InjVlv_uSetUpPress15_CUR InjVlv_uSetUpPress1_CUR InjVlv_uSetUpPress2_CUR InjVlv_uSetUpPress3_CUR InjVlv_uSetUpPress4_CUR InjVlv_uSetUpPress5_CUR InjVlv_uSetUpPress6_CUR InjVlv_uSetUpPress7_CUR InjVlv_uSetUpPress8_CUR InjVlv_uSetUpPress9_CUR /end DEF_CHARACTERISTIC
 /begin IN_MEASUREMENT InjVlv_pAct_mp InjVlv_pCalcVolt InjVlv_tiMI1PoI2Cor_mp /end IN_MEASUREMENT
 /begin OUT_MEASUREMENT InjVlv_facPCorQ_mp InjVlv_facPCorTi_mp InjVlv_facPCor_mp InjVlv_pCorBase_mp InjVlv_pPoI2WvCorOfsActr_mp InjVlv_pRailCorPoI2Actr_mp InjVlv_qDes_mp InjVlv_tActr_mp InjVlv_uSetUpActrPoI2_mp /end OUT_MEASUREMENT
/end FUNCTION
/begin FUNCTION injvlv_calcvoltoffs "Berechnung des Spannungsoffsets" /begin DEF_CHARACTERISTIC InjVlv_uOfs_C /end DEF_CHARACTERISTIC /begin OUT_MEASUREMENT InjVlv_uSetBase_mp /end OUT_MEASUREMENT /end FUNCTION
/begin FUNCTION injvlv_calcvoltoffs_msg "" /begin OUT_MEASUREMENT InjVlv_uOfsBand /end OUT_MEASUREMENT /end FUNCTION
/begin FUNCTION injvlv_calcvolt_msg ""
 /begin OUT_MEASUREMENT InjVlv_facVoltCorUp InjVlv_numClsVltgAdjActr InjVlv_pCalcVolt InjVlv_uSetBott InjVlv_uSetUpActr /end OUT_MEASUREMENT
/end FUNCTION
/begin FUNCTION injvlv_calcvolt_uic "" /end FUNCTION
/begin FUNCTION injvlv_chrgbalinjlim "maximale Anzahl an Einspritzungen aufgrund der Ladungsbilanz des Boosterkondensators"
 /begin DEF_CHARACTERISTIC InjVlv_numInjChrgBal_MAP InjVlv_rChrgBalPwrHys_C InjVlv_rChrgBalVltgHys_C InjVlv_uBufCInjLimXLow_C InjVlv_uBufCInjLimXHigh_C InjVlv_stBufCInjLimYLow_C InjVlv_stBufCInjLimYHigh_C InjVlv_wInj_CUR /end DEF_CHARACTERISTIC
 /begin IN_MEASUREMENT BattCD_u /end IN_MEASUREMENT
 /begin OUT_MEASUREMENT InjVlv_pwrInjAvrg_mp InjVlv_uSetUpAvrg_mp InjVlv_wInj_mp /end OUT_MEASUREMENT
/end FUNCTION
/begin FUNCTION injvlv_chrgbalinjlim_uic "" /begin OUT_MEASUREMENT InjVlv_numInjChrgBal_mp /end OUT_MEASUREMENT /end FUNCTION
/begin FUNCTION injvlv_currdcdc "Berechnung des aktuellen DCDC-Werts" /begin DEF_CHARACTERISTIC InjVlv_iDCDC_CUR /end DEF_CHARACTERISTIC /begin IN_MEASUREMENT BattCD_u /end IN_MEASUREMENT /begin OUT_MEASUREMENT InjVlv_iDCDC_mp /end OUT_MEASUREMENT /end FUNCTION
/begin FUNCTION injvlv_currdcdc_uic "" /end FUNCTION
/begin FUNCTION injvlv_errdet "Injektorfehlererkennung" /begin DEF_CHARACTERISTIC InjVlv_numSegOfs1_C InjVlv_numSegOfs2_C InjVlv_stErrDet_C /end DEF_CHARACTERISTIC /end FUNCTION
/begin FUNCTION injvlv_errdet_msg "" /begin OUT_MEASUREMENT InjVlv_nCyl InjVlv_qFBCCyl /end OUT_MEASUREMENT /end FUNCTION
/begin FUNCTION injvlv_errdet_uic "" /end FUNCTION
/begin FUNCTION injvlv_mon "Injektordiagnose"
 /begin DEF_CHARACTERISTIC InjVlv_ctMonQckThresLo_C InjVlv_ctMonQckThres_C InjVlv_DebBnkA0Def_C InjVlv_DebBnkA0Ok_C InjVlv_DebBnkA1Def_C InjVlv_DebBnkA1Ok_C InjVlv_DebBnkA2Def_C InjVlv_DebBnkA2Ok_C InjVlv_DebBnkA3Def_C InjVlv_DebBnkA3Ok_C InjVlv_DebBnkB0Def_C InjVlv_DebBnkB0Ok_C InjVlv_DebBnkB1Def_C InjVlv_DebBnkB1Ok_C InjVlv_DebBnkB2Def_C InjVlv_DebBnkB2Ok_C InjVlv_DebBnkB3Def_C InjVlv_DebBnkB3Ok_C InjVlv_DebChipA0Def_C InjVlv_DebChipA0Ok_C InjVlv_DebChipA1Def_C InjVlv_DebChipA1Ok_C InjVlv_DebChipA2Def_C InjVlv_DebChipA2Ok_C InjVlv_DebChipA3Def_C InjVlv_DebChipA3Ok_C InjVlv_DebChipB0Def_C InjVlv_DebChipB0Ok_C InjVlv_DebChipB1Def_C InjVlv_DebChipB1Ok_C InjVlv_DebChipB2Def_C InjVlv_DebChipB2Ok_C InjVlv_DebChipB3Def_C InjVlv_DebChipB3Ok_C InjVlv_DebCylA0Def_C InjVlv_DebCylA0Ok_C InjVlv_DebCylA1Def_C InjVlv_DebCylA1Ok_C InjVlv_DebCylA2Def_C InjVlv_DebCylA2Ok_C InjVlv_DebCylA3Def_C InjVlv_DebCylA3Ok_C InjVlv_DebCylB0Def_C InjVlv_DebCylB0Ok_C InjVlv_DebCylB1Def_C InjVlv_DebCylB1Ok_C InjVlv_DebCylB2Def_C InjVlv_DebCylB2Ok_C InjVlv_DebCylB3Def_C InjVlv_DebCylB3Ok_C InjVlv_DebCylC0Def_C InjVlv_DebCylC0Ok_C InjVlv_DebCylC1Def_C InjVlv_DebCylC1Ok_C InjVlv_DebCylC2Def_C InjVlv_DebCylC2Ok_C InjVlv_DebCylC3Def_C InjVlv_DebCylC3Ok_C InjVlv_iMonDisChDwn_C InjVlv_nMonQckThresLo_C InjVlv_numNoLoadCylMax_C InjVlv_stErrMskPattern_C InjVlv_stErrMskSelect_C InjVlv_stMonQckEna_C InjVlv_uMonBattThres_C /end DEF_CHARACTERISTIC
 /begin OUT_MEASUREMENT InjVlv_ctMonQckIDiff_mp InjVlv_ctMonQckISel_mp InjVlv_stMonQckErr_mp /end OUT_MEASUREMENT
/end FUNCTION
/begin FUNCTION injvlv_mon_msg "" /begin OUT_MEASUREMENT InjVlv_ctMonActrMeas InjVlv_stInjValve InjVlv_stMonDiag /end OUT_MEASUREMENT /end FUNCTION
/begin FUNCTION injvlv_mon_uic ""
 /begin OUT_MEASUREMENT InjVlv_numIdxErrCyl1_mp InjVlv_numIdxErrCyl2_mp InjVlv_numIdxErrCyl3_mp InjVlv_numIdxErrCyl4_mp InjVlv_numIdxErrCyl5_mp InjVlv_numIdxErrCyl6_mp InjVlv_numIdxErrCyl7_mp InjVlv_numIdxErrCyl8_mp InjVlv_stErrClctCyl1_mp InjVlv_stErrClctCyl2_mp InjVlv_stErrClctCyl3_mp InjVlv_stErrClctCyl4_mp InjVlv_stErrClctCyl5_mp InjVlv_stErrClctCyl6_mp InjVlv_stErrClctCyl7_mp InjVlv_stErrClctCyl8_mp InjVlv_stErrUnknown_mp /end OUT_MEASUREMENT
/end FUNCTION
/begin FUNCTION injvlv_nvc "Nominal Voltage Calibration (Spannungsadaption)"
 /begin DEF_CHARACTERISTIC InjVCD_stAvrgEnaTiWarn_C InjVlv_facNVCInitI_C InjVlv_facNVCInPI_C InjVlv_facNVCMax_C InjVlv_facNVCMin_C InjVlv_NVCIKi_C InjVlv_NVCIKiPos_C InjVlv_NVCIKiNeg_C InjVlv_uNVCIWinPos_C InjVlv_uNVCIWinNeg_C InjVlv_pNVCMax_C InjVlv_pNVCMin_C InjVlv_NVCPKp_C InjVlv_NVCPKpPos_C InjVlv_NVCPKpNeg_C InjVlv_uNVCPWinPos_C InjVlv_uNVCPWinNeg_C InjVlv_tiNVCDwnThres_C InjVlv_tiNVCUpThres_C InjVlv_tNVCEngMax_C InjVlv_tNVCEngMin_C InjVlv_uDiffNVCSet_CUR InjVlv_uNVCThres_C InjVlv_uSetUpNVCActrMax_C InjVlv_uSetUpNVCActrMin_C /end DEF_CHARACTERISTIC
 /begin IN_MEASUREMENT InjVCD_pActInj /end IN_MEASUREMENT
 /begin OUT_MEASUREMENT InjVlv_stNVCCrit_mp InjVlv_uDiffNVCActrInPI_mp InjVlv_uDiffNVCActr_mp InjVlv_uDiffNVCSet_mp InjVlv_uSetUpNVCActrUnLim_mp /end OUT_MEASUREMENT
/end FUNCTION
/begin FUNCTION injvlv_nvc_msg ""
 /begin OUT_MEASUREMENT InjVlv_facNVCActr InjVlv_stNVCEna InjVlv_stNVCPI InjVlv_uSetUpNVCActr InjVlv_uSetUpTiChrgActr /end OUT_MEASUREMENT
/end FUNCTION
/begin FUNCTION injvlv_nvc_uic "" /end FUNCTION
/begin FUNCTION injvlv_presmin "Abschaltanforderung aufgrund Mindestdruck" /begin DEF_CHARACTERISTIC InjVlv_pMin_C InjVlv_pMin_CUR /end DEF_CHARACTERISTIC /begin IN_MEASUREMENT InjCrv_tEng /end IN_MEASUREMENT /end FUNCTION
/begin FUNCTION injvlv_qntadj "Injektor-Mengenabgleich"
 /begin DEF_CHARACTERISTIC InjVlv_numClsVltgAdjMax_C InjVlv_numClsVltgAdjMin_C InjVlv_stQntAdj_MAP InjVlv_volQntAdjLim_C InjVlv_volQntAdjMax0_C InjVlv_volQntAdjMax1_C InjVlv_volQntAdjMax2_C InjVlv_volQntAdjMax3_C InjVlv_volQntAdjMin0_C InjVlv_volQntAdjMin1_C InjVlv_volQntAdjMin2_C InjVlv_volQntAdjMin3_C /end DEF_CHARACTERISTIC
 /begin IN_MEASUREMENT InjUn_volMI1Cor_mp RailCD_pPeak /end IN_MEASUREMENT
 /begin OUT_MEASUREMENT InjVlv_numCodeVltgAdj_mp InjVlv_stAdj_mp InjVlv_stCheckSumErrVltgAdj_mp InjVlv_stMaxErrVltgAdj_mp /end OUT_MEASUREMENT
/end FUNCTION
/begin FUNCTION injvlv_qntadjrepl "" /begin DEF_CHARACTERISTIC InjVlv_stQntAdjRepl_C InjVlv_swtQntAdj_C /end DEF_CHARACTERISTIC /end FUNCTION
/begin FUNCTION injvlv_qntadj_uic ""
 /begin OUT_MEASUREMENT InjVlv_volMI1QntAdj_mp InjVlv_volPiI1QntAdj_mp InjVlv_volPiI2QntAdj_mp InjVlv_volPiI3QntAdj_mp InjVlv_volPoI1QntAdj_mp InjVlv_volPoI2QntAdj_mp /end OUT_MEASUREMENT
/end FUNCTION
/begin FUNCTION injvlv_tdiffhyd "" /begin DEF_CHARACTERISTIC InjVlv_tiDiffHyd_MAP /end DEF_CHARACTERISTIC /begin IN_MEASUREMENT InjCrv_qMI1Des RailCD_pAct_mp /end IN_MEASUREMENT /end FUNCTION
/begin FUNCTION injvlv_tdiffhyd_uic ""
 /begin OUT_MEASUREMENT InjVlv_tiMI1DiffHydCor_mp InjVlv_tiPiI1DiffHydCor_mp InjVlv_tiPiI2DiffHydCor_mp /end OUT_MEASUREMENT
/end FUNCTION
/begin FUNCTION injvlv_wvcor "Druckwellenkorrektur"
 /begin DEF_CHARACTERISTIC InjVlv_facFTSWvCor_MAP InjVlv_qWvCorNorm_CUR InjVlv_stWvCorActv_C InjVlv_tWvCor_MAP /end DEF_CHARACTERISTIC
 /begin IN_MEASUREMENT CTSCD_tClnt FTSCD_tFuel InjVlv_tWvCor_mp RailCD_pPeak /end IN_MEASUREMENT
/end FUNCTION
/begin FUNCTION injvlv_wvcorlib "Druckwellenkorrektur Funktionsbibliothek"
 /begin DEF_CHARACTERISTIC InjVlv_facPiI2WvCor_C InjVlv_facWvCor1_MAP InjVlv_facWvCor2_MAP InjVlv_qWvCor1_MAP InjVlv_qWvCor2_MAP InjVlv_qWvCorMax_C InjVlv_qWvCorMin_C /end DEF_CHARACTERISTIC
 /begin IN_MEASUREMENT InjCrv_qMI1Des InjCrv_qPiI1Des InjCrv_qPoI2Des_mp InjVlv_rMI1WvCorNorm_mp InjVlv_tiMI1PoI2Cor_mp InjVlv_tiPiI1MI1Cor_mp RailCD_pAct_mp /end IN_MEASUREMENT
 /begin OUT_MEASUREMENT InjVlv_pAct_mp /end OUT_MEASUREMENT
/end FUNCTION
/begin FUNCTION injvlv_wvcorlib_uic ""
 /begin OUT_MEASUREMENT InjVlv_facMI1PoI2WvCor_mp InjVlv_facPiI2PiI1WvCor_mp InjVlv_facPiIMI1WvCor_mp InjVlv_qMI1PoI2WvCor_mp InjVlv_qMI1WvCor_mp InjVlv_qPiI1MI1WvCor_mp InjVlv_qPiI1WvCor_mp InjVlv_qPiI2MI1WvCor_mp InjVlv_qPiI2PiI1WvCor_mp InjVlv_qPoI2WvCor_mp InjVlv_rMI1WvCorNorm_mp InjVlv_tiMI1PoI2Cor_mp InjVlv_tiMI1PoI2_mp InjVlv_tiPiI1MI1Cor_mp InjVlv_tiPiI1MI1_mp InjVlv_tiPiI2MI1Cor_mp InjVlv_tiPiI2MI1_mp InjVlv_tiPiI2PiI1Cor_mp InjVlv_tiPiI2PiI1_mp /end OUT_MEASUREMENT
/end FUNCTION
/begin FUNCTION injvlv_wvcor_msg "" /begin OUT_MEASUREMENT InjVlv_facFTSWvCor InjVlv_qWvCorNorm InjVlv_stWvCor /end OUT_MEASUREMENT /end FUNCTION
/begin FUNCTION injvlv_wvcor_uic "" /begin OUT_MEASUREMENT InjVlv_tWvCor_mp /end OUT_MEASUREMENT /end FUNCTION
/begin FUNCTION ivctl_tichrg "Ladezeitregelung des Piezoaktors"
 /begin DEF_CHARACTERISTIC IVCtl_ChrgUpIKi_C IVCtl_ChrgUpIKiPos_C IVCtl_ChrgUpIKiNeg_C IVCtl_tiChrgUpIWinPos_C IVCtl_tiChrgUpIWinNeg_C IVCtl_ChrgUpPKp_C IVCtl_ChrgUpPKpPos_C IVCtl_ChrgUpPKpNeg_C IVCtl_tiChrgUpPWinPos_C IVCtl_tiChrgUpPWinNeg_C IVCtl_DisChDwnIKi_C IVCtl_DisChDwnIKiPos_C IVCtl_DisChDwnIKiNeg_C IVCtl_tiDisChDwnIWinPos_C IVCtl_tiDisChDwnIWinNeg_C IVCtl_DisChDwnPKp_C IVCtl_DisChDwnPKpPos_C IVCtl_DisChDwnPKpNeg_C IVCtl_tiDisChDwnPWinPos_C IVCtl_tiDisChDwnPWinNeg_C IVCtl_iChrgUpCls_C IVCtl_iChrgUpGovMax_C IVCtl_iChrgUpGovMin_C IVCtl_iChrgUpInitI_C IVCtl_iChrgUpMax_C IVCtl_iChrgUpMin_C IVCtl_iChrgUp_CUR IVCtl_iDisChDwnCls_C IVCtl_iDisChDwnGovMax_C IVCtl_iDisChDwnGovMin_C IVCtl_iDisChDwnInitI_C IVCtl_iDisChDwnMax_C IVCtl_iDisChDwnMin_C IVCtl_iDisChDwn_CUR IVCtl_swtTiChrgMinMaxActr_C IVCtl_swtTiChrgMinMaxRst_C IVCtl_swtTiChrgMinMax_C IVCtl_tiChrgSetUp_CUR IVCtl_tiChrgUpPse_C IVCtl_tiDisChDwnPse_C IVCtl_tiDisChSetDwn_CUR /end DEF_CHARACTERISTIC
 /begin OUT_MEASUREMENT IVCtl_iChrgUp2_mp IVCtl_iChrgUpPI_mp IVCtl_iChrgUp_mp IVCtl_iDisChDwnPI_mp IVCtl_tiChrgSetUp_mp IVCtl_tiChrgUpAvrg_mp IVCtl_tiChrgUpInPIActr_mp IVCtl_tiChrgUpMaxActr_mp IVCtl_tiChrgUpMax_mp IVCtl_tiChrgUpMinActr_mp IVCtl_tiChrgUpMin_mp IVCtl_tiChrgUpPse_mp IVCtl_tiDisChBottAvrg_mp IVCtl_tiDisChDwnInPIActr_mp IVCtl_tiDisChDwnMaxActr_mp IVCtl_tiDisChDwnMax_mp IVCtl_tiDisChDwnMinActr_mp IVCtl_tiDisChDwnMin_mp IVCtl_tiDisChDwnPse_mp IVCtl_tiDisChSetDwn_mp IVCtl_uSetUp2Avrg_mp IVCtl_uSetUpAvrg_mp /end OUT_MEASUREMENT
/end FUNCTION
/begin FUNCTION ivctl_tichrg_msg ""
 /begin OUT_MEASUREMENT IVCtl_iDisChDwn IVCtl_iDisChDwn2 IVCtl_stTiChrgPI IVCtl_tiChrgUpInPI IVCtl_tiDisChDwnInPI /end OUT_MEASUREMENT
/end FUNCTION
/begin COMPU_METHOD Actr_Calc "Zustände für Aktiv und Inaktiv" TAB_VERB "%6.3" "" COMPU_TAB_REF Actr_Calc /end COMPU_METHOD
/begin COMPU_VTAB Actr_Calc "Zustände für Aktiv und Inaktiv" TAB_VERB 2 0 "Inactive" 1 "Active" /end COMPU_VTAB
/begin COMPU_METHOD Actr_Cls_State "Zustände für die Piezoaktor Klassifizierung" TAB_VERB "%6.3" "" COMPU_TAB_REF Actr_Cls_State /end COMPU_METHOD
/begin COMPU_VTAB Actr_Cls_State "Zustände für die Piezoaktor Klassifizierung" TAB_VERB 4 0 "Wait" 1 "Energise" 2 "Measure" 4 "Done" /end COMPU_VTAB
/begin COMPU_METHOD Actr_Temp_Sel "Position des Schalters der die Basis für die Piezo-Aktortempartur auswählt" TAB_VERB "%6.3" "" COMPU_TAB_REF Actr_Temp_Sel /end COMPU_METHOD
/begin COMPU_VTAB Actr_Temp_Sel "Position des Schalters der die Basis für die Piezo-Aktortempartur auswählt" TAB_VERB 2 0 "coolant water temperature" 1 "fuel temperature" /end COMPU_VTAB
/begin COMPU_METHOD AngleCrS "Winkel Kurbelwelle" RAT_FUNC "%6.4" "[deg CrS]" COEFFS 0 42.6666666666667 0 0 0 1 /end COMPU_METHOD
/begin COMPU_METHOD Capacity_PA "Kapazität der Piezo-Aktoren" RAT_FUNC "%6.5" "uF" COEFFS 0 1000 0 0 0 1 /end COMPU_METHOD
/begin COMPU_METHOD Charge_PA "Ladung der Piezo-Aktoren" RAT_FUNC "%6.2" "uC" COEFFS 0 1 0 0 0 1 /end COMPU_METHOD
/begin COMPU_METHOD Curr "Strom" RAT_FUNC "%6.2" "[mA]" COEFFS 0 1 0 0 0 1 /end COMPU_METHOD
/begin COMPU_METHOD Delta_Volt_INT "ADC Spannungsgradient" RAT_FUNC "%6.2" "mV/ms" COEFFS 0 1 0 0 0 1 /end COMPU_METHOD
/begin COMPU_METHOD EngN "Motordrehzahl" RAT_FUNC "%6.2" "[rpm]" COEFFS 0 1 0 0 0 1 /end COMPU_METHOD
/begin COMPU_METHOD Fact "Faktor mit Auflösung 1 / 8192, hauptsächlich für einen Faktorenbereich 0...1 verwendet" RAT_FUNC "%6.5" "[-]" COEFFS 0 8192 0 0 0 1 /end COMPU_METHOD
/begin COMPU_METHOD Fact1 "Faktor mit Auflösung 0,01 (100 mal höherer Bereich als Fact)" RAT_FUNC "%6.4" "[-]" COEFFS 0 128 0 0 0 1 /end COMPU_METHOD
/begin COMPU_METHOD Fact_IntAmp "Auflösungsfaktor für Stromverstärkungsfaktor des CY370-Integrators - Auflösung 0.001" RAT_FUNC "%6.5" "-" COEFFS 0 1000 0 0 0 1 /end COMPU_METHOD
/begin COMPU_METHOD Frequency_PA "Frequenz" RAT_FUNC "%6.2" "Hz" COEFFS 0 1 0 0 0 1 /end COMPU_METHOD
/begin COMPU_METHOD InjMass "Einspritzmenge" RAT_FUNC "%6.4" "[mg/hub]" COEFFS 0 100 0 0 0 1 /end COMPU_METHOD
/begin COMPU_METHOD InjMassInj "Einspritzmenge pro Einspritzung (mg/Einspritzung)" RAT_FUNC "%6.4" "[mg/inj]" COEFFS 0 100 0 0 0 1 /end COMPU_METHOD
/begin COMPU_METHOD InjQntInj "Einspritzmenge der einzelnen Einspritzung" RAT_FUNC "%6.4" "mm^3/inj" COEFFS 0 100 0 0 0 1 /end COMPU_METHOD
/begin COMPU_METHOD InjTime_us "Zeit in Microsekunden für das Einspritztiming" RAT_FUNC "%6.2" "[us]" COEFFS 0 1 0 0 0 1 /end COMPU_METHOD
/begin COMPU_METHOD ISA_Code "ISA-Code für den Injektorspannungsabgleich" TAB_VERB "%6.3" "" COMPU_TAB_REF ISA_Code /end COMPU_METHOD
/begin COMPU_VTAB ISA_Code "ISA-Code für den Injektorspannungsabgleich" TAB_VERB 32 0 "A" 1 "B" 2 "C" 3 "D" 4 "E" 5 "F" 6 "G" 7 "H" 8 "I" 9 "K" 10 "L" 11 "M" 12 "N" 13 "O" 14 "P" 15 "R" 16 "S" 17 "T" 18 "U" 19 "V" 20 "W" 21 "X" 22 "Y" 23 "Z" 24 "1" 25 "2" 26 "3" 27 "4" 28 "5" 29 "6" 30 "7" 31 "8" /end COMPU_VTAB
/begin COMPU_METHOD Ki_us2mA "Umrechnung für PI-(Ent)ladezeitregler" RAT_FUNC "%6.4" "mA/(us*s)" COEFFS 0 429.4967296 0 0 0 1 /end COMPU_METHOD
/begin COMPU_METHOD Ki_VOLTPA2FACT "Integrale Verstärkung (Umrechnung von der Aktorspannung auf Faktor)" RAT_FUNC "%8.7" "1/(V*s)" COEFFS 0 351843.72088832 0 0 0 1 /end COMPU_METHOD
/begin COMPU_METHOD Kp_us2mA "Umrechnung für PI-(Ent)ladezeitregler" RAT_FUNC "%6.5" "mA/us" COEFFS 0 6553.6 0 0 0 1 /end COMPU_METHOD
/begin COMPU_METHOD Kp_VOLTPA2FACT "Proportionale Verstärkung (Umrechnung von der Aktorspannung auf den Faktor)" RAT_FUNC "%9.8" "1/V" COEFFS 0 5368709.12 0 0 0 1 /end COMPU_METHOD
/begin COMPU_METHOD Milli "Milli Auflösung" RAT_FUNC "%7.6" "-" COEFFS 0 25000 0 0 0 1 /end COMPU_METHOD
/begin COMPU_METHOD OneToOne "eins zu eins (physikalischer Wert ist gleich dem internen Wert)" RAT_FUNC "%6.2" "[-]" COEFFS 0 1 0 0 0 1 /end COMPU_METHOD
/begin COMPU_METHOD Prc "Prozent, gleiche interne Auflösung wie Fact, aber Darstellung in Prozent (0...100%)" RAT_FUNC "%6.4" "[%]" COEFFS 0 100 0 0 0 1 /end COMPU_METHOD
/begin COMPU_METHOD Pres_Rail "Raildruck in hPa" RAT_FUNC "%6.0" "[hPa]" COEFFS 0 0.01 0 0 0 1 /end COMPU_METHOD
/begin COMPU_METHOD Pwr_PA "Leistung für Piezo-Aktor" RAT_FUNC "%6.2" "mW" COEFFS 0 1 0 0 0 1 /end COMPU_METHOD
/begin COMPU_METHOD QntR "Normierungsverhältnis Einspritzmenge / Normierungsmenge" RAT_FUNC "%6.5" "-" COEFFS 0 1024 0 0 0 1 /end COMPU_METHOD
/begin COMPU_METHOD Resist_mOhm "Widerstand mit 1/10 mOhm Auflösung" RAT_FUNC "%6.3" "mOhm" COEFFS 0 10 0 0 0 1 /end COMPU_METHOD
/begin COMPU_METHOD RmpInjMass "Rampengradient für Einspritzmenge" RAT_FUNC "%6.5" "[(mg/stroke)/s]" COEFFS 0 6553.6 0 0 0 1 /end COMPU_METHOD
/begin COMPU_METHOD stMonShCir "Status des Ansteuerung im nachlauf für Kurzschlussunterscheidung" TAB_VERB "%6.3" "" COMPU_TAB_REF stMonShCir /end COMPU_METHOD
/begin COMPU_VTAB stMonShCir "Status des Ansteuerung im nachlauf für Kurzschlussunterscheidung" TAB_VERB 4 0 "Wait" 1 "Energise" 2 "Gettime" 4 "Done" /end COMPU_VTAB
/begin COMPU_METHOD Temp_Cels "Temperatur dargestellt in °C (gleiche interne Darstellung wie Temp_Kelv)" RAT_FUNC "%6.1" "[deg C]" COEFFS 0 10 2731.4 0 0 1 /end COMPU_METHOD
/begin COMPU_METHOD Temp_Fahr "Temperatur dargestellt in Fahrenheit (gleiche interne Darstellung wie Temp_Kelv)" RAT_FUNC "%6.1" "[deg F]" COEFFS 0 5.55555555555556 2553.62222222222 0 0 1 /end COMPU_METHOD
/begin COMPU_METHOD TimeADCFilt "Zeit, spezielle Aufloesung für ADCFilt" RAT_FUNC "%6.4" "[ms]" COEFFS 0 256.016385048643 0 0 0 1 /end COMPU_METHOD
/begin COMPU_METHOD TimeDelay_s_1 "Zeitkonstante T1 (in s) für PT1, DT1, etc. normiert auf 16 bit" RAT_FUNC "%9.6" "[s]" COEFFS 0 0 1 0 0.95367431640625 0 /end COMPU_METHOD
/begin COMPU_METHOD TimeDT "Abtastzeit (in us) für Library Regler, Filter, etc." RAT_FUNC "%6.2" "[us]" COEFFS 0 1 0 0 0 1 /end COMPU_METHOD
/begin COMPU_METHOD Time_Busy "Lade-/Entladezeit der Piezosteller (us)" RAT_FUNC "%6.3" "us" COEFFS 0 10 0 0 0 1 /end COMPU_METHOD
/begin COMPU_METHOD Time_ms "Zeit in ms für Fehlerentprellung (DSM) und SW-Timer" RAT_FUNC "%6.1" "[ms]" COEFFS 0 0.1 0 0 0 1 /end COMPU_METHOD
/begin COMPU_METHOD Trq "Motormoment" RAT_FUNC "%6.3" "[Nm]" COEFFS 0 10 0 0 0 1 /end COMPU_METHOD
/begin COMPU_METHOD VltgAdj "Zustand des Injektor Spannungsabgleichs" TAB_VERB "%6.3" "" COMPU_TAB_REF VltgAdj /end COMPU_METHOD
/begin COMPU_VTAB VltgAdj "Zustand des Injektor Spannungsabgleichs" TAB_VERB 3 0 "EEPROM" 1 "replace values" 8 "external access" /end COMPU_VTAB
/begin COMPU_METHOD Volt "Spannung in V (von ADC)" RAT_FUNC "%6.2" "[mV]" COEFFS 0 0.2046 0 0 0 1 /end COMPU_METHOD
/begin COMPU_METHOD VoltInt "Spannung vom ADC zum Integratorabgleich" RAT_FUNC "%6.4" "mV" COEFFS 0 204.6 0 0 0 1 /end COMPU_METHOD
/begin COMPU_METHOD Volt_Batt "Batteriespannung" RAT_FUNC "%6.1" "[mV]" COEFFS 0 0.0492252911173131 0 0 0 1 /end COMPU_METHOD
/begin COMPU_METHOD Volt_BUFC "zur Berechnung der DC/DC-Wandler Pufferspannung" RAT_FUNC "%6.4" "V" COEFFS 0 100 0 0 0 1 /end COMPU_METHOD
/begin COMPU_METHOD Volt_PA "Spannung des Piezo-Aktors" RAT_FUNC "%6.4" "V" COEFFS 0 100 0 0 0 1 /end COMPU_METHOD
/begin COMPU_METHOD W_PA "Energieverbrauch des Piezo-Aktors" RAT_FUNC "%6.2" "mWs" COEFFS 0 1 0 0 0 1 /end COMPU_METHOD
/begin RECORD_LAYOUT Gkf_Ws16 FNC_VALUES 1 SWORD COLUMN_DIR DIRECT /end RECORD_LAYOUT
/begin RECORD_LAYOUT GSst_Xs16 NO_AXIS_PTS_X 1 SWORD AXIS_PTS_X 2 SWORD INDEX_INCR DIRECT /end RECORD_LAYOUT
/begin RECORD_LAYOUT Kf_Xs16_Ys16_Ws16 NO_AXIS_PTS_X 1 SWORD NO_AXIS_PTS_Y 2 SWORD AXIS_PTS_X 3 SWORD INDEX_INCR DIRECT AXIS_PTS_Y 4 SWORD INDEX_INCR DIRECT FNC_VALUES 5 SWORD COLUMN_DIR DIRECT /end RECORD_LAYOUT
/begin RECORD_LAYOUT Kl_Xs16_Ws16 NO_AXIS_PTS_X 1 SWORD AXIS_PTS_X 2 SWORD INDEX_INCR DIRECT FNC_VALUES 3 SWORD COLUMN_DIR DIRECT /end RECORD_LAYOUT
/begin RECORD_LAYOUT Kwb_Ws16 FNC_VALUES 1 SWORD COLUMN_DIR DIRECT /end RECORD_LAYOUT
/begin RECORD_LAYOUT Kwb_Wu32 FNC_VALUES 1 ULONG COLUMN_DIR DIRECT /end RECORD_LAYOUT
/begin RECORD_LAYOUT Kw_Ws16 FNC_VALUES 1 SWORD COLUMN_DIR DIRECT /end RECORD_LAYOUT
/begin RECORD_LAYOUT Kw_Ws32 FNC_VALUES 1 SLONG COLUMN_DIR DIRECT /end RECORD_LAYOUT
/begin RECORD_LAYOUT Kw_Wu16 FNC_VALUES 1 UWORD COLUMN_DIR DIRECT /end RECORD_LAYOUT
/begin RECORD_LAYOUT Kw_Wu32 FNC_VALUES 1 ULONG COLUMN_DIR DIRECT /end RECORD_LAYOUT
/begin RECORD_LAYOUT Kw_Wu8 FNC_VALUES 1 UBYTE COLUMN_DIR DIRECT /end RECORD_LAYOUT
/end MODULE
/end PROJECT
