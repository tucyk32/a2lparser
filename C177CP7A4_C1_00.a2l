ASAP2_VERSION 1 3
/begin PROJECT C177 "EDC16CP"
/begin HEADER "" VERSION "VCP7A3" PROJECT_NO C177 /end HEADER
/begin MODULE DIM ""
/begin MOD_COMMON "" BYTE_ORDER MSB_FIRST ALIGNMENT_BYTE 1 ALIGNMENT_WORD 2 ALIGNMENT_LONG 4 ALIGNMENT_FLOAT32_IEEE 4 /end MOD_COMMON
/begin CHARACTERISTIC AFSCD_tiLPFilt_C "Zeitkonstante für HFM Tiefpaß Filter" VALUE 0x1C0C8C Kw_Wu32 0.099997239 TimeDelay_s 0.0000020000000 0.099999239 FORMAT "%10.8" EXTENDED_LIMITS 0.0000010000000 4294.9673 /end CHARACTERISTIC
/begin CHARACTERISTIC DSM_RdyABForceMsk_C "Maske zur Erzwingung von Readiness durch bitweises AND mit Message DSM_stRdyAB" VALUE 0x1CD92E Kw_Wu16 65535.00 OneToOne 0.00 65535.00 FORMAT "%8.2" /end CHARACTERISTIC
/begin CHARACTERISTIC DSM_RdyCDForceMsk_C "Maske zur Erzwingung von Readiness durch bitweises AND mit Message DSM_stRdyCD" VALUE 0x1CD930 Kw_Wu16 65535.00 OneToOne 0.00 65535.00 FORMAT "%8.2" /end CHARACTERISTIC
/begin CHARACTERISTIC DSM_RdyOnMilEnable_C "Verhalten Readiness bei angesteuerter MIL" VALUE 0x1CD932 Kw_Wu8 1.00000000000 RdyOnMilEnable 0.00 1.00000000000 FORMAT "%13.11" /end CHARACTERISTIC
/begin CHARACTERISTIC DSM_TsfDfp_ACCCDWrongCoded_C "Schwerezaehlergrenze fuer Fehlerpfad Dfp_ACCCDWrongCoded" VALUE 0x1CD7BE Kw_Wu8 51000. TimeDsmTsf 0.00 51000. FORMAT "%5.0" /end CHARACTERISTIC
/begin CHARACTERISTIC DSM_TsfDfp_ACCD_C "Schwerezaehlergrenze fuer Fehlerpfad Dfp_ACCD" VALUE 0x1CD7BF Kw_Wu8 51000. TimeDsmTsf 0.00 51000. FORMAT "%5.0" /end CHARACTERISTIC
/begin CHARACTERISTIC DSM_TsfDfp_ACCD_PAC_C "Schwerezaehlergrenze fuer Fehlerpfad Dfp_ACCD_PAC" VALUE 0x1CD7C0 Kw_Wu8 51000. TimeDsmTsf 0.00 51000. FORMAT "%5.0" /end CHARACTERISTIC
/begin CHARACTERISTIC DSM_TsfDfp_ACCD_pCAN_C "Schwerezaehlergrenze fuer Fehlerpfad Dfp_ACCD_pCAN" VALUE 0x1CD7C1 Kw_Wu8 51000. TimeDsmTsf 0.00 51000. FORMAT "%5.0" /end CHARACTERISTIC
/begin CHARACTERISTIC DSM_TsfDfp_ACCD_trqCAN_C "Schwerezaehlergrenze fuer Fehlerpfad Dfp_ACCD_trqCAN" VALUE 0x1CD7C2 Kw_Wu8 51000. TimeDsmTsf 0.00 51000. FORMAT "%5.0" /end CHARACTERISTIC
/begin CHARACTERISTIC DSM_TsfDfp_ACCnotPlaus_C "Schwerezaehlergrenze fuer Fehlerpfad Dfp_ACCnotPlaus" VALUE 0x1CD7C3 Kw_Wu8 51000. TimeDsmTsf 0.00 51000. FORMAT "%5.0" /end CHARACTERISTIC
/begin CHARACTERISTIC DSM_TsfDfp_ADCMon_C "Schwerezaehlergrenze fuer Fehlerpfad Dfp_ADCMon" VALUE 0x1CD7C4 Kw_Wu8 51000. TimeDsmTsf 0.00 51000. FORMAT "%5.0" /end CHARACTERISTIC
/begin CHARACTERISTIC DSM_TsfDfp_AFSCD_AirTempDcyc_C "Schwerezaehlergrenze fuer Fehlerpfad Dfp_AFSCD_AirTempDcyc" VALUE 0x1CD7C5 Kw_Wu8 51000. TimeDsmTsf 0.00 51000. FORMAT "%5.0" /end CHARACTERISTIC
/begin CHARACTERISTIC DSM_TsfDfp_AFSCD_PlOffsDrft_C "Schwerezaehlergrenze fuer Fehlerpfad Dfp_AFSCD_PlOffsDrft" VALUE 0x1CD7C6 Kw_Wu8 51000. TimeDsmTsf 0.00 51000. FORMAT "%5.0" /end CHARACTERISTIC
/begin CHARACTERISTIC DSM_TsfDfp_AFSCD_PlSetyDrft_C "Schwerezaehlergrenze fuer Fehlerpfad Dfp_AFSCD_PlSetyDrft" VALUE 0x1CD7C7 Kw_Wu8 51000. TimeDsmTsf 0.00 51000. FORMAT "%5.0" /end CHARACTERISTIC
/begin CHARACTERISTIC DSM_TsfDfp_AFSCD_Plaus_C "Schwerezaehlergrenze fuer Fehlerpfad Dfp_AFSCD_Plaus" VALUE 0x1CD7C8 Kw_Wu8 51000. TimeDsmTsf 0.00 51000. FORMAT "%5.0" /end CHARACTERISTIC
/begin CHARACTERISTIC DSM_TsfDfp_AFSCD_SRCAirTemp_C "Schwerezaehlergrenze fuer Fehlerpfad Dfp_AFSCD_SRCAirTemp" VALUE 0x1CD7C9 Kw_Wu8 51000. TimeDsmTsf 0.00 51000. FORMAT "%5.0" /end CHARACTERISTIC
/begin CHARACTERISTIC DSM_TsfDfp_AFSCD_SRCAirm_C "Schwerezaehlergrenze fuer Fehlerpfad Dfp_AFSCD_SRCAirm" VALUE 0x1CD7CA Kw_Wu8 51000. TimeDsmTsf 0.00 51000. FORMAT "%5.0" /end CHARACTERISTIC
/begin CHARACTERISTIC DSM_TsfDfp_AFSCD_SRCAirm2_C "Schwerezaehlergrenze fuer Fehlerpfad Dfp_AFSCD_SRCAirm2" VALUE 0x1CD7CB Kw_Wu8 51000. TimeDsmTsf 0.00 51000. FORMAT "%5.0" /end CHARACTERISTIC
/begin CHARACTERISTIC DSM_TsfDfp_AFSCD_SRCBatt_C "Schwerezaehlergrenze fuer Fehlerpfad Dfp_AFSCD_SRCBatt" VALUE 0x1CD7CC Kw_Wu8 51000. TimeDsmTsf 0.00 51000. FORMAT "%5.0" /end CHARACTERISTIC
/begin CHARACTERISTIC DSM_TsfDfp_AFSCD_SRCCorrAirm_C "Schwerezaehlergrenze fuer Fehlerpfad Dfp_AFSCD_SRCCorrAirm" VALUE 0x1CD7CD Kw_Wu8 51000. TimeDsmTsf 0.00 51000. FORMAT "%5.0" /end CHARACTERISTIC
/begin CHARACTERISTIC DSM_TsfDfp_AFSCD_SRCRawAirm_C "Schwerezaehlergrenze fuer Fehlerpfad Dfp_AFSCD_SRCRawAirm" VALUE 0x1CD7CE Kw_Wu8 51000. TimeDsmTsf 0.00 51000. FORMAT "%5.0" /end CHARACTERISTIC
/begin CHARACTERISTIC DSM_TsfDfp_AFSCD_SRCRefSigPer_C "Schwerezaehlergrenze fuer Fehlerpfad Dfp_AFSCD_SRCRefSigPer" VALUE 0x1CD7CF Kw_Wu8 51000. TimeDsmTsf 0.00 51000. FORMAT "%5.0" /end CHARACTERISTIC
/begin CHARACTERISTIC DSM_TsfDfp_AFVCD_Actr_C "Schwerezaehlergrenze fuer Fehlerpfad Dfp_AFVCD_Actr" VALUE 0x1CD7D0 Kw_Wu8 51000. TimeDsmTsf 0.00 51000. FORMAT "%5.0" /end CHARACTERISTIC
/begin CHARACTERISTIC DSM_TsfDfp_AOHtCDHt1_C "Schwerezaehlergrenze fuer Fehlerpfad Dfp_AOHtCDHt1" VALUE 0x1CD7D1 Kw_Wu8 51000. TimeDsmTsf 0.00 51000. FORMAT "%5.0" /end CHARACTERISTIC
/begin CHARACTERISTIC DSM_TsfDfp_AOHtCDHt2_C "Schwerezaehlergrenze fuer Fehlerpfad Dfp_AOHtCDHt2" VALUE 0x1CD7D2 Kw_Wu8 51000. TimeDsmTsf 0.00 51000. FORMAT "%5.0" /end CHARACTERISTIC
/begin CHARACTERISTIC DSM_TsfDfp_AOHtCDHt3_C "Schwerezaehlergrenze fuer Fehlerpfad Dfp_AOHtCDHt3" VALUE 0x1CD7D3 Kw_Wu8 51000. TimeDsmTsf 0.00 51000. FORMAT "%5.0" /end CHARACTERISTIC
/begin CHARACTERISTIC DSM_TsfDfp_APP1_C "Schwerezaehlergrenze fuer Fehlerpfad Dfp_APP1" VALUE 0x1CD7D4 Kw_Wu8 51000. TimeDsmTsf 0.00 51000. FORMAT "%5.0" /end CHARACTERISTIC
/begin CHARACTERISTIC DSM_TsfDfp_APP2_C "Schwerezaehlergrenze fuer Fehlerpfad Dfp_APP2" VALUE 0x1CD7D5 Kw_Wu8 51000. TimeDsmTsf 0.00 51000. FORMAT "%5.0" /end CHARACTERISTIC
/begin CHARACTERISTIC DSM_TsfDfp_APPCD_KickDown_C "Schwerezaehlergrenze fuer Fehlerpfad Dfp_APPCD_KickDown" VALUE 0x1CD7D6 Kw_Wu8 51000. TimeDsmTsf 0.00 51000. FORMAT "%5.0" /end CHARACTERISTIC
/begin CHARACTERISTIC DSM_TsfDfp_APPSync_C "Schwerezaehlergrenze fuer Fehlerpfad Dfp_APPSync" VALUE 0x1CD7D7 Kw_Wu8 51000. TimeDsmTsf 0.00 51000. FORMAT "%5.0" /end CHARACTERISTIC
/begin CHARACTERISTIC DSM_TsfDfp_APP_Npl_C "Schwerezaehlergrenze fuer Fehlerpfad Dfp_APP_Npl" VALUE 0x1CD7D8 Kw_Wu8 51000. TimeDsmTsf 0.00 51000. FORMAT "%5.0" /end CHARACTERISTIC
/begin CHARACTERISTIC DSM_TsfDfp_APSCD_C "Schwerezaehlergrenze fuer Fehlerpfad Dfp_APSCD" VALUE 0x1CD7D9 Kw_Wu8 51000. TimeDsmTsf 0.00 51000. FORMAT "%5.0" /end CHARACTERISTIC
/begin CHARACTERISTIC DSM_TsfDfp_AccPedPlausBrk_C "Schwerezaehlergrenze fuer Fehlerpfad Dfp_AccPedPlausBrk" VALUE 0x1CD7DA Kw_Wu8 51000. TimeDsmTsf 0.00 51000. FORMAT "%5.0" /end CHARACTERISTIC
/begin CHARACTERISTIC DSM_TsfDfp_AddPCD_C "Schwerezaehlergrenze fuer Fehlerpfad Dfp_AddPCD" VALUE 0x1CD7DB Kw_Wu8 51000. TimeDsmTsf 0.00 51000. FORMAT "%5.0" /end CHARACTERISTIC
/begin CHARACTERISTIC DSM_TsfDfp_AddPCDTnkLvl_C "Schwerezaehlergrenze fuer Fehlerpfad Dfp_AddPCDTnkLvl" VALUE 0x1CD7DC Kw_Wu8 51000. TimeDsmTsf 0.00 51000. FORMAT "%5.0" /end CHARACTERISTIC
/begin CHARACTERISTIC DSM_TsfDfp_AddPCDTnkLvlDef_C "Schwerezaehlergrenze fuer Fehlerpfad Dfp_AddPCDTnkLvlDef" VALUE 0x1CD7DD Kw_Wu8 51000. TimeDsmTsf 0.00 51000. FORMAT "%5.0" /end CHARACTERISTIC
/begin CHARACTERISTIC DSM_TsfDfp_AirCtl_GovDev_C "Schwerezaehlergrenze fuer Fehlerpfad Dfp_AirCtl_GovDev" VALUE 0x1CD7DE Kw_Wu8 51000. TimeDsmTsf 0.00 51000. FORMAT "%5.0" /end CHARACTERISTIC
/begin CHARACTERISTIC DSM_TsfDfp_AirbCDCrash_C "Schwerezaehlergrenze fuer Fehlerpfad Dfp_AirbCDCrash" VALUE 0x1CD7DF Kw_Wu8 51000. TimeDsmTsf 0.00 51000. FORMAT "%5.0" /end CHARACTERISTIC
/begin CHARACTERISTIC DSM_TsfDfp_AirbCDCrashCrCtl_C "Schwerezaehlergrenze fuer Fehlerpfad Dfp_AirbCDCrashCrCtl" VALUE 0x1CD7E0 Kw_Wu8 51000. TimeDsmTsf 0.00 51000. FORMAT "%5.0" /end CHARACTERISTIC
/begin CHARACTERISTIC DSM_TsfDfp_AirbCDCrashPSP_C "Schwerezaehlergrenze fuer Fehlerpfad Dfp_AirbCDCrashPSP" VALUE 0x1CD7E1 Kw_Wu8 51000. TimeDsmTsf 0.00 51000. FORMAT "%5.0" /end CHARACTERISTIC
/begin CHARACTERISTIC DSM_TsfDfp_AltCDExc_C "Schwerezaehlergrenze fuer Fehlerpfad Dfp_AltCDExc" VALUE 0x1CD7E2 Kw_Wu8 51000. TimeDsmTsf 0.00 51000. FORMAT "%5.0" /end CHARACTERISTIC
/begin CHARACTERISTIC DSM_TsfDfp_AltCD_Load_C "Schwerezaehlergrenze fuer Fehlerpfad Dfp_AltCD_Load" VALUE 0x1CD7E3 Kw_Wu8 51000. TimeDsmTsf 0.00 51000. FORMAT "%5.0" /end CHARACTERISTIC
/begin CHARACTERISTIC DSM_TsfDfp_AltPwrCan_C "Schwerezaehlergrenze fuer Fehlerpfad Dfp_AltPwrCan" VALUE 0x1CD7E4 Kw_Wu8 51000. TimeDsmTsf 0.00 51000. FORMAT "%5.0" /end CHARACTERISTIC
/begin CHARACTERISTIC DSM_TsfDfp_BPACD_Max_C "Schwerezaehlergrenze fuer Fehlerpfad Dfp_BPACD_Max" VALUE 0x1CD7E5 Kw_Wu8 51000. TimeDsmTsf 0.00 51000. FORMAT "%5.0" /end CHARACTERISTIC
/begin CHARACTERISTIC DSM_TsfDfp_BPACD_Min_C "Schwerezaehlergrenze fuer Fehlerpfad Dfp_BPACD_Min" VALUE 0x1CD7E6 Kw_Wu8 51000. TimeDsmTsf 0.00 51000. FORMAT "%5.0" /end CHARACTERISTIC
/begin CHARACTERISTIC DSM_TsfDfp_BPACD_SigNpl_C "Schwerezaehlergrenze fuer Fehlerpfad Dfp_BPACD_SigNpl" VALUE 0x1CD7E7 Kw_Wu8 51000. TimeDsmTsf 0.00 51000. FORMAT "%5.0" /end CHARACTERISTIC
/begin CHARACTERISTIC DSM_TsfDfp_BPAExcSensTemp_C "Schwerezaehlergrenze fuer Fehlerpfad Dfp_BPAExcSensTemp" VALUE 0x1CD7E8 Kw_Wu8 51000. TimeDsmTsf 0.00 51000. FORMAT "%5.0" /end CHARACTERISTIC
/begin CHARACTERISTIC DSM_TsfDfp_BPANotLrn_C "Schwerezaehlergrenze fuer Fehlerpfad Dfp_BPANotLrn" VALUE 0x1CD7E9 Kw_Wu8 51000. TimeDsmTsf 0.00 51000. FORMAT "%5.0" /end CHARACTERISTIC
/begin CHARACTERISTIC DSM_TsfDfp_BPASCDDcyc_C "Schwerezaehlergrenze fuer Fehlerpfad Dfp_BPASCDDcyc" VALUE 0x1CD7EA Kw_Wu8 51000. TimeDsmTsf 0.00 51000. FORMAT "%5.0" /end CHARACTERISTIC
/begin CHARACTERISTIC DSM_TsfDfp_BPASCDPeriod_C "Schwerezaehlergrenze fuer Fehlerpfad Dfp_BPASCDPeriod" VALUE 0x1CD7EB Kw_Wu8 51000. TimeDsmTsf 0.00 51000. FORMAT "%5.0" /end CHARACTERISTIC
/begin CHARACTERISTIC DSM_TsfDfp_BPSCD_C "Schwerezaehlergrenze fuer Fehlerpfad Dfp_BPSCD" VALUE 0x1CD7EC Kw_Wu8 51000. TimeDsmTsf 0.00 51000. FORMAT "%5.0" /end CHARACTERISTIC
/begin CHARACTERISTIC DSM_TsfDfp_BPSCDPlaus_C "Schwerezaehlergrenze fuer Fehlerpfad Dfp_BPSCDPlaus" VALUE 0x1CD7ED Kw_Wu8 51000. TimeDsmTsf 0.00 51000. FORMAT "%5.0" /end CHARACTERISTIC
/begin CHARACTERISTIC DSM_TsfDfp_BattCD_C "Schwerezaehlergrenze fuer Fehlerpfad Dfp_BattCD" VALUE 0x1CD7EE Kw_Wu8 51000. TimeDsmTsf 0.00 51000. FORMAT "%5.0" /end CHARACTERISTIC
/begin CHARACTERISTIC DSM_TsfDfp_BrkCD_C "Schwerezaehlergrenze fuer Fehlerpfad Dfp_BrkCD" VALUE 0x1CD7EF Kw_Wu8 51000. TimeDsmTsf 0.00 51000. FORMAT "%5.0" /end CHARACTERISTIC
/begin CHARACTERISTIC DSM_TsfDfp_BrkCDdynPl_C "Schwerezaehlergrenze fuer Fehlerpfad Dfp_BrkCDdynPl" VALUE 0x1CD7F0 Kw_Wu8 51000. TimeDsmTsf 0.00 51000. FORMAT "%5.0" /end CHARACTERISTIC
/begin CHARACTERISTIC DSM_TsfDfp_CANA_C "Schwerezaehlergrenze fuer Fehlerpfad Dfp_CANA" VALUE 0x1CD7F1 Kw_Wu8 51000. TimeDsmTsf 0.00 51000. FORMAT "%5.0" /end CHARACTERISTIC
/begin CHARACTERISTIC DSM_TsfDfp_CANB_C "Schwerezaehlergrenze fuer Fehlerpfad Dfp_CANB" VALUE 0x1CD7F2 Kw_Wu8 51000. TimeDsmTsf 0.00 51000. FORMAT "%5.0" /end CHARACTERISTIC
/begin CHARACTERISTIC DSM_TsfDfp_CANBus1_C "Schwerezaehlergrenze fuer Fehlerpfad Dfp_CANBus1" VALUE 0x1CD7F3 Kw_Wu8 51000. TimeDsmTsf 0.00 51000. FORMAT "%5.0" /end CHARACTERISTIC
/begin CHARACTERISTIC DSM_TsfDfp_CANBus2_C "Schwerezaehlergrenze fuer Fehlerpfad Dfp_CANBus2" VALUE 0x1CD7F4 Kw_Wu8 51000. TimeDsmTsf 0.00 51000. FORMAT "%5.0" /end CHARACTERISTIC
/begin CHARACTERISTIC DSM_TsfDfp_CANBus3_C "Schwerezaehlergrenze fuer Fehlerpfad Dfp_CANBus3" VALUE 0x1CD7F5 Kw_Wu8 51000. TimeDsmTsf 0.00 51000. FORMAT "%5.0" /end CHARACTERISTIC
/begin CHARACTERISTIC DSM_TsfDfp_CANC_C "Schwerezaehlergrenze fuer Fehlerpfad Dfp_CANC" VALUE 0x1CD7F6 Kw_Wu8 51000. TimeDsmTsf 0.00 51000. FORMAT "%5.0" /end CHARACTERISTIC
/begin CHARACTERISTIC DSM_TsfDfp_CANErrActA_C "Schwerezaehlergrenze fuer Fehlerpfad Dfp_CANErrActA" VALUE 0x1CD7F7 Kw_Wu8 51000. TimeDsmTsf 0.00 51000. FORMAT "%5.0" /end CHARACTERISTIC
/begin CHARACTERISTIC DSM_TsfDfp_CANErrActB_C "Schwerezaehlergrenze fuer Fehlerpfad Dfp_CANErrActB" VALUE 0x1CD7F8 Kw_Wu8 51000. TimeDsmTsf 0.00 51000. FORMAT "%5.0" /end CHARACTERISTIC
/begin CHARACTERISTIC DSM_TsfDfp_CANErrActC_C "Schwerezaehlergrenze fuer Fehlerpfad Dfp_CANErrActC" VALUE 0x1CD7F9 Kw_Wu8 51000. TimeDsmTsf 0.00 51000. FORMAT "%5.0" /end CHARACTERISTIC
/begin CHARACTERISTIC DSM_TsfDfp_COTSCD_C "Schwerezaehlergrenze fuer Fehlerpfad Dfp_COTSCD" VALUE 0x1CD7FA Kw_Wu8 51000. TimeDsmTsf 0.00 51000. FORMAT "%5.0" /end CHARACTERISTIC
/begin CHARACTERISTIC DSM_TsfDfp_CTSCD_C "Schwerezaehlergrenze fuer Fehlerpfad Dfp_CTSCD" VALUE 0x1CD7FB Kw_Wu8 51000. TimeDsmTsf 0.00 51000. FORMAT "%5.0" /end CHARACTERISTIC
/begin CHARACTERISTIC DSM_TsfDfp_CTSCDCanInac_C "Schwerezaehlergrenze fuer Fehlerpfad Dfp_CTSCDCanInac" VALUE 0x1CD7FC Kw_Wu8 51000. TimeDsmTsf 0.00 51000. FORMAT "%5.0" /end CHARACTERISTIC
/begin CHARACTERISTIC DSM_TsfDfp_CTSCDCanSig_C "Schwerezaehlergrenze fuer Fehlerpfad Dfp_CTSCDCanSig" VALUE 0x1CD7FD Kw_Wu8 51000. TimeDsmTsf 0.00 51000. FORMAT "%5.0" /end CHARACTERISTIC
/begin CHARACTERISTIC DSM_TsfDfp_Clg_DynTst_C "Schwerezaehlergrenze fuer Fehlerpfad Dfp_Clg_DynTst" VALUE 0x1CD7FE Kw_Wu8 51000. TimeDsmTsf 0.00 51000. FORMAT "%5.0" /end CHARACTERISTIC
/begin CHARACTERISTIC DSM_TsfDfp_CmbChbMisfire1_C "Schwerezaehlergrenze fuer Fehlerpfad Dfp_CmbChbMisfire1" VALUE 0x1CD7FF Kw_Wu8 51000. TimeDsmTsf 0.00 51000. FORMAT "%5.0" /end CHARACTERISTIC
/begin CHARACTERISTIC DSM_TsfDfp_CmbChbMisfire2_C "Schwerezaehlergrenze fuer Fehlerpfad Dfp_CmbChbMisfire2" VALUE 0x1CD800 Kw_Wu8 51000. TimeDsmTsf 0.00 51000. FORMAT "%5.0" /end CHARACTERISTIC
/begin CHARACTERISTIC DSM_TsfDfp_CmbChbMisfire3_C "Schwerezaehlergrenze fuer Fehlerpfad Dfp_CmbChbMisfire3" VALUE 0x1CD801 Kw_Wu8 51000. TimeDsmTsf 0.00 51000. FORMAT "%5.0" /end CHARACTERISTIC
/begin CHARACTERISTIC DSM_TsfDfp_CmbChbMisfire4_C "Schwerezaehlergrenze fuer Fehlerpfad Dfp_CmbChbMisfire4" VALUE 0x1CD802 Kw_Wu8 51000. TimeDsmTsf 0.00 51000. FORMAT "%5.0" /end CHARACTERISTIC
/begin CHARACTERISTIC DSM_TsfDfp_CmbChbMisfire5_C "Schwerezaehlergrenze fuer Fehlerpfad Dfp_CmbChbMisfire5" VALUE 0x1CD803 Kw_Wu8 51000. TimeDsmTsf 0.00 51000. FORMAT "%5.0" /end CHARACTERISTIC
/begin CHARACTERISTIC DSM_TsfDfp_CmbChbMisfire6_C "Schwerezaehlergrenze fuer Fehlerpfad Dfp_CmbChbMisfire6" VALUE 0x1CD804 Kw_Wu8 51000. TimeDsmTsf 0.00 51000. FORMAT "%5.0" /end CHARACTERISTIC
/begin CHARACTERISTIC DSM_TsfDfp_CmbChbMisfireMul_C "Schwerezaehlergrenze fuer Fehlerpfad Dfp_CmbChbMisfireMul" VALUE 0x1CD805 Kw_Wu8 51000. TimeDsmTsf 0.00 51000. FORMAT "%5.0" /end CHARACTERISTIC
/begin CHARACTERISTIC DSM_TsfDfp_CoVMDCSh_C "Schwerezaehlergrenze fuer Fehlerpfad Dfp_CoVMDCSh" VALUE 0x1CD806 Kw_Wu8 51000. TimeDsmTsf 0.00 51000. FORMAT "%5.0" /end CHARACTERISTIC
/begin CHARACTERISTIC DSM_TsfDfp_CoVMDCSp_C "Schwerezaehlergrenze fuer Fehlerpfad Dfp_CoVMDCSp" VALUE 0x1CD807 Kw_Wu8 51000. TimeDsmTsf 0.00 51000. FORMAT "%5.0" /end CHARACTERISTIC
/begin CHARACTERISTIC DSM_TsfDfp_CoVehEcoErr_C "Schwerezaehlergrenze fuer Fehlerpfad Dfp_CoVehEcoErr" VALUE 0x1CD808 Kw_Wu8 51000. TimeDsmTsf 0.00 51000. FORMAT "%5.0" /end CHARACTERISTIC
/begin CHARACTERISTIC DSM_TsfDfp_CoVehLvl2_C "Schwerezaehlergrenze fuer Fehlerpfad Dfp_CoVehLvl2" VALUE 0x1CD809 Kw_Wu8 51000. TimeDsmTsf 0.00 51000. FORMAT "%5.0" /end CHARACTERISTIC
/begin CHARACTERISTIC DSM_TsfDfp_ConvCD_C "Schwerezaehlergrenze fuer Fehlerpfad Dfp_ConvCD" VALUE 0x1CD80A Kw_Wu8 51000. TimeDsmTsf 0.00 51000. FORMAT "%5.0" /end CHARACTERISTIC
/begin CHARACTERISTIC DSM_TsfDfp_ConvCD_ConvErr_C "Schwerezaehlergrenze fuer Fehlerpfad Dfp_ConvCD_ConvErr" VALUE 0x1CD80B Kw_Wu8 51000. TimeDsmTsf 0.00 51000. FORMAT "%5.0" /end CHARACTERISTIC
/begin CHARACTERISTIC DSM_TsfDfp_CrCtlPLmpDef_C "Schwerezaehlergrenze fuer Fehlerpfad Dfp_CrCtlPLmpDef" VALUE 0x1CD80C Kw_Wu8 51000. TimeDsmTsf 0.00 51000. FORMAT "%5.0" /end CHARACTERISTIC
/begin CHARACTERISTIC DSM_TsfDfp_CrCtlPShutOff_C "Schwerezaehlergrenze fuer Fehlerpfad Dfp_CrCtlPShutOff" VALUE 0x1CD80D Kw_Wu8 51000. TimeDsmTsf 0.00 51000. FORMAT "%5.0" /end CHARACTERISTIC
/begin CHARACTERISTIC DSM_TsfDfp_CrCtlPTlrDef_C "Schwerezaehlergrenze fuer Fehlerpfad Dfp_CrCtlPTlrDef" VALUE 0x1CD80E Kw_Wu8 51000. TimeDsmTsf 0.00 51000. FORMAT "%5.0" /end CHARACTERISTIC
/begin CHARACTERISTIC DSM_TsfDfp_CrCtlPanErr_C "Schwerezaehlergrenze fuer Fehlerpfad Dfp_CrCtlPanErr" VALUE 0x1CD80F Kw_Wu8 51000. TimeDsmTsf 0.00 51000. FORMAT "%5.0" /end CHARACTERISTIC
/begin CHARACTERISTIC DSM_TsfDfp_CrCtlPanSwtErr_C "Schwerezaehlergrenze fuer Fehlerpfad Dfp_CrCtlPanSwtErr" VALUE 0x1CD810 Kw_Wu8 51000. TimeDsmTsf 0.00 51000. FORMAT "%5.0" /end CHARACTERISTIC
/begin CHARACTERISTIC DSM_TsfDfp_CtApCD_C "Schwerezaehlergrenze fuer Fehlerpfad Dfp_CtApCD" VALUE 0x1CD811 Kw_Wu8 51000. TimeDsmTsf 0.00 51000. FORMAT "%5.0" /end CHARACTERISTIC
/begin CHARACTERISTIC DSM_TsfDfp_CtTCD_C "Schwerezaehlergrenze fuer Fehlerpfad Dfp_CtTCD" VALUE 0x1CD812 Kw_Wu8 51000. TimeDsmTsf 0.00 51000. FORMAT "%5.0" /end CHARACTERISTIC
/begin CHARACTERISTIC DSM_TsfDfp_CtT_Mon_C "Schwerezaehlergrenze fuer Fehlerpfad Dfp_CtT_Mon" VALUE 0x1CD813 Kw_Wu8 51000. TimeDsmTsf 0.00 51000. FORMAT "%5.0" /end CHARACTERISTIC
/begin CHARACTERISTIC DSM_TsfDfp_DifftrqLimErrPat_C "Schwerezaehlergrenze fuer Fehlerpfad Dfp_DifftrqLimErrPat" VALUE 0x1CD814 Kw_Wu8 51000. TimeDsmTsf 0.00 51000. FORMAT "%5.0" /end CHARACTERISTIC
/begin CHARACTERISTIC DSM_TsfDfp_EATSCD_C "Schwerezaehlergrenze fuer Fehlerpfad Dfp_EATSCD" VALUE 0x1CD815 Kw_Wu8 51000. TimeDsmTsf 0.00 51000. FORMAT "%5.0" /end CHARACTERISTIC
/begin CHARACTERISTIC DSM_TsfDfp_EATSCDCanInac_C "Schwerezaehlergrenze fuer Fehlerpfad Dfp_EATSCDCanInac" VALUE 0x1CD816 Kw_Wu8 51000. TimeDsmTsf 0.00 51000. FORMAT "%5.0" /end CHARACTERISTIC
/begin CHARACTERISTIC DSM_TsfDfp_EATSCDCanSig_C "Schwerezaehlergrenze fuer Fehlerpfad Dfp_EATSCDCanSig" VALUE 0x1CD817 Kw_Wu8 51000. TimeDsmTsf 0.00 51000. FORMAT "%5.0" /end CHARACTERISTIC
/begin CHARACTERISTIC DSM_TsfDfp_EEPCDVarMng_C "Schwerezaehlergrenze fuer Fehlerpfad Dfp_EEPCDVarMng" VALUE 0x1CD818 Kw_Wu8 51000. TimeDsmTsf 0.00 51000. FORMAT "%5.0" /end CHARACTERISTIC
/begin CHARACTERISTIC DSM_TsfDfp_EGPpCDTPreTrbn_C "Schwerezaehlergrenze fuer Fehlerpfad Dfp_EgPpCDTPreTrbn" VALUE 0x1CD819 Kw_Wu8 51000. TimeDsmTsf 0.00 51000. FORMAT "%5.0" /end CHARACTERISTIC
/begin CHARACTERISTIC DSM_TsfDfp_EGPpCDTPreTrbn1_C "Schwerezaehlergrenze fuer Fehlerpfad Dfp_EGPpCDTPreTrbn1" VALUE 0x1CD81A Kw_Wu8 51000. TimeDsmTsf 0.00 51000. FORMAT "%5.0" /end CHARACTERISTIC
/begin CHARACTERISTIC DSM_TsfDfp_EGRCD_CBV_C "Schwerezaehlergrenze fuer Fehlerpfad Dfp_EGRCD_CBV" VALUE 0x1CD81B Kw_Wu8 51000. TimeDsmTsf 0.00 51000. FORMAT "%5.0" /end CHARACTERISTIC
/begin CHARACTERISTIC DSM_TsfDfp_EGRCD_Max_C "Schwerezaehlergrenze fuer Fehlerpfad Dfp_EGRCD_Max" VALUE 0x1CD81C Kw_Wu8 51000. TimeDsmTsf 0.00 51000. FORMAT "%5.0" /end CHARACTERISTIC
/begin CHARACTERISTIC DSM_TsfDfp_EGRCD_Min_C "Schwerezaehlergrenze fuer Fehlerpfad Dfp_EGRCD_Min" VALUE 0x1CD81D Kw_Wu8 51000. TimeDsmTsf 0.00 51000. FORMAT "%5.0" /end CHARACTERISTIC
/begin CHARACTERISTIC DSM_TsfDfp_EGRCD_SigNpl_C "Schwerezaehlergrenze fuer Fehlerpfad Dfp_EGRCD_SigNpl" VALUE 0x1CD81E Kw_Wu8 51000. TimeDsmTsf 0.00 51000. FORMAT "%5.0" /end CHARACTERISTIC
/begin CHARACTERISTIC DSM_TsfDfp_EMCCD_GTL1_C "Schwerezaehlergrenze fuer Fehlerpfad Dfp_EMCCD_GTL1" VALUE 0x1CD81F Kw_Wu8 51000. TimeDsmTsf 0.00 51000. FORMAT "%5.0" /end CHARACTERISTIC
/begin CHARACTERISTIC DSM_TsfDfp_EMCCD_GTL2_C "Schwerezaehlergrenze fuer Fehlerpfad Dfp_EMCCD_GTL2" VALUE 0x1CD820 Kw_Wu8 51000. TimeDsmTsf 0.00 51000. FORMAT "%5.0" /end CHARACTERISTIC
/begin CHARACTERISTIC DSM_TsfDfp_EMCCD_MLS1_C "Schwerezaehlergrenze fuer Fehlerpfad Dfp_EMCCD_MLS1" VALUE 0x1CD821 Kw_Wu8 51000. TimeDsmTsf 0.00 51000. FORMAT "%5.0" /end CHARACTERISTIC
/begin CHARACTERISTIC DSM_TsfDfp_EMCCD_MLS2_C "Schwerezaehlergrenze fuer Fehlerpfad Dfp_EMCCD_MLS2" VALUE 0x1CD822 Kw_Wu8 51000. TimeDsmTsf 0.00 51000. FORMAT "%5.0" /end CHARACTERISTIC
/begin CHARACTERISTIC DSM_TsfDfp_ETClbInj1_C "Schwerezaehlergrenze fuer Fehlerpfad Dfp_ETClbInj1" VALUE 0x1CD823 Kw_Wu8 51000. TimeDsmTsf 0.00 51000. FORMAT "%5.0" /end CHARACTERISTIC
/begin CHARACTERISTIC DSM_TsfDfp_ETClbInj2_C "Schwerezaehlergrenze fuer Fehlerpfad Dfp_ETClbInj2" VALUE 0x1CD824 Kw_Wu8 51000. TimeDsmTsf 0.00 51000. FORMAT "%5.0" /end CHARACTERISTIC
/begin CHARACTERISTIC DSM_TsfDfp_ETClbInj3_C "Schwerezaehlergrenze fuer Fehlerpfad Dfp_ETClbInj3" VALUE 0x1CD825 Kw_Wu8 51000. TimeDsmTsf 0.00 51000. FORMAT "%5.0" /end CHARACTERISTIC
/begin CHARACTERISTIC DSM_TsfDfp_ETClbInj4_C "Schwerezaehlergrenze fuer Fehlerpfad Dfp_ETClbInj4" VALUE 0x1CD826 Kw_Wu8 51000. TimeDsmTsf 0.00 51000. FORMAT "%5.0" /end CHARACTERISTIC
/begin CHARACTERISTIC DSM_TsfDfp_ETClbInj5_C "Schwerezaehlergrenze fuer Fehlerpfad Dfp_ETClbInj5" VALUE 0x1CD827 Kw_Wu8 51000. TimeDsmTsf 0.00 51000. FORMAT "%5.0" /end CHARACTERISTIC
/begin CHARACTERISTIC DSM_TsfDfp_ETClbInj6_C "Schwerezaehlergrenze fuer Fehlerpfad Dfp_ETClbInj6" VALUE 0x1CD828 Kw_Wu8 51000. TimeDsmTsf 0.00 51000. FORMAT "%5.0" /end CHARACTERISTIC
/begin CHARACTERISTIC DSM_TsfDfp_EngMCaS1_C "Schwerezaehlergrenze fuer Fehlerpfad Dfp_EngMCaS1" VALUE 0x1CD829 Kw_Wu8 51000. TimeDsmTsf 0.00 51000. FORMAT "%5.0" /end CHARACTERISTIC
/begin CHARACTERISTIC DSM_TsfDfp_EngMCrS1_C "Schwerezaehlergrenze fuer Fehlerpfad Dfp_EngMCrS1" VALUE 0x1CD82A Kw_Wu8 51000. TimeDsmTsf 0.00 51000. FORMAT "%5.0" /end CHARACTERISTIC
/begin CHARACTERISTIC DSM_TsfDfp_EngMOfsCaSCrS_C "Schwerezaehlergrenze fuer Fehlerpfad Dfp_EngMOfsCaSCrS" VALUE 0x1CD82B Kw_Wu8 51000. TimeDsmTsf 0.00 51000. FORMAT "%5.0" /end CHARACTERISTIC
/begin CHARACTERISTIC DSM_TsfDfp_EngMonIrrCmb_C "Schwerezaehlergrenze fuer Fehlerpfad Dfp_EngMonIrrCmb" VALUE 0x1CD82C Kw_Wu8 51000. TimeDsmTsf 0.00 51000. FORMAT "%5.0" /end CHARACTERISTIC
/begin CHARACTERISTIC DSM_TsfDfp_EngPrt_C "Schwerezaehlergrenze fuer Fehlerpfad Dfp_EngPrt" VALUE 0x1CD82D Kw_Wu8 51000. TimeDsmTsf 0.00 51000. FORMAT "%5.0" /end CHARACTERISTIC
/begin CHARACTERISTIC DSM_TsfDfp_ErLpCDMILReqON_C "Schwerezaehlergrenze fuer Fehlerpfad Dfp_ErLpCDMILReqON" VALUE 0x1CD82E Kw_Wu8 51000. TimeDsmTsf 0.00 51000. FORMAT "%5.0" /end CHARACTERISTIC
/begin CHARACTERISTIC DSM_TsfDfp_FMTC_NonMonotonMap_C "Schwerezaehlergrenze fuer Fehlerpfad Dfp_FMTC_NonMonotonMap" VALUE 0x1CD82F Kw_Wu8 51000. TimeDsmTsf 0.00 51000. FORMAT "%5.0" /end CHARACTERISTIC
/begin CHARACTERISTIC DSM_TsfDfp_FQlSCD_C "Schwerezaehlergrenze fuer Fehlerpfad Dfp_FQlSCD" VALUE 0x1CD830 Kw_Wu8 51000. TimeDsmTsf 0.00 51000. FORMAT "%5.0" /end CHARACTERISTIC
/begin CHARACTERISTIC DSM_TsfDfp_FTSCD_C "Schwerezaehlergrenze fuer Fehlerpfad Dfp_FTSCD" VALUE 0x1CD831 Kw_Wu8 51000. TimeDsmTsf 0.00 51000. FORMAT "%5.0" /end CHARACTERISTIC
/begin CHARACTERISTIC DSM_TsfDfp_FTSCDNpl_C "Schwerezaehlergrenze fuer Fehlerpfad Dfp_FTSCDNpl" VALUE 0x1CD832 Kw_Wu8 51000. TimeDsmTsf 0.00 51000. FORMAT "%5.0" /end CHARACTERISTIC
/begin CHARACTERISTIC DSM_TsfDfp_FanCD_Fan1Ctlr1_C "Schwerezaehlergrenze fuer Fehlerpfad Dfp_FanCD_Fan1Ctlr1" VALUE 0x1CD833 Kw_Wu8 51000. TimeDsmTsf 0.00 51000. FORMAT "%5.0" /end CHARACTERISTIC
/begin CHARACTERISTIC DSM_TsfDfp_FanCD_Fan1Ctlr2_C "Schwerezaehlergrenze fuer Fehlerpfad Dfp_FanCD_Fan1Ctlr2" VALUE 0x1CD834 Kw_Wu8 51000. TimeDsmTsf 0.00 51000. FORMAT "%5.0" /end CHARACTERISTIC
/begin CHARACTERISTIC DSM_TsfDfp_FanCD_Fan2Ctlr1_C "Schwerezaehlergrenze fuer Fehlerpfad Dfp_FanCD_Fan2Ctlr1" VALUE 0x1CD835 Kw_Wu8 51000. TimeDsmTsf 0.00 51000. FORMAT "%5.0" /end CHARACTERISTIC
/begin CHARACTERISTIC DSM_TsfDfp_FanCD_Fan2Ctlr2_C "Schwerezaehlergrenze fuer Fehlerpfad Dfp_FanCD_Fan2Ctlr2" VALUE 0x1CD836 Kw_Wu8 51000. TimeDsmTsf 0.00 51000. FORMAT "%5.0" /end CHARACTERISTIC
/begin CHARACTERISTIC DSM_TsfDfp_FanCD_FanCtlr1_C "Schwerezaehlergrenze fuer Fehlerpfad Dfp_FanCD_FanCtlr1" VALUE 0x1CD837 Kw_Wu8 51000. TimeDsmTsf 0.00 51000. FORMAT "%5.0" /end CHARACTERISTIC
/begin CHARACTERISTIC DSM_TsfDfp_FanCD_FanCtlr2_C "Schwerezaehlergrenze fuer Fehlerpfad Dfp_FanCD_FanCtlr2" VALUE 0x1CD838 Kw_Wu8 51000. TimeDsmTsf 0.00 51000. FORMAT "%5.0" /end CHARACTERISTIC
/begin CHARACTERISTIC DSM_TsfDfp_FanCD_OutFanCtlr1_C "Schwerezaehlergrenze fuer Fehlerpfad Dfp_FanCD_OutFanCtlr1" VALUE 0x1CD839 Kw_Wu8 51000. TimeDsmTsf 0.00 51000. FORMAT "%5.0" /end CHARACTERISTIC
/begin CHARACTERISTIC DSM_TsfDfp_FanCD_OutFanCtlr2_C "Schwerezaehlergrenze fuer Fehlerpfad Dfp_FanCD_OutFanCtlr2" VALUE 0x1CD83A Kw_Wu8 51000. TimeDsmTsf 0.00 51000. FORMAT "%5.0" /end CHARACTERISTIC
/begin CHARACTERISTIC DSM_TsfDfp_FlPpCD_C "Schwerezaehlergrenze fuer Fehlerpfad Dfp_FlPpCD" VALUE 0x1CD83B Kw_Wu8 51000. TimeDsmTsf 0.00 51000. FORMAT "%5.0" /end CHARACTERISTIC
/begin CHARACTERISTIC DSM_TsfDfp_FlSCDT1_C "Schwerezaehlergrenze fuer Fehlerpfad Dfp_FlSCDT1" VALUE 0x1CD83C Kw_Wu8 51000. TimeDsmTsf 0.00 51000. FORMAT "%5.0" /end CHARACTERISTIC
/begin CHARACTERISTIC DSM_TsfDfp_FrmMngAAGNpl_C "Schwerezaehlergrenze fuer Fehlerpfad Dfp_FrmMngAAGNpl" VALUE 0x1CD83D Kw_Wu8 51000. TimeDsmTsf 0.00 51000. FORMAT "%5.0" /end CHARACTERISTIC
/begin CHARACTERISTIC DSM_TsfDfp_FrmMngAAGTO_C "Schwerezaehlergrenze fuer Fehlerpfad Dfp_FrmMngAAGTO" VALUE 0x1CD83E Kw_Wu8 51000. TimeDsmTsf 0.00 51000. FORMAT "%5.0" /end CHARACTERISTIC
/begin CHARACTERISTIC DSM_TsfDfp_FrmMngAC1Npl_C "Schwerezaehlergrenze fuer Fehlerpfad Dfp_FrmMngAC1Npl" VALUE 0x1CD83F Kw_Wu8 51000. TimeDsmTsf 0.00 51000. FORMAT "%5.0" /end CHARACTERISTIC
/begin CHARACTERISTIC DSM_TsfDfp_FrmMngAC1TO_C "Schwerezaehlergrenze fuer Fehlerpfad Dfp_FrmMngAC1TO" VALUE 0x1CD840 Kw_Wu8 51000. TimeDsmTsf 0.00 51000. FORMAT "%5.0" /end CHARACTERISTIC
/begin CHARACTERISTIC DSM_TsfDfp_FrmMngACCNpl_C "Schwerezaehlergrenze fuer Fehlerpfad Dfp_FrmMngACCNpl" VALUE 0x1CD841 Kw_Wu8 51000. TimeDsmTsf 0.00 51000. FORMAT "%5.0" /end CHARACTERISTIC
/begin CHARACTERISTIC DSM_TsfDfp_FrmMngACCTO_C "Schwerezaehlergrenze fuer Fehlerpfad Dfp_FrmMngACCTO" VALUE 0x1CD842 Kw_Wu8 51000. TimeDsmTsf 0.00 51000. FORMAT "%5.0" /end CHARACTERISTIC
/begin CHARACTERISTIC DSM_TsfDfp_FrmMngAIRBGNpl_C "Schwerezaehlergrenze fuer Fehlerpfad Dfp_FrmMngAIRBGNpl" VALUE 0x1CD843 Kw_Wu8 51000. TimeDsmTsf 0.00 51000. FORMAT "%5.0" /end CHARACTERISTIC
/begin CHARACTERISTIC DSM_TsfDfp_FrmMngAIRBGTO_C "Schwerezaehlergrenze fuer Fehlerpfad Dfp_FrmMngAIRBGTO" VALUE 0x1CD844 Kw_Wu8 51000. TimeDsmTsf 0.00 51000. FORMAT "%5.0" /end CHARACTERISTIC
/begin CHARACTERISTIC DSM_TsfDfp_FrmMngAWD1Npl_C "Schwerezaehlergrenze fuer Fehlerpfad Dfp_FrmMngAWD1Npl" VALUE 0x1CD845 Kw_Wu8 51000. TimeDsmTsf 0.00 51000. FORMAT "%5.0" /end CHARACTERISTIC
/begin CHARACTERISTIC DSM_TsfDfp_FrmMngAWD1TO_C "Schwerezaehlergrenze fuer Fehlerpfad Dfp_FrmMngAWD1TO" VALUE 0x1CD846 Kw_Wu8 51000. TimeDsmTsf 0.00 51000. FORMAT "%5.0" /end CHARACTERISTIC
/begin CHARACTERISTIC DSM_TsfDfp_FrmMngBEM1Npl_C "Schwerezählergrenze für Fehlerpfad Dfp_FrmMngBEM1Npl" VALUE 0x1CD847 Kw_Wu8 51000. TimeDsmTsf 0.00 51000. FORMAT "%5.0" /end CHARACTERISTIC
/begin CHARACTERISTIC DSM_TsfDfp_FrmMngBEM1TO_C "Schwerezaehlergrenze fuer Fehlerpfad Dfp_FrmMngBEM1TO" VALUE 0x1CD848 Kw_Wu8 51000. TimeDsmTsf 0.00 51000. FORMAT "%5.0" /end CHARACTERISTIC
/begin CHARACTERISTIC DSM_TsfDfp_FrmMngBRK1Npl_C "Schwerezaehlergrenze fuer Fehlerpfad Dfp_FrmMngBRK1Npl" VALUE 0x1CD849 Kw_Wu8 51000. TimeDsmTsf 0.00 51000. FORMAT "%5.0" /end CHARACTERISTIC
/begin CHARACTERISTIC DSM_TsfDfp_FrmMngBRK1TO_C "Schwerezaehlergrenze fuer Fehlerpfad Dfp_FrmMngBRK1TO" VALUE 0x1CD84A Kw_Wu8 51000. TimeDsmTsf 0.00 51000. FORMAT "%5.0" /end CHARACTERISTIC
/begin CHARACTERISTIC DSM_TsfDfp_FrmMngBRK2Npl_C "Schwerezaehlergrenze fuer Fehlerpfad Dfp_FrmMngBRK2Npl" VALUE 0x1CD84B Kw_Wu8 51000. TimeDsmTsf 0.00 51000. FORMAT "%5.0" /end CHARACTERISTIC
/begin CHARACTERISTIC DSM_TsfDfp_FrmMngBRK2TO_C "Schwerezaehlergrenze fuer Fehlerpfad Dfp_FrmMngBRK2TO" VALUE 0x1CD84C Kw_Wu8 51000. TimeDsmTsf 0.00 51000. FORMAT "%5.0" /end CHARACTERISTIC
/begin CHARACTERISTIC DSM_TsfDfp_FrmMngBRK8Npl_C "Schwerezaehlergrenze fuer Fehlerpfad Dfp_FrmMngBRK8Npl" VALUE 0x1CD84D Kw_Wu8 51000. TimeDsmTsf 0.00 51000. FORMAT "%5.0" /end CHARACTERISTIC
/begin CHARACTERISTIC DSM_TsfDfp_FrmMngBRK8TO_C "Schwerezaehlergrenze fuer Fehlerpfad Dfp_FrmMngBRK8TO" VALUE 0x1CD84E Kw_Wu8 51000. TimeDsmTsf 0.00 51000. FORMAT "%5.0" /end CHARACTERISTIC
/begin CHARACTERISTIC DSM_TsfDfp_FrmMngCANVerErr_C "Schwerezaehlergrenze fuer Fehlerpfad Dfp_FrmMngCANVerErr" VALUE 0x1CD84F Kw_Wu8 51000. TimeDsmTsf 0.00 51000. FORMAT "%5.0" /end CHARACTERISTIC
/begin CHARACTERISTIC DSM_TsfDfp_FrmMngCCSel_C "Schwerezaehlergrenze fuer Fehlerpfad Dfp_FrmMngCCSel_C" VALUE 0x1CD850 Kw_Wu8 51000. TimeDsmTsf 0.00 51000. FORMAT "%5.0" /end CHARACTERISTIC
/begin CHARACTERISTIC DSM_TsfDfp_FrmMngCCTLNpl_C "Schwerezaehlergrenze fuer Fehlerpfad Dfp_FrmMngCCTLNpl" VALUE 0x1CD851 Kw_Wu8 51000. TimeDsmTsf 0.00 51000. FORMAT "%5.0" /end CHARACTERISTIC
/begin CHARACTERISTIC DSM_TsfDfp_FrmMngCCTLTO_C "Schwerezaehlergrenze fuer Fehlerpfad Dfp_FrmMngCCTLTO" VALUE 0x1CD852 Kw_Wu8 51000. TimeDsmTsf 0.00 51000. FORMAT "%5.0" /end CHARACTERISTIC
/begin CHARACTERISTIC DSM_TsfDfp_FrmMngCHRGR1Npl_C "Schwerezaehlergrenze fuer Fehlerpfad Dfp_FrmMngCHRGR1Npl" VALUE 0x1CD853 Kw_Wu8 51000. TimeDsmTsf 0.00 51000. FORMAT "%5.0" /end CHARACTERISTIC
/begin CHARACTERISTIC DSM_TsfDfp_FrmMngCHRGR1TO_C "Schwerezaehlergrenze fuer Fehlerpfad Dfp_FrmMngCHRGR1TO" VALUE 0x1CD854 Kw_Wu8 51000. TimeDsmTsf 0.00 51000. FORMAT "%5.0" /end CHARACTERISTIC
/begin CHARACTERISTIC DSM_TsfDfp_FrmMngCHRGR2Npl_C "Schwerezaehlergrenze fuer Fehlerpfad Dfp_FrmMngCHRGR2Npl" VALUE 0x1CD855 Kw_Wu8 51000. TimeDsmTsf 0.00 51000. FORMAT "%5.0" /end CHARACTERISTIC
/begin CHARACTERISTIC DSM_TsfDfp_FrmMngCHRGR2TO_C "Schwerezaehlergrenze fuer Fehlerpfad Dfp_FrmMngCHRGR2TO" VALUE 0x1CD856 Kw_Wu8 51000. TimeDsmTsf 0.00 51000. FORMAT "%5.0" /end CHARACTERISTIC
/begin CHARACTERISTIC DSM_TsfDfp_FrmMngChrgr1A_C "Schwerezaehlergrenze fuer Fehlerpfad Dfp_FrmMngChrgr1A" VALUE 0x1CD857 Kw_Wu8 51000. TimeDsmTsf 0.00 51000. FORMAT "%5.0" /end CHARACTERISTIC
/begin CHARACTERISTIC DSM_TsfDfp_FrmMngChrgr1C_C "Schwerezaehlergrenze fuer Fehlerpfad Dfp_FrmMngChrgr1C" VALUE 0x1CD858 Kw_Wu8 51000. TimeDsmTsf 0.00 51000. FORMAT "%5.0" /end CHARACTERISTIC
/begin CHARACTERISTIC DSM_TsfDfp_FrmMngChrgr1N_C "Schwerezaehlergrenze fuer Fehlerpfad Dfp_FrmMngChrgr1N" VALUE 0x1CD859 Kw_Wu8 51000. TimeDsmTsf 0.00 51000. FORMAT "%5.0" /end CHARACTERISTIC
/begin CHARACTERISTIC DSM_TsfDfp_FrmMngChrgr1T_C "Schwerezaehlergrenze fuer Fehlerpfad Dfp_FrmMngChrgr1T" VALUE 0x1CD85A Kw_Wu8 51000. TimeDsmTsf 0.00 51000. FORMAT "%5.0" /end CHARACTERISTIC
/begin CHARACTERISTIC DSM_TsfDfp_FrmMngChrgr1V_C "Schwerezaehlergrenze fuer Fehlerpfad Dfp_FrmMngChrgr1V" VALUE 0x1CD85B Kw_Wu8 51000. TimeDsmTsf 0.00 51000. FORMAT "%5.0" /end CHARACTERISTIC
/begin CHARACTERISTIC DSM_TsfDfp_FrmMngChrgr2A_C "Schwerezaehlergrenze fuer Fehlerpfad Dfp_FrmMngChrgr2A" VALUE 0x1CD85C Kw_Wu8 51000. TimeDsmTsf 0.00 51000. FORMAT "%5.0" /end CHARACTERISTIC
/begin CHARACTERISTIC DSM_TsfDfp_FrmMngChrgr2C_C "Schwerezaehlergrenze fuer Fehlerpfad Dfp_FrmMngChrgr2C" VALUE 0x1CD85D Kw_Wu8 51000. TimeDsmTsf 0.00 51000. FORMAT "%5.0" /end CHARACTERISTIC
/begin CHARACTERISTIC DSM_TsfDfp_FrmMngChrgr2N_C "Schwerezaehlergrenze fuer Fehlerpfad Dfp_FrmMngChrgr2N" VALUE 0x1CD85E Kw_Wu8 51000. TimeDsmTsf 0.00 51000. FORMAT "%5.0" /end CHARACTERISTIC
/begin CHARACTERISTIC DSM_TsfDfp_FrmMngChrgr2T_C "Schwerezaehlergrenze fuer Fehlerpfad Dfp_FrmMngChrgr2T" VALUE 0x1CD85F Kw_Wu8 51000. TimeDsmTsf 0.00 51000. FORMAT "%5.0" /end CHARACTERISTIC
/begin CHARACTERISTIC DSM_TsfDfp_FrmMngChrgr2V_C "Schwerezaehlergrenze fuer Fehlerpfad Dfp_FrmMngChrgr2V" VALUE 0x1CD860 Kw_Wu8 51000. TimeDsmTsf 0.00 51000. FORMAT "%5.0" /end CHARACTERISTIC
/begin CHARACTERISTIC DSM_TsfDfp_FrmMngDIA1Npl_C "Schwerezaehlergrenze fuer Fehlerpfad Dfp_FrmMngDIA1Npl" VALUE 0x1CD861 Kw_Wu8 51000. TimeDsmTsf 0.00 51000. FORMAT "%5.0" /end CHARACTERISTIC
/begin CHARACTERISTIC DSM_TsfDfp_FrmMngDIA1TO_C "Schwerezaehlergrenze fuer Fehlerpfad Dfp_FrmMngDIA1TO" VALUE 0x1CD862 Kw_Wu8 51000. TimeDsmTsf 0.00 51000. FORMAT "%5.0" /end CHARACTERISTIC
/begin CHARACTERISTIC DSM_TsfDfp_FrmMngDSP1Npl_C "Schwerezaehlergrenze fuer Fehlerpfad Dfp_FrmMngDSP1Npl" VALUE 0x1CD863 Kw_Wu8 51000. TimeDsmTsf 0.00 51000. FORMAT "%5.0" /end CHARACTERISTIC
/begin CHARACTERISTIC DSM_TsfDfp_FrmMngDSP1TO_C "Schwerezaehlergrenze fuer Fehlerpfad Dfp_FrmMngDSP1TO" VALUE 0x1CD864 Kw_Wu8 51000. TimeDsmTsf 0.00 51000. FORMAT "%5.0" /end CHARACTERISTIC
/begin CHARACTERISTIC DSM_TsfDfp_FrmMngDSP2Npl_C "Schwerezaehlergrenze fuer Fehlerpfad Dfp_FrmMngDSP2Npl" VALUE 0x1CD865 Kw_Wu8 51000. TimeDsmTsf 0.00 51000. FORMAT "%5.0" /end CHARACTERISTIC
/begin CHARACTERISTIC DSM_TsfDfp_FrmMngDSP2TO_C "Schwerezaehlergrenze fuer Fehlerpfad Dfp_FrmMngDSP2TO" VALUE 0x1CD866 Kw_Wu8 51000. TimeDsmTsf 0.00 51000. FORMAT "%5.0" /end CHARACTERISTIC
/begin CHARACTERISTIC DSM_TsfDfp_FrmMngESCUNpl_C "Schwerezaehlergrenze fuer Fehlerpfad Dfp_FrmMngESCUNpl" VALUE 0x1CD867 Kw_Wu8 51000. TimeDsmTsf 0.00 51000. FORMAT "%5.0" /end CHARACTERISTIC
/begin CHARACTERISTIC DSM_TsfDfp_FrmMngESCUTO_C "Schwerezaehlergrenze fuer Fehlerpfad Dfp_FrmMngESCUTO" VALUE 0x1CD868 Kw_Wu8 51000. TimeDsmTsf 0.00 51000. FORMAT "%5.0" /end CHARACTERISTIC
/begin CHARACTERISTIC DSM_TsfDfp_FrmMngGW1Npl_C "Schwerezaehlergrenze fuer Fehlerpfad Dfp_FrmMngGW1Npl" VALUE 0x1CD869 Kw_Wu8 51000. TimeDsmTsf 0.00 51000. FORMAT "%5.0" /end CHARACTERISTIC
/begin CHARACTERISTIC DSM_TsfDfp_FrmMngGW1TO_C "Schwerezaehlergrenze fuer Fehlerpfad Dfp_FrmMngGW1TO" VALUE 0x1CD86A Kw_Wu8 51000. TimeDsmTsf 0.00 51000. FORMAT "%5.0" /end CHARACTERISTIC
/begin CHARACTERISTIC DSM_TsfDfp_FrmMngILMNpl_C "Schwerezaehlergrenze fuer Fehlerpfad Dfp_FrmMngILMNpl" VALUE 0x1CD86B Kw_Wu8 51000. TimeDsmTsf 0.00 51000. FORMAT "%5.0" /end CHARACTERISTIC
/begin CHARACTERISTIC DSM_TsfDfp_FrmMngILMTO_C "Schwerezaehlergrenze fuer Fehlerpfad Dfp_FrmMngILMTO" VALUE 0x1CD86C Kw_Wu8 51000. TimeDsmTsf 0.00 51000. FORMAT "%5.0" /end CHARACTERISTIC
/begin CHARACTERISTIC DSM_TsfDfp_FrmMngNIV1WrngCod_C "Schwerezaehlergrenze fuer Fehlerpfad Dfp_FrmMngNIV1WrngCod" VALUE 0x1CD86D Kw_Wu8 51000. TimeDsmTsf 0.00 51000. FORMAT "%5.0" /end CHARACTERISTIC
/begin CHARACTERISTIC DSM_TsfDfp_FrmMngNIVEAU1Npl_C "Schwerezaehlergrenze fuer Fehlerpfad Dfp_FrmMngNIVEAU1Npl" VALUE 0x1CD86E Kw_Wu8 51000. TimeDsmTsf 0.00 51000. FORMAT "%5.0" /end CHARACTERISTIC
/begin CHARACTERISTIC DSM_TsfDfp_FrmMngNIVEAU1TO_C "Schwerezaehlergrenze fuer Fehlerpfad Dfp_FrmMngNIVEAU1TO" VALUE 0x1CD86F Kw_Wu8 51000. TimeDsmTsf 0.00 51000. FORMAT "%5.0" /end CHARACTERISTIC
/begin CHARACTERISTIC DSM_TsfDfp_FrmMngSTIGNNpl_C "Schwerezaehlergrenze fuer Fehlerpfad Dfp_FrmMngSTIGNNpl" VALUE 0x1CD870 Kw_Wu8 51000. TimeDsmTsf 0.00 51000. FORMAT "%5.0" /end CHARACTERISTIC
/begin CHARACTERISTIC DSM_TsfDfp_FrmMngStIgnTO_C "Schwerezaehlergrenze fuer Fehlerpfad Dfp_FrmMngStIgnTO" VALUE 0x1CD871 Kw_Wu8 51000. TimeDsmTsf 0.00 51000. FORMAT "%5.0" /end CHARACTERISTIC
/begin CHARACTERISTIC DSM_TsfDfp_FrmMngTOSNpl_C "Schwerezaehlergrenze fuer Fehlerpfad Dfp_FrmMngTOSNpl" VALUE 0x1CD872 Kw_Wu8 51000. TimeDsmTsf 0.00 51000. FORMAT "%5.0" /end CHARACTERISTIC
/begin CHARACTERISTIC DSM_TsfDfp_FrmMngTOSTO_C "Schwerezaehlergrenze fuer Fehlerpfad Dfp_FrmMngTOSTO" VALUE 0x1CD873 Kw_Wu8 51000. TimeDsmTsf 0.00 51000. FORMAT "%5.0" /end CHARACTERISTIC
/begin CHARACTERISTIC DSM_TsfDfp_FrmMngTSC1Npl_C "Schwerezaehlergrenze fuer Fehlerpfad Dfp_FrmMngTSC1Npl" VALUE 0x1CD874 Kw_Wu8 51000. TimeDsmTsf 0.00 51000. FORMAT "%5.0" /end CHARACTERISTIC
/begin CHARACTERISTIC DSM_TsfDfp_FrmMngTSC1TO_C "Schwerezaehlergrenze fuer Fehlerpfad Dfp_FrmMngTSC1TO" VALUE 0x1CD875 Kw_Wu8 51000. TimeDsmTsf 0.00 51000. FORMAT "%5.0" /end CHARACTERISTIC
/begin CHARACTERISTIC DSM_TsfDfp_FrmMngTSC2Npl_C "Schwerezaehlergrenze fuer Fehlerpfad Dfp_FrmMngTSC2Npl" VALUE 0x1CD876 Kw_Wu8 51000. TimeDsmTsf 0.00 51000. FORMAT "%5.0" /end CHARACTERISTIC
/begin CHARACTERISTIC DSM_TsfDfp_FrmMngTSC2TO_C "Schwerezaehlergrenze fuer Fehlerpfad Dfp_FrmMngTSC2TO" VALUE 0x1CD877 Kw_Wu8 51000. TimeDsmTsf 0.00 51000. FORMAT "%5.0" /end CHARACTERISTIC
/begin CHARACTERISTIC DSM_TsfDfp_FrmMngTSC3Npl_C "Schwerezaehlergrenze fuer Fehlerpfad Dfp_FrmMngTSC3Npl" VALUE 0x1CD878 Kw_Wu8 51000. TimeDsmTsf 0.00 51000. FORMAT "%5.0" /end CHARACTERISTIC
/begin CHARACTERISTIC DSM_TsfDfp_FrmMngTSC3TO_C "Schwerezaehlergrenze fuer Fehlerpfad Dfp_FrmMngTSC3TO" VALUE 0x1CD879 Kw_Wu8 51000. TimeDsmTsf 0.00 51000. FORMAT "%5.0" /end CHARACTERISTIC
/begin CHARACTERISTIC DSM_TsfDfp_GearbxASTh_C "Schwerezaehlergrenze fuer Fehlerpfad Dfp_GearbxASTh" VALUE 0x1CD87A Kw_Wu8 51000. TimeDsmTsf 0.00 51000. FORMAT "%5.0" /end CHARACTERISTIC
/begin CHARACTERISTIC DSM_TsfDfp_GearbxASTl_C "Schwerezaehlergrenze fuer Fehlerpfad Dfp_GearbxASTl" VALUE 0x1CD87B Kw_Wu8 51000. TimeDsmTsf 0.00 51000. FORMAT "%5.0" /end CHARACTERISTIC
/begin CHARACTERISTIC DSM_TsfDfp_GearbxTSC_C "Schwerezaehlergrenze fuer Fehlerpfad Dfp_GearbxTSC" VALUE 0x1CD87C Kw_Wu8 51000. TimeDsmTsf 0.00 51000. FORMAT "%5.0" /end CHARACTERISTIC
/begin CHARACTERISTIC DSM_TsfDfp_GearbxTypeMTErr_C "Schwerezaehlergrenze fuer Fehlerpfad Dfp_GearbxTypeMTErr" VALUE 0x1CD87D Kw_Wu8 51000. TimeDsmTsf 0.00 51000. FORMAT "%5.0" /end CHARACTERISTIC
/begin CHARACTERISTIC DSM_TsfDfp_GlwCD_Actr_C "Schwerezaehlergrenze fuer Fehlerpfad Dfp_GlwCD_Actr" VALUE 0x1CD87E Kw_Wu8 51000. TimeDsmTsf 0.00 51000. FORMAT "%5.0" /end CHARACTERISTIC
/begin CHARACTERISTIC DSM_TsfDfp_GlwCD_DIAG_C "Schwerezaehlergrenze fuer Fehlerpfad Dfp_GlwCD_DIAG" VALUE 0x1CD87F Kw_Wu8 51000. TimeDsmTsf 0.00 51000. FORMAT "%5.0" /end CHARACTERISTIC
/begin CHARACTERISTIC DSM_TsfDfp_GlwCD_Error1_C "Schwerezaehlergrenze fuer Fehlerpfad Dfp_GlwCD_Error1" VALUE 0x1CD880 Kw_Wu8 51000. TimeDsmTsf 0.00 51000. FORMAT "%5.0" /end CHARACTERISTIC
/begin CHARACTERISTIC DSM_TsfDfp_GlwCD_Error2_C "Schwerezaehlergrenze fuer Fehlerpfad Dfp_GlwCD_Error2" VALUE 0x1CD881 Kw_Wu8 51000. TimeDsmTsf 0.00 51000. FORMAT "%5.0" /end CHARACTERISTIC
/begin CHARACTERISTIC DSM_TsfDfp_GlwCD_EvalCod_C "Durch Fehlerpfad Dfp_GlwCD_EvalCod verriegelte Funktionsidentifier" VALUE 0x1CD882 Kw_Wu8 51000. TimeDsmTsf 0.00 51000. FORMAT "%5.0" /end CHARACTERISTIC
/begin CHARACTERISTIC DSM_TsfDfp_GlwCD_GSK_C "Schwerezaehlergrenze fuer Fehlerpfad Dfp_GlwCD_GSK" VALUE 0x1CD883 Kw_Wu8 51000. TimeDsmTsf 0.00 51000. FORMAT "%5.0" /end CHARACTERISTIC
/begin CHARACTERISTIC DSM_TsfDfp_GlwCD_Lamp_C "Schwerezaehlergrenze fuer Fehlerpfad Dfp_GlwCD_Lamp" VALUE 0x1CD884 Kw_Wu8 51000. TimeDsmTsf 0.00 51000. FORMAT "%5.0" /end CHARACTERISTIC
/begin CHARACTERISTIC DSM_TsfDfp_GlwCD_LampCan_C "Schwerezaehlergrenze fuer Fehlerpfad Dfp_GlwCD_LampCan" VALUE 0x1CD885 Kw_Wu8 51000. TimeDsmTsf 0.00 51000. FORMAT "%5.0" /end CHARACTERISTIC
/begin CHARACTERISTIC DSM_TsfDfp_GlwCD_PLUG0_C "Schwerezaehlergrenze fuer Fehlerpfad Dfp_GlwCD_PLUG0" VALUE 0x1CD886 Kw_Wu8 51000. TimeDsmTsf 0.00 51000. FORMAT "%5.0" /end CHARACTERISTIC
/begin CHARACTERISTIC DSM_TsfDfp_GlwCD_PLUG1_C "Schwerezaehlergrenze fuer Fehlerpfad Dfp_GlwCD_PLUG1" VALUE 0x1CD887 Kw_Wu8 51000. TimeDsmTsf 0.00 51000. FORMAT "%5.0" /end CHARACTERISTIC
/begin CHARACTERISTIC DSM_TsfDfp_GlwCD_PLUG2_C "Schwerezaehlergrenze fuer Fehlerpfad Dfp_GlwCD_PLUG2" VALUE 0x1CD888 Kw_Wu8 51000. TimeDsmTsf 0.00 51000. FORMAT "%5.0" /end CHARACTERISTIC
/begin CHARACTERISTIC DSM_TsfDfp_GlwCD_PLUG3_C "Schwerezaehlergrenze fuer Fehlerpfad Dfp_GlwCD_PLUG3" VALUE 0x1CD889 Kw_Wu8 51000. TimeDsmTsf 0.00 51000. FORMAT "%5.0" /end CHARACTERISTIC
/begin CHARACTERISTIC DSM_TsfDfp_GlwCD_PLUG4_C "Schwerezaehlergrenze fuer Fehlerpfad Dfp_GlwCD_PLUG4" VALUE 0x1CD88A Kw_Wu8 51000. TimeDsmTsf 0.00 51000. FORMAT "%5.0" /end CHARACTERISTIC
/begin CHARACTERISTIC DSM_TsfDfp_GlwCD_PLUG5_C "Schwerezaehlergrenze fuer Fehlerpfad Dfp_GlwCD_PLUG5" VALUE 0x1CD88B Kw_Wu8 51000. TimeDsmTsf 0.00 51000. FORMAT "%5.0" /end CHARACTERISTIC
/begin CHARACTERISTIC DSM_TsfDfp_GlwCD_SFD_C "Schwerezaehlergrenze fuer Fehlerpfad Dfp_GlwCD_SFD" VALUE 0x1CD88C Kw_Wu8 51000. TimeDsmTsf 0.00 51000. FORMAT "%5.0" /end CHARACTERISTIC
/begin CHARACTERISTIC DSM_TsfDfp_HDSCD_C "Schwerezaehlergrenze fuer Fehlerpfad Dfp_HDSCD" VALUE 0x1CD88D Kw_Wu8 51000. TimeDsmTsf 0.00 51000. FORMAT "%5.0" /end CHARACTERISTIC
/begin CHARACTERISTIC DSM_TsfDfp_HWEMonCom_C "Schwerezaehlergrenze fuer Fehlerpfad Dfp_HWEMonCom" VALUE 0x1CD88E Kw_Wu8 51000. TimeDsmTsf 0.00 51000. FORMAT "%5.0" /end CHARACTERISTIC
/begin CHARACTERISTIC DSM_TsfDfp_HWEMonEEPROM_C "Schwerezaehlergrenze fuer Fehlerpfad Dfp_HWEMonEEPROM" VALUE 0x1CD88F Kw_Wu8 51000. TimeDsmTsf 0.00 51000. FORMAT "%5.0" /end CHARACTERISTIC
/begin CHARACTERISTIC DSM_TsfDfp_HWEMonRcyLocked_C "Schwerezaehlergrenze fuer Fehlerpfad Dfp_HWEMonRcyLocked" VALUE 0x1CD890 Kw_Wu8 51000. TimeDsmTsf 0.00 51000. FORMAT "%5.0" /end CHARACTERISTIC
/begin CHARACTERISTIC DSM_TsfDfp_HWEMonRcySuppressed_C "Schwerezaehlergrenze fuer Fehlerpfad Dfp_HWEMonRcySuppressed" VALUE 0x1CD891 Kw_Wu8 51000. TimeDsmTsf 0.00 51000. FORMAT "%5.0" /end CHARACTERISTIC
/begin CHARACTERISTIC DSM_TsfDfp_HWEMonRcyVisible_C "Schwerezaehlergrenze fuer Fehlerpfad Dfp_HWEMonRcyVisible" VALUE 0x1CD892 Kw_Wu8 51000. TimeDsmTsf 0.00 51000. FORMAT "%5.0" /end CHARACTERISTIC
/begin CHARACTERISTIC DSM_TsfDfp_HWEMonUMaxSupply_C "Schwerezaehlergrenze fuer Fehlerpfad Dfp_HWEMonUMaxSupply" VALUE 0x1CD893 Kw_Wu8 51000. TimeDsmTsf 0.00 51000. FORMAT "%5.0" /end CHARACTERISTIC
/begin CHARACTERISTIC DSM_TsfDfp_HWEMonUMinSupply_C "Schwerezaehlergrenze fuer Fehlerpfad Dfp_HWEMonUMinSupply" VALUE 0x1CD894 Kw_Wu8 51000. TimeDsmTsf 0.00 51000. FORMAT "%5.0" /end CHARACTERISTIC
/begin CHARACTERISTIC DSM_TsfDfp_IATSCD_C "Schwerezaehlergrenze fuer Fehlerpfad Dfp_IATSCD" VALUE 0x1CD895 Kw_Wu8 51000. TimeDsmTsf 0.00 51000. FORMAT "%5.0" /end CHARACTERISTIC
/begin CHARACTERISTIC DSM_TsfDfp_IFCD_C "Schwerezaehlergrenze fuer Fehlerpfad Dfp_IFCD" VALUE 0x1CD896 Kw_Wu8 51000. TimeDsmTsf 0.00 51000. FORMAT "%5.0" /end CHARACTERISTIC
/begin CHARACTERISTIC DSM_TsfDfp_ImmCtl_C "Schwerezaehlergrenze fuer Fehlerpfad Dfp_ImmCtl" VALUE 0x1CD897 Kw_Wu8 51000. TimeDsmTsf 0.00 51000. FORMAT "%5.0" /end CHARACTERISTIC
/begin CHARACTERISTIC DSM_TsfDfp_InjCrv_InjLim_C "Schwerezaehlergrenze fuer Fehlerpfad Dfp_InjCrv_InjLim" VALUE 0x1CD898 Kw_Wu8 51000. TimeDsmTsf 0.00 51000. FORMAT "%5.0" /end CHARACTERISTIC
/begin CHARACTERISTIC DSM_TsfDfp_InjVCDActrChrg_C "Schwerezaehlergrenze fuer Fehlerpfad Dfp_InjVCDActrChrg" VALUE 0x1CD899 Kw_Wu8 51000. TimeDsmTsf 0.00 51000. FORMAT "%5.0" /end CHARACTERISTIC
/begin CHARACTERISTIC DSM_TsfDfp_InjVCDActrVolt_C "Schwerezaehlergrenze fuer Fehlerpfad Dfp_InjVCDActrVolt" VALUE 0x1CD89A Kw_Wu8 51000. TimeDsmTsf 0.00 51000. FORMAT "%5.0" /end CHARACTERISTIC
/begin CHARACTERISTIC DSM_TsfDfp_InjVCDClsBank1_C "Schwerezaehlergrenze fuer Fehlerpfad Dfp_InjVCDClsBank1" VALUE 0x1CD89B Kw_Wu8 51000. TimeDsmTsf 0.00 51000. FORMAT "%5.0" /end CHARACTERISTIC
/begin CHARACTERISTIC DSM_TsfDfp_InjVCDClsBank2_C "Schwerezaehlergrenze fuer Fehlerpfad Dfp_InjVCDClsBank2" VALUE 0x1CD89C Kw_Wu8 51000. TimeDsmTsf 0.00 51000. FORMAT "%5.0" /end CHARACTERISTIC
/begin CHARACTERISTIC DSM_TsfDfp_InjVCDMonCab_C "Schwerezaehlergrenze fuer Fehlerpfad Dfp_InjVCDMonCab" VALUE 0x1CD89D Kw_Wu8 51000. TimeDsmTsf 0.00 51000. FORMAT "%5.0" /end CHARACTERISTIC
/begin CHARACTERISTIC DSM_TsfDfp_InjVCDMonSwt_C "Schwerezaehlergrenze fuer Fehlerpfad Dfp_InjVCDMonSwt" VALUE 0x1CD89E Kw_Wu8 51000. TimeDsmTsf 0.00 51000. FORMAT "%5.0" /end CHARACTERISTIC
/begin CHARACTERISTIC DSM_TsfDfp_InjVCDShOffDCDC_C "Schwerezaehlergrenze fuer Fehlerpfad Dfp_InjVCDShOffDCDC" VALUE 0x1CD89F Kw_Wu8 51000. TimeDsmTsf 0.00 51000. FORMAT "%5.0" /end CHARACTERISTIC
/begin CHARACTERISTIC DSM_TsfDfp_InjVCDUBuf_C "Schwerezaehlergrenze fuer Fehlerpfad Dfp_InjVCDUBuf" VALUE 0x1CD8A0 Kw_Wu8 51000. TimeDsmTsf 0.00 51000. FORMAT "%5.0" /end CHARACTERISTIC
/begin CHARACTERISTIC DSM_TsfDfp_InjVCD_CY370Ampl_C "Schwerezaehlergrenze fuer Fehlerpfad Dfp_InjVCD_CY370Ampl" VALUE 0x1CD8A1 Kw_Wu8 51000. TimeDsmTsf 0.00 51000. FORMAT "%5.0" /end CHARACTERISTIC
/begin CHARACTERISTIC DSM_TsfDfp_InjVlvBnk1A_C "Schwerezaehlergrenze fuer Fehlerpfad Dfp_InjVlvBnk1A" VALUE 0x1CD8A2 Kw_Wu8 51000. TimeDsmTsf 0.00 51000. FORMAT "%5.0" /end CHARACTERISTIC
/begin CHARACTERISTIC DSM_TsfDfp_InjVlvBnk1B_C "Schwerezaehlergrenze fuer Fehlerpfad Dfp_InjVlvBnk1B" VALUE 0x1CD8A3 Kw_Wu8 51000. TimeDsmTsf 0.00 51000. FORMAT "%5.0" /end CHARACTERISTIC
/begin CHARACTERISTIC DSM_TsfDfp_InjVlvBnk2A_C "Schwerezaehlergrenze fuer Fehlerpfad Dfp_InjVlvBnk2A" VALUE 0x1CD8A4 Kw_Wu8 51000. TimeDsmTsf 0.00 51000. FORMAT "%5.0" /end CHARACTERISTIC
/begin CHARACTERISTIC DSM_TsfDfp_InjVlvBnk2B_C "Schwerezaehlergrenze fuer Fehlerpfad Dfp_InjVlvBnk2B" VALUE 0x1CD8A5 Kw_Wu8 51000. TimeDsmTsf 0.00 51000. FORMAT "%5.0" /end CHARACTERISTIC
/begin CHARACTERISTIC DSM_TsfDfp_InjVlvChipA_C "Schwerezaehlergrenze fuer Fehlerpfad Dfp_InjVlvChipA" VALUE 0x1CD8A6 Kw_Wu8 51000. TimeDsmTsf 0.00 51000. FORMAT "%5.0" /end CHARACTERISTIC
/begin CHARACTERISTIC DSM_TsfDfp_InjVlvChipB_C "Schwerezaehlergrenze fuer Fehlerpfad Dfp_InjVlvChipB" VALUE 0x1CD8A7 Kw_Wu8 51000. TimeDsmTsf 0.00 51000. FORMAT "%5.0" /end CHARACTERISTIC
/begin CHARACTERISTIC DSM_TsfDfp_InjVlvCyl1A_C "Schwerezaehlergrenze fuer Fehlerpfad Dfp_InjVlvCyl1A" VALUE 0x1CD8A8 Kw_Wu8 51000. TimeDsmTsf 0.00 51000. FORMAT "%5.0" /end CHARACTERISTIC
/begin CHARACTERISTIC DSM_TsfDfp_InjVlvCyl1B_C "Schwerezaehlergrenze fuer Fehlerpfad Dfp_InjVlvCyl1B" VALUE 0x1CD8A9 Kw_Wu8 51000. TimeDsmTsf 0.00 51000. FORMAT "%5.0" /end CHARACTERISTIC
/begin CHARACTERISTIC DSM_TsfDfp_InjVlvCyl1C_C "Schwerezaehlergrenze fuer Fehlerpfad Dfp_InjVlvCyl1C" VALUE 0x1CD8AA Kw_Wu8 51000. TimeDsmTsf 0.00 51000. FORMAT "%5.0" /end CHARACTERISTIC
/begin CHARACTERISTIC DSM_TsfDfp_InjVlvCyl2A_C "Schwerezaehlergrenze fuer Fehlerpfad Dfp_InjVlvCyl2A" VALUE 0x1CD8AB Kw_Wu8 51000. TimeDsmTsf 0.00 51000. FORMAT "%5.0" /end CHARACTERISTIC
/begin CHARACTERISTIC DSM_TsfDfp_InjVlvCyl2B_C "Schwerezaehlergrenze fuer Fehlerpfad Dfp_InjVlvCyl2B" VALUE 0x1CD8AC Kw_Wu8 51000. TimeDsmTsf 0.00 51000. FORMAT "%5.0" /end CHARACTERISTIC
/begin CHARACTERISTIC DSM_TsfDfp_InjVlvCyl2C_C "Schwerezaehlergrenze fuer Fehlerpfad Dfp_InjVlvCyl2C" VALUE 0x1CD8AD Kw_Wu8 51000. TimeDsmTsf 0.00 51000. FORMAT "%5.0" /end CHARACTERISTIC
/begin CHARACTERISTIC DSM_TsfDfp_InjVlvCyl3A_C "Schwerezaehlergrenze fuer Fehlerpfad Dfp_InjVlvCyl3A" VALUE 0x1CD8AE Kw_Wu8 51000. TimeDsmTsf 0.00 51000. FORMAT "%5.0" /end CHARACTERISTIC
/begin CHARACTERISTIC DSM_TsfDfp_InjVlvCyl3B_C "Schwerezaehlergrenze fuer Fehlerpfad Dfp_InjVlvCyl3B" VALUE 0x1CD8AF Kw_Wu8 51000. TimeDsmTsf 0.00 51000. FORMAT "%5.0" /end CHARACTERISTIC
/begin CHARACTERISTIC DSM_TsfDfp_InjVlvCyl3C_C "Schwerezaehlergrenze fuer Fehlerpfad Dfp_InjVlvCyl3C" VALUE 0x1CD8B0 Kw_Wu8 51000. TimeDsmTsf 0.00 51000. FORMAT "%5.0" /end CHARACTERISTIC
/begin CHARACTERISTIC DSM_TsfDfp_InjVlvCyl4A_C "Schwerezaehlergrenze fuer Fehlerpfad Dfp_InjVlvCyl4A" VALUE 0x1CD8B1 Kw_Wu8 51000. TimeDsmTsf 0.00 51000. FORMAT "%5.0" /end CHARACTERISTIC
/begin CHARACTERISTIC DSM_TsfDfp_InjVlvCyl4B_C "Schwerezaehlergrenze fuer Fehlerpfad Dfp_InjVlvCyl4B" VALUE 0x1CD8B2 Kw_Wu8 51000. TimeDsmTsf 0.00 51000. FORMAT "%5.0" /end CHARACTERISTIC
/begin CHARACTERISTIC DSM_TsfDfp_InjVlvCyl4C_C "Schwerezaehlergrenze fuer Fehlerpfad Dfp_InjVlvCyl4C" VALUE 0x1CD8B3 Kw_Wu8 51000. TimeDsmTsf 0.00 51000. FORMAT "%5.0" /end CHARACTERISTIC
/begin CHARACTERISTIC DSM_TsfDfp_InjVlvCyl5A_C "Schwerezaehlergrenze fuer Fehlerpfad Dfp_InjVlvCyl5A" VALUE 0x1CD8B4 Kw_Wu8 51000. TimeDsmTsf 0.00 51000. FORMAT "%5.0" /end CHARACTERISTIC
/begin CHARACTERISTIC DSM_TsfDfp_InjVlvCyl5B_C "Schwerezaehlergrenze fuer Fehlerpfad Dfp_InjVlvCyl5B" VALUE 0x1CD8B5 Kw_Wu8 51000. TimeDsmTsf 0.00 51000. FORMAT "%5.0" /end CHARACTERISTIC
/begin CHARACTERISTIC DSM_TsfDfp_InjVlvCyl5C_C "Schwerezaehlergrenze fuer Fehlerpfad Dfp_InjVlvCyl5C" VALUE 0x1CD8B6 Kw_Wu8 51000. TimeDsmTsf 0.00 51000. FORMAT "%5.0" /end CHARACTERISTIC
/begin CHARACTERISTIC DSM_TsfDfp_InjVlvCyl6A_C "Schwerezaehlergrenze fuer Fehlerpfad Dfp_InjVlvCyl6A" VALUE 0x1CD8B7 Kw_Wu8 51000. TimeDsmTsf 0.00 51000. FORMAT "%5.0" /end CHARACTERISTIC
/begin CHARACTERISTIC DSM_TsfDfp_InjVlvCyl6B_C "Schwerezaehlergrenze fuer Fehlerpfad Dfp_InjVlvCyl6B" VALUE 0x1CD8B8 Kw_Wu8 51000. TimeDsmTsf 0.00 51000. FORMAT "%5.0" /end CHARACTERISTIC
/begin CHARACTERISTIC DSM_TsfDfp_InjVlvCyl6C_C "Schwerezaehlergrenze fuer Fehlerpfad Dfp_InjVlvCyl6C" VALUE 0x1CD8B9 Kw_Wu8 51000. TimeDsmTsf 0.00 51000. FORMAT "%5.0" /end CHARACTERISTIC
/begin CHARACTERISTIC DSM_TsfDfp_InjVlvCyl7A_C "Schwerezaehlergrenze fuer Fehlerpfad Dfp_InjVlvCyl7A" VALUE 0x1CD8BA Kw_Wu8 51000. TimeDsmTsf 0.00 51000. FORMAT "%5.0" /end CHARACTERISTIC
/begin CHARACTERISTIC DSM_TsfDfp_InjVlvCyl7B_C "Schwerezaehlergrenze fuer Fehlerpfad Dfp_InjVlvCyl7B" VALUE 0x1CD8BB Kw_Wu8 51000. TimeDsmTsf 0.00 51000. FORMAT "%5.0" /end CHARACTERISTIC
/begin CHARACTERISTIC DSM_TsfDfp_InjVlvCyl7C_C "Schwerezaehlergrenze fuer Fehlerpfad Dfp_InjVlvCyl7C" VALUE 0x1CD8BC Kw_Wu8 51000. TimeDsmTsf 0.00 51000. FORMAT "%5.0" /end CHARACTERISTIC
/begin CHARACTERISTIC DSM_TsfDfp_InjVlvCyl8A_C "Schwerezaehlergrenze fuer Fehlerpfad Dfp_InjVlvCyl8A" VALUE 0x1CD8BD Kw_Wu8 51000. TimeDsmTsf 0.00 51000. FORMAT "%5.0" /end CHARACTERISTIC
/begin CHARACTERISTIC DSM_TsfDfp_InjVlvCyl8B_C "Schwerezaehlergrenze fuer Fehlerpfad Dfp_InjVlvCyl8B" VALUE 0x1CD8BE Kw_Wu8 51000. TimeDsmTsf 0.00 51000. FORMAT "%5.0" /end CHARACTERISTIC
/begin CHARACTERISTIC DSM_TsfDfp_InjVlvCyl8C_C "Schwerezaehlergrenze fuer Fehlerpfad Dfp_InjVlvCyl8C" VALUE 0x1CD8BF Kw_Wu8 51000. TimeDsmTsf 0.00 51000. FORMAT "%5.0" /end CHARACTERISTIC
/begin CHARACTERISTIC DSM_TsfDfp_LSUCDCircNernst0_C "Schwerezaehlergrenze fuer Fehlerpfad Dfp_LSUCDCircNernst0" VALUE 0x1CD8C0 Kw_Wu8 51000. TimeDsmTsf 0.00 51000. FORMAT "%5.0" /end CHARACTERISTIC
/begin CHARACTERISTIC DSM_TsfDfp_LSUCDCircPumpCur0_C "Schwerezaehlergrenze fuer Fehlerpfad Dfp_LSUCDCircPumpCur0" VALUE 0x1CD8C1 Kw_Wu8 51000. TimeDsmTsf 0.00 51000. FORMAT "%5.0" /end CHARACTERISTIC
/begin CHARACTERISTIC DSM_TsfDfp_LSUCDCircVirtGnd0_C "Schwerezaehlergrenze fuer Fehlerpfad Dfp_LSUCDCircVirtGnd0" VALUE 0x1CD8C2 Kw_Wu8 51000. TimeDsmTsf 0.00 51000. FORMAT "%5.0" /end CHARACTERISTIC
/begin CHARACTERISTIC DSM_TsfDfp_LSUCDHeater0_C "Schwerezaehlergrenze fuer Fehlerpfad Dfp_LSUCDHeater0" VALUE 0x1CD8C3 Kw_Wu8 51000. TimeDsmTsf 0.00 51000. FORMAT "%5.0" /end CHARACTERISTIC
/begin CHARACTERISTIC DSM_TsfDfp_LSUCDHtCoup0_C "Schwerezaehlergrenze fuer Fehlerpfad Dfp_LSUCDHtCoup0" VALUE 0x1CD8C4 Kw_Wu8 51000. TimeDsmTsf 0.00 51000. FORMAT "%5.0" /end CHARACTERISTIC
/begin CHARACTERISTIC DSM_TsfDfp_LSUCDO20_C "Schwerezaehlergrenze fuer Fehlerpfad Dfp_LSUCDO20" VALUE 0x1CD8C5 Kw_Wu8 51000. TimeDsmTsf 0.00 51000. FORMAT "%5.0" /end CHARACTERISTIC
/begin CHARACTERISTIC DSM_TsfDfp_LSUCDO2Clb0_C "Schwerezaehlergrenze fuer Fehlerpfad Dfp_LSUCDO2Clb0" VALUE 0x1CD8C6 Kw_Wu8 51000. TimeDsmTsf 0.00 51000. FORMAT "%5.0" /end CHARACTERISTIC
/begin CHARACTERISTIC DSM_TsfDfp_LSUCDRiClb0_C "Schwerezaehlergrenze fuer Fehlerpfad Dfp_LSUCDRiClb0" VALUE 0x1CD8C7 Kw_Wu8 51000. TimeDsmTsf 0.00 51000. FORMAT "%5.0" /end CHARACTERISTIC
/begin CHARACTERISTIC DSM_TsfDfp_LSUCDSPI0_C "Schwerezaehlergrenze fuer Fehlerpfad Dfp_LSUCDSPI0" VALUE 0x1CD8C8 Kw_Wu8 51000. TimeDsmTsf 0.00 51000. FORMAT "%5.0" /end CHARACTERISTIC
/begin CHARACTERISTIC DSM_TsfDfp_LSUCDSPIBattLow0_C "Schwerezaehlergrenze fuer Fehlerpfad Dfp_LSUCDSPIBattLow0" VALUE 0x1CD8C9 Kw_Wu8 51000. TimeDsmTsf 0.00 51000. FORMAT "%5.0" /end CHARACTERISTIC
/begin CHARACTERISTIC DSM_TsfDfp_LSUCDWireIP0_C "Schwerezaehlergrenze fuer Fehlerpfad Dfp_LSUCDWireIP0" VALUE 0x1CD8CA Kw_Wu8 51000. TimeDsmTsf 0.00 51000. FORMAT "%5.0" /end CHARACTERISTIC
/begin CHARACTERISTIC DSM_TsfDfp_LSUCtlRiExc0_C "Schwerezaehlergrenze fuer Fehlerpfad Dfp_LSUCtlRiExc0" VALUE 0x1CD8CB Kw_Wu8 51000. TimeDsmTsf 0.00 51000. FORMAT "%5.0" /end CHARACTERISTIC
/begin CHARACTERISTIC DSM_TsfDfp_LSUMon1Sens_C "Schwerezaehlergrenze fuer Fehlerpfad Dfp_LSUMon1Sens" VALUE 0x1CD8CC Kw_Wu8 51000. TimeDsmTsf 0.00 51000. FORMAT "%5.0" /end CHARACTERISTIC
/begin CHARACTERISTIC DSM_TsfDfp_LSUMon2Sens_C "Schwerezaehlergrenze fuer Fehlerpfad Dfp_LSUMon2Sens" VALUE 0x1CD8CD Kw_Wu8 51000. TimeDsmTsf 0.00 51000. FORMAT "%5.0" /end CHARACTERISTIC
/begin CHARACTERISTIC DSM_TsfDfp_MIL_C "Schwerezaehlergrenze fuer Fehlerpfad Dfp_MIL" VALUE 0x1CD8CE Kw_Wu8 51000. TimeDsmTsf 0.00 51000. FORMAT "%5.0" /end CHARACTERISTIC
/begin CHARACTERISTIC DSM_TsfDfp_MRlyCD_C "Schwerezaehlergrenze fuer Fehlerpfad Dfp_MRlyCD" VALUE 0x1CD8CF Kw_Wu8 51000. TimeDsmTsf 0.00 51000. FORMAT "%5.0" /end CHARACTERISTIC
/begin CHARACTERISTIC DSM_TsfDfp_MeUnCDNoLoad_C "Schwerezaehlergrenze fuer Fehlerpfad Dfp_MeUnCDNoLoad" VALUE 0x1CD8D0 Kw_Wu8 51000. TimeDsmTsf 0.00 51000. FORMAT "%5.0" /end CHARACTERISTIC
/begin CHARACTERISTIC DSM_TsfDfp_MeUnCDSCBat_C "Schwerezaehlergrenze fuer Fehlerpfad Dfp_MeUnCDSCBat" VALUE 0x1CD8D1 Kw_Wu8 51000. TimeDsmTsf 0.00 51000. FORMAT "%5.0" /end CHARACTERISTIC
/begin CHARACTERISTIC DSM_TsfDfp_MeUnCDSCGnd_C "Schwerezaehlergrenze fuer Fehlerpfad Dfp_MeUnCDSCGnd" VALUE 0x1CD8D2 Kw_Wu8 51000. TimeDsmTsf 0.00 51000. FORMAT "%5.0" /end CHARACTERISTIC
/begin CHARACTERISTIC DSM_TsfDfp_MeUnCD_ADC_C "Schwerezaehlergrenze fuer Fehlerpfad Dfp_MeUnCD_ADC" VALUE 0x1CD8D3 Kw_Wu8 51000. TimeDsmTsf 0.00 51000. FORMAT "%5.0" /end CHARACTERISTIC
/begin CHARACTERISTIC DSM_TsfDfp_Montr_C "Schwerezaehlergrenze fuer Fehlerpfad Dfp_Montr" VALUE 0x1CD8D4 Kw_Wu8 51000. TimeDsmTsf 0.00 51000. FORMAT "%5.0" /end CHARACTERISTIC
/begin CHARACTERISTIC DSM_TsfDfp_OTSCD_C "Schwerezaehlergrenze fuer Fehlerpfad Dfp_OTSCD" VALUE 0x1CD8D5 Kw_Wu8 51000. TimeDsmTsf 0.00 51000. FORMAT "%5.0" /end CHARACTERISTIC
/begin CHARACTERISTIC DSM_TsfDfp_OTSCDCanInac_C "Schwerezaehlergrenze fuer Fehlerpfad Dfp_OTSCDCanInac" VALUE 0x1CD8D6 Kw_Wu8 51000. TimeDsmTsf 0.00 51000. FORMAT "%5.0" /end CHARACTERISTIC
/begin CHARACTERISTIC DSM_TsfDfp_OTSCDCanSig_C "Schwerezaehlergrenze fuer Fehlerpfad Dfp_OTSCDCanSig" VALUE 0x1CD8D7 Kw_Wu8 51000. TimeDsmTsf 0.00 51000. FORMAT "%5.0" /end CHARACTERISTIC
/begin CHARACTERISTIC DSM_TsfDfp_OvRMon_C "Schwerezaehlergrenze fuer Fehlerpfad Dfp_OvRMon" VALUE 0x1CD8D8 Kw_Wu8 51000. TimeDsmTsf 0.00 51000. FORMAT "%5.0" /end CHARACTERISTIC
/begin CHARACTERISTIC DSM_TsfDfp_OvRMonCrCtlP_C "Schwerezaehlergrenze fuer Fehlerpfad Dfp_OvRMonCrCtlP" VALUE 0x1CD8D9 Kw_Wu8 51000. TimeDsmTsf 0.00 51000. FORMAT "%5.0" /end CHARACTERISTIC
/begin CHARACTERISTIC DSM_TsfDfp_OvRMonSigA_C "Schwerezaehlergrenze fuer Fehlerpfad Dfp_OvRMonSigA" VALUE 0x1CD8DA Kw_Wu8 51000. TimeDsmTsf 0.00 51000. FORMAT "%5.0" /end CHARACTERISTIC
/begin CHARACTERISTIC DSM_TsfDfp_OxiCCDTPre_C "Schwerezaehlergrenze fuer Fehlerpfad Dfp_OxiCCDTPre" VALUE 0x1CD8DB Kw_Wu8 51000. TimeDsmTsf 0.00 51000. FORMAT "%5.0" /end CHARACTERISTIC
/begin CHARACTERISTIC DSM_TsfDfp_OxiCCDTPre1_C "Schwerezaehlergrenze fuer Fehlerpfad Dfp_OxiCCDTPre1" VALUE 0x1CD8DC Kw_Wu8 51000. TimeDsmTsf 0.00 51000. FORMAT "%5.0" /end CHARACTERISTIC
/begin CHARACTERISTIC DSM_TsfDfp_PCR_BalGovDev_C "Schwerezaehlergrenze fuer Fehlerpfad Dfp_PCR_BalGovDev" VALUE 0x1CD8DD Kw_Wu8 51000. TimeDsmTsf 0.00 51000. FORMAT "%5.0" /end CHARACTERISTIC
/begin CHARACTERISTIC DSM_TsfDfp_PCR_GovDev_C "Schwerezaehlergrenze fuer Fehlerpfad Dfp_PCR_GovDev" VALUE 0x1CD8DE Kw_Wu8 51000. TimeDsmTsf 0.00 51000. FORMAT "%5.0" /end CHARACTERISTIC
/begin CHARACTERISTIC DSM_TsfDfp_PCVCDNoLoad_C "Schwerezaehlergrenze fuer Fehlerpfad Dfp_PCVCDNoLoad" VALUE 0x1CD8DF Kw_Wu8 51000. TimeDsmTsf 0.00 51000. FORMAT "%5.0" /end CHARACTERISTIC
/begin CHARACTERISTIC DSM_TsfDfp_PCVCDSCBat_C "Schwerezaehlergrenze fuer Fehlerpfad Dfp_PCVCDSCBat" VALUE 0x1CD8E0 Kw_Wu8 51000. TimeDsmTsf 0.00 51000. FORMAT "%5.0" /end CHARACTERISTIC
/begin CHARACTERISTIC DSM_TsfDfp_PCVCDSCGnd_C "Schwerezaehlergrenze fuer Fehlerpfad Dfp_PCVCDSCGnd" VALUE 0x1CD8E1 Kw_Wu8 51000. TimeDsmTsf 0.00 51000. FORMAT "%5.0" /end CHARACTERISTIC
/begin CHARACTERISTIC DSM_TsfDfp_PCVCD_ADC_C "Schwerezaehlergrenze fuer Fehlerpfad Dfp_PCVCD_ADC" VALUE 0x1CD8E2 Kw_Wu8 51000. TimeDsmTsf 0.00 51000. FORMAT "%5.0" /end CHARACTERISTIC
/begin CHARACTERISTIC DSM_TsfDfp_PFltCDHtg_C "Schwerezaehlergrenze fuer Fehlerpfad Dfp_PFltCDHtg" VALUE 0x1CD8E3 Kw_Wu8 51000. TimeDsmTsf 0.00 51000. FORMAT "%5.0" /end CHARACTERISTIC
/begin CHARACTERISTIC DSM_TsfDfp_PFltCDHtg1_C "Schwerezaehlergrenze fuer Fehlerpfad Dfp_PFltCDHtg1" VALUE 0x1CD8E4 Kw_Wu8 51000. TimeDsmTsf 0.00 51000. FORMAT "%5.0" /end CHARACTERISTIC
/begin CHARACTERISTIC DSM_TsfDfp_PFltCDPDiff_C "Schwerezaehlergrenze fuer Fehlerpfad Dfp_PFltCDPDiff" VALUE 0x1CD8E5 Kw_Wu8 51000. TimeDsmTsf 0.00 51000. FORMAT "%5.0" /end CHARACTERISTIC
/begin CHARACTERISTIC DSM_TsfDfp_PFltCDPDiff1_C "Schwerezaehlergrenze fuer Fehlerpfad Dfp_PFltCDPDiff1" VALUE 0x1CD8E6 Kw_Wu8 51000. TimeDsmTsf 0.00 51000. FORMAT "%5.0" /end CHARACTERISTIC
/begin CHARACTERISTIC DSM_TsfDfp_PFltCDTPre_C "Schwerezaehlergrenze fuer Fehlerpfad Dfp_PFltCDTPre" VALUE 0x1CD8E7 Kw_Wu8 51000. TimeDsmTsf 0.00 51000. FORMAT "%5.0" /end CHARACTERISTIC
/begin CHARACTERISTIC DSM_TsfDfp_PFltCDTPst_C "Schwerezaehlergrenze fuer Fehlerpfad Dfp_PFltCDTPst" VALUE 0x1CD8E8 Kw_Wu8 51000. TimeDsmTsf 0.00 51000. FORMAT "%5.0" /end CHARACTERISTIC
/begin CHARACTERISTIC DSM_TsfDfp_PFltCDTempPre_C "Schwerezaehlergrenze fuer Fehlerpfad Dfp_PFltCDTempPre" VALUE 0x1CD8E9 Kw_Wu8 51000. TimeDsmTsf 0.00 51000. FORMAT "%5.0" /end CHARACTERISTIC
/begin CHARACTERISTIC DSM_TsfDfp_PFltCDTempPre1_C "Schwerezaehlergrenze fuer Fehlerpfad Dfp_PFltCDTempPre1" VALUE 0x1CD8EA Kw_Wu8 51000. TimeDsmTsf 0.00 51000. FORMAT "%5.0" /end CHARACTERISTIC
/begin CHARACTERISTIC DSM_TsfDfp_PFltChar_C "Schwerezaehlergrenze fuer Fehlerpfad Dfp_PFltChar" VALUE 0x1CD8EB Kw_Wu8 51000. TimeDsmTsf 0.00 51000. FORMAT "%5.0" /end CHARACTERISTIC
/begin CHARACTERISTIC DSM_TsfDfp_PFltEngPrt_C "Schwerezaehlergrenze fuer Fehlerpfad Dfp_PFltEngPrt" VALUE 0x1CD8EC Kw_Wu8 51000. TimeDsmTsf 0.00 51000. FORMAT "%5.0" /end CHARACTERISTIC
/begin CHARACTERISTIC DSM_TsfDfp_PFltPresDynPlaus_C "Schwerezaehlergrenze fuer Fehlerpfad Dfp_PFltPresDynPlaus" VALUE 0x1CD8ED Kw_Wu8 51000. TimeDsmTsf 0.00 51000. FORMAT "%5.0" /end CHARACTERISTIC
/begin CHARACTERISTIC DSM_TsfDfp_PFltPresSens_C "Schwerezaehlergrenze fuer Fehlerpfad Dfp_PFltPresSens" VALUE 0x1CD8EE Kw_Wu8 51000. TimeDsmTsf 0.00 51000. FORMAT "%5.0" /end CHARACTERISTIC
/begin CHARACTERISTIC DSM_TsfDfp_PFltPresSensHsLn_C "Schwerezaehlergrenze fuer Fehlerpfad Dfp_PFltPresSensHsLn" VALUE 0x1CD8EF Kw_Wu8 51000. TimeDsmTsf 0.00 51000. FORMAT "%5.0" /end CHARACTERISTIC
/begin CHARACTERISTIC DSM_TsfDfp_PFltPresSensSot_C "Schwerezaehlergrenze fuer Fehlerpfad Dfp_PFltPresSensSot" VALUE 0x1CD8F0 Kw_Wu8 51000. TimeDsmTsf 0.00 51000. FORMAT "%5.0" /end CHARACTERISTIC
/begin CHARACTERISTIC DSM_TsfDfp_PFltRgnPerm_C "Schwerezaehlergrenze fuer Fehlerpfad Dfp_PFltRgnPerm" VALUE 0x1CD8F1 Kw_Wu8 51000. TimeDsmTsf 0.00 51000. FORMAT "%5.0" /end CHARACTERISTIC
/begin CHARACTERISTIC DSM_TsfDfp_PFltTempDwnStrm_C "Schwerezaehlergrenze fuer Fehlerpfad Dfp_PFltTempDwnStrm" VALUE 0x1CD8F2 Kw_Wu8 51000. TimeDsmTsf 0.00 51000. FORMAT "%5.0" /end CHARACTERISTIC
/begin CHARACTERISTIC DSM_TsfDfp_PFltTempSens_C "Schwerezaehlergrenze fuer Fehlerpfad Dfp_PFltTempSens" VALUE 0x1CD8F3 Kw_Wu8 51000. TimeDsmTsf 0.00 51000. FORMAT "%5.0" /end CHARACTERISTIC
/begin CHARACTERISTIC DSM_TsfDfp_PFltTempUpStrm_C "Schwerezaehlergrenze fuer Fehlerpfad Dfp_PFltTempUpStrm" VALUE 0x1CD8F4 Kw_Wu8 51000. TimeDsmTsf 0.00 51000. FORMAT "%5.0" /end CHARACTERISTIC
/begin CHARACTERISTIC DSM_TsfDfp_PSPCD_Actr_C "Schwerezaehlergrenze fuer Fehlerpfad Dfp_PSPCD_Actr" VALUE 0x1CD8F5 Kw_Wu8 51000. TimeDsmTsf 0.00 51000. FORMAT "%5.0" /end CHARACTERISTIC
/begin CHARACTERISTIC DSM_TsfDfp_PrpCtlvLimErrPat_C "Schwerezaehlergrenze fuer Fehlerpfad Dfp_PrpCtlvLimErrPat" VALUE 0x1CD8F6 Kw_Wu8 51000. TimeDsmTsf 0.00 51000. FORMAT "%5.0" /end CHARACTERISTIC
/begin CHARACTERISTIC DSM_TsfDfp_RailCD_C "Schwerezaehlergrenze fuer Fehlerpfad Dfp_RailCD" VALUE 0x1CD8F7 Kw_Wu8 51000. TimeDsmTsf 0.00 51000. FORMAT "%5.0" /end CHARACTERISTIC
/begin CHARACTERISTIC DSM_TsfDfp_RailCDOfsTst_C "Schwerezaehlergrenze fuer Fehlerpfad Dfp_RailCDOfsTst" VALUE 0x1CD8F8 Kw_Wu8 51000. TimeDsmTsf 0.00 51000. FORMAT "%5.0" /end CHARACTERISTIC
/begin CHARACTERISTIC DSM_TsfDfp_RailMeUn0_C "Schwerezaehlergrenze fuer Fehlerpfad Dfp_RailMeUn0" VALUE 0x1CD8F9 Kw_Wu8 51000. TimeDsmTsf 0.00 51000. FORMAT "%5.0" /end CHARACTERISTIC
/begin CHARACTERISTIC DSM_TsfDfp_RailMeUn1_C "Schwerezaehlergrenze fuer Fehlerpfad Dfp_RailMeUn1" VALUE 0x1CD8FA Kw_Wu8 51000. TimeDsmTsf 0.00 51000. FORMAT "%5.0" /end CHARACTERISTIC
/begin CHARACTERISTIC DSM_TsfDfp_RailMeUn2_C "Schwerezaehlergrenze fuer Fehlerpfad Dfp_RailMeUn2" VALUE 0x1CD8FB Kw_Wu8 51000. TimeDsmTsf 0.00 51000. FORMAT "%5.0" /end CHARACTERISTIC
/begin CHARACTERISTIC DSM_TsfDfp_RailMeUn3_C "Schwerezaehlergrenze fuer Fehlerpfad Dfp_RailMeUn3" VALUE 0x1CD8FC Kw_Wu8 51000. TimeDsmTsf 0.00 51000. FORMAT "%5.0" /end CHARACTERISTIC
/begin CHARACTERISTIC DSM_TsfDfp_RailMeUn4_C "Schwerezaehlergrenze fuer Fehlerpfad Dfp_RailMeUn4" VALUE 0x1CD8FD Kw_Wu8 51000. TimeDsmTsf 0.00 51000. FORMAT "%5.0" /end CHARACTERISTIC
/begin CHARACTERISTIC DSM_TsfDfp_RailPCV0_C "Schwerezaehlergrenze fuer Fehlerpfad Dfp_RailPCV0" VALUE 0x1CD8FE Kw_Wu8 51000. TimeDsmTsf 0.00 51000. FORMAT "%5.0" /end CHARACTERISTIC
/begin CHARACTERISTIC DSM_TsfDfp_RailPCV1_C "Schwerezaehlergrenze fuer Fehlerpfad Dfp_RailPCV1" VALUE 0x1CD8FF Kw_Wu8 51000. TimeDsmTsf 0.00 51000. FORMAT "%5.0" /end CHARACTERISTIC
/begin CHARACTERISTIC DSM_TsfDfp_RailPCV2_C "Schwerezaehlergrenze fuer Fehlerpfad Dfp_RailPCV2" VALUE 0x1CD900 Kw_Wu8 51000. TimeDsmTsf 0.00 51000. FORMAT "%5.0" /end CHARACTERISTIC
/begin CHARACTERISTIC DSM_TsfDfp_RailPCV3_C "Schwerezaehlergrenze fuer Fehlerpfad Dfp_RailPCV3" VALUE 0x1CD901 Kw_Wu8 51000. TimeDsmTsf 0.00 51000. FORMAT "%5.0" /end CHARACTERISTIC
/begin CHARACTERISTIC DSM_TsfDfp_RailPCV4_C "Schwerezaehlergrenze fuer Fehlerpfad Dfp_RailPCV4" VALUE 0x1CD902 Kw_Wu8 51000. TimeDsmTsf 0.00 51000. FORMAT "%5.0" /end CHARACTERISTIC
/begin CHARACTERISTIC DSM_TsfDfp_RailPCV5_C "Schwerezaehlergrenze fuer Fehlerpfad Dfp_RailPCV5" VALUE 0x1CD903 Kw_Wu8 51000. TimeDsmTsf 0.00 51000. FORMAT "%5.0" /end CHARACTERISTIC
/begin CHARACTERISTIC DSM_TsfDfp_SOPTst_C "Schwerezaehlergrenze fuer Fehlerpfad Dfp_SOPTst" VALUE 0x1CD904 Kw_Wu8 51000. TimeDsmTsf 0.00 51000. FORMAT "%5.0" /end CHARACTERISTIC
/begin CHARACTERISTIC DSM_TsfDfp_SSpMon1_C "Schwerezaehlergrenze fuer Fehlerpfad Dfp_SSpMon1" VALUE 0x1CD905 Kw_Wu8 51000. TimeDsmTsf 0.00 51000. FORMAT "%5.0" /end CHARACTERISTIC
/begin CHARACTERISTIC DSM_TsfDfp_SSpMon2_C "Schwerezaehlergrenze fuer Fehlerpfad Dfp_SSpMon2" VALUE 0x1CD906 Kw_Wu8 51000. TimeDsmTsf 0.00 51000. FORMAT "%5.0" /end CHARACTERISTIC
/begin CHARACTERISTIC DSM_TsfDfp_SSpMon3_C "Schwerezaehlergrenze fuer Fehlerpfad Dfp_SSpMon3" VALUE 0x1CD907 Kw_Wu8 51000. TimeDsmTsf 0.00 51000. FORMAT "%5.0" /end CHARACTERISTIC
/begin CHARACTERISTIC DSM_TsfDfp_StrtCDOffRly_C "Schwerezählergrenze für Fehlerpfad Dfp_StrtCDOffRly" VALUE 0x1CD908 Kw_Wu8 51000. TimeDsmTsf 0.00 51000. FORMAT "%5.0" /end CHARACTERISTIC
/begin CHARACTERISTIC DSM_TsfDfp_StrtCDOnRly_C "Schwerezählergrenze für Fehlerpfad Dfp_StrtCDOnRly" VALUE 0x1CD909 Kw_Wu8 51000. TimeDsmTsf 0.00 51000. FORMAT "%5.0" /end CHARACTERISTIC
/begin CHARACTERISTIC DSM_TsfDfp_StrtCtlIlsNotPlaus_C "Schwerezählergrenze für Fehlerpfad Dfp_StrtCtlIlsNotPlaus" VALUE 0x1CD90A Kw_Wu8 51000. TimeDsmTsf 0.00 51000. FORMAT "%5.0" /end CHARACTERISTIC
/begin CHARACTERISTIC DSM_TsfDfp_StrtCtlT50ROneRly1_C "Schwerezaehlergrenze fuer Fehlerpfad Dfp_StrtCtlT50ROneRly1" VALUE 0x1CD90B Kw_Wu8 51000. TimeDsmTsf 0.00 51000. FORMAT "%5.0" /end CHARACTERISTIC
/begin CHARACTERISTIC DSM_TsfDfp_StrtCtlT50ROneRly2_C "Schwerezaehlergrenze fuer Fehlerpfad Dfp_StrtCtlT50ROneRly2" VALUE 0x1CD90C Kw_Wu8 51000. TimeDsmTsf 0.00 51000. FORMAT "%5.0" /end CHARACTERISTIC
/begin CHARACTERISTIC DSM_TsfDfp_StrtCtlT50RZero_C "Schwerezaehlergrenze fuer Fehlerpfad Dfp_StrtCtlT50RZero" VALUE 0x1CD90D Kw_Wu8 51000. TimeDsmTsf 0.00 51000. FORMAT "%5.0" /end CHARACTERISTIC
/begin CHARACTERISTIC DSM_TsfDfp_SysLamp_C "Schwerezaehlergrenze fuer Fehlerpfad Dfp_SysLamp" VALUE 0x1CD90E Kw_Wu8 51000. TimeDsmTsf 0.00 51000. FORMAT "%5.0" /end CHARACTERISTIC
/begin CHARACTERISTIC DSM_TsfDfp_T15CD_C "Schwerezaehlergrenze fuer Fehlerpfad Dfp_T15CD" VALUE 0x1CD90F Kw_Wu8 51000. TimeDsmTsf 0.00 51000. FORMAT "%5.0" /end CHARACTERISTIC
/begin CHARACTERISTIC DSM_TsfDfp_TPUMon_C "Schwerezaehlergrenze fuer Fehlerpfad Dfp_TPUMon" VALUE 0x1CD910 Kw_Wu8 51000. TimeDsmTsf 0.00 51000. FORMAT "%5.0" /end CHARACTERISTIC
/begin CHARACTERISTIC DSM_TsfDfp_TTSCD_C "Schwerezaehlergrenze fuer Fehlerpfad Dfp_TTSCD" VALUE 0x1CD911 Kw_Wu8 51000. TimeDsmTsf 0.00 51000. FORMAT "%5.0" /end CHARACTERISTIC
/begin CHARACTERISTIC DSM_TsfDfp_TVACD_Max_C "Schwerezaehlergrenze fuer Fehlerpfad Dfp_TVACD_Max" VALUE 0x1CD912 Kw_Wu8 51000. TimeDsmTsf 0.00 51000. FORMAT "%5.0" /end CHARACTERISTIC
/begin CHARACTERISTIC DSM_TsfDfp_TVACD_Min_C "Schwerezaehlergrenze fuer Fehlerpfad Dfp_TVACD_Min" VALUE 0x1CD913 Kw_Wu8 51000. TimeDsmTsf 0.00 51000. FORMAT "%5.0" /end CHARACTERISTIC
/begin CHARACTERISTIC DSM_TsfDfp_TVACD_SigNpl_C "Schwerezaehlergrenze fuer Fehlerpfad Dfp_TVACD_SigNpl" VALUE 0x1CD914 Kw_Wu8 51000. TimeDsmTsf 0.00 51000. FORMAT "%5.0" /end CHARACTERISTIC
/begin CHARACTERISTIC DSM_TsfDfp_TVACD_stLineDef_C "Schwerezaehlergrenze fuer Fehlerpfad Dfp_TVACD_stLineDef" VALUE 0x1CD915 Kw_Wu8 51000. TimeDsmTsf 0.00 51000. FORMAT "%5.0" /end CHARACTERISTIC
/begin CHARACTERISTIC DSM_TsfDfp_UAcc_CodeBitErr_C "Schwerezaehlergrenze fuer Fehlerpfad Dfp_UAcc_CodeBitErr" VALUE 0x1CD916 Kw_Wu8 51000. TimeDsmTsf 0.00 51000. FORMAT "%5.0" /end CHARACTERISTIC
/begin CHARACTERISTIC DSM_TsfDfp_USAp_DataVariant_C "Schwerezaehlergrenze fuer Fehlerpfad Dfp_USAp_DataVariant" VALUE 0x1CD917 Kw_Wu8 51000. TimeDsmTsf 0.00 51000. FORMAT "%5.0" /end CHARACTERISTIC
/begin CHARACTERISTIC DSM_TsfDfp_USAp_FuncCodeRead_C "Schwerezaehlergrenze fuer Fehlerpfad Dfp_USAp_FuncCodeRead" VALUE 0x1CD918 Kw_Wu8 51000. TimeDsmTsf 0.00 51000. FORMAT "%5.0" /end CHARACTERISTIC
/begin CHARACTERISTIC DSM_TsfDfp_VSACD1_Max_C "Schwerezaehlergrenze fuer Fehlerpfad Dfp_VSACD1_Max" VALUE 0x1CD919 Kw_Wu8 51000. TimeDsmTsf 0.00 51000. FORMAT "%5.0" /end CHARACTERISTIC
/begin CHARACTERISTIC DSM_TsfDfp_VSACD1_Min_C "Schwerezaehlergrenze fuer Fehlerpfad Dfp_VSACD1_Min" VALUE 0x1CD91A Kw_Wu8 51000. TimeDsmTsf 0.00 51000. FORMAT "%5.0" /end CHARACTERISTIC
/begin CHARACTERISTIC DSM_TsfDfp_VSACD1_SigNpl_C "Schwerezaehlergrenze fuer Fehlerpfad Dfp_VSACD1_SigNpl" VALUE 0x1CD91B Kw_Wu8 51000. TimeDsmTsf 0.00 51000. FORMAT "%5.0" /end CHARACTERISTIC
/begin CHARACTERISTIC DSM_TsfDfp_VSACD2_Max_C "Schwerezaehlergrenze fuer Fehlerpfad Dfp_VSACD2_Max" VALUE 0x1CD91C Kw_Wu8 51000. TimeDsmTsf 0.00 51000. FORMAT "%5.0" /end CHARACTERISTIC
/begin CHARACTERISTIC DSM_TsfDfp_VSACD2_Min_C "Schwerezaehlergrenze fuer Fehlerpfad Dfp_VSACD2_Min" VALUE 0x1CD91D Kw_Wu8 51000. TimeDsmTsf 0.00 51000. FORMAT "%5.0" /end CHARACTERISTIC
/begin CHARACTERISTIC DSM_TsfDfp_VSACD2_SigNpl_C "Schwerezaehlergrenze fuer Fehlerpfad Dfp_VSACD2_SigNpl" VALUE 0x1CD91E Kw_Wu8 51000. TimeDsmTsf 0.00 51000. FORMAT "%5.0" /end CHARACTERISTIC
/begin CHARACTERISTIC DSM_TsfDfp_VSAExcSensTemp1_C "Schwerezaehlergrenze fuer Fehlerpfad Dfp_VSAExcSensTemp1" VALUE 0x1CD91F Kw_Wu8 51000. TimeDsmTsf 0.00 51000. FORMAT "%5.0" /end CHARACTERISTIC
/begin CHARACTERISTIC DSM_TsfDfp_VSAExcSensTemp2_C "Schwerezaehlergrenze fuer Fehlerpfad Dfp_VSAExcSensTemp2" VALUE 0x1CD920 Kw_Wu8 51000. TimeDsmTsf 0.00 51000. FORMAT "%5.0" /end CHARACTERISTIC
/begin CHARACTERISTIC DSM_TsfDfp_VSANotLrn1_C "Schwerezaehlergrenze fuer Fehlerpfad Dfp_VSANotLrn1" VALUE 0x1CD921 Kw_Wu8 51000. TimeDsmTsf 0.00 51000. FORMAT "%5.0" /end CHARACTERISTIC
/begin CHARACTERISTIC DSM_TsfDfp_VSANotLrn2_C "Schwerezaehlergrenze fuer Fehlerpfad Dfp_VSANotLrn2" VALUE 0x1CD922 Kw_Wu8 51000. TimeDsmTsf 0.00 51000. FORMAT "%5.0" /end CHARACTERISTIC
/begin CHARACTERISTIC DSM_TsfDfp_VSASCDDcyc1_C "Schwerezaehlergrenze fuer Fehlerpfad Dfp_VSASCDDcyc1" VALUE 0x1CD923 Kw_Wu8 51000. TimeDsmTsf 0.00 51000. FORMAT "%5.0" /end CHARACTERISTIC
/begin CHARACTERISTIC DSM_TsfDfp_VSASCDDcyc2_C "Schwerezaehlergrenze fuer Fehlerpfad Dfp_VSASCDDcyc2" VALUE 0x1CD924 Kw_Wu8 51000. TimeDsmTsf 0.00 51000. FORMAT "%5.0" /end CHARACTERISTIC
/begin CHARACTERISTIC DSM_TsfDfp_VSASCDPeriod1_C "Schwerezaehlergrenze fuer Fehlerpfad Dfp_VSASCDPeriod1" VALUE 0x1CD925 Kw_Wu8 51000. TimeDsmTsf 0.00 51000. FORMAT "%5.0" /end CHARACTERISTIC
/begin CHARACTERISTIC DSM_TsfDfp_VSASCDPeriod2_C "Schwerezaehlergrenze fuer Fehlerpfad Dfp_VSASCDPeriod2" VALUE 0x1CD926 Kw_Wu8 51000. TimeDsmTsf 0.00 51000. FORMAT "%5.0" /end CHARACTERISTIC
/begin CHARACTERISTIC DSM_TsfDfp_VSSCD1_C "Schwerezaehlergrenze fuer Fehlerpfad Dfp_VSSCD1" VALUE 0x1CD927 Kw_Wu8 51000. TimeDsmTsf 0.00 51000. FORMAT "%5.0" /end CHARACTERISTIC
/begin CHARACTERISTIC DSM_TsfDfp_VSSCD2_C "Schwerezaehlergrenze fuer Fehlerpfad Dfp_VSSCD2" VALUE 0x1CD928 Kw_Wu8 51000. TimeDsmTsf 0.00 51000. FORMAT "%5.0" /end CHARACTERISTIC
/begin CHARACTERISTIC DSM_TsfDfp_VSSCD4_C "Schwerezaehlergrenze fuer Fehlerpfad Dfp_VSSCD4" VALUE 0x1CD929 Kw_Wu8 51000. TimeDsmTsf 0.00 51000. FORMAT "%5.0" /end CHARACTERISTIC
/begin CHARACTERISTIC DSM_TsfDfp_VSSCDBrkLowVltg_C "Schwerezaehlergrenze fuer Fehlerpfad Dfp_VSSCDBrkLowVltg" VALUE 0x1CD92A Kw_Wu8 51000. TimeDsmTsf 0.00 51000. FORMAT "%5.0" /end CHARACTERISTIC
/begin CHARACTERISTIC DSM_TsfDfp_VSSCDCAN_C "Schwerezaehlergrenze fuer Fehlerpfad Dfp_VSSCDCAN" VALUE 0x1CD92B Kw_Wu8 51000. TimeDsmTsf 0.00 51000. FORMAT "%5.0" /end CHARACTERISTIC
/begin CHARACTERISTIC DSM_TsfDfp_VSSCDNpl_C "Schwerezaehlergrenze fuer Fehlerpfad Dfp_VSSCDNpl" VALUE 0x1CD92C Kw_Wu8 51000. TimeDsmTsf 0.00 51000. FORMAT "%5.0" /end CHARACTERISTIC
/begin CHARACTERISTIC DSM_TsfDfp_WdCom_C "Schwerezaehlergrenze fuer Fehlerpfad Dfp_WdCom" VALUE 0x1CD92D Kw_Wu8 51000. TimeDsmTsf 0.00 51000. FORMAT "%5.0" /end CHARACTERISTIC
/begin CHARACTERISTIC EATSCD_uSRCMin_C "SRC Minimum Umgebungstemperatur" VALUE 0x1CD948 Kw_Ws16 5200.391 Volt 0.00 5200.391 FORMAT "%8.3" EXTENDED_LIMITS -160156.4 160151.5 /end CHARACTERISTIC
/begin CHARACTERISTIC EATSCD_uSRCMax_C "SRC Maximum Umgebungstemperatur" VALUE 0x1CD94A Kw_Ws16 5200.391 Volt 0.00 5200.391 FORMAT "%8.3" EXTENDED_LIMITS -160156.4 160151.5 /end CHARACTERISTIC
/begin CHARACTERISTIC EATSCD_tLin_CUR "Linearisierungskennlinie der Umgebungstemperatur" CURVE 0x1CD94C Kl_Xs16_Ws16 250.0000 Temp_Cels -50.04000 199.9600 FORMAT "%8.4" EXTENDED_LIMITS -3549.940 3003.560
 /begin AXIS_DESCR STD_AXIS EATSCD_uRaw Volt 25 0.00 5200.391 FORMAT "%8.3" EXTENDED_LIMITS -160156.4 160151.5 DEPOSIT ABSOLUTE /end AXIS_DESCR
/end CHARACTERISTIC
/begin CHARACTERISTIC EATSCD_DebCanDefDef_C "Fehlerentprellung  Umgebungstemperatursensor defekt über CAN" VALUE 0x1CD9B2 Kw_Wu16 655350.0 Time_ms 0.00 655350.0 FORMAT "%8.1" /end CHARACTERISTIC
/begin CHARACTERISTIC EATSCD_DebCanDefOk_C "Heilungsentprellung  Umgebungstemperatursensor defekt über CAN" VALUE 0x1CD9B4 Kw_Wu16 655350.0 Time_ms 0.00 655350.0 FORMAT "%8.1" /end CHARACTERISTIC
/begin CHARACTERISTIC EATSCD_DebCanInacDef_C "Fehlerentprellung  Umgebungstemperatursensor ungenau über CAN" VALUE 0x1CD9B6 Kw_Wu16 655350.0 Time_ms 0.00 655350.0 FORMAT "%8.1" /end CHARACTERISTIC
/begin CHARACTERISTIC EATSCD_DebCanInacOk_C "Heilungsentprellung  Umgebungstemperatursensor ungenau über CAN" VALUE 0x1CD9B8 Kw_Wu16 655350.0 Time_ms 0.00 655350.0 FORMAT "%8.1" /end CHARACTERISTIC
/begin CHARACTERISTIC EATSCD_DebCanNotImplDef_C "Fehlerentprellung  Umgebungstemperatursensor nicht verbaut über CAN" VALUE 0x1CD9BA Kw_Wu16 655350.0 Time_ms 0.00 655350.0 FORMAT "%8.1" /end CHARACTERISTIC
/begin CHARACTERISTIC EATSCD_DebCanNotImplOk_C "Heilungsentprellung  Umgebungstemperatursensor nicht verbaut über CAN" VALUE 0x1CD9BC Kw_Wu16 655350.0 Time_ms 0.00 655350.0 FORMAT "%8.1" /end CHARACTERISTIC
/begin CHARACTERISTIC EATSCD_DebSRCHighDef_C "EATS Fehlerentprellungszeit fuer SRC-High" VALUE 0x1CD9BE Kw_Wu16 655350.0 Time_ms 0.00 655350.0 FORMAT "%8.1" /end CHARACTERISTIC
/begin CHARACTERISTIC EATSCD_DebSRCHighOk_C "EATS Heilungsentprellzeit fuer SRC-High" VALUE 0x1CD9C0 Kw_Wu16 655350.0 Time_ms 0.00 655350.0 FORMAT "%8.1" /end CHARACTERISTIC
/begin CHARACTERISTIC EATSCD_DebSRCLowDef_C "EATS Fehlerentprellungszeit fuer SRC-Low" VALUE 0x1CD9C2 Kw_Wu16 655350.0 Time_ms 0.00 655350.0 FORMAT "%8.1" /end CHARACTERISTIC
/begin CHARACTERISTIC EATSCD_DebSRCLowOk_C "EATS Heilungsentprellzeit fuer SRC-Low" VALUE 0x1CD9C4 Kw_Wu16 655350.0 Time_ms 0.00 655350.0 FORMAT "%8.1" /end CHARACTERISTIC
/begin CHARACTERISTIC EATSCD_dtRmpSlpUp_C "popsitive Rampensteigung" VALUE 0x1CD9C8 Kw_Wu32 6553599.99847 RmpTemp 0.00 6553599.99847 FORMAT "%13.5" /end CHARACTERISTIC
/begin CHARACTERISTIC EATSCD_dtRmpSlpDwn_C "negative Rampensteigung" VALUE 0x1CD9CC Kw_Wu32 6553599.99847 RmpTemp 0.00 6553599.99847 FORMAT "%13.5" /end CHARACTERISTIC
/begin CHARACTERISTIC EATSCD_swtSigVal_C "Datensatzwert Signalquelle Umgebungsluftemperatur (ADC oder CAN)" VALUE 0x1CD9D0 Kw_Wu8 2.000 OneToOne 0.00 2.000 FORMAT "%5.3" EXTENDED_LIMITS 0.00 255.0 /end CHARACTERISTIC
/begin CHARACTERISTIC EATSCD_swtSigType_C "Auswahlschalter Belegung EATSCD_swtSig mit EATSCD_swtSigVal_C oder E2PROM" VALUE 0x1CD9D1 Kw_Wu8 1.000 OneToOne 1.000 2.000 FORMAT "%5.3" EXTENDED_LIMITS 0.00 255.0 /end CHARACTERISTIC
/begin CHARACTERISTIC EATSCD_stSensIDWord_C "Geberkennwort Umgebungstemperatur" VALUE 0x1CD9D2 Kw_Wu16 65535.00 OneToOne 0.00 65535.00 FORMAT "%8.2" /end CHARACTERISTIC
/begin CHARACTERISTIC EATSCD_tDfl_C "Vorgabewert Umgebungstemperatur" VALUE 0x1CD9D4 Kw_Ws16 250.0000 Temp_Cels -50.04000 199.9600 FORMAT "%8.4" EXTENDED_LIMITS -3549.940 3003.560 /end CHARACTERISTIC
/begin CHARACTERISTIC EcoCD_tiDebNeg_C "Entprellzeit für Signalwechsel von HIGH auf LOW" VALUE 0x1CD9D8 Kw_Wu16 2000.000 TimeDeb 0.00 2000.000 FORMAT "%8.3" EXTENDED_LIMITS 0.00 655350.0 /end CHARACTERISTIC
/begin CHARACTERISTIC EcoCD_tiDebPos_C "Entprellzeit für Signalwechsel von LOW auf HIGH" VALUE 0x1CD9DA Kw_Wu16 2000.000 TimeDeb 0.00 2000.000 FORMAT "%8.3" EXTENDED_LIMITS 0.00 655350.0 /end CHARACTERISTIC
/begin CHARACTERISTIC EcoCD_swtInv_C "Schalter für die Invertierung des Eingangssignals" VALUE 0x1CD9DC Kw_Wu8 1.000 OneToOne 0.00 1.000 FORMAT "%5.3" EXTENDED_LIMITS 0.00 255.0 /end CHARACTERISTIC
/begin CHARACTERISTIC EcoCD_swtSig_C "Schalter für Eingang über HW oder CAN (1= CAN, 0= HW)" VALUE 0x1CD9DD Kw_Wu8 1.000 OneToOne 0.00 1.000 FORMAT "%5.3" EXTENDED_LIMITS 0.00 255.0 /end CHARACTERISTIC
/begin CHARACTERISTIC EcuInit_tiTimestampTO_C "Timeout für Timestamp, welche in Flash geschrieben werden" VALUE 0x1CD9E0 Kw_Wu16 655.1400 Time_s 0.00 655.1400 FORMAT "%8.4" EXTENDED_LIMITS 0.00 655.3500 /end CHARACTERISTIC
/begin CHARACTERISTIC ECU_vPrgThres_C "obere Geschwindigkeitsgrenze für die FLASH Programmierung" VALUE 0x1CD9DE Kw_Ws16 327.6700 Vel 0.00 327.6700 FORMAT "%8.4" EXTENDED_LIMITS -327.6800 327.6700 /end CHARACTERISTIC
/begin CHARACTERISTIC EEPCD_DsSWT1_AAG_C "Kennwerte pflegen, eine Variante zu befreien" VALUE 0x1CD9E2 Kw_Wu16 65535.00 OneToOne 0.00 65535.00 FORMAT "%8.2" /end CHARACTERISTIC
/begin CHARACTERISTIC EEPCD_DsSWT1_KSK_C "Applikationslabelmaske für EEPROM-Schalter" VALUE 0x1CD9E4 Kw_Wu16 65535.00 OneToOne 0.00 65535.00 FORMAT "%8.2" /end CHARACTERISTIC
/begin CHARACTERISTIC EEPCD_DsSWT1_SWTCC_C "Applikationslabelmaske für EEPROM-Schalter PRP_CCON" VALUE 0x1CD9E6 Kw_Wu16 65535.00 OneToOne 0.00 65535.00 FORMAT "%8.2" /end CHARACTERISTIC
/begin CHARACTERISTIC EEPCD_DsSWT2_CCTYPE_C "Applikationslabelmaske für EEPROM-Schalter PRP_CCSel" VALUE 0x1CD9E8 Kw_Wu16 65535.00 OneToOne 0.00 65535.00 FORMAT "%8.2" /end CHARACTERISTIC
/begin CHARACTERISTIC EEPCD_DsSWT2_EATS_C "Applikationslabelmaske für EEPROM-Schalter" VALUE 0x1CD9EA Kw_Wu16 65535.00 OneToOne 0.00 65535.00 FORMAT "%8.2" /end CHARACTERISTIC
/begin CHARACTERISTIC EEPCD_DsSWT2_OTS_C "Applikationslabelmaske für EEPROM-Schalter" VALUE 0x1CD9EC Kw_Wu16 65535.00 OneToOne 0.00 65535.00 FORMAT "%8.2" /end CHARACTERISTIC
/begin CHARACTERISTIC EepDev_dVal_C "der zu schreibende Wert (EEPROM)" VALUE 0x1CD9EE Kw_Wu8 255.0 OneToOne 0.00 255.0 FORMAT "%5.1" /end CHARACTERISTIC
/begin CHARACTERISTIC EepDev_dWrInitPattern_C "Trigger für das Schreiben des Erstinitialisirungsmarkers" VALUE 0x1CD9EF Kw_Wu8 0.00 OneToOne 0.00 0.00 FORMAT "%5.2" EXTENDED_LIMITS 0.00 255.0 /end CHARACTERISTIC
/begin CHARACTERISTIC EepDev_numBlock_C "Nummer des zu lesenden bzw.schreibenden Blockes" VALUE 0x1CD9F0 Kw_Wu8 255.0 OneToOne 0.00 255.0 FORMAT "%5.1" /end CHARACTERISTIC
/begin CHARACTERISTIC EepDev_numOffset_C "Byteoffset des zu schreibenden Wertes" VALUE 0x1CD9F1 Kw_Wu8 255.0 OneToOne 0.00 255.0 FORMAT "%5.1" /end CHARACTERISTIC
/begin CHARACTERISTIC EepDev_stJob_C "Starten des Lese- bzw. Schreibaufgabe" VALUE 0x1CD9F2 Kw_Wu8 255.0 OneToOne 0.00 255.0 FORMAT "%5.1" /end CHARACTERISTIC
/begin CHARACTERISTIC EepInit_AirCtlTrm_C "Trimmwert Sollwertbildung AGR" VALUE 0x1C0C90 Kw_Ws16 3276.700 AirMassPerCyl 0.00 3276.700 FORMAT "%8.3" EXTENDED_LIMITS -3276.800 3276.700 /end CHARACTERISTIC
/begin CHARACTERISTIC EepInit_dCodeTbl_C "Codiertabelle" VAL_BLK 0x1C0C92 Kwb_Wu8 255.0 OneToOne 0.00 255.0 FORMAT "%5.1" NUMBER 4 /end CHARACTERISTIC
/begin CHARACTERISTIC EepInit_dHwPartNum_C "Erstinitalisirungswert für dHwPartNum" ASCII 0x1C0C96 Ktx 255.0 defaultAscii 0.00 255.0 NUMBER 12 /end CHARACTERISTIC
/begin CHARACTERISTIC EepInit_dnCoVehLvl1_C "Offset- Wert der Zielmotorehzahl fuer Leerlauf [ E1 ]" VALUE 0x1C0CA4 Kw_Ws16 6000.000 EngN 0.00 6000.000 FORMAT "%8.3" EXTENDED_LIMITS -32768.00 32767.00 /end CHARACTERISTIC
/begin CHARACTERISTIC EepInit_dnCoVehLvl2_C "Offset- Wert der Zielmotorehzahl fuer Leerlauf [ E2 ]" VALUE 0x1C0CA6 Kw_Ws16 6000.000 EngN 0.00 6000.000 FORMAT "%8.3" EXTENDED_LIMITS -32768.00 32767.00 /end CHARACTERISTIC
/begin CHARACTERISTIC EepInit_dnSetpointTrm_C "Trimmwert Leerlaufdrehzahl" VALUE 0x1C0CA8 Kw_Ws16 32767.00 EngN 0.00 32767.00 FORMAT "%8.2" EXTENDED_LIMITS -32768.00 32767.00 /end CHARACTERISTIC
/begin CHARACTERISTIC EepInit_dPartNr_C "VW/Audi - Teilenummer" ASCII 0x1C0CAA Ktx 255.0 defaultAscii 0.00 255.0 NUMBER 12 /end CHARACTERISTIC
/begin CHARACTERISTIC EepInit_dPrgVer_C "Programmstand" ASCII 0x1C0CB7 Ktx 255.0 defaultAscii 0.00 255.0 NUMBER 4 /end CHARACTERISTIC
/begin CHARACTERISTIC EepInit_dSysName_C "Systembezeichnung" ASCII 0x1C0CBC Ktx 255.0 defaultAscii 0.00 255.0 NUMBER 20 /end CHARACTERISTIC
/begin CHARACTERISTIC EepInit_factAltDemTrm_C "Trimmwert des Generatormomentes" VALUE 0x1C0CD2 Kw_Ws16 3.999878 Fact 0.00 3.999878 FORMAT "%8.6" EXTENDED_LIMITS -4.000000 3.999878 /end CHARACTERISTIC
/begin CHARACTERISTIC EepInit_factSvrPmpDemTrm_C "Trimmwert der Lenkungsservopumpe" VALUE 0x1C0CD4 Kw_Ws16 3.999878 Fact 0.00 3.999878 FORMAT "%8.6" EXTENDED_LIMITS -4.000000 3.999878 /end CHARACTERISTIC
/begin CHARACTERISTIC EepInit_factTrqACTrm_C "Trimmwert für Klimakompressormomentenabgleich" VALUE 0x1C0CD6 Kw_Ws16 0.00 Fact 1.000000 1.000000 FORMAT "%8.6" EXTENDED_LIMITS -4.000000 3.999878 /end CHARACTERISTIC
/begin CHARACTERISTIC EepInit_factTrqLimTrm_C "Trimmwert des Maximalmomentes" VALUE 0x1C0CD8 Kw_Ws16 3.999878 Fact 0.00 3.999878 FORMAT "%8.6" EXTENDED_LIMITS -4.000000 3.999878 /end CHARACTERISTIC
/begin CHARACTERISTIC EepInit_SWT1_C "Funktionsschalter" VALUE 0x1C0CDA Kw_Wu16 65535.00 OneToOne 0.00 65535.00 FORMAT "%8.2" /end CHARACTERISTIC
/begin CHARACTERISTIC EepInit_SWT2_C "Signalschalter" VALUE 0x1C0CDC Kw_Wu16 65535.00 OneToOne 0.00 65535.00 FORMAT "%8.2" /end CHARACTERISTIC
/begin CHARACTERISTIC EepInit_tGlwCtlTrm_C "EEPROM-Initialisierungswert des Trimmwerts für Kühlmitteltemperaturabgleich" VALUE 0x1C0CDE Kw_Ws16 100.0000 TempDiff_Kelv -50.00000 50.00000 FORMAT "%8.5" EXTENDED_LIMITS -3276.800 3276.700 /end CHARACTERISTIC
/begin CHARACTERISTIC EepInit_trqStartTrm_C "Trimmwert des Startbasismomentes" VALUE 0x1C0CE0 Kw_Ws16 3276.700 Trq 0.00 3276.700 FORMAT "%8.3" EXTENDED_LIMITS -3276.800 3276.700 /end CHARACTERISTIC
/begin CHARACTERISTIC EepInit_vSpdLimMax_C "Trimmwert der Höchstgeschwindigkeitsbegrenzung" VALUE 0x1C0CE2 Kw_Ws16 300.0000 Vel 0.00 300.0000 FORMAT "%8.4" EXTENDED_LIMITS -327.6800 327.6700 /end CHARACTERISTIC
/begin CHARACTERISTIC EGPpCD_uSRCMinTemp_C "SRC-MIN-Wert für Abgastemperatur vor Abgasturbolader" VALUE 0x1CDAEC Kw_Ws16 5200.391 Volt 0.00 5200.391 FORMAT "%8.3" EXTENDED_LIMITS -160156.4 160151.5 /end CHARACTERISTIC
/begin CHARACTERISTIC EGPpCD_uSRCMaxTemp_C "SRC-MAX-Wert für Abgastemperatur vor Abgasturbolader" VALUE 0x1CDAEE Kw_Ws16 5200.391 Volt 0.00 5200.391 FORMAT "%8.3" EXTENDED_LIMITS -160156.4 160151.5 /end CHARACTERISTIC
/begin CHARACTERISTIC EGPpCD_tLinTemp1_CUR "Linearisierungskennlinie der Abgastemperatur vor Abgasturbolader 1" CURVE 0x1CDAF0 Kl_Xs16_Ws16 1050.000 Temp_Cels -50.14000 999.8600 FORMAT "%8.4" EXTENDED_LIMITS -3549.940 3003.560
 /begin AXIS_DESCR STD_AXIS EGPpCD_uRawTempPreTrbn Volt 40 0.00 5200.391 FORMAT "%8.3" EXTENDED_LIMITS -160156.4 160151.5 DEPOSIT ABSOLUTE /end AXIS_DESCR
/end CHARACTERISTIC
/begin CHARACTERISTIC EGPpCD_DebSRCHighDefTemp_C "Fehlerentprellung SRC-High-Fehler der Abgastemperatur vor Turbine" VALUE 0x1CDB92 Kw_Wu16 655350.0 Time_ms 0.00 655350.0 FORMAT "%8.1" /end CHARACTERISTIC
/begin CHARACTERISTIC EGPpCD_DebSRCHighOkTemp_C "Heilungsentprellung SRC-High-Fehler der Abgastemperatur vor Turbine" VALUE 0x1CDB94 Kw_Wu16 655350.0 Time_ms 0.00 655350.0 FORMAT "%8.1" /end CHARACTERISTIC
/begin CHARACTERISTIC EGPpCD_DebSRCLowDefTemp_C "Fehlerentprellung SRC-Low-Fehler für die Abgastemperatur vor Turbine" VALUE 0x1CDB96 Kw_Wu16 655350.0 Time_ms 0.00 655350.0 FORMAT "%8.1" /end CHARACTERISTIC
/begin CHARACTERISTIC EGPpCD_DebSRCLowOkTemp_C "Heilungsentprellzeit für SRC-Low-Fehler für die Abgastemperatur vor Turbine" VALUE 0x1CDB98 Kw_Wu16 655350.0 Time_ms 0.00 655350.0 FORMAT "%8.1" /end CHARACTERISTIC
/begin CHARACTERISTIC EGPpCD_dtRmpSlpUpTemp_C "Aufwärts-Schrittweite für Abgastemperatur vor Abgasturbolader" VALUE 0x1CDB9C Kw_Wu32 6553599.99847 RmpTemp 0.00 6553599.99847 FORMAT "%13.5" /end CHARACTERISTIC
/begin CHARACTERISTIC EGPpCD_dtRmpSlpDwnTemp_C "Abwärts-Schrittweite für Abgastemperatur vor Abgasturbolader" VALUE 0x1CDBA0 Kw_Wu32 6553599.99847 RmpTemp 0.00 6553599.99847 FORMAT "%13.5" /end CHARACTERISTIC
/begin CHARACTERISTIC EGPpCD_swtActvTPreTrbn_C "Aktivierung/Deaktivierung  des Komponententreibers für Abgastemperatur vor Abgasturbolader" VALUE 0x1CDBA4 Kw_Wu8 1.000 OneToOne 0.00 1.000 FORMAT "%5.3" EXTENDED_LIMITS 0.00 255.0 /end CHARACTERISTIC
/begin CHARACTERISTIC EGPpCD_stSensIDWordTemp_C "Kennzahl zur Festlegung des Fehlerverhaltens der Abgastemperatur vor Abgasturbolader" VALUE 0x1CDBA6 Kw_Wu16 65535.00 OneToOne 0.00 65535.00 FORMAT "%8.2" /end CHARACTERISTIC
/begin CHARACTERISTIC EGPpCD_tDflTemp_C "Vorgabewert für Abgastemperatur vor Abgasturbolader" VALUE 0x1CDBA8 Kw_Ws16 1050.000 Temp_Cels -50.14000 999.8600 FORMAT "%8.4" EXTENDED_LIMITS -3549.940 3003.560 /end CHARACTERISTIC
/begin CHARACTERISTIC EGPp_pPstPFlt_MAP "Druckabfallkennfeld" MAP 0x1CD9F4 Kf_Xs16_Ys16_Ws16 4000.000 Pres_hPa 0.00 4000.000 FORMAT "%8.3" EXTENDED_LIMITS -32768.00 32767.00
 /begin AXIS_DESCR STD_AXIS PFlt_dmEG AirMassPerTime 10 0.00 1000.000 FORMAT "%8.3" EXTENDED_LIMITS -3276.800 3276.700 DEPOSIT ABSOLUTE /end AXIS_DESCR
 /begin AXIS_DESCR STD_AXIS PFlt_tFlt Temp_Cels 10 -50.14000 999.8600 FORMAT "%8.4" EXTENDED_LIMITS -3549.940 3003.560 DEPOSIT ABSOLUTE /end AXIS_DESCR
/end CHARACTERISTIC
/begin CHARACTERISTIC EGPp_tiPresFltPT1_C "PT1 Filterzeit für die Druckmodellierung im Abgasrohr" VALUE 0x1CDAE8 Kw_Wu32 4294.9673 TimeDelay_s 0.0000010000000 4294.9673 FORMAT "%9.4" /end CHARACTERISTIC
/begin CHARACTERISTIC EGRCD_CBVDebExcTempDef_C "Defekterkennungszeit für Übertemperatur" VALUE 0x1CDCC0 Kw_Wu16 655350.0 Time_ms 0.00 655350.0 FORMAT "%8.1" /end CHARACTERISTIC
/begin CHARACTERISTIC EGRCD_CBVDebExcTempOK_C "Fehlerheilungszeit für Übertemperatur" VALUE 0x1CDCC2 Kw_Wu16 655350.0 Time_ms 0.00 655350.0 FORMAT "%8.1" /end CHARACTERISTIC
/begin CHARACTERISTIC EGRCD_CBVDebNoLoadDef_C "Fehlererkenungszeit für Lastabfall" VALUE 0x1CDCC4 Kw_Wu16 655350.0 Time_ms 0.00 655350.0 FORMAT "%8.1" /end CHARACTERISTIC
/begin CHARACTERISTIC EGRCD_CBVDebNoLoadOK_C "Heilungszeit für Fehler Lastabfall" VALUE 0x1CDCC6 Kw_Wu16 655350.0 Time_ms 0.00 655350.0 FORMAT "%8.1" /end CHARACTERISTIC
/begin CHARACTERISTIC EGRCD_CBVDebShortCircBatDef_C "Defekterkennungszeit für Fehler KS mit Batteriespannung" VALUE 0x1CDCC8 Kw_Wu16 655350.0 Time_ms 0.00 655350.0 FORMAT "%8.1" /end CHARACTERISTIC
/begin CHARACTERISTIC EGRCD_CBVDebShortCircBatOK_C "Heilungszeit für Fehler KS mit Batteriespannung" VALUE 0x1CDCCA Kw_Wu16 655350.0 Time_ms 0.00 655350.0 FORMAT "%8.1" /end CHARACTERISTIC
/begin CHARACTERISTIC EGRCD_CBVDebShortCircGndDef_C "Fehlererkennungszeit für KS mit Masse" VALUE 0x1CDCCC Kw_Wu16 655350.0 Time_ms 0.00 655350.0 FORMAT "%8.1" /end CHARACTERISTIC
/begin CHARACTERISTIC EGRCD_CBVDebShortCircGndOK_C "Heilungszeit für Fehler KS mit Masse" VALUE 0x1CDCCE Kw_Wu16 655350.0 Time_ms 0.00 655350.0 FORMAT "%8.1" /end CHARACTERISTIC
/begin CHARACTERISTIC EGRCD_DebExcTempDef_C "Fehlerentprellzeit für Übertemperatur" VALUE 0x1CDBAC Kw_Wu16 655350.0 Time_ms 0.00 655350.0 FORMAT "%8.1" /end CHARACTERISTIC
/begin CHARACTERISTIC EGRCD_DebExcTempOk_C "Heilungsentprellzeit für Übertemperatur" VALUE 0x1CDBAE Kw_Wu16 655350.0 Time_ms 0.00 655350.0 FORMAT "%8.1" /end CHARACTERISTIC
/begin CHARACTERISTIC EGRCD_DebNoLoadDef_C "Fehlerentprellzeit für Lastabfall" VALUE 0x1CDBB0 Kw_Wu16 655350.0 Time_ms 0.00 655350.0 FORMAT "%8.1" /end CHARACTERISTIC
/begin CHARACTERISTIC EGRCD_DebNoLoadOk_C "Heilungsentprellzeit für Lastabfall" VALUE 0x1CDBB2 Kw_Wu16 655350.0 Time_ms 0.00 655350.0 FORMAT "%8.1" /end CHARACTERISTIC
/begin CHARACTERISTIC EGRCD_DebShortCircBatDef_C "Fehlerentprellzeit für Kurzschluß nach Batteriespannung" VALUE 0x1CDBB4 Kw_Wu16 655350.0 Time_ms 0.00 655350.0 FORMAT "%8.1" /end CHARACTERISTIC
/begin CHARACTERISTIC EGRCD_DebShortCircBatOk_C "Heilungsentprellzeit für Kurzschluß nach Batteriespannung" VALUE 0x1CDBB6 Kw_Wu16 655350.0 Time_ms 0.00 655350.0 FORMAT "%8.1" /end CHARACTERISTIC
/begin CHARACTERISTIC EGRCD_DebShortCircGndDef_C "Fehlerentprellzeit für Kurzschluß nach Masse" VALUE 0x1CDBB8 Kw_Wu16 655350.0 Time_ms 0.00 655350.0 FORMAT "%8.1" /end CHARACTERISTIC
/begin CHARACTERISTIC EGRCD_DebShortCircGndOk_C "Heilungsentprellzeit für Kurzschluß nach Masse" VALUE 0x1CDBBA Kw_Wu16 655350.0 Time_ms 0.00 655350.0 FORMAT "%8.1" /end CHARACTERISTIC
/begin CHARACTERISTIC EGRCD_stInvOut_C "Invertierungsparameter für das Signal der Abgasrückführstellerendstufe" VALUE 0x1CDBBC Kw_Wu8 1.000 OneToOne 0.00 1.000 FORMAT "%5.3" EXTENDED_LIMITS 0.00 255.0 /end CHARACTERISTIC
/begin CHARACTERISTIC EGRCD_tiPer_C "Periodendauer Abgasrückführsteller" VALUE 0x1CDBBE Kw_Ws16 10.60000 Period 1.100000 11.70000 FORMAT "%8.5" EXTENDED_LIMITS -3276.800 3276.700 /end CHARACTERISTIC
/begin CHARACTERISTIC EGRCD_rCnv_MAP "Kennfeld zur konvertierung in Tastverhältnis" MAP 0x1CDBC0 Kf_Xs16_Ys16_Ws16 100.0000 DtyCyc 0.00 100.0000 FORMAT "%8.4" EXTENDED_LIMITS -327.6800 327.6700
 /begin AXIS_DESCR STD_AXIS Eng_nAvrg EngN 10 0.00 8000.000 FORMAT "%8.3" EXTENDED_LIMITS -32768.00 32767.00 DEPOSIT ABSOLUTE /end AXIS_DESCR
 /begin AXIS_DESCR STD_AXIS AirCtl_rEGR Prc 10 -327.6800 327.6700 FORMAT "%8.4" DEPOSIT ABSOLUTE /end AXIS_DESCR
/end CHARACTERISTIC
/begin CHARACTERISTIC EGRCD_rOutMax_C "Maximal auszugebendes Tastverhältnis" VALUE 0x1CDCB4 Kw_Ws16 655.3500 DtyCyc -327.6800 327.6700 FORMAT "%8.4" /end CHARACTERISTIC
/begin CHARACTERISTIC EGRCD_rOutMin_C "Minimal auszugebendes Tastverhältnis" VALUE 0x1CDCB6 Kw_Ws16 655.3500 DtyCyc -327.6800 327.6700 FORMAT "%8.4" /end CHARACTERISTIC
/begin CHARACTERISTIC EGRCD_rOut_Vector "Konfigurationslabel für Bypass Freischnitt" VALUE 0x1C0A64 Kw_Wu8 255.0 OneToOne 0.00 255.0 FORMAT "%5.1" /end CHARACTERISTIC
/begin CHARACTERISTIC EGRCD_rOut_Channel "Konfigurationslabel für Bypass Freischnitt" VALUE 0x1C0A65 Kw_Wu8 255.0 OneToOne 0.00 255.0 FORMAT "%5.1" /end CHARACTERISTIC
/begin CHARACTERISTIC EGRCD_rTst_C "Tastverhältnis, dass im Fehlerfall zyklisch ausgegeben wird" VALUE 0x1CDCB8 Kw_Ws16 100.0000 DtyCyc 0.00 100.0000 FORMAT "%8.4" EXTENDED_LIMITS -327.6800 327.6700 /end CHARACTERISTIC
/begin CHARACTERISTIC EGRCD_stCBVInvOut_C "Invertierung des Ausgangs" VALUE 0x1CDCD0 Kw_Wu8 1.000 OneToOne 0.00 1.000 FORMAT "%5.3" EXTENDED_LIMITS 0.00 255.0 /end CHARACTERISTIC
/begin CHARACTERISTIC EGRCD_stCBVPwrStgActv_C "Statuswort für die Deaktivierung der Endstufe" VALUE 0x1CDCD1 Kw_Wu8 255.0 OneToOne 0.00 255.0 FORMAT "%5.1" /end CHARACTERISTIC
/begin CHARACTERISTIC EGRCD_stCBVPwrStgDia_C "Statuswort für die Deaktivierung der Endstufendiagnose" VALUE 0x1CDCD2 Kw_Wu8 255.0 OneToOne 0.00 255.0 FORMAT "%5.1" /end CHARACTERISTIC
/begin CHARACTERISTIC EGRCD_stPwrStgActv_C "Aktivierung der Abschaltbedingungen der Endstufe" VALUE 0x1CDCBA Kw_Wu8 255.0 OneToOne 0.00 255.0 FORMAT "%5.1" /end CHARACTERISTIC
/begin CHARACTERISTIC EGRCD_stPwrStgDia_C "Aktivierung der Abschaltbedingungen der Endstufendiagnose" VALUE 0x1CDCBB Kw_Wu8 255.0 OneToOne 0.00 255.0 FORMAT "%5.1" /end CHARACTERISTIC
/begin CHARACTERISTIC EGRCD_swt_C "Schalter Batteriesspannungskorrektur (0 = AUS, 1 = EIN)" VALUE 0x1CDCBC Kw_Wu8 255.0 OneToOne 0.00 255.0 FORMAT "%5.1" /end CHARACTERISTIC
/begin CHARACTERISTIC EGRCD_tiBtwTst_C "Zeitabstand, in dem im Fehlerfall die Endstufe getestet wird" VALUE 0x1CDCBE Kw_Wu16 29980.00 Time_ms 20.00000 30000.00 FORMAT "%8.2" EXTENDED_LIMITS 0.00 655350.0 /end CHARACTERISTIC
/begin CHARACTERISTIC EGSys_CalValFl_C "Unterer Heizwert Kraftstoff" VALUE 0x1CE664 Kw_Wu16 65535.00 Calory 0.00 65535.00 FORMAT "%8.2" /end CHARACTERISTIC
/begin CHARACTERISTIC EGSys_cndHtEG_CUR "Wärmeleitfähigkeit Abgas (nicht applizierbar)" CURVE 0x1CE1BA Kl_Xs16_Ws16 1.000000 Fact 0.00 1.000000 FORMAT "%8.6" EXTENDED_LIMITS -4.000000 3.999878 READ_ONLY
 /begin AXIS_DESCR STD_AXIS EGSys_tEGInpCrv_mp Temp_Cels 8 -45.04000 1049.960 FORMAT "%8.3" EXTENDED_LIMITS -3549.940 3003.560 DEPOSIT ABSOLUTE /end AXIS_DESCR
/end CHARACTERISTIC
/begin CHARACTERISTIC EGSys_cpChrg_C "Wärmekapazität Turbolader" VALUE 0x1CE7A0 Kw_Ws16 3000.000 HeatCapacity 0.00 3000.000 FORMAT "%8.3" EXTENDED_LIMITS -3276.800 3276.700 /end CHARACTERISTIC
/begin CHARACTERISTIC EGSys_cpEG_MAP "Wärmekapazität Abgas (nicht applizierbar)" MAP 0x1CE1DC Kf_Xs16_Ys16_Ws16 2.000000 SpecificHeat 0.00 2.000000 FORMAT "%8.6" EXTENDED_LIMITS -3.276800 3.276700 READ_ONLY
 /begin AXIS_DESCR STD_AXIS EGSys_tEGInpCrv_mp Temp_Cels 6 -45.04000 3003.560 FORMAT "%8.3" EXTENDED_LIMITS -3549.940 3003.560 DEPOSIT ABSOLUTE /end AXIS_DESCR
 /begin AXIS_DESCR STD_AXIS EGSys_rLmbdAprx lambda 6 -30.00000 30.00000 FORMAT "%8.5" EXTENDED_LIMITS -32.76800 32.76700 DEPOSIT ABSOLUTE /end AXIS_DESCR
/end CHARACTERISTIC
/begin CHARACTERISTIC EGSys_cpNSC_C "Wärmekapazität NSC" VALUE 0x1CE5B4 Kw_Ws16 2999.900 HeatCapacity 0.1000000 3000.000 FORMAT "%8.3" EXTENDED_LIMITS -3276.800 3276.700 /end CHARACTERISTIC
/begin CHARACTERISTIC EGSys_cpOxiCat_C "Wärmekapazität Oxidationskatalysator" VALUE 0x1CE666 Kw_Ws16 2999.900 HeatCapacity 0.1000000 3000.000 FORMAT "%8.3" EXTENDED_LIMITS -3276.800 3276.700 /end CHARACTERISTIC
/begin CHARACTERISTIC EGSys_dmAir_MAP "Kennfeld zur Ermittlung Luftmassenstrom im Auslegungspunkt (zur Temperaturkorrektur)" MAP 0x1CE298 Kf_Xs16_Ys16_Ws16 1000.000 AirMassPerTime 0.00 1000.000 FORMAT "%8.3" EXTENDED_LIMITS -3276.800 3276.700
 /begin AXIS_DESCR STD_AXIS Eng_nAvrg EngN 8 0.00 8000.000 FORMAT "%8.3" EXTENDED_LIMITS -32768.00 32767.00 DEPOSIT ABSOLUTE /end AXIS_DESCR
 /begin AXIS_DESCR STD_AXIS InjCtl_qCurr InjMass 8 0.00 100.0000 FORMAT "%8.4" EXTENDED_LIMITS -327.6800 327.6700 DEPOSIT ABSOLUTE /end AXIS_DESCR
/end CHARACTERISTIC
/begin CHARACTERISTIC EGSys_dmEGMinVal_C "Kleinstwert Abgasmassenstrom für thermische Modellierung" VALUE 0x1CE240 Kw_Ws16 1000.000 AirMassPerTime 0.00 1000.000 FORMAT "%8.3" EXTENDED_LIMITS -3276.800 3276.700 /end CHARACTERISTIC
/begin CHARACTERISTIC EGSys_dmExhGas_MAP "Abgasmassenstrom" MAP 0x1CDEDE Kf_Xs16_Ys16_Ws16 1000.000 AirMassPerTime 0.00 1000.000 FORMAT "%8.3" EXTENDED_LIMITS -3276.800 3276.700
 /begin AXIS_DESCR STD_AXIS AFSCD_dmAirPerTime AirMassPerTime 10 0.00 1000.000 FORMAT "%8.3" EXTENDED_LIMITS -3276.800 3276.700 DEPOSIT ABSOLUTE /end AXIS_DESCR
 /begin AXIS_DESCR STD_AXIS InjCtl_qCurr InjMass 10 0.00 100.0000 FORMAT "%8.4" EXTENDED_LIMITS -327.6800 327.6700 DEPOSIT ABSOLUTE /end AXIS_DESCR
/end CHARACTERISTIC
/begin CHARACTERISTIC EGSys_dmPlsThresLSU_C "Minimaler Massenstrom für gültigen Gasstoß" VAL_BLK 0x1CDCD4 Kwb_Ws16 1000.000 AirMassPerTime 0.00 1000.000 FORMAT "%8.3" EXTENDED_LIMITS -3276.800 3276.700 NUMBER 1 /end CHARACTERISTIC
/begin CHARACTERISTIC EGSys_etaChrg_MAP "Kennfeld Gesamtwirkungsgrad Turbolader" MAP 0x1CE7A2 Kf_Xs16_Ys16_Ws16 0.9998779 Fact 0.0001220703 1.000000 FORMAT "%8.6" EXTENDED_LIMITS -4.000000 3.999878
 /begin AXIS_DESCR STD_AXIS AFSCD_dmAirPerTime AirMassPerTime 8 0.00 1000.000 FORMAT "%8.3" EXTENDED_LIMITS -3276.800 3276.700 DEPOSIT ABSOLUTE /end AXIS_DESCR
 /begin AXIS_DESCR STD_AXIS EGSys_rPresCmpr_mp Fact 8 0.00 8.000000 FORMAT "%8.6" EXTENDED_LIMITS -4.000000 3.999878 DEPOSIT ABSOLUTE /end AXIS_DESCR
/end CHARACTERISTIC
/begin CHARACTERISTIC EGSys_facAirMass_CUR "Kennlinie zur Luftmassenabhängigen Temperaturkorrektur" CURVE 0x1CE33C Kl_Xs16_Ws16 2.000000 Fact 0.00 2.000000 FORMAT "%8.6" EXTENDED_LIMITS -4.000000 3.999878
 /begin AXIS_DESCR STD_AXIS EGSys_rAirPerTime_mp Fact 8 0.00 8.000000 FORMAT "%8.6" EXTENDED_LIMITS -4.000000 3.999878 DEPOSIT ABSOLUTE /end AXIS_DESCR
/end CHARACTERISTIC
/begin CHARACTERISTIC EGSys_facCldStrtLSU_C "Faktor für Schwellwerterhöhung bei wiederholtem Kaltstart" VAL_BLK 0x1CDCD6 Kwb_Ws16 1.000000 Fact 0.00 1.000000 FORMAT "%8.6" EXTENDED_LIMITS -4.000000 3.999878 NUMBER 1 /end CHARACTERISTIC
/begin CHARACTERISTIC EGSys_facCorrCldEng_CUR "Kennlinie zur Abgastemperatur-Korrektur beim kaltem Motor" CURVE 0x1CE35E Kl_Xs16_Ws16 2.000000 Fact 0.00 2.000000 FORMAT "%8.6" EXTENDED_LIMITS -4.000000 3.999878
 /begin AXIS_DESCR STD_AXIS EGSys_tDiffCldEng_mp TempDiff_Kelv 8 -3276.800 3276.700 FORMAT "%8.3" DEPOSIT ABSOLUTE /end AXIS_DESCR
/end CHARACTERISTIC
/begin CHARACTERISTIC EGSys_facIAT_CUR "Kennlinie zur ansauglufttemperaturabhängigen Korrektur der Abgastemperatur" CURVE 0x1CE380 Kl_Xs16_Ws16 2.000000 Fact 0.00 2.000000 FORMAT "%8.6" EXTENDED_LIMITS -4.000000 3.999878
 /begin AXIS_DESCR STD_AXIS EGSys_tDiffIAT_mp TempDiff_Kelv 8 -3276.800 3276.700 FORMAT "%8.3" DEPOSIT ABSOLUTE /end AXIS_DESCR
/end CHARACTERISTIC
/begin CHARACTERISTIC EGSys_facPlsLSU_C "Faktor für Abnahme der Wärmeschwelle bei gültigem Gasstoß" VAL_BLK 0x1CDCD8 Kwb_Ws16 1.000000 Fact 0.00 1.000000 FORMAT "%8.6" EXTENDED_LIMITS -4.000000 3.999878 NUMBER 1 /end CHARACTERISTIC
/begin CHARACTERISTIC EGSys_facPlsThresLSU_C "minimaler Wärmemengenschwellwert zur Aktivierung der Gasstoß-Erkennung" VAL_BLK 0x1CDCDA Kwb_Ws16 1.000000 Fact 0.00 1.000000 FORMAT "%8.6" EXTENDED_LIMITS -4.000000 3.999878 NUMBER 1 /end CHARACTERISTIC
/begin CHARACTERISTIC EGSys_facStrtDlv_CUR "Kennlinie zur Förderbeginnabhängigen Temperaturkorrektur" CURVE 0x1CE3A2 Kl_Xs16_Ws16 2.000000 Fact 0.00 2.000000 FORMAT "%8.6" EXTENDED_LIMITS -4.000000 3.999878
 /begin AXIS_DESCR STD_AXIS EGSys_phiDiffStrt_mp AngleCrS 8 -49.99219 49.99219 FORMAT "%8.5" EXTENDED_LIMITS -768.0000 767.9766 DEPOSIT ABSOLUTE /end AXIS_DESCR
/end CHARACTERISTIC
/begin CHARACTERISTIC EGSys_facTempClg_CUR "Abkühlkennlinie abgasführende Bauteile" CURVE 0x1CE738 Kl_Xs16_Ws16 2.000000 Fact 0.00 2.000000 FORMAT "%8.6" EXTENDED_LIMITS -4.000000 3.999878
 /begin AXIS_DESCR STD_AXIS EGSys_rTimeTrb_mp Fact1 8 0.00 8.000000 FORMAT "%8.6" EXTENDED_LIMITS -256.0000 255.9922 DEPOSIT ABSOLUTE /end AXIS_DESCR
/end CHARACTERISTIC
/begin CHARACTERISTIC EGSys_facTempCmb_CUR "Temperaturabhängiger Faktor zur Korrektur der im Oxidationskatalysator abreagierenden Kraftstoffmasse" CURVE 0x1CE668 Kl_Xs16_Ws16 2.000000 Fact 0.00 2.000000 FORMAT "%8.6" EXTENDED_LIMITS -4.000000 3.999878
 /begin AXIS_DESCR STD_AXIS EGSys_tAvrgOxiCat_mp Temp_Cels 8 -3549.940 3003.560 FORMAT "%8.3" DEPOSIT ABSOLUTE /end AXIS_DESCR
/end CHARACTERISTIC
/begin CHARACTERISTIC EGSys_facTimeClg_CUR "inverse Abkühlkennlinie Motor" CURVE 0x1CE75A Kl_Xs16_Ws16 255.0000 Fact1 0.00 255.0000 FORMAT "%8.4" EXTENDED_LIMITS -256.0000 255.9922
 /begin AXIS_DESCR STD_AXIS EGSys_rTempClnt_mp Fact 8 0.00 3.900024 FORMAT "%8.6" EXTENDED_LIMITS -4.000000 3.999878 DEPOSIT ABSOLUTE /end AXIS_DESCR
/end CHARACTERISTIC
/begin CHARACTERISTIC EGSys_tiPT1NSC_C "Feste thermische Zeitkonstante zur NSC-Modellierung" VALUE 0x1CE5B8 Kw_Wu32 4294.9663 TimeDelay_s 0.0010000001 4294.9673 FORMAT "%9.4" EXTENDED_LIMITS 0.0000010000000 4294.9673 /end CHARACTERISTIC
/begin CHARACTERISTIC EGSys_nTrbnMax_MAP "Mögliche Antriebsdrehzahl der Turbine" MAP 0x1CDFD2 Kf_Xs16_Ys16_Ws16 250000.0 TurboN 0.00 250000.0 FORMAT "%8.1" EXTENDED_LIMITS -327680.0 327670.0
 /begin AXIS_DESCR STD_AXIS EGSys_dmExhGas_mp AirMassPerTime 10 0.00 1000.000 FORMAT "%8.3" EXTENDED_LIMITS -3276.800 3276.700 DEPOSIT ABSOLUTE /end AXIS_DESCR
 /begin AXIS_DESCR STD_AXIS PCR_rBPACD Prc 10 -100.0000 200.0000 FORMAT "%8.4" EXTENDED_LIMITS -327.6800 327.6700 DEPOSIT ABSOLUTE /end AXIS_DESCR
/end CHARACTERISTIC
/begin CHARACTERISTIC EGSys_numECU_C "Anzahl der Steuergeräte" VALUE 0x1CE242 Kw_Wu8 254.0 OneToOne 1.000 255.0 FORMAT "%5.1" EXTENDED_LIMITS 0.00 255.0 /end CHARACTERISTIC
/begin CHARACTERISTIC EGSys_numMaxCldStrt_C "Maximale Anzahl der zu zählenden Kaltstarts" VAL_BLK 0x1CDCDC Kwb_Wu8 10.00 OneToOne 0.00 10.00 FORMAT "%5.2" EXTENDED_LIMITS 0.00 255.0 NUMBER 1 /end CHARACTERISTIC
/begin CHARACTERISTIC EGSys_numRdPosLSU2_C "Leseindex im Temperaturarray für Abgastemperatur(en) am Sensoreinbauort (im Fehlerfall)" VAL_BLK 0x1CE243 Kwb_Wu8 12.00 OneToOne 0.00 12.00 FORMAT "%5.2" EXTENDED_LIMITS 0.00 255.0 NUMBER 1 /end CHARACTERISTIC
/begin CHARACTERISTIC EGSys_numRdPosLSUWall_C "Leseindex der Rohrwandtemperatur im Temperaturarray" VAL_BLK 0x1CE244 Kwb_Wu8 15.00 OneToOne 0.00 15.00 FORMAT "%5.2" EXTENDED_LIMITS 0.00 255.0 NUMBER 1 /end CHARACTERISTIC
/begin CHARACTERISTIC EGSys_numRdPosLSU_C "Leseindex im Temperaturarray für Abgastemperatur(en) am Sensoreinbauort" VAL_BLK 0x1CE245 Kwb_Wu8 12.00 OneToOne 0.00 12.00 FORMAT "%5.2" EXTENDED_LIMITS 0.00 255.0 NUMBER 1 /end CHARACTERISTIC
/begin CHARACTERISTIC EGSys_numRdPosNSC2_C "Leseindex im Temperaturarray für NSC Einlaßtemperatur (im Fehlerfall)" VALUE 0x1CE246 Kw_Wu8 12.00 OneToOne 0.00 12.00 FORMAT "%5.2" EXTENDED_LIMITS 0.00 255.0 /end CHARACTERISTIC
/begin CHARACTERISTIC EGSys_numRdPosNSC_C "Leseindex im Temperaturarray für NSC Einlaßtemperatur" VALUE 0x1CE247 Kw_Wu8 12.00 OneToOne 0.00 12.00 FORMAT "%5.2" EXTENDED_LIMITS 0.00 255.0 /end CHARACTERISTIC
/begin CHARACTERISTIC EGSys_numRdPosOxiCat2_C "Leseindex im Temperaturarray für Oxydations-Katalysator-Einlaßtemperatur (im Fehlerfall)" VALUE 0x1CE248 Kw_Wu8 12.00 OneToOne 0.00 12.00 FORMAT "%5.2" EXTENDED_LIMITS 0.00 255.0 /end CHARACTERISTIC
/begin CHARACTERISTIC EGSys_numRdPosOxiCat_C "Leseindex im Temperaturarray für Oxydations-Katalysator-Einlaßtemperatur" VALUE 0x1CE249 Kw_Wu8 12.00 OneToOne 0.00 12.00 FORMAT "%5.2" EXTENDED_LIMITS 0.00 255.0 /end CHARACTERISTIC
/begin CHARACTERISTIC EGSys_numRdPosTrbn2_C "Leseindex im Temperaturarray für Turbineneinlaßtemperatur (im Fehlerfall)" VALUE 0x1CE24A Kw_Wu8 12.00 OneToOne 0.00 12.00 FORMAT "%5.2" EXTENDED_LIMITS 0.00 255.0 /end CHARACTERISTIC
/begin CHARACTERISTIC EGSys_numRdPosTrbn_C "Leseindex im Temperaturarray für Turbineneinlaßtemperatur" VALUE 0x1CE24B Kw_Wu8 12.00 OneToOne 0.00 12.00 FORMAT "%5.2" EXTENDED_LIMITS 0.00 255.0 /end CHARACTERISTIC
/begin CHARACTERISTIC EGSys_numRdPosTube2_C "Leseindex im Temperaturarray für Rohr-Einlaßtemperaturen (im Fehlerfall)" VAL_BLK 0x1CE24C Kwb_Wu8 12.00 OneToOne 0.00 12.00 FORMAT "%5.2" EXTENDED_LIMITS 0.00 255.0 NUMBER 2 /end CHARACTERISTIC
/begin CHARACTERISTIC EGSys_numRdPosTube_C "Leseindex im Temperaturarray für Rohr-Einlaßtemperaturen" VAL_BLK 0x1CE24E Kwb_Wu8 12.00 OneToOne 0.00 12.00 FORMAT "%5.2" EXTENDED_LIMITS 0.00 255.0 NUMBER 2 /end CHARACTERISTIC
/begin CHARACTERISTIC EGSys_tiPT1OxiCat_C "Feste thermische Zeitkonstante zur Oxidationskatalysator-Modellierung" VALUE 0x1CE68C Kw_Wu32 4294.9663 TimeDelay_s 0.0010000001 4294.9673 FORMAT "%9.4" EXTENDED_LIMITS 0.0000010000000 4294.9673 /end CHARACTERISTIC
/begin CHARACTERISTIC EGSys_pExhGas_MAP "Kennfeld für Abgasgegendruck" MAP 0x1CDDE8 Kf_Xs16_Ys16_Ws16 3500.000 Pres_hPa 0.00 3500.000 FORMAT "%8.3" EXTENDED_LIMITS -32768.00 32767.00
 /begin AXIS_DESCR STD_AXIS AFSCD_dmAirPerTime AirMassPerTime 10 0.00 1000.000 FORMAT "%8.3" EXTENDED_LIMITS -3276.800 3276.700 DEPOSIT ABSOLUTE /end AXIS_DESCR
 /begin AXIS_DESCR STD_AXIS InjCtl_qSetUnBal InjMass 10 0.00 327.6700 FORMAT "%8.4" EXTENDED_LIMITS -327.6800 327.6700 DEPOSIT ABSOLUTE /end AXIS_DESCR
/end CHARACTERISTIC
/begin CHARACTERISTIC EGSys_phiStrtDlv_MAP "Kennfeld zur Ermittlung Förderbeginn MI1 im Auslegungspunkt (zur Temperaturkorrektur)" MAP 0x1CE3C4 Kf_Xs16_Ys16_Ws16 99.98437 AngleCrS -49.99219 49.99219 FORMAT "%8.5" EXTENDED_LIMITS -768.0000 767.9766
 /begin AXIS_DESCR STD_AXIS Eng_nAvrg EngN 8 0.00 8000.000 FORMAT "%8.3" EXTENDED_LIMITS -32768.00 32767.00 DEPOSIT ABSOLUTE /end AXIS_DESCR
 /begin AXIS_DESCR STD_AXIS InjCtl_qCurr InjMass 8 0.00 100.0000 FORMAT "%8.4" EXTENDED_LIMITS -327.6800 327.6700 DEPOSIT ABSOLUTE /end AXIS_DESCR
/end CHARACTERISTIC
/begin CHARACTERISTIC EGSys_tiChrgPT1_C "Feste thermische Zeitkonstante Turbolader" VALUE 0x1CE848 Kw_Wu32 4294.9663 TimeDelay_s 0.0010000001 4294.9673 FORMAT "%9.4" EXTENDED_LIMITS 0.0000010000000 4294.9673 /end CHARACTERISTIC
/begin CHARACTERISTIC EGSys_pValDfl_C "Vorgabewert Umgebungsdruck für Turboladermodell" VALUE 0x1CE84C Kw_Ws16 1000.000 Pres_hPa 500.0000 1500.000 FORMAT "%8.3" EXTENDED_LIMITS -32768.00 32767.00 /end CHARACTERISTIC
/begin CHARACTERISTIC EGSys_rPres_MAP "Abgasgegendruckverhältnis vor und nach Turbine" MAP 0x1CE0C6 Kf_Xs16_Ys16_Ws16 3.900024 Fact 0.00 3.900024 FORMAT "%8.6" EXTENDED_LIMITS -4.000000 3.999878
 /begin AXIS_DESCR STD_AXIS PCR_nTrbn TurboN 10 0.00 250000.0 FORMAT "%8.1" EXTENDED_LIMITS -327680.0 327670.0 DEPOSIT ABSOLUTE /end AXIS_DESCR
 /begin AXIS_DESCR STD_AXIS EGSys_nTrbnMax_mp TurboN 10 0.00 250000.0 FORMAT "%8.1" EXTENDED_LIMITS -327680.0 327670.0 DEPOSIT ABSOLUTE /end AXIS_DESCR
/end CHARACTERISTIC
/begin CHARACTERISTIC EGSys_rTempAdbt_CUR "Kennlinie für die adiabatische Zustandänderung der Temperatur (nicht applizierbar)" CURVE 0x1CE84E Kl_Xs16_Ws16 0.4000244 Fact 1.000000 1.400024 FORMAT "%8.6" EXTENDED_LIMITS -4.000000 3.999878 READ_ONLY
 /begin AXIS_DESCR STD_AXIS EGSys_rPresCmpr_mp Fact 8 1.000000 8.000000 FORMAT "%8.6" EXTENDED_LIMITS -4.000000 3.999878 DEPOSIT ABSOLUTE /end AXIS_DESCR
/end CHARACTERISTIC
/begin CHARACTERISTIC EGSys_swtDewDetShOff_C "Umschalter für Ersatzfunktion (Zeitapplikation)" VAL_BLK 0x1CDCDD Kwb_Wu8 10.00 OneToOne 0.00 10.00 FORMAT "%5.2" EXTENDED_LIMITS 0.00 255.0 NUMBER 1 /end CHARACTERISTIC
/begin CHARACTERISTIC EGSys_swtPresSel_C "Auswahl, ob Atmosphaerendruck (=1) oder Druck vor Partikelfilter (=0)" VALUE 0x1CDEDC Kw_Wu8 1.000 OneToOne 0.00 1.000 FORMAT "%5.3" EXTENDED_LIMITS 0.00 255.0 /end CHARACTERISTIC
/begin CHARACTERISTIC EGSys_swtTAirSens_C "Umschalter für Umgebungstemperatursensor" VALUE 0x1CE77C Kw_Wu8 1.000 OneToOne 0.00 1.000 FORMAT "%5.3" EXTENDED_LIMITS 0.00 255.0 /end CHARACTERISTIC
/begin CHARACTERISTIC EGSys_swttAirSens_C "Umschalter für Umgebungstemperatursensor" VALUE 0x1CE294 Kw_Wu8 1.000 OneToOne 0.00 1.000 FORMAT "%5.3" EXTENDED_LIMITS 0.00 255.0 /end CHARACTERISTIC
/begin CHARACTERISTIC EGSys_swtTimeChrg_C "Schalter zur Verwendung fester oder variabler thermischer Zeitkonstante für Turbolader" VALUE 0x1CE870 Kw_Wu8 1.000 OneToOne 0.00 1.000 FORMAT "%5.3" EXTENDED_LIMITS 0.00 255.0 /end CHARACTERISTIC
/begin CHARACTERISTIC EGSys_swtTimeNSC_C "Schalter zur Verwendung fester oder variabler thermischer Zeitkonstante für NSC" VALUE 0x1CE5BC Kw_Wu8 1.000 OneToOne 0.00 1.000 FORMAT "%5.3" EXTENDED_LIMITS 0.00 255.0 /end CHARACTERISTIC
/begin CHARACTERISTIC EGSys_swtTimeOxiCat_C "Schalter zur Verwendung fester oder variabler thermischer Zeitkonstante für Oxidationskatalysator" VALUE 0x1CE690 Kw_Wu8 1.000 OneToOne 0.00 1.000 FORMAT "%5.3" EXTENDED_LIMITS 0.00 255.0 /end CHARACTERISTIC
/begin CHARACTERISTIC EGSys_tEGPstTrbnDfl_C "Ersatzwert Turbinentemperatur im Fehlerfall" VALUE 0x1CE872 Kw_Ws16 1095.000 Temp_Cels -45.04000 1049.960 FORMAT "%8.3" EXTENDED_LIMITS -3549.940 3003.560 /end CHARACTERISTIC
/begin CHARACTERISTIC EGSys_tEngStat_C "Kühlmitteltemperatur (bzw Motortemperatur) betriebswarmer Motor unter normalen Bendingungen" VALUE 0x1CE468 Kw_Ws16 1095.000 Temp_Cels -45.04000 1049.960 FORMAT "%8.3" EXTENDED_LIMITS -3549.940 3003.560 /end CHARACTERISTIC
/begin CHARACTERISTIC EGSys_tExcClntDfl_C "Ersatzwert für Motor-Übertemperatur" VALUE 0x1CE296 Kw_Ws16 1095.000 TempDiff_Kelv -45.00000 1050.000 FORMAT "%8.3" EXTENDED_LIMITS -3276.800 3276.700 /end CHARACTERISTIC
/begin CHARACTERISTIC EGSys_tIAT_MAP "Kennfeld Ansauglufttemperatur im Auslegungspunkt zur Korrektur der stationären Krümmeraustrittstemperatur" MAP 0x1CE46A Kf_Xs16_Ys16_Ws16 3048.600 Temp_Cels -45.04000 3003.560 FORMAT "%8.3" EXTENDED_LIMITS -3549.940 3003.560
 /begin AXIS_DESCR STD_AXIS Eng_nAvrg EngN 8 0.00 8000.000 FORMAT "%8.3" EXTENDED_LIMITS -32768.00 32767.00 DEPOSIT ABSOLUTE /end AXIS_DESCR
 /begin AXIS_DESCR STD_AXIS InjCtl_qCurr InjMass 8 0.00 100.0000 FORMAT "%8.4" EXTENDED_LIMITS -327.6800 327.6700 DEPOSIT ABSOLUTE /end AXIS_DESCR
/end CHARACTERISTIC
/begin CHARACTERISTIC EGSys_tiDebLSU0_C "Entprellzeit Heizungsfreigabe Lambdasonde 0" VAL_BLK 0x1CDCDE Kwb_Wu16 20.00000 Time_s 0.00 20.00000 FORMAT "%8.5" EXTENDED_LIMITS 0.00 655.3500 NUMBER 1 /end CHARACTERISTIC
/begin CHARACTERISTIC EGSys_tiDebNrmTransOk_C "Entprellzeit zur Verzögerung der Berechnungen nach Start bis gültige Temperaturen anliegen" VALUE 0x1CDCE0 Kw_Ws16 1000.000 TimeDeb 0.00 1000.000 FORMAT "%8.3" EXTENDED_LIMITS -327680.0 327670.0 /end CHARACTERISTIC
/begin CHARACTERISTIC EGSys_tiHaValClnt_C "Abkühl-Halbwertszeit Motor" VALUE 0x1CE780 Kw_Wu32 42949672.9500 Time_s 0.00 42949672.9500 FORMAT "%13.4" /end CHARACTERISTIC
/begin CHARACTERISTIC EGSys_tiHaValNSC_C "Abkühl-Halbwertszeit NSC" VALUE 0x1CE784 Kw_Wu32 42949672.9500 Time_s 0.00 42949672.9500 FORMAT "%13.4" /end CHARACTERISTIC
/begin CHARACTERISTIC EGSys_tiHaValOxiCat_C "Abkühl-Halbwertszeit Oxidationskatalysator" VALUE 0x1CE788 Kw_Wu32 42949672.9500 Time_s 0.00 42949672.9500 FORMAT "%13.4" /end CHARACTERISTIC
/begin CHARACTERISTIC EGSys_tiHaValTrb_C "Abkühlen der Halbzeit-Periode turbocharge" VALUE 0x1CE78C Kw_Wu32 42949672.9500 Time_s 0.00 42949672.9500 FORMAT "%13.4" /end CHARACTERISTIC
/begin CHARACTERISTIC EGSys_tiHaValTube_C "Abkühl-Halbwertszeit Abgasrohr" VAL_BLK 0x1CE790 Kwb_Wu32 42949672.9500 Time_s 0.00 42949672.9500 FORMAT "%13.4" NUMBER 2 /end CHARACTERISTIC
/begin CHARACTERISTIC EGSys_tiHtgDelLSU_C "Verzögerung der Heizungsfreigabe im Fehlerfall" VAL_BLK 0x1CDCE4 Kwb_Wu32 42949672.9500 Time_s 0.00 42949672.9500 FORMAT "%13.4" NUMBER 1 /end CHARACTERISTIC
/begin CHARACTERISTIC EGSys_tIntegIni_C "Temperaturschwellwert für die Aktivierung des Wärmemengenintegrators" VAL_BLK 0x1CDCE8 Kwb_Ws16 100.0000 Temp_Cels -0.04000000 99.96000 FORMAT "%8.4" EXTENDED_LIMITS -3549.940 3003.560 NUMBER 1 /end CHARACTERISTIC
/begin CHARACTERISTIC EGSys_tiOfsClg_C "Abkühlzeitkorrektur Motor wg. Stauwärmeeffekten" VALUE 0x1CE798 Kw_Wu32 42949672.9500 Time_s 0.00 42949672.9500 FORMAT "%13.4" /end CHARACTERISTIC
/begin CHARACTERISTIC EGSys_tiPlsLSU_C "Minimale Dauer für gültigen Gaspuls" VAL_BLK 0x1CDCEA Kwb_Wu16 20.00000 Time_s 0.00 20.00000 FORMAT "%8.5" EXTENDED_LIMITS 0.00 655.3500 NUMBER 1 /end CHARACTERISTIC
/begin CHARACTERISTIC EGSys_tManfDfl_C "Vorgabewert Abgaskrümmertemperatur im Fehlerfall" VALUE 0x1CE50E Kw_Ws16 1095.000 Temp_Cels -45.04000 1049.960 FORMAT "%8.3" EXTENDED_LIMITS -3549.940 3003.560 /end CHARACTERISTIC
/begin CHARACTERISTIC EGSys_tManfStat_MAP "Kennfeld zur Ermittlung der stationären Abgaskrümmertemperatur" MAP 0x1CE510 Kf_Xs16_Ys16_Ws16 3048.600 Temp_Cels -45.04000 3003.560 FORMAT "%8.3" EXTENDED_LIMITS -3549.940 3003.560
 /begin AXIS_DESCR STD_AXIS Eng_nAvrg EngN 8 0.00 8000.000 FORMAT "%8.3" EXTENDED_LIMITS -32768.00 32767.00 DEPOSIT ABSOLUTE /end AXIS_DESCR
 /begin AXIS_DESCR STD_AXIS InjCtl_qCurr InjMass 8 0.00 100.0000 FORMAT "%8.4" EXTENDED_LIMITS -327.6800 327.6700 DEPOSIT ABSOLUTE /end AXIS_DESCR
/end CHARACTERISTIC
/begin CHARACTERISTIC EGSys_tNSCDfl_C "Ersatzwert für NSC Temperatur" VALUE 0x1CE5BE Kw_Ws16 1095.000 Temp_Cels -45.04000 1049.960 FORMAT "%8.3" EXTENDED_LIMITS -3549.940 3003.560 /end CHARACTERISTIC
/begin CHARACTERISTIC EGSys_tNSCExoIncr_MAP "Kennfeld für Temperaturerhöhung im NSC aufgrund chemischer Reaktionen" MAP 0x1CE5C0 Kf_Xs16_Ys16_Ws16 1095.000 TempDiff_Kelv -45.00000 1050.000 FORMAT "%8.3" EXTENDED_LIMITS -3276.800 3276.700
 /begin AXIS_DESCR STD_AXIS EGSys_tAvrgNSC_mp Temp_Cels 8 -3549.940 3003.560 FORMAT "%8.3" DEPOSIT ABSOLUTE /end AXIS_DESCR
 /begin AXIS_DESCR STD_AXIS EGSys_rLmbdAprx lambda 8 -30.00000 30.00000 FORMAT "%8.5" EXTENDED_LIMITS -32.76800 32.76700 DEPOSIT ABSOLUTE /end AXIS_DESCR
/end CHARACTERISTIC
/begin CHARACTERISTIC EGSys_tOxiCatDfl_C "Ersatzwert Oxidationskatalysatortemperatur" VALUE 0x1CE692 Kw_Ws16 1095.000 Temp_Cels -45.04000 1049.960 FORMAT "%8.3" EXTENDED_LIMITS -3549.940 3003.560 /end CHARACTERISTIC
/begin CHARACTERISTIC EGSys_tOxiCatExoIncr_MAP "Kennfeld für Tempertaturerhöhung im Oxidationskatalysator aufgrund chemischer Reaktionen" MAP 0x1CE694 Kf_Xs16_Ys16_Ws16 1095.000 TempDiff_Kelv -45.00000 1050.000 FORMAT "%8.3" EXTENDED_LIMITS -3276.800 3276.700
 /begin AXIS_DESCR STD_AXIS EGSys_tAvrgOxiCat_mp Temp_Cels 8 -3549.940 3003.560 FORMAT "%8.3" DEPOSIT ABSOLUTE /end AXIS_DESCR
 /begin AXIS_DESCR STD_AXIS EGSys_rLmbdAprx lambda 8 -30.00000 30.00000 FORMAT "%8.5" EXTENDED_LIMITS -32.76800 32.76700 DEPOSIT ABSOLUTE /end AXIS_DESCR
/end CHARACTERISTIC
/begin CHARACTERISTIC EGSys_tStrtCsRepl_C "Ersatzwert für Initialisierungstemperaturen der abgasführen den Bauteile im Fehlerfall" VALUE 0x1CE79C Kw_Ws16 1095.000 Temp_Cels -45.04000 1049.960 FORMAT "%8.3" EXTENDED_LIMITS -3549.940 3003.560 /end CHARACTERISTIC
/begin CHARACTERISTIC EGSys_tThresLSUAct_C "Temperaturschwellwert für reversible TPE" VAL_BLK 0x1CDCEC Kwb_Ws16 100.0000 Temp_Cels -0.04000000 99.96000 FORMAT "%8.4" EXTENDED_LIMITS -3549.940 3003.560 NUMBER 1 /end CHARACTERISTIC
/begin CHARACTERISTIC EGSys_tWtEquiv_C "äquivalente Wassertemperatur beim Verdampfen" VAL_BLK 0x1CDCEE Kwb_Ws16 1095.000 Temp_Cels -45.04000 1049.960 FORMAT "%8.3" EXTENDED_LIMITS -3549.940 3003.560 NUMBER 1 /end CHARACTERISTIC
/begin CHARACTERISTIC EGSys_vscDynEG_CUR "Dynamische Viskosität Abgas (nicht applizierbar)" CURVE 0x1CE250 Kl_Xs16_Ws16 0.9998779 Fact 0.0001220703 1.000000 FORMAT "%8.6" EXTENDED_LIMITS -4.000000 3.999878 READ_ONLY
 /begin AXIS_DESCR STD_AXIS EGSys_tEGInpCrv_mp Temp_Cels 8 -45.04000 1049.960 FORMAT "%8.3" EXTENDED_LIMITS -3549.940 3003.560 DEPOSIT ABSOLUTE /end AXIS_DESCR
/end CHARACTERISTIC
/begin CHARACTERISTIC EGSys_vscKinEG_CUR "Kinematische Viskosität Abgas (nicht applizierbar)" CURVE 0x1CE272 Kl_Xs16_Ws16 0.9998779 Fact 0.0001220703 1.000000 FORMAT "%8.6" EXTENDED_LIMITS -4.000000 3.999878 READ_ONLY
 /begin AXIS_DESCR STD_AXIS EGSys_tEGInpCrv_mp Temp_Cels 8 -45.04000 1049.960 FORMAT "%8.3" EXTENDED_LIMITS -3549.940 3003.560 DEPOSIT ABSOLUTE /end AXIS_DESCR
/end CHARACTERISTIC
/begin CHARACTERISTIC EGSys_wLSUIKi_C "Verstärkung des Integrators" VAL_BLK 0x1CDCF0 Kwb_Ws16 5.000000 OneToOne 0.00 5.000000 FORMAT "%8.6" EXTENDED_LIMITS -32768.00 32767.00 NUMBER 1 /end CHARACTERISTIC
/begin CHARACTERISTIC EGSys_wThresLSU0_MAP "Wärmeschwellen Grundkennfeld Lambdasonde 0" MAP 0x1CDCF2 Kf_Xs16_Ys16_Ws16 6000.000 Energy 0.00 6000.000 FORMAT "%8.3" EXTENDED_LIMITS -32768.00 32767.00
 /begin AXIS_DESCR STD_AXIS EGSys_tEGLSUInpCrv0_mp Temp_Cels 10 -45.04000 1049.960 FORMAT "%8.3" EXTENDED_LIMITS -3549.940 3003.560 DEPOSIT ABSOLUTE /end AXIS_DESCR
 /begin AXIS_DESCR STD_AXIS Eng_tEng Temp_Cels 10 -45.04000 1049.960 FORMAT "%8.3" EXTENDED_LIMITS -3549.940 3003.560 DEPOSIT ABSOLUTE /end AXIS_DESCR
/end CHARACTERISTIC
/begin CHARACTERISTIC PFltCD_tPst_C "Temperatur nach Partikelfilter" VALUE 0x1CD942 Kw_Ws16 250.1000 Temp_Cels -50.14000 199.9600 FORMAT "%8.4" EXTENDED_LIMITS -3549.940 3003.560 /end CHARACTERISTIC
/begin CHARACTERISTIC PFlt_stSimOn_C "Beladungssimulation aktiv Dummy" VALUE 0x1CD944 Kw_Wu8 10.00 OneToOne 0.00 10.00 FORMAT "%5.2" EXTENDED_LIMITS 0.00 255.0 /end CHARACTERISTIC
/begin MEASUREMENT AFSCD_dmAirPerTime2 "MLt Luftmassenstrom 2 n. Liniarisierung + Mittelung" SWORD AirMassPerTime 1 100 -3276.800 3276.700 FORMAT "%8.3" ECU_ADDRESS 0x7F9562 /end MEASUREMENT
/begin MEASUREMENT AFSCD_mAirPerCyl1 "angesaugte Luftmasse pro Zylinder 1" SWORD AirMassPerCyl 1 100 -3276.800 3276.700 FORMAT "%8.3" ECU_ADDRESS 0x7F9570 /end MEASUREMENT
/begin MEASUREMENT AFSCD_mAirPerCyl2 "angesaugte Luftmasse pro Zylinder 2" SWORD AirMassPerCyl 1 100 -3276.800 3276.700 FORMAT "%8.3" ECU_ADDRESS 0x7F9572 /end MEASUREMENT
/begin MEASUREMENT BattCD_uFlt "PT1-gefilterte Batteriespannung" SWORD OneToOne 1 100 -32768.00 32767.00 FORMAT "%8.2" ECU_ADDRESS 0x7F964E /end MEASUREMENT
/begin MEASUREMENT DfpErrCol_mp "Meßpunkt der für alle Fehlerpfade die Fehlerinformation gesammelt zur Verfügung stellt." UWORD OneToOne 1 100 0.00 65535.00 FORMAT "%8.2" ARRAY_SIZE 26 ECU_ADDRESS 0x802936 /end MEASUREMENT
/begin MEASUREMENT DFPM_stFCMChkCause "Message für DSM internen gebrauch (unterstützung bei DSM problemen)" UBYTE FCMChkCause 1 100 1.00000000000 15.0000000000 FORMAT "%13.10" ECU_ADDRESS 0x7FD150 /end MEASUREMENT
/begin MEASUREMENT DfpZyfCol_mp "Meßpunkt der gesammelt für alle Fehlerpfade das Zyklus Bit (getested Info) zur Verfügung stellt." UWORD OneToOne 1 100 0.00 65535.00 FORMAT "%8.2" ARRAY_SIZE 26 ECU_ADDRESS 0x80296A /end MEASUREMENT
/begin MEASUREMENT Dfp_HWEMonCom_Low "LowByte von Dfp_HWEMonCom_mp" UBYTE OneToOne 1 100 0.00 255.0 FORMAT "%5.1" ECU_ADDRESS 0x7F938C /end MEASUREMENT
/begin MEASUREMENT Dfp_HWEMonEEPROM_Low "LowByte of Dfp_HWEMonEEPROM_mp" UBYTE OneToOne 1 100 0.00 255.0 FORMAT "%5.1" ECU_ADDRESS 0x7F938D /end MEASUREMENT
/begin MEASUREMENT Dfp_HWEMonUMaxSupply_Low "LowByte von Dfp_HWEMonUMaxSupply_mp" UBYTE OneToOne 1 100 0.00 255.0 FORMAT "%5.1" ECU_ADDRESS 0x7F938E /end MEASUREMENT
/begin MEASUREMENT Dfp_HWEMonUMinSupply_Low "LowByte von HWEMonUMinSupply_mp" UBYTE OneToOne 1 100 0.00 255.0 FORMAT "%5.1" ECU_ADDRESS 0x7F938F /end MEASUREMENT
/begin MEASUREMENT Dfp_LSUCDCircNernst0_Low "LowByte von Dfp_LSUCDCircNernst0_mp" UBYTE OneToOne 1 100 0.00 255.0 FORMAT "%5.1" ECU_ADDRESS 0x7F9390 /end MEASUREMENT
/begin MEASUREMENT Dfp_LSUCDCircPumpCur0_Low "LowByte von Dfp_LSUCDCircPumpCur0_mp" UBYTE OneToOne 1 100 0.00 255.0 FORMAT "%5.1" ECU_ADDRESS 0x7F9391 /end MEASUREMENT
/begin MEASUREMENT Dfp_LSUCDCircVirtGnd0_Low "LowByte von Dfp_LSUCDCircVirtGnd0_mp" UBYTE OneToOne 1 100 0.00 255.0 FORMAT "%5.1" ECU_ADDRESS 0x7F9392 /end MEASUREMENT
/begin MEASUREMENT Dfp_LSUCDHeater0_Low "LowByte von Dfp_LSUCDHeater0_mp" UBYTE OneToOne 1 100 0.00 255.0 FORMAT "%5.1" ECU_ADDRESS 0x7F9393 /end MEASUREMENT
/begin MEASUREMENT Dfp_LSUCDHtCoup0_Low "LowByte von Dfp_LSUCDHtCoup0_mp" UBYTE OneToOne 1 100 0.00 255.0 FORMAT "%5.1" ECU_ADDRESS 0x7F9394 /end MEASUREMENT
/begin MEASUREMENT Dfp_LSUCDO20_Low "LowByte von Dfp_LSUCDO20_mp" UBYTE OneToOne 1 100 0.00 255.0 FORMAT "%5.1" ECU_ADDRESS 0x7F9395 /end MEASUREMENT
/begin MEASUREMENT Dfp_LSUCDO2Clb0_Low "LowByte von Dfp_LSUCDO2Clb0_mp" UBYTE OneToOne 1 100 0.00 255.0 FORMAT "%5.1" ECU_ADDRESS 0x7F9396 /end MEASUREMENT
/begin MEASUREMENT Dfp_LSUCDRiClb0_Low "LowByte von Dfp_LSUCDRiClb0_mp" UBYTE OneToOne 1 100 0.00 255.0 FORMAT "%5.1" ECU_ADDRESS 0x7F9397 /end MEASUREMENT
/begin MEASUREMENT Dfp_LSUCDSPI0_Low "LowByte von Dfp_LSUCDSPI0_mp" UBYTE OneToOne 1 100 0.00 255.0 FORMAT "%5.1" ECU_ADDRESS 0x7F9398 /end MEASUREMENT
/begin MEASUREMENT Dfp_LSUCDWireIP0_Low "LowByte von Dfp_LSUCDWireIP0_mp" UBYTE OneToOne 1 100 0.00 255.0 FORMAT "%5.1" ECU_ADDRESS 0x7F9399 /end MEASUREMENT
/begin MEASUREMENT Dfp_LSUCtlRiExc0_Low "LowByte von Dfp_LSUCtlRiExc0_mp" UBYTE OneToOne 1 100 0.00 255.0 FORMAT "%5.1" ECU_ADDRESS 0x7F939A /end MEASUREMENT
/begin MEASUREMENT Dfp_LSUMon1Sens_Low "LowByte von Dfp_LSUMon1Sens_mp" UBYTE OneToOne 1 100 0.00 255.0 FORMAT "%5.1" ECU_ADDRESS 0x7F939B /end MEASUREMENT
/begin MEASUREMENT Dfp_LSUMon2Sens_Low "LowByte von Dfp_LSUMon2Sens_mp" UBYTE OneToOne 1 100 0.00 255.0 FORMAT "%5.1" ECU_ADDRESS 0x7F939C /end MEASUREMENT
/begin MEASUREMENT Dfp_SOPTst_Low "LowByte von Dfp_SOPTst_mp" UBYTE OneToOne 1 100 0.00 255.0 FORMAT "%5.1" ECU_ADDRESS 0x7F939D /end MEASUREMENT
/begin MEASUREMENT DSCHED_numDefDfpArray_mp "Array von defekten DFPs welche einen ausgewählten FID verriegeln" UWORD DfpName 1 100 0.00 368.000000000 FORMAT "%13.9" ARRAY_SIZE 10 ECU_ADDRESS 0x80299E /end MEASUREMENT
/begin MEASUREMENT DSCHED_numOkDfpArray_mp "Array von nicht defekten DFPs welche einen ausgewählten FID verriegeln" UWORD DfpName 1 100 0.00 368.000000000 FORMAT "%13.9" ARRAY_SIZE 20 ECU_ADDRESS 0x8029B2 /end MEASUREMENT
/begin MEASUREMENT DSM_ctDfctPath "Anzahl der momentan defekten Fehlerpfade" UWORD OneToOne 1 100 0.00 65535.00 FORMAT "%8.2" ECU_ADDRESS 0x7F9790 /end MEASUREMENT
/begin MEASUREMENT DSM_ctFcmEntry "Anzahl der belegten Fehlerspeichereinträge" UBYTE OneToOne 1 100 0.00 255.0 FORMAT "%5.1" ECU_ADDRESS 0x7F9383 /end MEASUREMENT
/begin MEASUREMENT DSM_ctFCMEntrySize_mp "Größe eines Fehlerspeichereintrages in Bytes (Inklusive Füllbyte falls vorhanden)" UBYTE OneToOne 1 100 0.00 255.0 FORMAT "%5.1" ECU_ADDRESS 0x8029DA /end MEASUREMENT
/begin MEASUREMENT DSM_ctOBDPath "Anzahl der momentanen OBD-fehler im Fehlerspeicher" UBYTE OneToOne 1 100 0.00 255.0 FORMAT "%5.1" ECU_ADDRESS 0x7F9384 /end MEASUREMENT
/begin MEASUREMENT DSM_ctOBDValidPath "Anzahl bestätigter OBD relevanter Fehlerspeicher Einträge." UBYTE OneToOne 1 100 0.00 255.0 FORMAT "%5.1" ECU_ADDRESS 0x7F9385 /end MEASUREMENT
/begin MEASUREMENT DSM_ctPath_mp "Anzahl der existierenden Fehlerpfade" UWORD OneToOne 1 100 0.00 65535.00 FORMAT "%8.2" ECU_ADDRESS 0x8029DC /end MEASUREMENT
/begin MEASUREMENT DSM_ctRdyActCyc_mp "Status für jedes Readinessbit aus dem aktuellen driving cycle" UBYTE OneToOne 1 100 0.00 255.0 FORMAT "%5.1" ECU_ADDRESS 0x802918 /end MEASUREMENT
/begin MEASUREMENT DSM_ctRdyCycCat_mp "Anzahl der für Readiness Bit Catalyst erreichten Zyklen." UBYTE OneToOne 1 100 0.00 255.0 FORMAT "%5.1" ECU_ADDRESS 0x802919 /end MEASUREMENT
/begin MEASUREMENT DSM_ctRdyCycCompr_mp "Anzahl der für Readiness Bit Comprehensive Components erreichten Zyklen." UBYTE OneToOne 1 100 0.00 255.0 FORMAT "%5.1" ECU_ADDRESS 0x80291A /end MEASUREMENT
/begin MEASUREMENT DSM_ctRdyCycEGR_mp "Anzahl der für Readiness Bit EGR erreichten Zyklen." UBYTE OneToOne 1 100 0.00 255.0 FORMAT "%5.1" ECU_ADDRESS 0x80291B /end MEASUREMENT
/begin MEASUREMENT DSM_ctRdyCycFuel_mp "Anzahl der für Readiness Bit Fuel System erreichten Zyklen." UBYTE OneToOne 1 100 0.00 255.0 FORMAT "%5.1" ECU_ADDRESS 0x80291C /end MEASUREMENT
/begin MEASUREMENT DSM_ctRdyCycMisf_mp "Anzahl der für Readiness Bit Misfire erreichten Zyklen." UBYTE OneToOne 1 100 0.00 255.0 FORMAT "%5.1" ECU_ADDRESS 0x80291D /end MEASUREMENT
/begin MEASUREMENT DSM_ctRdyCycOxSenHt_mp "Anzahl erreichter Zyklen für Readiness Bit Oxygen Sensor Heater" UBYTE OneToOne 1 100 0.00 255.0 FORMAT "%5.1" ECU_ADDRESS 0x80291E /end MEASUREMENT
/begin MEASUREMENT DSM_ctRdyCycOxSen_mp "Anzahl der erreichten Zyklen für Readiness Bit Oxygen Sensor" UBYTE OneToOne 1 100 0.00 255.0 FORMAT "%5.1" ECU_ADDRESS 0x80291F /end MEASUREMENT
/begin MEASUREMENT DSM_ctRdyLimCat_mp "Notwendige Anzahl Zyklen für Readiness Bit Catalyst." UBYTE OneToOne 1 100 0.00 255.0 FORMAT "%5.1" ECU_ADDRESS 0x802920 /end MEASUREMENT
/begin MEASUREMENT DSM_ctRdyLimCompr_mp "Notwendige Anzahl Zyklen für Readiness Bit Comprehensive Components." UBYTE OneToOne 1 100 0.00 255.0 FORMAT "%5.1" ECU_ADDRESS 0x802921 /end MEASUREMENT
/begin MEASUREMENT DSM_ctRdyLimEGR_mp "Notwendige Anzahl Zyklen für Readiness Bit EGR." UBYTE OneToOne 1 100 0.00 255.0 FORMAT "%5.1" ECU_ADDRESS 0x802922 /end MEASUREMENT
/begin MEASUREMENT DSM_ctRdyLimFuel_mp "Notwendige Anzahl Zyklen für Readiness Bit Fuel System." UBYTE OneToOne 1 100 0.00 255.0 FORMAT "%5.1" ECU_ADDRESS 0x802923 /end MEASUREMENT
/begin MEASUREMENT DSM_ctRdyLimMisf_mp "Notwendige Anzahl Zyklen für Readiness Bit Misfire." UBYTE OneToOne 1 100 0.00 255.0 FORMAT "%5.1" ECU_ADDRESS 0x802924 /end MEASUREMENT
/begin MEASUREMENT DSM_ctRdyLimOxSenHt_mp "Notwendige Anzahl von Zyklen für Readiness Bit Oxygen Sensor Heater" UBYTE OneToOne 1 100 0.00 255.0 FORMAT "%5.1" ECU_ADDRESS 0x802925 /end MEASUREMENT
/begin MEASUREMENT DSM_ctRdyLimOxSen_mp "Notwendige Anzahl Zyklen für Readiness Bit Oxygen Sensor" UBYTE OneToOne 1 100 0.00 255.0 FORMAT "%5.1" ECU_ADDRESS 0x802926 /end MEASUREMENT
/begin MEASUREMENT DSM_ctRdyPathsCat_mp "Anzahl von Fehlerpfaden die zum Readiness Bit Catalyst gehören." UBYTE OneToOne 1 100 0.00 255.0 FORMAT "%5.1" ECU_ADDRESS 0x802927 /end MEASUREMENT
/begin MEASUREMENT DSM_ctRdyPathsCompr_mp "Anzahl von Fehlerpfaden die zum Readiness Bit Comprehensive Components gehören." UBYTE OneToOne 1 100 0.00 255.0 FORMAT "%5.1" ECU_ADDRESS 0x802928 /end MEASUREMENT
/begin MEASUREMENT DSM_ctRdyPathsEGR_mp "Anzahl von Fehlerpfaden die zum Readiness Bit EGR gehören." UBYTE OneToOne 1 100 0.00 255.0 FORMAT "%5.1" ECU_ADDRESS 0x802929 /end MEASUREMENT
/begin MEASUREMENT DSM_ctRdyPathsFuel_mp "Anzahl von Fehlerpfaden die zum Readiness Bit Fuel System gehören." UBYTE OneToOne 1 100 0.00 255.0 FORMAT "%5.1" ECU_ADDRESS 0x80292A /end MEASUREMENT
/begin MEASUREMENT DSM_ctRdyPathsMisf_mp "Anzahl von Fehlerpfaden die zum Readiness Bit Misfire gehören." UBYTE OneToOne 1 100 0.00 255.0 FORMAT "%5.1" ECU_ADDRESS 0x80292B /end MEASUREMENT
/begin MEASUREMENT DSM_ctRdyPathsOxSenHt_mp "Anzahl von Fehlerpfaden, die zum Readiness Bit Oxygen Sensor Heater gehören" UBYTE OneToOne 1 100 0.00 255.0 FORMAT "%5.1" ECU_ADDRESS 0x80292C /end MEASUREMENT
/begin MEASUREMENT DSM_ctRdyPathsOxSen_mp "Anzahl der Fehlerpfade die zum Readiness Bit Oxygen Sensor gehören" UBYTE OneToOne 1 100 0.00 255.0 FORMAT "%5.1" ECU_ADDRESS 0x80292D /end MEASUREMENT
/begin MEASUREMENT DSM_ctRdyTstCat_mp "Anzahl von in diesem Zyklus getesteten Fehlerpfaden die zum Readiness Bit Catalyst gehören." UBYTE OneToOne 1 100 0.00 255.0 FORMAT "%5.1" ECU_ADDRESS 0x80292E /end MEASUREMENT
/begin MEASUREMENT DSM_ctRdyTstCompr_mp "Anzahl von in diesem Zyklus getesteten Fehlerpfaden die zum Readiness Bit Comprehensive Components  gehören." UBYTE OneToOne 1 100 0.00 255.0 FORMAT "%5.1" ECU_ADDRESS 0x80292F /end MEASUREMENT
/begin MEASUREMENT DSM_ctRdyTstEGR_mp "Anzahl von in diesem Zyklus getesteten Fehlerpfaden die zum Readiness Bit EGR gehören." UBYTE OneToOne 1 100 0.00 255.0 FORMAT "%5.1" ECU_ADDRESS 0x802930 /end MEASUREMENT
/begin MEASUREMENT DSM_ctRdyTstFuel_mp "Anzahl von in diesem Zyklus getesteten Fehlerpfaden die zum Readiness Bit Fuel System gehören." UBYTE OneToOne 1 100 0.00 255.0 FORMAT "%5.1" ECU_ADDRESS 0x802931 /end MEASUREMENT
/begin MEASUREMENT DSM_ctRdyTstMisf_mp "Anzahl von in diesem Zyklus getesteten Fehlerpfaden die zum Readiness Bit Misfire  gehören." UBYTE OneToOne 1 100 0.00 255.0 FORMAT "%5.1" ECU_ADDRESS 0x802932 /end MEASUREMENT
/begin MEASUREMENT DSM_ctRdyTstOxSenHt_mp "Anzahl von in diesem Zyklus getesteten Fehlerpfaden die zum Readiness Bit Oxygen Sensor Heater gehören." UBYTE OneToOne 1 100 0.00 255.0 FORMAT "%5.1" ECU_ADDRESS 0x802933 /end MEASUREMENT
/begin MEASUREMENT DSM_ctRdyTstOxSen_mp "Anzahl von in diesem Zyklus getesteten Fehlerpfaden die zum Readiness Bit Oxygen Sensor Heater gehören." UBYTE OneToOne 1 100 0.00 255.0 FORMAT "%5.1" ECU_ADDRESS 0x802934 /end MEASUREMENT
/begin MEASUREMENT DSM_ctTstPath "Anzahl der getesteten Fehlerpfade" UWORD OneToOne 1 100 0.00 65535.00 FORMAT "%8.2" ECU_ADDRESS 0x7F9792 /end MEASUREMENT
/begin MEASUREMENT DSM_ctWUC "Anzahl der Warm Up Cycle seit dem letzten Fehlerspeicherlöschen  (PID $30)" UBYTE OneToOne 1 100 0.00 255.0 FORMAT "%5.1" ECU_ADDRESS 0x7FEA76 /end MEASUREMENT
/begin MEASUREMENT DSM_lDist "Anzahl der gefahrenen Strecke seitdem letzten Fehlerspeicherlöschen (PID $31)" UWORD OneToOne 1 100 0.00 65535.00 FORMAT "%8.2" ECU_ADDRESS 0x7FEA78 /end MEASUREMENT
/begin MEASUREMENT DSM_stCycles "Status der DSM Trigger Zyklen (WUC, DC, ...)" UBYTE OneToOne 1 100 0.00 255.0 FORMAT "%5.1" ECU_ADDRESS 0x7F9386 /end MEASUREMENT
/begin MEASUREMENT DSM_stECUMasterSlave "Statusinformation ob das Steuergerät ein Master- oder ein Slave-Steuergerät ist" UBYTE OneToOne 1 100 0.00 255.0 FORMAT "%5.1" ECU_ADDRESS 0x7F9387 /end MEASUREMENT
/begin MEASUREMENT DSM_stInhDelay "Status Fehlerverriegelungs Verzögerung (1 wenn mindestens 1 Verzögerung aktiv)" UBYTE OneToOne 1 100 0.00 255.0 FORMAT "%5.1" ECU_ADDRESS 0x7F9388 /end MEASUREMENT
/begin MEASUREMENT DSM_stMIL "DSM Mil Anforderungsstatus (1 = kontinuierlich, 2 blinkend)" UBYTE OneToOne 1 100 0.00 255.0 FORMAT "%5.1" ECU_ADDRESS 0x7F9389 /end MEASUREMENT
/begin MEASUREMENT DSM_stPID41 "Readiness Status für Diagnoseschnittstelle gemäß ISO/DIS 15031-6.5, PID41" ULONG OneToOne 1 100 0.00 4294967295.00 FORMAT "%13.2" ECU_ADDRESS 0x7F9C80 /end MEASUREMENT
/begin MEASUREMENT DSM_stRdyAB "Readiness Status für Diagnoseschnittstelle gemäß SAE J1979 PID1 Byte A + B" UWORD OneToOne 1 100 0.00 65535.00 FORMAT "%8.2" ECU_ADDRESS 0x7F9794 /end MEASUREMENT
/begin MEASUREMENT DSM_stRdyCD "Readiness Status für Diagnoseschnittstelle gemäß SAE J1979 PID1 Byte C * D" UWORD OneToOne 1 100 0.00 65535.00 FORMAT "%8.2" ECU_ADDRESS 0x7F9796 /end MEASUREMENT
/begin MEASUREMENT DSM_stRdyCheckEnable "veroderte ready-bits der dfps, die durch die Funktion DSM_SetDfpSleep ermittelt wurden" UBYTE OneToOne 1 100 0.00 255.0 FORMAT "%5.1" ECU_ADDRESS 0x7F938A /end MEASUREMENT
/begin MEASUREMENT DSM_stSysLamp "DSM System Lampen Anforderungsstatus (1 = kontinuierlich)" UBYTE OneToOne 1 100 0.00 255.0 FORMAT "%5.1" ECU_ADDRESS 0x7F938B /end MEASUREMENT
/begin MEASUREMENT DSM_tiDCDelay_mp "aktuelle Zeit für Driving cycle Verzögerungszeit" UWORD OneToOne 1 100 0.00 65535.00 FORMAT "%8.2" ECU_ADDRESS 0x8029DE /end MEASUREMENT
/begin MEASUREMENT EATSCD_swtSig "Signalquelle Umgebungstemperatur (ADC oder CAN)" UBYTE OneToOne 1 100 0.00 255.0 FORMAT "%5.1" ECU_ADDRESS 0x7F939F /end MEASUREMENT
/begin MEASUREMENT EATSCD_tAir "Umgebungstemperatur" SWORD Temp_Cels 1 100 -3549.940 3003.560 FORMAT "%8.3" ECU_ADDRESS 0x7F979C /end MEASUREMENT
/begin MEASUREMENT EATSCD_tAirLin "linearisierter Wert der Umgebungstemperatur" SWORD Temp_Cels 1 100 -3549.940 3003.560 FORMAT "%8.3" ECU_ADDRESS 0x7F979E /end MEASUREMENT
/begin MEASUREMENT EATSCD_uRaw "Spannungsrohwert der Umgebungstemperatur" SWORD Volt 1 100 0.00 5000.000 FORMAT "%8.3" ECU_ADDRESS 0x7F97A0 /end MEASUREMENT
/begin MEASUREMENT EcoCD_stDebVal "Entprelltes Eingangssignal" UBYTE OneToOne 1 100 0.00 255.0 FORMAT "%5.1" ECU_ADDRESS 0x7F93AC /end MEASUREMENT
/begin MEASUREMENT EcoCD_stRawVal "Rohwert des Eingangssignal" UBYTE OneToOne 1 100 0.00 255.0 FORMAT "%5.1" ECU_ADDRESS 0x7F93AD /end MEASUREMENT
/begin MEASUREMENT EcuInit_stProduction "Programmierstatus des SG" UBYTE OneToOne 1 100 0.00 255.0 FORMAT "%5.1" ECU_ADDRESS 0x7F93AE /end MEASUREMENT
/begin MEASUREMENT EEPCD_stErrSet "Allgemeiner Fehlerzustand bei der Aktivierung einer Konfiguration" UBYTE OneToOne 1 100 0.00 255.0 FORMAT "%5.1" ECU_ADDRESS 0x7F93A0 /end MEASUREMENT
/begin MEASUREMENT EEPCD_stOptErrCodKwp "Fehlercode der Option, in der beim Download (KWP) ein Fehler auftrat" UBYTE OneToOne 1 100 0.00 255.0 FORMAT "%5.1" ECU_ADDRESS 0x7F93A1 /end MEASUREMENT
/begin MEASUREMENT EEPCD_stOptErrCodSet "Fehlercode der Option, in der während der Aktivierung der neuen Konfiguration ein Fehler auftrat" UBYTE OneToOne 1 100 0.00 255.0 FORMAT "%5.1" ECU_ADDRESS 0x7F93A2 /end MEASUREMENT
/begin MEASUREMENT EEPCD_stOptNumKwp "Nummer der Option, in der beim Download (KWP) ein Fehler auftrat" UBYTE OneToOne 1 100 0.00 255.0 FORMAT "%5.1" ECU_ADDRESS 0x7F93A3 /end MEASUREMENT
/begin MEASUREMENT EEPCD_stOptNumSet "Nummer der Option, in der während der Aktivierung der neuen Konfiguration ein Fehler auftrat" UBYTE OneToOne 1 100 0.00 255.0 FORMAT "%5.1" ECU_ADDRESS 0x7F93A4 /end MEASUREMENT
/begin MEASUREMENT EepDev_dBlockVal_mp "Mepßunkt der Anzeige eines gelesenen bzw. geschriebenen Blockinhaltes (max. 100 Byte)" ULONG OneToOne 1 100 0.00 4294967295.00 FORMAT "%13.2" ARRAY_SIZE 25 ECU_ADDRESS 0x7FF450 /end MEASUREMENT
/begin MEASUREMENT EepDev_stLastJob_mp "Status des letzten Lese- bzw. Schreibauftrages" UWORD OneToOne 1 100 0.00 65535.00 FORMAT "%8.2" ECU_ADDRESS 0x7FF530 /end MEASUREMENT
/begin MEASUREMENT EGPpCD_tLinPreTrbn "Linearisierter Wert der Abgastemperatur vor Abgasturbolader" SWORD Temp_Cels 1 100 -3549.940 3003.560 FORMAT "%8.3" ECU_ADDRESS 0x7F97A2 /end MEASUREMENT
/begin MEASUREMENT EGPpCD_tPreTrbn "Abgastemperatur vor Abgasturbolader" SWORD Temp_Cels 1 100 -3549.940 3003.560 FORMAT "%8.3" ECU_ADDRESS 0x7F97A4 /end MEASUREMENT
/begin MEASUREMENT EGPpCD_tPreTrbn1 "Abgastemperatur vor Abgasturbolader 1" SWORD Temp_Cels 1 100 -3549.940 3003.560 FORMAT "%8.3" ECU_ADDRESS 0x7F97A6 /end MEASUREMENT
/begin MEASUREMENT EGPpCD_tPreTrbn2 "Abgastemperatur vor Turbolader 2" SWORD Temp_Cels 1 100 -3549.940 3003.560 FORMAT "%8.3" ECU_ADDRESS 0x7F97A8 /end MEASUREMENT
/begin MEASUREMENT EGPpCD_uRawTempPreTrbn "Spannungsrohwert der Abgastemperatur vor Abgasturbolader" SWORD Volt 1 100 0.00 5000.000 FORMAT "%8.3" ECU_ADDRESS 0x7F97AA /end MEASUREMENT
/begin MEASUREMENT EGPp_pPstPFlt "Druckabfall des Abgassystems nach Partikelfilter" SWORD Pres_hPa 1 100 -32768.00 32767.00 FORMAT "%8.2" ECU_ADDRESS 0x7F97AC /end MEASUREMENT
/begin MEASUREMENT EGRCD_rCnv_mp "Tastverhältnis  basierend auf dem Ausgang des Abgasrückführreglers" SWORD DtyCyc 1 100 -327.6800 327.6700 FORMAT "%8.4" ECU_ADDRESS 0x802A16 /end MEASUREMENT
/begin MEASUREMENT EGRCD_rOut "Tastverhältnis zür Endstufenansteuerung" SWORD DtyCyc 1 100 -327.6800 327.6700 FORMAT "%8.4" ECU_ADDRESS 0x7F97AE /end MEASUREMENT
/begin MEASUREMENT EGRCD_rOutByp_mp "Meßpunkt für Bypass Freischnitt" SWORD DtyCyc 1 100 -327.6800 327.6700 FORMAT "%8.4" ECU_ADDRESS 0x802A18 /end MEASUREMENT
/begin MEASUREMENT EGRCD_stCBVOutHWE_mp "Ausgabewert nach Fehlerbehandlung" SWORD OneToOne 1 100 -32768.00 32767.00 FORMAT "%8.2" ECU_ADDRESS 0x802A1A /end MEASUREMENT
/begin MEASUREMENT EGRCD_stType "Zeigt die in der Software implementierte Variante der Funktion EGRCD an" UBYTE OneToOne 1 100 0.00 255.0 FORMAT "%5.1" ECU_ADDRESS 0x7F93A5 /end MEASUREMENT
/begin MEASUREMENT EGRSCD_rRelPos "relative Offset-korrigierte Position des Abgasrückführventils" SWORD DtyCyc 1 100 -327.6800 327.6700 FORMAT "%8.4" ECU_ADDRESS 0x7F97B0 /end MEASUREMENT
/begin MEASUREMENT EGRSCD_stAdapt "Status des Nullpunktslernens im Nachlauf" UBYTE OneToOne 1 100 0.00 255.0 FORMAT "%5.1" ECU_ADDRESS 0x7F93A6 /end MEASUREMENT
/begin MEASUREMENT EGSys_cpEGLSU_mp "Spezifische Wärmekapazität des Abgases" SWORD SpecificHeat 1 100 -3.276800 3.276700 FORMAT "%8.6" ARRAY_SIZE 1 ECU_ADDRESS 0x802A1C /end MEASUREMENT
/begin MEASUREMENT EGSys_cpEGNSC_mp "Spezifische Wärmekapazität Abgas im NSC" SWORD SpecificHeat 1 100 -3.276800 3.276700 FORMAT "%8.6" ECU_ADDRESS 0x802A70 /end MEASUREMENT
/begin MEASUREMENT EGSys_cpEGOxiCat_mp "Spezifische Wärmekapazität Abgas im Oxidationskatalysator" SWORD SpecificHeat 1 100 -3.276800 3.276700 FORMAT "%8.6" ECU_ADDRESS 0x802A78 /end MEASUREMENT
/begin MEASUREMENT EGSys_ctCldStrtLSU_mp "Zähler für wiederholte Kaltstarts" UBYTE OneToOne 1 100 0.00 255.0 FORMAT "%5.1" ARRAY_SIZE 1 ECU_ADDRESS 0x802A1E /end MEASUREMENT
/begin MEASUREMENT EGSys_dmEG "näherungsweiser Abgasmassenstrom" SWORD AirMassPerTime 1 100 -3276.800 3276.700 FORMAT "%8.3" ECU_ADDRESS 0x7F97B2 /end MEASUREMENT
/begin MEASUREMENT EGSys_dmExhGas2_mp "Abgasmassenstrom rechtes System" SWORD AirMassPerTime 1 100 -3276.800 3276.700 FORMAT "%8.3" ECU_ADDRESS 0x802A30 /end MEASUREMENT
/begin MEASUREMENT EGSys_dmExhGas_mp "Abgasmassenstrom linkes System" SWORD AirMassPerTime 1 100 -3276.800 3276.700 FORMAT "%8.3" ECU_ADDRESS 0x802A36 /end MEASUREMENT
/begin MEASUREMENT EGSys_dwFlCmb_mp "Wärmestrom durch spät nacheingespritzte Kraftstoffmenge" SLONG Pwr1 1 100 -214748364.800 214748364.700 FORMAT "%13.3" ECU_ADDRESS 0x802A7C /end MEASUREMENT
/begin MEASUREMENT EGSys_dwLSU_mp "Abgaswärmestrom an Sondenposition" SWORD Pwr_kW_Sec 1 100 -327.6800 327.6700 FORMAT "%8.4" ARRAY_SIZE 1 ECU_ADDRESS 0x802A20 /end MEASUREMENT
/begin MEASUREMENT EGSys_facAirMass_mp "Luftmassen-Korrekturfaktor für stationäre Abgaskrümmertemperatur" SWORD Fact 1 100 -4.000000 3.999878 FORMAT "%8.6" ECU_ADDRESS 0x802A5E /end MEASUREMENT
/begin MEASUREMENT EGSys_facStrtDlv_mp "Förderbeginn-Korrekturfaktor für stationäre Abgaskrümmertemperatur" SWORD Fact 1 100 -4.000000 3.999878 FORMAT "%8.6" ECU_ADDRESS 0x802A60 /end MEASUREMENT
/begin MEASUREMENT EGSys_nTrbnMax2_mp "Mögliche Antriebsdrehzahl der Turbine rechts" SWORD TurboN 1 100 -327680.0 327670.0 FORMAT "%8.1" ECU_ADDRESS 0x802A32 /end MEASUREMENT
/begin MEASUREMENT EGSys_nTrbnMax_mp "Mögliche Antriebsdrehzahl der Turbine links" SWORD TurboN 1 100 -327680.0 327670.0 FORMAT "%8.1" ECU_ADDRESS 0x802A38 /end MEASUREMENT
/begin MEASUREMENT EGSys_pExhGas "Abgasgegendruck" SWORD Pres_hPa 1 100 -32768.00 32767.00 FORMAT "%8.2" ARRAY_SIZE 1 ECU_ADDRESS 0x7F97B4 /end MEASUREMENT
/begin MEASUREMENT EGSys_phiDiffStrt_mp "Differenz zwischen Förderbeginn im Auslegungspunkt und aktuellem Wert" SWORD AngleCrS 1 100 -768.0000 767.9766 FORMAT "%8.4" ECU_ADDRESS 0x802A62 /end MEASUREMENT
/begin MEASUREMENT EGSys_pPreTrbn "Abgasgegendruck for der Turbine links" SWORD Pres_hPa 1 100 -32768.00 32767.00 FORMAT "%8.2" ECU_ADDRESS 0x7F97B6 /end MEASUREMENT
/begin MEASUREMENT EGSys_pPreTrbn2 "Abgasgegendruck vor der Turbine rechts" SWORD Pres_hPa 1 100 -32768.00 32767.00 FORMAT "%8.2" ECU_ADDRESS 0x7F97B8 /end MEASUREMENT
/begin MEASUREMENT EGSys_qMIStd "Vor- und haupteingespritzte Kraftstoffmenge (im Brennraum verbrannt)" SWORD InjMassCyc 1 100 -327.6800 327.6700 FORMAT "%8.4" ECU_ADDRESS 0x7F97BA /end MEASUREMENT
/begin MEASUREMENT EGSys_qPoIRgn "Spät nacheingespritzte Kraftstoffmenge (nicht im Brennraum verbrannt)" SWORD InjMassInj 1 100 -327.6800 327.6700 FORMAT "%8.4" ECU_ADDRESS 0x7F97BC /end MEASUREMENT
/begin MEASUREMENT EGSys_rAirPerTime_mp "Verhältnis Luftmassenstrom im Auslegungspunkt zu aktuellem Wert" SWORD Fact 1 100 -4.000000 3.999878 FORMAT "%8.6" ECU_ADDRESS 0x802A64 /end MEASUREMENT
/begin MEASUREMENT EGSys_rLmbdAprx "näherungsweiser Lambda-Wert" SWORD lambda 1 100 -32.76800 32.76700 FORMAT "%8.5" ECU_ADDRESS 0x7F97BE /end MEASUREMENT
/begin MEASUREMENT EGSys_rPres2_mp "Abgasgegendruckverhältnis vor und nach Turbine rechts" SWORD Fact 1 100 -4.000000 3.999878 FORMAT "%8.6" ECU_ADDRESS 0x802A34 /end MEASUREMENT
/begin MEASUREMENT EGSys_rPres_mp "Abgasgegendruckverhältnis vor und nach Turbine links" SWORD Fact 1 100 -4.000000 3.999878 FORMAT "%8.6" ECU_ADDRESS 0x802A3A /end MEASUREMENT
/begin MEASUREMENT EGSys_rTempClnt_mp "Verhältnis Motorübertemperatur Motorstart / -stop" SWORD Fact 1 100 -4.000000 3.999878 FORMAT "%8.6" ECU_ADDRESS 0x802A8C /end MEASUREMENT
/begin MEASUREMENT EGSys_rTimeNSC_mp "Verhältnis Standzeit zu Halbwertszeit NSC" SWORD Fact1 1 100 -256.0000 255.9922 FORMAT "%8.4" ECU_ADDRESS 0x802A8E /end MEASUREMENT
/begin MEASUREMENT EGSys_rTimeOxiCat_mp "Verhältnis Standzeit zu Halbwertszeit Oxidationskatalysator" SWORD Fact1 1 100 -256.0000 255.9922 FORMAT "%8.4" ECU_ADDRESS 0x802A90 /end MEASUREMENT
/begin MEASUREMENT EGSys_rTimeTrb_mp "Verhältnis-Stillstand-Zeit / Halbzeit-Periode turbocharger" SWORD Fact1 1 100 -256.0000 255.9922 FORMAT "%8.4" ECU_ADDRESS 0x802A92 /end MEASUREMENT
/begin MEASUREMENT EGSys_rTimeTube_mp "Verhältnis Standzeit zu Halbwertszeit Abgasrohr" SWORD Fact1 1 100 -256.0000 255.9922 FORMAT "%8.4" ARRAY_SIZE 2 ECU_ADDRESS 0x802A88 /end MEASUREMENT
/begin MEASUREMENT EGSys_stHtgLSU "Statusbit Freigabe Sensor-Heizung" UBYTE OneToOne 1 100 0.00 255.0 FORMAT "%5.1" ARRAY_SIZE 1 ECU_ADDRESS 0x7F93A7 /end MEASUREMENT
/begin MEASUREMENT EGSys_stHtgLSULstTrp_mp "Status der Taupunktfreigabe des letzten Fahrzyklus" UBYTE OneToOne 1 100 0.00 255.0 FORMAT "%5.1" ARRAY_SIZE 1 ECU_ADDRESS 0x802A22 /end MEASUREMENT
/begin MEASUREMENT EGSys_stHtgThresLSUHit_mp "Statusmessage für Überschreiten des Wärmemengenschwellwertes" UBYTE OneToOne 1 100 0.00 255.0 FORMAT "%5.1" ARRAY_SIZE 1 ECU_ADDRESS 0x802A23 /end MEASUREMENT
/begin MEASUREMENT EGSys_stIntegIni_mp "Status Integrator Initialisierung" UBYTE OneToOne 1 100 0.00 255.0 FORMAT "%5.1" ARRAY_SIZE 1 ECU_ADDRESS 0x802A24 /end MEASUREMENT
/begin MEASUREMENT EGSys_stPlsLSU_mp "Status-Bit gültiger Gaspuls" UBYTE OneToOne 1 100 0.00 255.0 FORMAT "%5.1" ARRAY_SIZE 1 ECU_ADDRESS 0x802A25 /end MEASUREMENT
/begin MEASUREMENT EGSys_tAvrgNSC_mp "Mittlere Temperatur NSC" SWORD Temp_Cels 1 100 -3549.940 3003.560 FORMAT "%8.3" ECU_ADDRESS 0x802A72 /end MEASUREMENT
/begin MEASUREMENT EGSys_tAvrgOxiCat_mp "Mittlere Temperatur Oxidationskatalysator" SWORD Temp_Cels 1 100 -3549.940 3003.560 FORMAT "%8.3" ECU_ADDRESS 0x802A80 /end MEASUREMENT
/begin MEASUREMENT EGSys_tCorrIAT_mp "Temperaturoffset aufgrund Schwankungen der Ansauglufttemperatur" SWORD TempDiff_Kelv 1 100 -3276.800 3276.700 FORMAT "%8.3" ECU_ADDRESS 0x802A66 /end MEASUREMENT
/begin MEASUREMENT EGSys_tCorrManf_mp "Temperaturoffset Krümmer bei kaltem Motor" SWORD TempDiff_Kelv 1 100 -3276.800 3276.700 FORMAT "%8.3" ECU_ADDRESS 0x802A68 /end MEASUREMENT
/begin MEASUREMENT EGSys_tDiffCldEng_mp "Abweichung aktuelle Motortemperatur von stationärem Wert" SWORD TempDiff_Kelv 1 100 -3276.800 3276.700 FORMAT "%8.3" ECU_ADDRESS 0x802A6A /end MEASUREMENT
/begin MEASUREMENT EGSys_tDiffIAT_mp "Differenz zwischen Ansaulglufttemperatur im Auslegungspunkt und aktuellem Wert" SWORD TempDiff_Kelv 1 100 -3276.800 3276.700 FORMAT "%8.3" ECU_ADDRESS 0x802A6C /end MEASUREMENT
/begin MEASUREMENT EGSys_tEGInpCrv_mp "Meßpunkt für Abgastemperatur in allen Temperaturmodellen" SWORD Temp_Cels 1 100 -3549.940 3003.560 FORMAT "%8.3" ECU_ADDRESS 0x802A3C /end MEASUREMENT
/begin MEASUREMENT EGSys_tEGLSU "Abgas-Temperatur an Sensor-Position" SWORD Temp_Cels 1 100 -3549.940 3003.560 FORMAT "%8.3" ARRAY_SIZE 1 ECU_ADDRESS 0x7F97C0 /end MEASUREMENT
/begin MEASUREMENT EGSys_tEGLSUInpCrv0_mp "Messpunkt Eingang der Kennlinien" SWORD Temp_Cels 1 100 -3549.940 3003.560 FORMAT "%8.3" ECU_ADDRESS 0x802A3E /end MEASUREMENT
/begin MEASUREMENT EGSys_tEGPreNSC "Abgastemperatur am NSC-Eintritt" SWORD Temp_Cels 1 100 -3549.940 3003.560 FORMAT "%8.3" ECU_ADDRESS 0x7F97C2 /end MEASUREMENT
/begin MEASUREMENT EGSys_tEGPreOxiCat "Abgastemperatur am Oxidationskatalysator-Eintritt" SWORD Temp_Cels 1 100 -3549.940 3003.560 FORMAT "%8.3" ECU_ADDRESS 0x7F97C4 /end MEASUREMENT
/begin MEASUREMENT EGSys_tEGPreTrbn "Abgas-Temperatur vor Turbine" SWORD Temp_Cels 1 100 -3549.940 3003.560 FORMAT "%8.3" ECU_ADDRESS 0x7F97C6 /end MEASUREMENT
/begin MEASUREMENT EGSys_tEGPreTube "Abgastemperatur am Abgasrohr-Eintritt" SWORD Temp_Cels 1 100 -3549.940 3003.560 FORMAT "%8.3" ARRAY_SIZE 2 ECU_ADDRESS 0x7F9C84 /end MEASUREMENT
/begin MEASUREMENT EGSys_tEGPstTrbn "Abgas-Temperatur nach Turbolader" SWORD Temp_Cels 1 100 -3549.940 3003.560 FORMAT "%8.3" ECU_ADDRESS 0x7F97C8 /end MEASUREMENT
/begin MEASUREMENT EGSys_tExcClntStrtCs_mp "Motorübertemperatur bei Motorstart" SWORD TempDiff_Kelv 1 100 -3276.800 3276.700 FORMAT "%8.3" ECU_ADDRESS 0x802A94 /end MEASUREMENT
/begin MEASUREMENT EGSys_tiClg_mp "Abkühlzeit" ULONG Time_s 1 100 0.00 42949672.9500 FORMAT "%13.4" ECU_ADDRESS 0x802A98 /end MEASUREMENT
/begin MEASUREMENT EGSys_tIncrPoI_mp "Temperaturerhöhung im Oxidationskatalysator aufgrund später Nacheinspritzung" SWORD TempDiff_Kelv 1 100 -3276.800 3276.700 FORMAT "%8.3" ECU_ADDRESS 0x802A82 /end MEASUREMENT
/begin MEASUREMENT EGSys_tiRefClg_mp "Referenz-Abkühlzeit aus Motor-Abkühlung" ULONG Time_s 1 100 0.00 42949672.9500 FORMAT "%13.4" ECU_ADDRESS 0x802A9C /end MEASUREMENT
/begin MEASUREMENT EGSys_tManfStat "stationäre Abgastemperatur im Abgaskrümmer" SWORD Temp_Cels 1 100 -3549.940 3003.560 FORMAT "%8.3" ECU_ADDRESS 0x7F97CA /end MEASUREMENT
/begin MEASUREMENT EGSys_tManfStat_mp "stationäre Abgastemperatur im Abgaskrümmer ohne Korrekturen" SWORD Temp_Cels 1 100 -3549.940 3003.560 FORMAT "%8.3" ECU_ADDRESS 0x802A6E /end MEASUREMENT
/begin MEASUREMENT EGSys_tMem_mp "Zwischenspeicher für Temperaturen" SWORD Temp_Cels 1 100 -3549.940 3003.560 FORMAT "%8.3" ARRAY_SIZE 14 ECU_ADDRESS 0x802A40 /end MEASUREMENT
/begin MEASUREMENT EGSys_tNSC "Temperatur NSC (Austritt)" SWORD Temp_Cels 1 100 -3549.940 3003.560 FORMAT "%8.3" ECU_ADDRESS 0x7F97CC /end MEASUREMENT
/begin MEASUREMENT EGSys_tNSCExoIncr_mp "Temperaturerhöhung im NSC durch chemische Reaktionen" SWORD TempDiff_Kelv 1 100 -3276.800 3276.700 FORMAT "%8.3" ECU_ADDRESS 0x802A74 /end MEASUREMENT
/begin MEASUREMENT EGSys_tNSCStat_mp "Stationäre Temperatur NSC" SWORD Temp_Cels 1 100 -3549.940 3003.560 FORMAT "%8.3" ECU_ADDRESS 0x802A76 /end MEASUREMENT
/begin MEASUREMENT EGSys_tNSCStrtCs "Temperatur NSC bei Motorstart" SWORD Temp_Cels 1 100 -3549.940 3003.560 FORMAT "%8.3" ECU_ADDRESS 0x7F97CE /end MEASUREMENT
/begin MEASUREMENT EGSys_tOxiCat "Temperatur Oxidationskatalysator (Austritt)" SWORD Temp_Cels 1 100 -3549.940 3003.560 FORMAT "%8.3" ECU_ADDRESS 0x7F97D0 /end MEASUREMENT
/begin MEASUREMENT EGSys_tOxiCatExoIncr_mp "Temperaturerhöhung im Oxidationskatalysator durch chemische Reaktionen" SWORD TempDiff_Kelv 1 100 -3276.800 3276.700 FORMAT "%8.3" ECU_ADDRESS 0x802A84 /end MEASUREMENT
/begin MEASUREMENT EGSys_tOxiCatStat_mp "Stationäre Temperatur Oxidationskatalysator" SWORD Temp_Cels 1 100 -3549.940 3003.560 FORMAT "%8.3" ECU_ADDRESS 0x802A86 /end MEASUREMENT
/begin MEASUREMENT EGSys_tOxiCatStrtCs "Temperatur Oxidationskatalysator bei Motorstart" SWORD Temp_Cels 1 100 -3549.940 3003.560 FORMAT "%8.3" ECU_ADDRESS 0x7F97D2 /end MEASUREMENT
/begin MEASUREMENT EGSys_tShOffTExcClnt_mp "Motorübertemperature bei Motorstop" SWORD TempDiff_Kelv 1 100 -3276.800 3276.700 FORMAT "%8.3" ECU_ADDRESS 0x802A5C /end MEASUREMENT
/begin MEASUREMENT EGSys_tTrbStrtCs "Turbocharger Temperatur an Maschinenanfang" SWORD Temp_Cels 1 100 -3549.940 3003.560 FORMAT "%8.3" ECU_ADDRESS 0x7F97D4 /end MEASUREMENT
/begin MEASUREMENT EGSys_tTubeStrtCs "Temperatur Abgasrohr bei Motorstart" SWORD Temp_Cels 1 100 -3549.940 3003.560 FORMAT "%8.3" ARRAY_SIZE 2 ECU_ADDRESS 0x7F9C90 /end MEASUREMENT
/begin MEASUREMENT EGSys_tWallLSU "Wandtemperatur am Sondeneinbauort" SWORD Temp_Cels 1 100 -3549.940 3003.560 FORMAT "%8.3" ARRAY_SIZE 1 ECU_ADDRESS 0x7F97D6 /end MEASUREMENT
/begin MEASUREMENT EGSys_wLSU_mp " integrierte Wärmemenge an Sensor-Position." SWORD Energy 1 100 -32768.00 32767.00 FORMAT "%8.2" ARRAY_SIZE 1 ECU_ADDRESS 0x802A26 /end MEASUREMENT
/begin MEASUREMENT EGSys_wThresLSUAct_mp "aktueller Wärmeschwellwert an Sensorposition." SWORD Energy 1 100 -32768.00 32767.00 FORMAT "%8.2" ARRAY_SIZE 1 ECU_ADDRESS 0x802A28 /end MEASUREMENT
/begin MEASUREMENT EGSys_wThresLSUNoPls_mp "Hitzeschwelle ohne gültigen Gaspuls." SWORD Energy 1 100 -32768.00 32767.00 FORMAT "%8.2" ARRAY_SIZE 1 ECU_ADDRESS 0x802A2A /end MEASUREMENT
/begin MEASUREMENT EGSys_wThresLSUPls_mp "Hitzeschwelle für gültigen Gaspuls" SWORD Energy 1 100 -32768.00 32767.00 FORMAT "%8.2" ARRAY_SIZE 1 ECU_ADDRESS 0x802A2C /end MEASUREMENT
/begin MEASUREMENT EGSys_wThresLSU_mp "Grundlegender Wert-Hitzeschwelle-Sensor" SWORD Energy 1 100 -32768.00 32767.00 FORMAT "%8.2" ARRAY_SIZE 1 ECU_ADDRESS 0x802A2E /end MEASUREMENT
/begin MEASUREMENT EGT_stDel "Verzögerte Regenerationsanforderung für Abgasnachbehandlung (drehzahl synchron)" ULONG OneToOne 1 100 0.00 4294967295.00 FORMAT "%13.2" ECU_ADDRESS 0x7F9C98 /end MEASUREMENT
/begin MEASUREMENT FidCol_mp "Meßpunkt der gesammelt den Zustand aller Funktionsidentifier (Fid) zur Verfügung stellt." UWORD OneToOne 1 100 0.00 65535.00 FORMAT "%8.2" ARRAY_SIZE 26 ECU_ADDRESS 0x8029E0 /end MEASUREMENT
/begin MEASUREMENT FrmMng_rtrqInrAvrg "relatives gemitteltes Master/Slave Motormoment für CAN" SWORD rTrqCAN 1 100 -12850.20 12849.81 FORMAT "%8.2" ECU_ADDRESS 0x7F989C /end MEASUREMENT
/begin MEASUREMENT InjCrv_qSmkTrqCor "systemspezifische Rauchbegrenzungskorrekturmenge" SWORD InjMass 1 100 -327.6800 327.6700 FORMAT "%8.4" ECU_ADDRESS 0x7F99D8 /end MEASUREMENT
/begin MEASUREMENT LSUCD_stCircModeNewLow "LowByte von LSUCD_stCircModeNew" UBYTE OneToOne 1 100 0.00 255.0 FORMAT "%5.1" ECU_ADDRESS 0x7F94A9 /end MEASUREMENT
/begin MEASUREMENT PFltCD_tPst "Abgastemperatur hinter dem Partikelfilter" SWORD Temp_Cels 1 100 -3549.940 3003.560 FORMAT "%8.3" ECU_ADDRESS 0x7F9AE6 /end MEASUREMENT
/begin MEASUREMENT PFlt_resFlowFlt "gefilterter Strömungswiderstand" SWORD Res_hPaHrPerCM 1 100 -32.76800 32.76700 FORMAT "%8.5" ECU_ADDRESS 0x7F9B06 /end MEASUREMENT
/begin MEASUREMENT PFlt_resFlowOfs "Strömungswiderstandoffset" SWORD Res_hPaHrPerCM 1 100 -32.76800 32.76700 FORMAT "%8.5" ECU_ADDRESS 0x7F9B08 /end MEASUREMENT
/begin MEASUREMENT PFlt_stSimOn "Statusbit Simulation aktiv" UBYTE OneToOne 1 100 0.00 255.0 FORMAT "%5.1" ECU_ADDRESS 0x7F94EE /end MEASUREMENT
/begin MEASUREMENT SOPTst_stShOffAR "Abschaltpfadtest im Nachlauf" UWORD OneToOne 1 100 0.00 65535.00 FORMAT "%8.2" ECU_ADDRESS 0x7F9B60 /end MEASUREMENT
/begin FUNCTION dsm_auto_tsf ""
 /begin DEF_CHARACTERISTIC DSM_TsfDfp_ACCCDWrongCoded_C DSM_TsfDfp_ACCD_C DSM_TsfDfp_ACCD_PAC_C DSM_TsfDfp_ACCD_pCAN_C DSM_TsfDfp_ACCD_trqCAN_C DSM_TsfDfp_ACCnotPlaus_C DSM_TsfDfp_ADCMon_C DSM_TsfDfp_AFSCD_AirTempDcyc_C DSM_TsfDfp_AFSCD_PlOffsDrft_C DSM_TsfDfp_AFSCD_PlSetyDrft_C DSM_TsfDfp_AFSCD_Plaus_C DSM_TsfDfp_AFSCD_SRCAirTemp_C DSM_TsfDfp_AFSCD_SRCAirm_C DSM_TsfDfp_AFSCD_SRCAirm2_C DSM_TsfDfp_AFSCD_SRCBatt_C DSM_TsfDfp_AFSCD_SRCCorrAirm_C DSM_TsfDfp_AFSCD_SRCRawAirm_C DSM_TsfDfp_AFSCD_SRCRefSigPer_C DSM_TsfDfp_AFVCD_Actr_C DSM_TsfDfp_AOHtCDHt1_C DSM_TsfDfp_AOHtCDHt2_C DSM_TsfDfp_AOHtCDHt3_C DSM_TsfDfp_APP1_C DSM_TsfDfp_APP2_C DSM_TsfDfp_APPCD_KickDown_C DSM_TsfDfp_APPSync_C DSM_TsfDfp_APP_Npl_C DSM_TsfDfp_APSCD_C DSM_TsfDfp_AccPedPlausBrk_C DSM_TsfDfp_AddPCD_C DSM_TsfDfp_AddPCDTnkLvl_C DSM_TsfDfp_AddPCDTnkLvlDef_C DSM_TsfDfp_AirCtl_GovDev_C DSM_TsfDfp_AirbCDCrash_C DSM_TsfDfp_AirbCDCrashCrCtl_C DSM_TsfDfp_AirbCDCrashPSP_C DSM_TsfDfp_AltCDExc_C DSM_TsfDfp_AltCD_Load_C DSM_TsfDfp_AltPwrCan_C DSM_TsfDfp_BPACD_Max_C DSM_TsfDfp_BPACD_Min_C DSM_TsfDfp_BPACD_SigNpl_C DSM_TsfDfp_BPAExcSensTemp_C DSM_TsfDfp_BPANotLrn_C DSM_TsfDfp_BPASCDDcyc_C DSM_TsfDfp_BPASCDPeriod_C DSM_TsfDfp_BPSCD_C DSM_TsfDfp_BPSCDPlaus_C DSM_TsfDfp_BattCD_C DSM_TsfDfp_BrkCD_C DSM_TsfDfp_BrkCDdynPl_C DSM_TsfDfp_CANA_C DSM_TsfDfp_CANB_C DSM_TsfDfp_CANBus1_C DSM_TsfDfp_CANBus2_C DSM_TsfDfp_CANBus3_C DSM_TsfDfp_CANC_C DSM_TsfDfp_CANErrActA_C DSM_TsfDfp_CANErrActB_C DSM_TsfDfp_CANErrActC_C DSM_TsfDfp_COTSCD_C DSM_TsfDfp_CTSCD_C DSM_TsfDfp_CTSCDCanInac_C DSM_TsfDfp_CTSCDCanSig_C DSM_TsfDfp_Clg_DynTst_C DSM_TsfDfp_CmbChbMisfire1_C DSM_TsfDfp_CmbChbMisfire2_C DSM_TsfDfp_CmbChbMisfire3_C DSM_TsfDfp_CmbChbMisfire4_C DSM_TsfDfp_CmbChbMisfire5_C DSM_TsfDfp_CmbChbMisfire6_C DSM_TsfDfp_CmbChbMisfireMul_C DSM_TsfDfp_CoVMDCSh_C DSM_TsfDfp_CoVMDCSp_C DSM_TsfDfp_CoVehEcoErr_C DSM_TsfDfp_CoVehLvl2_C DSM_TsfDfp_ConvCD_C DSM_TsfDfp_ConvCD_ConvErr_C DSM_TsfDfp_CrCtlPLmpDef_C DSM_TsfDfp_CrCtlPShutOff_C DSM_TsfDfp_CrCtlPTlrDef_C DSM_TsfDfp_CrCtlPanErr_C DSM_TsfDfp_CrCtlPanSwtErr_C DSM_TsfDfp_CtApCD_C DSM_TsfDfp_CtTCD_C DSM_TsfDfp_CtT_Mon_C DSM_TsfDfp_DifftrqLimErrPat_C DSM_TsfDfp_EATSCD_C DSM_TsfDfp_EATSCDCanInac_C DSM_TsfDfp_EATSCDCanSig_C DSM_TsfDfp_EEPCDVarMng_C DSM_TsfDfp_EGPpCDTPreTrbn_C DSM_TsfDfp_EGPpCDTPreTrbn1_C DSM_TsfDfp_EGRCD_CBV_C DSM_TsfDfp_EGRCD_Max_C DSM_TsfDfp_EGRCD_Min_C DSM_TsfDfp_EGRCD_SigNpl_C DSM_TsfDfp_EMCCD_GTL1_C DSM_TsfDfp_EMCCD_GTL2_C DSM_TsfDfp_EMCCD_MLS1_C DSM_TsfDfp_EMCCD_MLS2_C DSM_TsfDfp_ETClbInj1_C DSM_TsfDfp_ETClbInj2_C DSM_TsfDfp_ETClbInj3_C DSM_TsfDfp_ETClbInj4_C DSM_TsfDfp_ETClbInj5_C DSM_TsfDfp_ETClbInj6_C DSM_TsfDfp_EngMCaS1_C DSM_TsfDfp_EngMCrS1_C DSM_TsfDfp_EngMOfsCaSCrS_C DSM_TsfDfp_EngMonIrrCmb_C DSM_TsfDfp_EngPrt_C DSM_TsfDfp_ErLpCDMILReqON_C DSM_TsfDfp_FMTC_NonMonotonMap_C DSM_TsfDfp_FQlSCD_C DSM_TsfDfp_FTSCD_C DSM_TsfDfp_FTSCDNpl_C DSM_TsfDfp_FanCD_Fan1Ctlr1_C DSM_TsfDfp_FanCD_Fan1Ctlr2_C DSM_TsfDfp_FanCD_Fan2Ctlr1_C DSM_TsfDfp_FanCD_Fan2Ctlr2_C DSM_TsfDfp_FanCD_FanCtlr1_C DSM_TsfDfp_FanCD_FanCtlr2_C DSM_TsfDfp_FanCD_OutFanCtlr1_C DSM_TsfDfp_FanCD_OutFanCtlr2_C DSM_TsfDfp_FlPpCD_C DSM_TsfDfp_FlSCDT1_C DSM_TsfDfp_FrmMngAAGNpl_C DSM_TsfDfp_FrmMngAAGTO_C DSM_TsfDfp_FrmMngAC1Npl_C DSM_TsfDfp_FrmMngAC1TO_C DSM_TsfDfp_FrmMngACCNpl_C DSM_TsfDfp_FrmMngACCTO_C DSM_TsfDfp_FrmMngAIRBGNpl_C DSM_TsfDfp_FrmMngAIRBGTO_C DSM_TsfDfp_FrmMngAWD1Npl_C DSM_TsfDfp_FrmMngAWD1TO_C DSM_TsfDfp_FrmMngBEM1Npl_C DSM_TsfDfp_FrmMngBEM1TO_C DSM_TsfDfp_FrmMngBRK1Npl_C DSM_TsfDfp_FrmMngBRK1TO_C DSM_TsfDfp_FrmMngBRK2Npl_C DSM_TsfDfp_FrmMngBRK2TO_C DSM_TsfDfp_FrmMngBRK8Npl_C DSM_TsfDfp_FrmMngBRK8TO_C DSM_TsfDfp_FrmMngCANVerErr_C DSM_TsfDfp_FrmMngCCSel_C DSM_TsfDfp_FrmMngCCTLNpl_C DSM_TsfDfp_FrmMngCCTLTO_C DSM_TsfDfp_FrmMngCHRGR1Npl_C DSM_TsfDfp_FrmMngCHRGR1TO_C DSM_TsfDfp_FrmMngCHRGR2Npl_C DSM_TsfDfp_FrmMngCHRGR2TO_C DSM_TsfDfp_FrmMngChrgr1A_C DSM_TsfDfp_FrmMngChrgr1C_C DSM_TsfDfp_FrmMngChrgr1N_C DSM_TsfDfp_FrmMngChrgr1T_C DSM_TsfDfp_FrmMngChrgr1V_C DSM_TsfDfp_FrmMngChrgr2A_C DSM_TsfDfp_FrmMngChrgr2C_C DSM_TsfDfp_FrmMngChrgr2N_C DSM_TsfDfp_FrmMngChrgr2T_C DSM_TsfDfp_FrmMngChrgr2V_C DSM_TsfDfp_FrmMngDIA1Npl_C DSM_TsfDfp_FrmMngDIA1TO_C DSM_TsfDfp_FrmMngDSP1Npl_C DSM_TsfDfp_FrmMngDSP1TO_C DSM_TsfDfp_FrmMngDSP2Npl_C DSM_TsfDfp_FrmMngDSP2TO_C DSM_TsfDfp_FrmMngESCUNpl_C DSM_TsfDfp_FrmMngESCUTO_C DSM_TsfDfp_FrmMngGW1Npl_C DSM_TsfDfp_FrmMngGW1TO_C DSM_TsfDfp_FrmMngILMNpl_C DSM_TsfDfp_FrmMngILMTO_C DSM_TsfDfp_FrmMngNIV1WrngCod_C DSM_TsfDfp_FrmMngNIVEAU1Npl_C DSM_TsfDfp_FrmMngNIVEAU1TO_C DSM_TsfDfp_FrmMngSTIGNNpl_C DSM_TsfDfp_FrmMngStIgnTO_C DSM_TsfDfp_FrmMngTOSNpl_C DSM_TsfDfp_FrmMngTOSTO_C DSM_TsfDfp_FrmMngTSC1Npl_C DSM_TsfDfp_FrmMngTSC1TO_C DSM_TsfDfp_FrmMngTSC2Npl_C DSM_TsfDfp_FrmMngTSC2TO_C DSM_TsfDfp_FrmMngTSC3Npl_C DSM_TsfDfp_FrmMngTSC3TO_C DSM_TsfDfp_GearbxASTh_C DSM_TsfDfp_GearbxASTl_C DSM_TsfDfp_GearbxTSC_C DSM_TsfDfp_GearbxTypeMTErr_C DSM_TsfDfp_GlwCD_Actr_C DSM_TsfDfp_GlwCD_DIAG_C DSM_TsfDfp_GlwCD_Error1_C DSM_TsfDfp_GlwCD_Error2_C DSM_TsfDfp_GlwCD_EvalCod_C DSM_TsfDfp_GlwCD_GSK_C DSM_TsfDfp_GlwCD_Lamp_C DSM_TsfDfp_GlwCD_LampCan_C DSM_TsfDfp_GlwCD_PLUG0_C DSM_TsfDfp_GlwCD_PLUG1_C DSM_TsfDfp_GlwCD_PLUG2_C DSM_TsfDfp_GlwCD_PLUG3_C DSM_TsfDfp_GlwCD_PLUG4_C DSM_TsfDfp_GlwCD_PLUG5_C DSM_TsfDfp_GlwCD_SFD_C DSM_TsfDfp_HDSCD_C DSM_TsfDfp_HWEMonCom_C DSM_TsfDfp_HWEMonEEPROM_C DSM_TsfDfp_HWEMonRcyLocked_C DSM_TsfDfp_HWEMonRcySuppressed_C DSM_TsfDfp_HWEMonRcyVisible_C DSM_TsfDfp_HWEMonUMaxSupply_C DSM_TsfDfp_HWEMonUMinSupply_C DSM_TsfDfp_IATSCD_C DSM_TsfDfp_IFCD_C DSM_TsfDfp_ImmCtl_C DSM_TsfDfp_InjCrv_InjLim_C DSM_TsfDfp_InjVCDActrChrg_C DSM_TsfDfp_InjVCDActrVolt_C DSM_TsfDfp_InjVCDClsBank1_C DSM_TsfDfp_InjVCDClsBank2_C DSM_TsfDfp_InjVCDMonCab_C DSM_TsfDfp_InjVCDMonSwt_C DSM_TsfDfp_InjVCDShOffDCDC_C DSM_TsfDfp_InjVCDUBuf_C DSM_TsfDfp_InjVCD_CY370Ampl_C DSM_TsfDfp_InjVlvBnk1A_C DSM_TsfDfp_InjVlvBnk1B_C DSM_TsfDfp_InjVlvBnk2A_C DSM_TsfDfp_InjVlvBnk2B_C DSM_TsfDfp_InjVlvChipA_C DSM_TsfDfp_InjVlvChipB_C DSM_TsfDfp_InjVlvCyl1A_C DSM_TsfDfp_InjVlvCyl1B_C DSM_TsfDfp_InjVlvCyl1C_C DSM_TsfDfp_InjVlvCyl2A_C DSM_TsfDfp_InjVlvCyl2B_C DSM_TsfDfp_InjVlvCyl2C_C DSM_TsfDfp_InjVlvCyl3A_C DSM_TsfDfp_InjVlvCyl3B_C DSM_TsfDfp_InjVlvCyl3C_C DSM_TsfDfp_InjVlvCyl4A_C DSM_TsfDfp_InjVlvCyl4B_C DSM_TsfDfp_InjVlvCyl4C_C DSM_TsfDfp_InjVlvCyl5A_C DSM_TsfDfp_InjVlvCyl5B_C DSM_TsfDfp_InjVlvCyl5C_C DSM_TsfDfp_InjVlvCyl6A_C DSM_TsfDfp_InjVlvCyl6B_C DSM_TsfDfp_InjVlvCyl6C_C DSM_TsfDfp_InjVlvCyl7A_C DSM_TsfDfp_InjVlvCyl7B_C DSM_TsfDfp_InjVlvCyl7C_C DSM_TsfDfp_InjVlvCyl8A_C DSM_TsfDfp_InjVlvCyl8B_C DSM_TsfDfp_InjVlvCyl8C_C DSM_TsfDfp_LSUCDCircNernst0_C DSM_TsfDfp_LSUCDCircPumpCur0_C DSM_TsfDfp_LSUCDCircVirtGnd0_C DSM_TsfDfp_LSUCDHeater0_C DSM_TsfDfp_LSUCDHtCoup0_C DSM_TsfDfp_LSUCDO20_C DSM_TsfDfp_LSUCDO2Clb0_C DSM_TsfDfp_LSUCDRiClb0_C DSM_TsfDfp_LSUCDSPI0_C DSM_TsfDfp_LSUCDSPIBattLow0_C DSM_TsfDfp_LSUCDWireIP0_C DSM_TsfDfp_LSUCtlRiExc0_C DSM_TsfDfp_LSUMon1Sens_C DSM_TsfDfp_LSUMon2Sens_C DSM_TsfDfp_MIL_C DSM_TsfDfp_MRlyCD_C DSM_TsfDfp_MeUnCDNoLoad_C DSM_TsfDfp_MeUnCDSCBat_C DSM_TsfDfp_MeUnCDSCGnd_C DSM_TsfDfp_MeUnCD_ADC_C DSM_TsfDfp_Montr_C DSM_TsfDfp_OTSCD_C DSM_TsfDfp_OTSCDCanInac_C DSM_TsfDfp_OTSCDCanSig_C DSM_TsfDfp_OvRMon_C DSM_TsfDfp_OvRMonCrCtlP_C DSM_TsfDfp_OvRMonSigA_C DSM_TsfDfp_OxiCCDTPre_C DSM_TsfDfp_OxiCCDTPre1_C DSM_TsfDfp_PCR_BalGovDev_C DSM_TsfDfp_PCR_GovDev_C DSM_TsfDfp_PCVCDNoLoad_C DSM_TsfDfp_PCVCDSCBat_C DSM_TsfDfp_PCVCDSCGnd_C DSM_TsfDfp_PCVCD_ADC_C DSM_TsfDfp_PFltCDHtg_C DSM_TsfDfp_PFltCDHtg1_C DSM_TsfDfp_PFltCDPDiff_C DSM_TsfDfp_PFltCDPDiff1_C DSM_TsfDfp_PFltCDTPre_C DSM_TsfDfp_PFltCDTPst_C DSM_TsfDfp_PFltCDTempPre_C DSM_TsfDfp_PFltCDTempPre1_C DSM_TsfDfp_PFltChar_C DSM_TsfDfp_PFltEngPrt_C DSM_TsfDfp_PFltPresDynPlaus_C DSM_TsfDfp_PFltPresSens_C DSM_TsfDfp_PFltPresSensHsLn_C DSM_TsfDfp_PFltPresSensSot_C DSM_TsfDfp_PFltRgnPerm_C DSM_TsfDfp_PFltTempDwnStrm_C DSM_TsfDfp_PFltTempSens_C DSM_TsfDfp_PFltTempUpStrm_C DSM_TsfDfp_PSPCD_Actr_C DSM_TsfDfp_PrpCtlvLimErrPat_C DSM_TsfDfp_RailCD_C DSM_TsfDfp_RailCDOfsTst_C DSM_TsfDfp_RailMeUn0_C DSM_TsfDfp_RailMeUn1_C DSM_TsfDfp_RailMeUn2_C DSM_TsfDfp_RailMeUn3_C DSM_TsfDfp_RailMeUn4_C DSM_TsfDfp_RailPCV0_C DSM_TsfDfp_RailPCV1_C DSM_TsfDfp_RailPCV2_C DSM_TsfDfp_RailPCV3_C DSM_TsfDfp_RailPCV4_C DSM_TsfDfp_RailPCV5_C DSM_TsfDfp_SOPTst_C DSM_TsfDfp_SSpMon1_C DSM_TsfDfp_SSpMon2_C DSM_TsfDfp_SSpMon3_C DSM_TsfDfp_StrtCDOffRly_C DSM_TsfDfp_StrtCDOnRly_C DSM_TsfDfp_StrtCtlIlsNotPlaus_C DSM_TsfDfp_StrtCtlT50ROneRly1_C DSM_TsfDfp_StrtCtlT50ROneRly2_C DSM_TsfDfp_StrtCtlT50RZero_C DSM_TsfDfp_SysLamp_C DSM_TsfDfp_T15CD_C DSM_TsfDfp_TPUMon_C DSM_TsfDfp_TTSCD_C DSM_TsfDfp_TVACD_Max_C DSM_TsfDfp_TVACD_Min_C DSM_TsfDfp_TVACD_SigNpl_C DSM_TsfDfp_TVACD_stLineDef_C DSM_TsfDfp_UAcc_CodeBitErr_C DSM_TsfDfp_USAp_DataVariant_C DSM_TsfDfp_USAp_FuncCodeRead_C DSM_TsfDfp_VSACD1_Max_C DSM_TsfDfp_VSACD1_Min_C DSM_TsfDfp_VSACD1_SigNpl_C DSM_TsfDfp_VSACD2_Max_C DSM_TsfDfp_VSACD2_Min_C DSM_TsfDfp_VSACD2_SigNpl_C DSM_TsfDfp_VSAExcSensTemp1_C DSM_TsfDfp_VSAExcSensTemp2_C DSM_TsfDfp_VSANotLrn1_C DSM_TsfDfp_VSANotLrn2_C DSM_TsfDfp_VSASCDDcyc1_C DSM_TsfDfp_VSASCDDcyc2_C DSM_TsfDfp_VSASCDPeriod1_C DSM_TsfDfp_VSASCDPeriod2_C DSM_TsfDfp_VSSCD1_C DSM_TsfDfp_VSSCD2_C DSM_TsfDfp_VSSCD4_C DSM_TsfDfp_VSSCDBrkLowVltg_C DSM_TsfDfp_VSSCDCAN_C DSM_TsfDfp_VSSCDNpl_C DSM_TsfDfp_WdCom_C /end DEF_CHARACTERISTIC
/end FUNCTION
/begin FUNCTION dsm_msg ""
 /begin OUT_MEASUREMENT DFPM_stFCMChkCause DSM_ctDfctPath DSM_ctFcmEntry DSM_ctOBDPath DSM_ctOBDValidPath DSM_ctTstPath DSM_ctWUC DSM_lDist DSM_stCycles DSM_stECUMasterSlave DSM_stInhDelay DSM_stMIL DSM_stPID41 DSM_stRdyAB DSM_stRdyCD DSM_stRdyCheckEnable DSM_stSysLamp /end OUT_MEASUREMENT
/end FUNCTION
/begin FUNCTION dsm_rdy ""
 /begin DEF_CHARACTERISTIC DSM_RdyABForceMsk_C DSM_RdyCDForceMsk_C DSM_RdyOnMilEnable_C /end DEF_CHARACTERISTIC
/end FUNCTION
/begin FUNCTION dsm_rdy_msg "" /end FUNCTION
/begin FUNCTION dsm_rdy_uic ""
 /begin OUT_MEASUREMENT DSM_ctRdyActCyc_mp DSM_ctRdyCycCat_mp DSM_ctRdyCycCompr_mp DSM_ctRdyCycEGR_mp DSM_ctRdyCycFuel_mp DSM_ctRdyCycMisf_mp DSM_ctRdyCycOxSenHt_mp DSM_ctRdyCycOxSen_mp DSM_ctRdyLimCat_mp DSM_ctRdyLimCompr_mp DSM_ctRdyLimEGR_mp DSM_ctRdyLimFuel_mp DSM_ctRdyLimMisf_mp DSM_ctRdyLimOxSenHt_mp DSM_ctRdyLimOxSen_mp DSM_ctRdyPathsCat_mp DSM_ctRdyPathsCompr_mp DSM_ctRdyPathsEGR_mp DSM_ctRdyPathsFuel_mp DSM_ctRdyPathsMisf_mp DSM_ctRdyPathsOxSenHt_mp DSM_ctRdyPathsOxSen_mp DSM_ctRdyTstCat_mp DSM_ctRdyTstCompr_mp DSM_ctRdyTstEGR_mp DSM_ctRdyTstFuel_mp DSM_ctRdyTstMisf_mp DSM_ctRdyTstOxSenHt_mp DSM_ctRdyTstOxSen_mp /end OUT_MEASUREMENT
/end FUNCTION
/begin FUNCTION dsm_sy_conf "" /end FUNCTION
/begin FUNCTION dsm_uic ""
 /begin OUT_MEASUREMENT DfpErrCol_mp DfpZyfCol_mp DSCHED_numDefDfpArray_mp DSCHED_numOkDfpArray_mp DSM_ctFCMEntrySize_mp DSM_ctPath_mp DSM_tiDCDelay_mp FidCol_mp /end OUT_MEASUREMENT
/end FUNCTION
/begin FUNCTION dummy "" /begin DEF_CHARACTERISTIC AFSCD_tiLPFilt_C /end DEF_CHARACTERISTIC /end FUNCTION
/begin FUNCTION dummy_base "" /begin DEF_CHARACTERISTIC PFltCD_tPst_C PFlt_stSimOn_C /end DEF_CHARACTERISTIC /end FUNCTION
/begin FUNCTION dummy_base_msg ""
 /begin OUT_MEASUREMENT Dfp_HWEMonCom_Low Dfp_HWEMonEEPROM_Low Dfp_HWEMonUMaxSupply_Low Dfp_HWEMonUMinSupply_Low Dfp_LSUCDCircNernst0_Low Dfp_LSUCDCircPumpCur0_Low Dfp_LSUCDCircVirtGnd0_Low Dfp_LSUCDHeater0_Low Dfp_LSUCDHtCoup0_Low Dfp_LSUCDO20_Low Dfp_LSUCDO2Clb0_Low Dfp_LSUCDRiClb0_Low Dfp_LSUCDSPI0_Low Dfp_LSUCDWireIP0_Low Dfp_LSUCtlRiExc0_Low Dfp_LSUMon1Sens_Low Dfp_LSUMon2Sens_Low Dfp_SOPTst_Low EGPpCD_tPreTrbn1 EGPpCD_tPreTrbn2 EGRSCD_stAdapt FrmMng_rtrqInrAvrg LSUCD_stCircModeNewLow PFltCD_tPst PFlt_resFlowFlt PFlt_resFlowOfs PFlt_stSimOn /end OUT_MEASUREMENT
/end FUNCTION
/begin FUNCTION dummy_msg ""
 /begin OUT_MEASUREMENT AFSCD_dmAirPerTime2 AFSCD_mAirPerCyl1 AFSCD_mAirPerCyl2 BattCD_uFlt EGRSCD_rRelPos EGT_stDel InjCrv_qSmkTrqCor SOPTst_stShOffAR /end OUT_MEASUREMENT
/end FUNCTION
/begin FUNCTION eatscd "Umgebungslufttemperaturerfassung"
 /begin DEF_CHARACTERISTIC EATSCD_uSRCMin_C EATSCD_uSRCMax_C EATSCD_tLin_CUR EATSCD_DebCanDefDef_C EATSCD_DebCanDefOk_C EATSCD_DebCanInacDef_C EATSCD_DebCanInacOk_C EATSCD_DebCanNotImplDef_C EATSCD_DebCanNotImplOk_C EATSCD_DebSRCHighDef_C EATSCD_DebSRCHighOk_C EATSCD_DebSRCLowDef_C EATSCD_DebSRCLowOk_C EATSCD_dtRmpSlpUp_C EATSCD_dtRmpSlpDwn_C EATSCD_swtSigVal_C EATSCD_swtSigType_C EATSCD_stSensIDWord_C EATSCD_tDfl_C /end DEF_CHARACTERISTIC
 /begin IN_MEASUREMENT EATSCD_uRaw /end IN_MEASUREMENT
/end FUNCTION
/begin FUNCTION eatscd_msg "" /begin OUT_MEASUREMENT EATSCD_swtSig EATSCD_tAir EATSCD_tAirLin EATSCD_uRaw /end OUT_MEASUREMENT /end FUNCTION
/begin FUNCTION eatscd_uic "" /end FUNCTION
/begin FUNCTION ecocd ""
 /begin DEF_CHARACTERISTIC EcoCD_tiDebNeg_C EcoCD_tiDebPos_C EcoCD_swtInv_C EcoCD_swtSig_C /end DEF_CHARACTERISTIC
/end FUNCTION
/begin FUNCTION ecocd_msg "" /begin OUT_MEASUREMENT EcoCD_stDebVal EcoCD_stRawVal /end OUT_MEASUREMENT /end FUNCTION
/begin FUNCTION ecocd_uic "" /end FUNCTION
/begin FUNCTION ecu "" /begin DEF_CHARACTERISTIC ECU_vPrgThres_C /end DEF_CHARACTERISTIC /end FUNCTION
/begin FUNCTION ecuinit "" /begin DEF_CHARACTERISTIC EcuInit_tiTimestampTO_C /end DEF_CHARACTERISTIC /end FUNCTION
/begin FUNCTION ecuinit_msg "" /begin OUT_MEASUREMENT EcuInit_stProduction /end OUT_MEASUREMENT /end FUNCTION
/begin FUNCTION eepcd "Komponenten Treiber für EEPROM Zugriffe"
 /begin DEF_CHARACTERISTIC EEPCD_DsSWT1_AAG_C EEPCD_DsSWT1_KSK_C EEPCD_DsSWT1_SWTCC_C EEPCD_DsSWT2_CCTYPE_C EEPCD_DsSWT2_EATS_C EEPCD_DsSWT2_OTS_C /end DEF_CHARACTERISTIC
/end FUNCTION
/begin FUNCTION eepcd_msg ""
 /begin OUT_MEASUREMENT EEPCD_stErrSet EEPCD_stOptErrCodKwp EEPCD_stOptErrCodSet EEPCD_stOptNumKwp EEPCD_stOptNumSet /end OUT_MEASUREMENT
/end FUNCTION
/begin FUNCTION eepinit "EEPROM Erstinitialisierung"
 /begin DEF_CHARACTERISTIC EepInit_AirCtlTrm_C EepInit_dCodeTbl_C EepInit_dHwPartNum_C EepInit_dnCoVehLvl1_C EepInit_dnCoVehLvl2_C EepInit_dnSetpointTrm_C EepInit_dPartNr_C EepInit_dPrgVer_C EepInit_dSysName_C EepInit_factAltDemTrm_C EepInit_factSvrPmpDemTrm_C EepInit_factTrqACTrm_C EepInit_factTrqLimTrm_C EepInit_SWT1_C EepInit_SWT2_C EepInit_tGlwCtlTrm_C EepInit_trqStartTrm_C EepInit_vSpdLimMax_C /end DEF_CHARACTERISTIC
/end FUNCTION
/begin FUNCTION eepinit_develop "ließt Bloecke vom EEPROM und schreibt ein Byte an waelbare Positionen"
 /begin DEF_CHARACTERISTIC EepDev_dVal_C EepDev_dWrInitPattern_C EepDev_numBlock_C EepDev_numOffset_C EepDev_stJob_C /end DEF_CHARACTERISTIC
 /begin OUT_MEASUREMENT EepDev_dBlockVal_mp EepDev_stLastJob_mp /end OUT_MEASUREMENT
/end FUNCTION
/begin FUNCTION egppcd_gettpretrbn_1 ""
 /begin DEF_CHARACTERISTIC EGPpCD_uSRCMinTemp_C EGPpCD_uSRCMaxTemp_C EGPpCD_tLinTemp1_CUR EGPpCD_DebSRCHighDefTemp_C EGPpCD_DebSRCHighOkTemp_C EGPpCD_DebSRCLowDefTemp_C EGPpCD_DebSRCLowOkTemp_C EGPpCD_dtRmpSlpUpTemp_C EGPpCD_dtRmpSlpDwnTemp_C EGPpCD_swtActvTPreTrbn_C EGPpCD_stSensIDWordTemp_C EGPpCD_tDflTemp_C /end DEF_CHARACTERISTIC
 /begin IN_MEASUREMENT EGPpCD_uRawTempPreTrbn /end IN_MEASUREMENT
/end FUNCTION
/begin FUNCTION egppcd_gettpretrbn_1_msg "" /begin OUT_MEASUREMENT EGPpCD_tLinPreTrbn EGPpCD_tPreTrbn EGPpCD_uRawTempPreTrbn /end OUT_MEASUREMENT /end FUNCTION
/begin FUNCTION egppcd_gettpretrbn_1_uic "" /end FUNCTION
/begin FUNCTION egppcd_gettpretrbn_1_var "" /end FUNCTION
/begin FUNCTION egppcd_gettpretrbn_1_var_msg "" /end FUNCTION
/begin FUNCTION egppcd_gettpretrbn_1_var_uic "" /end FUNCTION
/begin FUNCTION egpp_prescalc "Berechnung des Abgasdruckes" /begin DEF_CHARACTERISTIC EGPp_pPstPFlt_MAP EGPp_tiPresFltPT1_C /end DEF_CHARACTERISTIC /begin IN_MEASUREMENT PFlt_dmEG PFlt_tFlt /end IN_MEASUREMENT /end FUNCTION
/begin FUNCTION egpp_prescalc_msg "" /begin OUT_MEASUREMENT EGPp_pPstPFlt /end OUT_MEASUREMENT /end FUNCTION
/begin FUNCTION egrcd "Komponententreiber Abgasrückführsteller"
 /begin DEF_CHARACTERISTIC EGRCD_DebExcTempDef_C EGRCD_DebExcTempOk_C EGRCD_DebNoLoadDef_C EGRCD_DebNoLoadOk_C EGRCD_DebShortCircBatDef_C EGRCD_DebShortCircBatOk_C EGRCD_DebShortCircGndDef_C EGRCD_DebShortCircGndOk_C EGRCD_stInvOut_C EGRCD_tiPer_C EGRCD_rCnv_MAP EGRCD_rOutMax_C EGRCD_rOutMin_C EGRCD_rTst_C EGRCD_stPwrStgActv_C EGRCD_stPwrStgDia_C EGRCD_swt_C EGRCD_tiBtwTst_C /end DEF_CHARACTERISTIC
 /begin IN_MEASUREMENT AirCtl_rEGR Eng_nAvrg /end IN_MEASUREMENT
/end FUNCTION
/begin FUNCTION egrcd_clntbyp "EGR-Kühler Bypass Ventilansteuerung"
 /begin DEF_CHARACTERISTIC EGRCD_CBVDebExcTempDef_C EGRCD_CBVDebExcTempOK_C EGRCD_CBVDebNoLoadDef_C EGRCD_CBVDebNoLoadOK_C EGRCD_CBVDebShortCircBatDef_C EGRCD_CBVDebShortCircBatOK_C EGRCD_CBVDebShortCircGndDef_C EGRCD_CBVDebShortCircGndOK_C EGRCD_stCBVInvOut_C EGRCD_stCBVPwrStgActv_C EGRCD_stCBVPwrStgDia_C /end DEF_CHARACTERISTIC
/end FUNCTION
/begin FUNCTION egrcd_msg "" /begin OUT_MEASUREMENT EGRCD_rOut EGRCD_stType /end OUT_MEASUREMENT /end FUNCTION
/begin FUNCTION egrcd_uic "" /begin DEF_CHARACTERISTIC EGRCD_rOut_Vector EGRCD_rOut_Channel /end DEF_CHARACTERISTIC /begin OUT_MEASUREMENT EGRCD_rCnv_mp EGRCD_rOutByp_mp EGRCD_stCBVOutHWE_mp /end OUT_MEASUREMENT /end FUNCTION
/begin FUNCTION egrcd_var "" /end FUNCTION
/begin FUNCTION egsys_dewdet "Taupunktbestimmungslogik"
 /begin DEF_CHARACTERISTIC EGSys_dmPlsThresLSU_C EGSys_facCldStrtLSU_C EGSys_facPlsLSU_C EGSys_facPlsThresLSU_C EGSys_numMaxCldStrt_C EGSys_swtDewDetShOff_C EGSys_tiDebLSU0_C EGSys_tiDebNrmTransOk_C EGSys_tiHtgDelLSU_C EGSys_tIntegIni_C EGSys_tiPlsLSU_C EGSys_tThresLSUAct_C EGSys_tWtEquiv_C EGSys_wLSUIKi_C EGSys_wThresLSU0_MAP /end DEF_CHARACTERISTIC
 /begin IN_MEASUREMENT EGSys_tEGLSUInpCrv0_mp Eng_tEng /end IN_MEASUREMENT
 /begin OUT_MEASUREMENT EGSys_cpEGLSU_mp EGSys_ctCldStrtLSU_mp EGSys_dwLSU_mp EGSys_stHtgLSULstTrp_mp EGSys_stHtgThresLSUHit_mp EGSys_stIntegIni_mp EGSys_stPlsLSU_mp EGSys_wLSU_mp EGSys_wThresLSUAct_mp EGSys_wThresLSUNoPls_mp EGSys_wThresLSUPls_mp EGSys_wThresLSU_mp /end OUT_MEASUREMENT
/end FUNCTION
/begin FUNCTION egsys_dewdet_msg "" /begin OUT_MEASUREMENT EGSys_stHtgLSU /end OUT_MEASUREMENT /end FUNCTION
/begin FUNCTION egsys_dewdet_uic "" /end FUNCTION
/begin FUNCTION egsys_mdlbackpres "Berechnung des Abgasgegendrucks" /begin DEF_CHARACTERISTIC EGSys_pExhGas_MAP EGSys_swtPresSel_C /end DEF_CHARACTERISTIC /begin IN_MEASUREMENT AFSCD_dmAirPerTime InjCtl_qSetUnBal /end IN_MEASUREMENT /end FUNCTION
/begin FUNCTION egsys_mdlbackpres_msg "" /begin OUT_MEASUREMENT EGSys_pExhGas /end OUT_MEASUREMENT /end FUNCTION
/begin FUNCTION egsys_mdlbackpres_uic "" /end FUNCTION
/begin FUNCTION egsys_modpretrbn "Modell des Abgasgegendrucks vor Turbine" /begin DEF_CHARACTERISTIC EGSys_dmExhGas_MAP EGSys_nTrbnMax_MAP EGSys_rPres_MAP /end DEF_CHARACTERISTIC
 /begin IN_MEASUREMENT AFSCD_dmAirPerTime EGSys_dmExhGas_mp EGSys_nTrbnMax_mp InjCtl_qCurr PCR_nTrbn PCR_rBPACD /end IN_MEASUREMENT
/end FUNCTION
/begin FUNCTION egsys_modpretrbn_msg "" /begin OUT_MEASUREMENT EGSys_pPreTrbn /end OUT_MEASUREMENT /end FUNCTION
/begin FUNCTION egsys_modpretrbn_sec_msg "" /begin OUT_MEASUREMENT EGSys_pPreTrbn2 /end OUT_MEASUREMENT /end FUNCTION
/begin FUNCTION egsys_modpretrbn_sec_uic "" /begin OUT_MEASUREMENT EGSys_dmExhGas2_mp EGSys_nTrbnMax2_mp EGSys_rPres2_mp /end OUT_MEASUREMENT /end FUNCTION
/begin FUNCTION egsys_modpretrbn_uic "" /begin OUT_MEASUREMENT EGSys_dmExhGas_mp EGSys_nTrbnMax_mp EGSys_rPres_mp /end OUT_MEASUREMENT /end FUNCTION
/begin FUNCTION egsys_tegco "Schnittstellenkoordinator für Abgastemperaturmodell"
 /begin DEF_CHARACTERISTIC EGSys_cndHtEG_CUR EGSys_cpEG_MAP EGSys_dmEGMinVal_C EGSys_numECU_C EGSys_numRdPosLSU2_C EGSys_numRdPosLSUWall_C EGSys_numRdPosLSU_C EGSys_numRdPosNSC2_C EGSys_numRdPosNSC_C EGSys_numRdPosOxiCat2_C EGSys_numRdPosOxiCat_C EGSys_numRdPosTrbn2_C EGSys_numRdPosTrbn_C EGSys_numRdPosTube2_C EGSys_numRdPosTube_C EGSys_vscDynEG_CUR EGSys_vscKinEG_CUR /end DEF_CHARACTERISTIC
 /begin IN_MEASUREMENT EGSys_rLmbdAprx /end IN_MEASUREMENT
 /begin OUT_MEASUREMENT EGSys_tEGInpCrv_mp EGSys_tEGLSUInpCrv0_mp EGSys_tMem_mp /end OUT_MEASUREMENT
/end FUNCTION
/begin FUNCTION egsys_tegco_msg ""
 /begin OUT_MEASUREMENT EGSys_dmEG EGSys_qMIStd EGSys_qPoIRgn EGSys_rLmbdAprx EGSys_tEGLSU EGSys_tEGPreNSC EGSys_tEGPreOxiCat EGSys_tEGPreTrbn EGSys_tEGPreTube EGSys_tWallLSU /end OUT_MEASUREMENT
/end FUNCTION
/begin FUNCTION egsys_tegco_uic "" /begin OUT_MEASUREMENT EGSys_tShOffTExcClnt_mp /end OUT_MEASUREMENT /end FUNCTION
/begin FUNCTION egsys_tegco_var "" /begin DEF_CHARACTERISTIC EGSys_swttAirSens_C EGSys_tExcClntDfl_C /end DEF_CHARACTERISTIC /end FUNCTION
/begin FUNCTION egsys_tegmod "Abgastemperaturmodell"
 /begin DEF_CHARACTERISTIC EGSys_dmAir_MAP EGSys_facAirMass_CUR EGSys_facCorrCldEng_CUR EGSys_facIAT_CUR EGSys_facStrtDlv_CUR EGSys_phiStrtDlv_MAP EGSys_tEngStat_C EGSys_tIAT_MAP EGSys_tManfDfl_C EGSys_tManfStat_MAP /end DEF_CHARACTERISTIC
 /begin IN_MEASUREMENT EGSys_phiDiffStrt_mp EGSys_rAirPerTime_mp EGSys_tDiffCldEng_mp EGSys_tDiffIAT_mp Eng_nAvrg InjCtl_qCurr /end IN_MEASUREMENT
/end FUNCTION
/begin FUNCTION egsys_tegmod_msg "" /begin OUT_MEASUREMENT EGSys_tManfStat /end OUT_MEASUREMENT /end FUNCTION
/begin FUNCTION egsys_tegmod_uic ""
 /begin OUT_MEASUREMENT EGSys_facAirMass_mp EGSys_facStrtDlv_mp EGSys_phiDiffStrt_mp EGSys_rAirPerTime_mp EGSys_tCorrIAT_mp EGSys_tCorrManf_mp EGSys_tDiffCldEng_mp EGSys_tDiffIAT_mp EGSys_tManfStat_mp /end OUT_MEASUREMENT
/end FUNCTION
/begin FUNCTION egsys_tnscmod "Temperaturmodell für NOx-Speicherkatalysator"
 /begin DEF_CHARACTERISTIC EGSys_cpNSC_C EGSys_tiPT1NSC_C EGSys_swtTimeNSC_C EGSys_tNSCDfl_C EGSys_tNSCExoIncr_MAP /end DEF_CHARACTERISTIC
 /begin IN_MEASUREMENT EGSys_rLmbdAprx EGSys_tAvrgNSC_mp /end IN_MEASUREMENT
/end FUNCTION
/begin FUNCTION egsys_tnscmod_msg "" /begin OUT_MEASUREMENT EGSys_tNSC /end OUT_MEASUREMENT /end FUNCTION
/begin FUNCTION egsys_tnscmod_uic ""
 /begin OUT_MEASUREMENT EGSys_cpEGNSC_mp EGSys_tAvrgNSC_mp EGSys_tNSCExoIncr_mp EGSys_tNSCStat_mp /end OUT_MEASUREMENT
/end FUNCTION
/begin FUNCTION egsys_toxicatmod "Temperaturmodel für Oxidationskatalysator"
 /begin DEF_CHARACTERISTIC EGSys_CalValFl_C EGSys_cpOxiCat_C EGSys_facTempCmb_CUR EGSys_tiPT1OxiCat_C EGSys_swtTimeOxiCat_C EGSys_tOxiCatDfl_C EGSys_tOxiCatExoIncr_MAP /end DEF_CHARACTERISTIC
 /begin IN_MEASUREMENT EGSys_rLmbdAprx EGSys_tAvrgOxiCat_mp /end IN_MEASUREMENT
/end FUNCTION
/begin FUNCTION egsys_toxicatmod_msg "" /begin OUT_MEASUREMENT EGSys_tOxiCat /end OUT_MEASUREMENT /end FUNCTION
/begin FUNCTION egsys_toxicatmod_uic ""
 /begin OUT_MEASUREMENT EGSys_cpEGOxiCat_mp EGSys_dwFlCmb_mp EGSys_tAvrgOxiCat_mp EGSys_tIncrPoI_mp EGSys_tOxiCatExoIncr_mp EGSys_tOxiCatStat_mp /end OUT_MEASUREMENT
/end FUNCTION
/begin FUNCTION egsys_tstrtcalc "Temperaturmodell für Fahrzeugstillstand"
 /begin DEF_CHARACTERISTIC EGSys_facTempClg_CUR EGSys_facTimeClg_CUR EGSys_swtTAirSens_C EGSys_tiHaValClnt_C EGSys_tiHaValNSC_C EGSys_tiHaValOxiCat_C EGSys_tiHaValTrb_C EGSys_tiHaValTube_C EGSys_tiOfsClg_C EGSys_tStrtCsRepl_C /end DEF_CHARACTERISTIC
 /begin IN_MEASUREMENT EGSys_rTempClnt_mp EGSys_rTimeTrb_mp /end IN_MEASUREMENT
 /begin OUT_MEASUREMENT EGSys_rTimeTube_mp /end OUT_MEASUREMENT
/end FUNCTION
/begin FUNCTION egsys_tstrtcalc_msg ""
 /begin OUT_MEASUREMENT EGSys_tNSCStrtCs EGSys_tOxiCatStrtCs EGSys_tTrbStrtCs EGSys_tTubeStrtCs /end OUT_MEASUREMENT
/end FUNCTION
/begin FUNCTION egsys_tstrtcalc_uic ""
 /begin OUT_MEASUREMENT EGSys_rTempClnt_mp EGSys_rTimeNSC_mp EGSys_rTimeOxiCat_mp EGSys_rTimeTrb_mp EGSys_tExcClntStrtCs_mp EGSys_tiClg_mp EGSys_tiRefClg_mp /end OUT_MEASUREMENT
/end FUNCTION
/begin FUNCTION egsys_ttrbmod ""
 /begin DEF_CHARACTERISTIC EGSys_cpChrg_C EGSys_etaChrg_MAP EGSys_tiChrgPT1_C EGSys_pValDfl_C EGSys_rTempAdbt_CUR EGSys_swtTimeChrg_C EGSys_tEGPstTrbnDfl_C /end DEF_CHARACTERISTIC
 /begin IN_MEASUREMENT AFSCD_dmAirPerTime EGSys_rPresCmpr_mp /end IN_MEASUREMENT
/end FUNCTION
/begin FUNCTION egsys_ttrbmod_msg "" /begin OUT_MEASUREMENT EGSys_tEGPstTrbn /end OUT_MEASUREMENT /end FUNCTION
/begin COMPU_METHOD AirMassPerCyl "Luftmasse pro Zylinder" RAT_FUNC "%6.3" "[mg/Hub Luft]" COEFFS 0 10 0 0 0 1 /end COMPU_METHOD
/begin COMPU_METHOD AirMassPerTime "Luftmasse pro Zeit" RAT_FUNC "%6.3" "[Kg/h Luft]" COEFFS 0 10 0 0 0 1 /end COMPU_METHOD
/begin COMPU_METHOD AngleCrS "Winkel Kurbelwelle" RAT_FUNC "%6.4" "[deg CrS]" COEFFS 0 42.6666666666667 0 0 0 1 /end COMPU_METHOD
/begin COMPU_METHOD Calory "Heizwert" RAT_FUNC "%6.2" "[J/g]" COEFFS 0 1 0 0 0 1 /end COMPU_METHOD
/begin COMPU_METHOD DfpName "Verbale Umrechnung für Fehlerpfadnamen" TAB_VERB "%6.3" "[-]" COMPU_TAB_REF DfpName /end COMPU_METHOD
/begin COMPU_VTAB DfpName "Verbale Umrechnung für Fehlerpfadnamen" TAB_VERB 369 0 "Dfp_unused" 1 "Dfp_ACCCDWrongCoded" 2 "Dfp_ACCD" 3 "Dfp_ACCD_PAC" 4 "Dfp_ACCD_pCAN" 5 "Dfp_ACCD_trqCAN" 6 "Dfp_ACCnotPlaus" 7 "Dfp_ADCMon" 8 "Dfp_AFSCD_AirTempDcyc" 9 "Dfp_AFSCD_PlOffsDrft" 10 "Dfp_AFSCD_PlSetyDrft" 11 "Dfp_AFSCD_Plaus" 12 "Dfp_AFSCD_SRCAirTemp" 13 "Dfp_AFSCD_SRCAirm" 14 "Dfp_AFSCD_SRCAirm2" 15 "Dfp_AFSCD_SRCBatt" 16 "Dfp_AFSCD_SRCCorrAirm" 17 "Dfp_AFSCD_SRCRawAirm" 18 "Dfp_AFSCD_SRCRefSigPer" 19 "Dfp_AFVCD_Actr" 20 "Dfp_AOHtCDHt1" 21 "Dfp_AOHtCDHt2" 22 "Dfp_AOHtCDHt3" 23 "Dfp_APP1" 24 "Dfp_APP2" 25 "Dfp_APPCD_KickDown" 26 "Dfp_APPSync" 27 "Dfp_APP_Npl" 28 "Dfp_APSCD" 29 "Dfp_AccPedPlausBrk" 30 "Dfp_AddPCD" 31 "Dfp_AddPCDTnkLvl" 32 "Dfp_AddPCDTnkLvlDef" 33 "Dfp_AirCtl_GovDev" 34 "Dfp_AirbCDCrash" 35 "Dfp_AirbCDCrashCrCtl" 36 "Dfp_AirbCDCrashPSP" 37 "Dfp_AltCDExc" 38 "Dfp_AltCD_Load" 39 "Dfp_AltPwrCan" 40 "Dfp_BPACD_Max" 41 "Dfp_BPACD_Min" 42 "Dfp_BPACD_SigNpl" 43 "Dfp_BPAExcSensTemp" 44 "Dfp_BPANotLrn" 45 "Dfp_BPASCDDcyc" 46 "Dfp_BPASCDPeriod" 47 "Dfp_BPSCD" 48 "Dfp_BPSCDPlaus" 49 "Dfp_BattCD" 50 "Dfp_BrkCD" 51 "Dfp_BrkCDdynPl" 52 "Dfp_CANA" 53 "Dfp_CANB" 54 "Dfp_CANBus1" 55 "Dfp_CANBus2" 56 "Dfp_CANBus3" 57 "Dfp_CANC" 58 "Dfp_CANErrActA" 59 "Dfp_CANErrActB" 60 "Dfp_CANErrActC" 61 "Dfp_COTSCD" 62 "Dfp_CTSCD" 63 "Dfp_CTSCDCanInac" 64 "Dfp_CTSCDCanSig" 65 "Dfp_Clg_DynTst" 66 "Dfp_CmbChbMisfire1" 67 "Dfp_CmbChbMisfire2" 68 "Dfp_CmbChbMisfire3" 69 "Dfp_CmbChbMisfire4" 70 "Dfp_CmbChbMisfire5" 71 "Dfp_CmbChbMisfire6" 72 "Dfp_CmbChbMisfireMul" 73 "Dfp_CoVMDCSh" 74 "Dfp_CoVMDCSp" 75 "Dfp_CoVehEcoErr" 76 "Dfp_CoVehLvl2" 77 "Dfp_ConvCD" 78 "Dfp_ConvCD_ConvErr" 79 "Dfp_CrCtlPLmpDef" 80 "Dfp_CrCtlPShutOff" 81 "Dfp_CrCtlPTlrDef" 82 "Dfp_CrCtlPanErr" 83 "Dfp_CrCtlPanSwtErr" 84 "Dfp_CtApCD" 85 "Dfp_CtTCD" 86 "Dfp_CtT_Mon" 87 "Dfp_DifftrqLimErrPat" 88 "Dfp_EATSCD" 89 "Dfp_EATSCDCanInac" 90 "Dfp_EATSCDCanSig" 91 "Dfp_EEPCDVarMng" 92 "Dfp_EGPpCDTPreTrbn" 93 "Dfp_EGPpCDTPreTrbn1" 94 "Dfp_EGRCD_CBV" 95 "Dfp_EGRCD_Max" 96 "Dfp_EGRCD_Min" 97 "Dfp_EGRCD_SigNpl" 98 "Dfp_EMCCD_GTL1" 99 "Dfp_EMCCD_GTL2" 100 "Dfp_EMCCD_MLS1" 101 "Dfp_EMCCD_MLS2" 102 "Dfp_ETClbInj1" 103 "Dfp_ETClbInj2" 104 "Dfp_ETClbInj3" 105 "Dfp_ETClbInj4" 106 "Dfp_ETClbInj5" 107 "Dfp_ETClbInj6" 108 "Dfp_EngMCaS1" 109 "Dfp_EngMCrS1" 110 "Dfp_EngMOfsCaSCrS" 111 "Dfp_EngMonIrrCmb" 112 "Dfp_EngPrt" 113 "Dfp_ErLpCDMILReqON" 114 "Dfp_FMTC_NonMonotonMap" 115 "Dfp_FQlSCD" 116 "Dfp_FTSCD" 117 "Dfp_FTSCDNpl" 118 "Dfp_FanCD_Fan1Ctlr1" 119 "Dfp_FanCD_Fan1Ctlr2" 120 "Dfp_FanCD_Fan2Ctlr1" 121 "Dfp_FanCD_Fan2Ctlr2" 122 "Dfp_FanCD_FanCtlr1" 123 "Dfp_FanCD_FanCtlr2" 124 "Dfp_FanCD_OutFanCtlr1" 125 "Dfp_FanCD_OutFanCtlr2" 126 "Dfp_FlPpCD" 127 "Dfp_FlSCDT1" 128 "Dfp_FrmMngAAGNpl" 129 "Dfp_FrmMngAAGTO" 130 "Dfp_FrmMngAC1Npl" 131 "Dfp_FrmMngAC1TO" 132 "Dfp_FrmMngACCNpl" 133 "Dfp_FrmMngACCTO" 134 "Dfp_FrmMngAIRBGNpl" 135 "Dfp_FrmMngAIRBGTO" 136 "Dfp_FrmMngAWD1Npl" 137 "Dfp_FrmMngAWD1TO" 138 "Dfp_FrmMngBEM1Npl" 139 "Dfp_FrmMngBEM1TO" 140 "Dfp_FrmMngBRK1Npl" 141 "Dfp_FrmMngBRK1TO" 142 "Dfp_FrmMngBRK2Npl" 143 "Dfp_FrmMngBRK2TO" 144 "Dfp_FrmMngBRK8Npl" 145 "Dfp_FrmMngBRK8TO" 146 "Dfp_FrmMngCANVerErr" 147 "Dfp_FrmMngCCSel" 148 "Dfp_FrmMngCCTLNpl" 149 "Dfp_FrmMngCCTLTO" 150 "Dfp_FrmMngCHRGR1Npl" 151 "Dfp_FrmMngCHRGR1TO" 152 "Dfp_FrmMngCHRGR2Npl" 153 "Dfp_FrmMngCHRGR2TO" 154 "Dfp_FrmMngChrgr1A" 155 "Dfp_FrmMngChrgr1C" 156 "Dfp_FrmMngChrgr1N" 157 "Dfp_FrmMngChrgr1T" 158 "Dfp_FrmMngChrgr1V" 159 "Dfp_FrmMngChrgr2A" 160 "Dfp_FrmMngChrgr2C" 161 "Dfp_FrmMngChrgr2N" 162 "Dfp_FrmMngChrgr2T" 163 "Dfp_FrmMngChrgr2V" 164 "Dfp_FrmMngDIA1Npl" 165 "Dfp_FrmMngDIA1TO" 166 "Dfp_FrmMngDSP1Npl" 167 "Dfp_FrmMngDSP1TO" 168 "Dfp_FrmMngDSP2Npl" 169 "Dfp_FrmMngDSP2TO" 170 "Dfp_FrmMngESCUNpl" 171 "Dfp_FrmMngESCUTO" 172 "Dfp_FrmMngGW1Npl" 173 "Dfp_FrmMngGW1TO" 174 "Dfp_FrmMngILMNpl" 175 "Dfp_FrmMngILMTO" 176 "Dfp_FrmMngNIV1WrngCod" 177 "Dfp_FrmMngNIVEAU1Npl" 178 "Dfp_FrmMngNIVEAU1TO" 179 "Dfp_FrmMngSTIGNNpl" 180 "Dfp_FrmMngStIgnTO" 181 "Dfp_FrmMngTOSNpl" 182 "Dfp_FrmMngTOSTO" 183 "Dfp_FrmMngTSC1Npl" 184 "Dfp_FrmMngTSC1TO" 185 "Dfp_FrmMngTSC2Npl" 186 "Dfp_FrmMngTSC2TO" 187 "Dfp_FrmMngTSC3Npl" 188 "Dfp_FrmMngTSC3TO" 189 "Dfp_GearbxASTh" 190 "Dfp_GearbxASTl" 191 "Dfp_GearbxTSC" 192 "Dfp_GearbxTypeMTErr" 193 "Dfp_GlwCD_Actr" 194 "Dfp_GlwCD_DIAG" 195 "Dfp_GlwCD_Error1" 196 "Dfp_GlwCD_Error2" 197 "Dfp_GlwCD_EvalCod" 198 "Dfp_GlwCD_GSK" 199 "Dfp_GlwCD_Lamp" 200 "Dfp_GlwCD_LampCan" 201 "Dfp_GlwCD_PLUG0" 202 "Dfp_GlwCD_PLUG1" 203 "Dfp_GlwCD_PLUG2" 204 "Dfp_GlwCD_PLUG3" 205 "Dfp_GlwCD_PLUG4" 206 "Dfp_GlwCD_PLUG5" 207 "Dfp_GlwCD_SFD" 208 "Dfp_HDSCD" 209 "Dfp_HWEMonCom" 210 "Dfp_HWEMonEEPROM" 211 "Dfp_HWEMonRcyLocked" 212 "Dfp_HWEMonRcySuppressed" 213 "Dfp_HWEMonRcyVisible" 214 "Dfp_HWEMonUMaxSupply" 215 "Dfp_HWEMonUMinSupply" 216 "Dfp_IATSCD" 217 "Dfp_IFCD" 218 "Dfp_ImmCtl" 219 "Dfp_InjCrv_InjLim" 220 "Dfp_InjVCDActrChrg" 221 "Dfp_InjVCDActrVolt" 222 "Dfp_InjVCDClsBank1" 223 "Dfp_InjVCDClsBank2" 224 "Dfp_InjVCDMonCab" 225 "Dfp_InjVCDMonSwt" 226 "Dfp_InjVCDShOffDCDC" 227 "Dfp_InjVCDUBuf" 228 "Dfp_InjVCD_CY370Ampl" 229 "Dfp_InjVlvBnk1A" 230 "Dfp_InjVlvBnk1B" 231 "Dfp_InjVlvBnk2A" 232 "Dfp_InjVlvBnk2B" 233 "Dfp_InjVlvChipA" 234 "Dfp_InjVlvChipB" 235 "Dfp_InjVlvCyl1A" 236 "Dfp_InjVlvCyl1B" 237 "Dfp_InjVlvCyl1C" 238 "Dfp_InjVlvCyl2A" 239 "Dfp_InjVlvCyl2B" 240 "Dfp_InjVlvCyl2C" 241 "Dfp_InjVlvCyl3A" 242 "Dfp_InjVlvCyl3B" 243 "Dfp_InjVlvCyl3C" 244 "Dfp_InjVlvCyl4A" 245 "Dfp_InjVlvCyl4B" 246 "Dfp_InjVlvCyl4C" 247 "Dfp_InjVlvCyl5A" 248 "Dfp_InjVlvCyl5B" 249 "Dfp_InjVlvCyl5C" 250 "Dfp_InjVlvCyl6A" 251 "Dfp_InjVlvCyl6B" 252 "Dfp_InjVlvCyl6C" 253 "Dfp_InjVlvCyl7A" 254 "Dfp_InjVlvCyl7B" 255 "Dfp_InjVlvCyl7C" 256 "Dfp_InjVlvCyl8A" 257 "Dfp_InjVlvCyl8B" 258 "Dfp_InjVlvCyl8C" 259 "Dfp_LSUCDCircNernst0" 260 "Dfp_LSUCDCircPumpCur0" 261 "Dfp_LSUCDCircVirtGnd0" 262 "Dfp_LSUCDHeater0" 263 "Dfp_LSUCDHtCoup0" 264 "Dfp_LSUCDO20" 265 "Dfp_LSUCDO2Clb0" 266 "Dfp_LSUCDRiClb0" 267 "Dfp_LSUCDSPI0" 268 "Dfp_LSUCDSPIBattLow0" 269 "Dfp_LSUCDWireIP0" 270 "Dfp_LSUCtlRiExc0" 271 "Dfp_LSUMon1Sens" 272 "Dfp_LSUMon2Sens" 273 "Dfp_MIL" 274 "Dfp_MRlyCD" 275 "Dfp_MeUnCDNoLoad" 276 "Dfp_MeUnCDSCBat" 277 "Dfp_MeUnCDSCGnd" 278 "Dfp_MeUnCD_ADC" 279 "Dfp_Montr" 280 "Dfp_OTSCD" 281 "Dfp_OTSCDCanInac" 282 "Dfp_OTSCDCanSig" 283 "Dfp_OvRMon" 284 "Dfp_OvRMonCrCtlP" 285 "Dfp_OvRMonSigA" 286 "Dfp_OxiCCDTPre" 287 "Dfp_OxiCCDTPre1" 288 "Dfp_PCR_BalGovDev" 289 "Dfp_PCR_GovDev" 290 "Dfp_PCVCDNoLoad" 291 "Dfp_PCVCDSCBat" 292 "Dfp_PCVCDSCGnd" 293 "Dfp_PCVCD_ADC" 294 "Dfp_PFltCDHtg" 295 "Dfp_PFltCDHtg1" 296 "Dfp_PFltCDPDiff" 297 "Dfp_PFltCDPDiff1" 298 "Dfp_PFltCDTPre" 299 "Dfp_PFltCDTPst" 300 "Dfp_PFltCDTempPre" 301 "Dfp_PFltCDTempPre1" 302 "Dfp_PFltChar" 303 "Dfp_PFltEngPrt" 304 "Dfp_PFltPresDynPlaus" 305 "Dfp_PFltPresSens" 306 "Dfp_PFltPresSensHsLn" 307 "Dfp_PFltPresSensSot" 308 "Dfp_PFltRgnPerm" 309 "Dfp_PFltTempDwnStrm" 310 "Dfp_PFltTempSens" 311 "Dfp_PFltTempUpStrm" 312 "Dfp_PSPCD_Actr" 313 "Dfp_PrpCtlvLimErrPat" 314 "Dfp_RailCD" 315 "Dfp_RailCDOfsTst" 316 "Dfp_RailMeUn0" 317 "Dfp_RailMeUn1" 318 "Dfp_RailMeUn2" 319 "Dfp_RailMeUn3" 320 "Dfp_RailMeUn4" 321 "Dfp_RailPCV0" 322 "Dfp_RailPCV1" 323 "Dfp_RailPCV2" 324 "Dfp_RailPCV3" 325 "Dfp_RailPCV4" 326 "Dfp_RailPCV5" 327 "Dfp_SOPTst" 328 "Dfp_SSpMon1" 329 "Dfp_SSpMon2" 330 "Dfp_SSpMon3" 331 "Dfp_StrtCDOffRly" 332 "Dfp_StrtCDOnRly" 333 "Dfp_StrtCtlIlsNotPlaus" 334 "Dfp_StrtCtlT50ROneRly1" 335 "Dfp_StrtCtlT50ROneRly2" 336 "Dfp_StrtCtlT50RZero" 337 "Dfp_SysLamp" 338 "Dfp_T15CD" 339 "Dfp_TPUMon" 340 "Dfp_TTSCD" 341 "Dfp_TVACD_Max" 342 "Dfp_TVACD_Min" 343 "Dfp_TVACD_SigNpl" 344 "Dfp_TVACD_stLineDef" 345 "Dfp_UAcc_CodeBitErr" 346 "Dfp_USAp_DataVariant" 347 "Dfp_USAp_FuncCodeRead" 348 "Dfp_VSACD1_Max" 349 "Dfp_VSACD1_Min" 350 "Dfp_VSACD1_SigNpl" 351 "Dfp_VSACD2_Max" 352 "Dfp_VSACD2_Min" 353 "Dfp_VSACD2_SigNpl" 354 "Dfp_VSAExcSensTemp1" 355 "Dfp_VSAExcSensTemp2" 356 "Dfp_VSANotLrn1" 357 "Dfp_VSANotLrn2" 358 "Dfp_VSASCDDcyc1" 359 "Dfp_VSASCDDcyc2" 360 "Dfp_VSASCDPeriod1" 361 "Dfp_VSASCDPeriod2" 362 "Dfp_VSSCD1" 363 "Dfp_VSSCD2" 364 "Dfp_VSSCD4" 365 "Dfp_VSSCDBrkLowVltg" 366 "Dfp_VSSCDCAN" 367 "Dfp_VSSCDNpl" 368 "Dfp_WdCom" /end COMPU_VTAB
/begin COMPU_METHOD DtyCyc "Tastverhaeltnis" RAT_FUNC "%6.4" "[%]" COEFFS 0 100 0 0 0 1 /end COMPU_METHOD
/begin COMPU_METHOD Energy "Energie in Jouls" RAT_FUNC "%6.2" "[kJ]" COEFFS 0 1 0 0 0 1 /end COMPU_METHOD
/begin COMPU_METHOD EngN "Motordrehzahl" RAT_FUNC "%6.2" "[rpm]" COEFFS 0 1 0 0 0 1 /end COMPU_METHOD
/begin COMPU_METHOD Fact "Faktor mit Auflösung 1 / 8192, hauptsächlich für einen Faktorenbereich 0...1 verwendet" RAT_FUNC "%6.5" "[-]" COEFFS 0 8192 0 0 0 1 /end COMPU_METHOD
/begin COMPU_METHOD Fact1 "Faktor mit Auflösung 0,01 (100 mal höherer Bereich als Fact)" RAT_FUNC "%6.4" "[-]" COEFFS 0 128 0 0 0 1 /end COMPU_METHOD
/begin COMPU_METHOD FCMChkCause "Verbale Umrechnung für Message für DSM internen gebrauch (unterstützung bei DSM problemen)" TAB_VERB "%6.3" "" COMPU_TAB_REF FCMChkCause /end COMPU_METHOD
/begin COMPU_VTAB FCMChkCause "Verbale Umrechnung für Message für DSM internen gebrauch (unterstützung bei DSM problemen)" TAB_VERB 15 1 "fcmEnd npl: fcmEnd > FCM_TAB_SIZE" 2 "Erf and Typ npl" 3 "fcmEnd npl: line == fcmEnd" 4 "Mem set but no entry" 5 "No Mem set but entry" 6 "Mem npl class blocked" 7 "class npl" 8 "Mil npl 1" 9 "Mil npl 2" 10 "Scatt npl" 11 "Flc npl" 12 "Hlc npl" 13 "Fcm blocked" 14 "complement npl" 15 "dpfToClear are blocked" /end COMPU_VTAB
/begin COMPU_METHOD HeatCapacity "Waermekapazitaet einer Substanz" RAT_FUNC "%6.3" "[J/K]" COEFFS 0 10 0 0 0 1 /end COMPU_METHOD
/begin COMPU_METHOD InjMass "Einspritzmenge" RAT_FUNC "%6.4" "[mg/hub]" COEFFS 0 100 0 0 0 1 /end COMPU_METHOD
/begin COMPU_METHOD InjMassCyc "Einspritzmenge pro Zyklus (mg/Zyklus)" RAT_FUNC "%6.4" "[mg/cyc]" COEFFS 0 100 0 0 0 1 /end COMPU_METHOD
/begin COMPU_METHOD InjMassInj "Einspritzmenge pro Einspritzung (mg/Einspritzung)" RAT_FUNC "%6.4" "[mg/inj]" COEFFS 0 100 0 0 0 1 /end COMPU_METHOD
/begin COMPU_METHOD InjTime_ms "Einspritzzeit in Millisekunden" RAT_FUNC "%6.4" "ms" COEFFS 0 100 0 0 0 1 /end COMPU_METHOD
/begin COMPU_METHOD lambda "Lambda" RAT_FUNC "%6.5" "[-]" COEFFS 0 1000 0 0 0 1 /end COMPU_METHOD
/begin COMPU_METHOD OneToOne "eins zu eins (physikalischer Wert ist gleich dem internen Wert)" RAT_FUNC "%6.2" "[-]" COEFFS 0 1 0 0 0 1 /end COMPU_METHOD
/begin COMPU_METHOD Period "Periodendauer" RAT_FUNC "%6.3" "[ms]" COEFFS 0 10 0 0 0 1 /end COMPU_METHOD
/begin COMPU_METHOD Prc "Prozent, gleiche interne Auflösung wie Fact, aber Darstellung in Prozent (0...100%)" RAT_FUNC "%6.4" "[%]" COEFFS 0 100 0 0 0 1 /end COMPU_METHOD
/begin COMPU_METHOD Pres_hPa "Druck (angezeigt in [hPa])" RAT_FUNC "%6.2" "[hPa]" COEFFS 0 1 0 0 0 1 /end COMPU_METHOD
/begin COMPU_METHOD Pwr1 "Leistung mit Hoher Aufloesung" RAT_FUNC "%6.3" "[W]" COEFFS 0 10 0 0 0 1 /end COMPU_METHOD
/begin COMPU_METHOD Pwr_kW_Sec "Leistungsaenderungsrate in kW/s" RAT_FUNC "%6.4" "[kW/s]" COEFFS 0 100 0 0 0 1 /end COMPU_METHOD
/begin COMPU_METHOD RdyOnMilEnable "Verbale Umrechnung für DSM_RdyOnMilEnable_C" TAB_VERB "%6.3" "" COMPU_TAB_REF RdyOnMilEnable /end COMPU_METHOD
/begin COMPU_VTAB RdyOnMilEnable "Verbale Umrechnung für DSM_RdyOnMilEnable_C" TAB_VERB 2 0 "normal" 1 "set all Rdy bits on Mil ON" /end COMPU_VTAB
/begin COMPU_METHOD Res_hPaHrPerCM "Strömungswiderstand [hPa h/m3]" RAT_FUNC "%6.5" "[hPa/(m^3/h)]" COEFFS 0 1000 0 0 0 1 /end COMPU_METHOD
/begin COMPU_METHOD RmpTemp "Rampengradient für Temperatur" RAT_FUNC "%6.4" "[deg C/s]" COEFFS 0 655.36 0 0 0 1 /end COMPU_METHOD
/begin COMPU_METHOD rTrqCAN "Momentenverhältnis für CAN" RAT_FUNC "%6.3" "[%]" COEFFS 0 2.54999910750031 0 0 0 1 /end COMPU_METHOD
/begin COMPU_METHOD SpecificHeat "spezifische Waermekapazitaet einer Substanz" RAT_FUNC "%7.6" "[J/g/K]" COEFFS 0 10000 0 0 0 1 /end COMPU_METHOD
/begin COMPU_METHOD TempDiff_Kelv "Offsettemperatur dargestellt in [K]" RAT_FUNC "%6.3" "[ deg C ]" COEFFS 0 10 0 0 0 1 /end COMPU_METHOD
/begin COMPU_METHOD Temp_Cels "Temperatur dargestellt in °C (gleiche interne Darstellung wie Temp_Kelv)" RAT_FUNC "%6.1" "[deg C]" COEFFS 0 10 2731.4 0 0 1 /end COMPU_METHOD
/begin COMPU_METHOD TimeDeb "Entprellzeit in Millisekunden für Libraryfunktion Debounce" RAT_FUNC "%6.1" "[ms]" COEFFS 0 0.1 0 0 0 1 /end COMPU_METHOD
/begin COMPU_METHOD TimeDelay_s "Zeitkonstante T1 (in s) für PT1, DT1, etc." RAT_FUNC "%9.3" "[s]" COEFFS 0 0 1 0 0.00023283064365387 0 /end COMPU_METHOD
/begin COMPU_METHOD TimeDsmTsf "Skalierung der DSM Schwerezähler Werte" RAT_FUNC "%6.0" "[ms]" COEFFS 0 0.005 0 0 0 1 /end COMPU_METHOD
/begin COMPU_METHOD Time_ms "Zeit in ms für Fehlerentprellung (DSM) und SW-Timer" RAT_FUNC "%6.1" "[ms]" COEFFS 0 0.1 0 0 0 1 /end COMPU_METHOD
/begin COMPU_METHOD Time_s "Zeit in s für Fehlerentprellung (DSM) und SW-Timer" RAT_FUNC "%6.4" "[s]" COEFFS 0 100 0 0 0 1 /end COMPU_METHOD
/begin COMPU_METHOD Trq "Motormoment" RAT_FUNC "%6.3" "[Nm]" COEFFS 0 10 0 0 0 1 /end COMPU_METHOD
/begin COMPU_METHOD TurboN "Turboladerdrehzahl" RAT_FUNC "%6.1" "[rpm]" COEFFS 0 1 0 0 0 10 /end COMPU_METHOD
/begin COMPU_METHOD Vel "Fahrzeuggeschwindigkeit, gleiche interne Auflösung wie Vel_SI" RAT_FUNC "%6.4" "[km/h]" COEFFS 0 100 0 0 0 1 /end COMPU_METHOD
/begin COMPU_METHOD Volt "Spannung in V (von ADC)" RAT_FUNC "%6.2" "[mV]" COEFFS 0 0.2046 0 0 0 1 /end COMPU_METHOD
/begin COMPU_METHOD defaultAscii "" RAT_FUNC "%6.2" "" COEFFS 0 1 0 0 0 1 /end COMPU_METHOD
/begin RECORD_LAYOUT Kf_Xs16_Ys16_Ws16 NO_AXIS_PTS_X 1 SWORD NO_AXIS_PTS_Y 2 SWORD AXIS_PTS_X 3 SWORD INDEX_INCR DIRECT AXIS_PTS_Y 4 SWORD INDEX_INCR DIRECT FNC_VALUES 5 SWORD COLUMN_DIR DIRECT /end RECORD_LAYOUT
/begin RECORD_LAYOUT Kl_Xs16_Ws16 NO_AXIS_PTS_X 1 SWORD AXIS_PTS_X 2 SWORD INDEX_INCR DIRECT FNC_VALUES 3 SWORD COLUMN_DIR DIRECT /end RECORD_LAYOUT
/begin RECORD_LAYOUT Ktx FNC_VALUES 1 UBYTE COLUMN_DIR DIRECT /end RECORD_LAYOUT
/begin RECORD_LAYOUT Kwb_Ws16 FNC_VALUES 1 SWORD COLUMN_DIR DIRECT /end RECORD_LAYOUT
/begin RECORD_LAYOUT Kwb_Wu16 FNC_VALUES 1 UWORD COLUMN_DIR DIRECT /end RECORD_LAYOUT
/begin RECORD_LAYOUT Kwb_Wu32 FNC_VALUES 1 ULONG COLUMN_DIR DIRECT /end RECORD_LAYOUT
/begin RECORD_LAYOUT Kwb_Wu8 FNC_VALUES 1 UBYTE COLUMN_DIR DIRECT /end RECORD_LAYOUT
/begin RECORD_LAYOUT Kw_Ws16 FNC_VALUES 1 SWORD COLUMN_DIR DIRECT /end RECORD_LAYOUT
/begin RECORD_LAYOUT Kw_Wu16 FNC_VALUES 1 UWORD COLUMN_DIR DIRECT /end RECORD_LAYOUT
/begin RECORD_LAYOUT Kw_Wu32 FNC_VALUES 1 ULONG COLUMN_DIR DIRECT /end RECORD_LAYOUT
/begin RECORD_LAYOUT Kw_Wu8 FNC_VALUES 1 UBYTE COLUMN_DIR DIRECT /end RECORD_LAYOUT
/end MODULE
/end PROJECT
