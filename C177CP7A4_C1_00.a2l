ASAP2_VERSION 1 3
/begin PROJECT C177 "EDC16CP"
/begin HEADER "" VERSION "VCP7A3" PROJECT_NO C177 /end HEADER
/begin MODULE DIM ""
/begin MOD_COMMON "" BYTE_ORDER MSB_FIRST ALIGNMENT_BYTE 1 ALIGNMENT_WORD 2 ALIGNMENT_LONG 4 ALIGNMENT_FLOAT32_IEEE 4 /end MOD_COMMON
/begin CHARACTERISTIC CTSCD_uSRCMinZoom_C "SRC-Min-Wassertemperatur bei Zoom-in" VALUE 0x1C9818 Kw_Ws16 5200.391 Volt 0.00 5200.391 FORMAT "%8.3" EXTENDED_LIMITS -160156.4 160151.5 /end CHARACTERISTIC
/begin CHARACTERISTIC CTSCD_uSRCMaxZoom_C "SRC-Max-Wassertemperatur bei Zoom-in" VALUE 0x1C981A Kw_Ws16 5200.391 Volt 0.00 5200.391 FORMAT "%8.3" EXTENDED_LIMITS -160156.4 160151.5 /end CHARACTERISTIC
/begin CHARACTERISTIC CTSCD_tLinZoom_CUR "Linearisierungskennlinie für WTF-Sensor bei zoom-in" CURVE 0x1C981C Kl_Xs16_Ws16 250.0000 Temp_Cels -50.14000 199.8600 FORMAT "%8.4" EXTENDED_LIMITS -3549.940 3003.560
 /begin AXIS_DESCR STD_AXIS CTSCD_uRawZoom Volt 25 0.00 5200.391 FORMAT "%8.3" EXTENDED_LIMITS -160156.4 160151.5 DEPOSIT ABSOLUTE /end AXIS_DESCR
/end CHARACTERISTIC
/begin CHARACTERISTIC CTSCD_uSRCMin_C "Minimalwert für SRC WTF-Sensor" VALUE 0x1C9882 Kw_Ws16 5200.391 Volt 0.00 5200.391 FORMAT "%8.3" EXTENDED_LIMITS -160156.4 160151.5 /end CHARACTERISTIC
/begin CHARACTERISTIC CTSCD_uSRCMax_C "Maximalwert für SRC WTF-Sensor" VALUE 0x1C9884 Kw_Ws16 5200.391 Volt 0.00 5200.391 FORMAT "%8.3" EXTENDED_LIMITS -160156.4 160151.5 /end CHARACTERISTIC
/begin CHARACTERISTIC CTSCD_tLin_CUR "Linearisierungskennlinie für WTF-Sensor" CURVE 0x1C9886 Kl_Xs16_Ws16 250.0000 Temp_Cels -50.14000 199.8600 FORMAT "%8.4" EXTENDED_LIMITS -3549.940 3003.560
 /begin AXIS_DESCR STD_AXIS CTSCD_uRaw Volt 25 0.00 5200.391 FORMAT "%8.3" EXTENDED_LIMITS -160156.4 160151.5 DEPOSIT ABSOLUTE /end AXIS_DESCR
/end CHARACTERISTIC
/begin CHARACTERISTIC CTSCD_DebCanDefDef_C "Fehlerentprellung  Wassertemperatursensor defekt über CAN" VALUE 0x1C98EC Kw_Wu16 655350.0 Time_ms 0.00 655350.0 FORMAT "%8.1" /end CHARACTERISTIC
/begin CHARACTERISTIC CTSCD_DebCanDefOk_C "Heilungsentprellung  Wassertemperatursensor defekt über CAN" VALUE 0x1C98EE Kw_Wu16 655350.0 Time_ms 0.00 655350.0 FORMAT "%8.1" /end CHARACTERISTIC
/begin CHARACTERISTIC CTSCD_DebCanInacDef_C "Fehlerentprellung  Wassertemperatursensor ungenau über CAN" VALUE 0x1C98F0 Kw_Wu16 655350.0 Time_ms 0.00 655350.0 FORMAT "%8.1" /end CHARACTERISTIC
/begin CHARACTERISTIC CTSCD_DebCanInacOk_C "Heilungsentprellung  Wassertemperatursensor ungenau über CAN" VALUE 0x1C98F2 Kw_Wu16 655350.0 Time_ms 0.00 655350.0 FORMAT "%8.1" /end CHARACTERISTIC
/begin CHARACTERISTIC CTSCD_DebCanNotImplDef_C "Fehlerentprellung  Wassertemperatursensor nicht verbaut über CAN" VALUE 0x1C98F4 Kw_Wu16 655350.0 Time_ms 0.00 655350.0 FORMAT "%8.1" /end CHARACTERISTIC
/begin CHARACTERISTIC CTSCD_DebCanNotImplOk_C "Heilungsentprellung  Wassertemperatursensor nicht verbaut über CAN" VALUE 0x1C98F6 Kw_Wu16 655350.0 Time_ms 0.00 655350.0 FORMAT "%8.1" /end CHARACTERISTIC
/begin CHARACTERISTIC CTSCD_DebSRCHighDef_C "WTF Fehlerentprellzeit fuer SRC-High" VALUE 0x1C98F8 Kw_Wu16 655350.0 Time_ms 0.00 655350.0 FORMAT "%8.1" /end CHARACTERISTIC
/begin CHARACTERISTIC CTSCD_DebSRCHighOk_C "WTF Heilungsentprellzeit fuer SRC-High" VALUE 0x1C98FA Kw_Wu16 655350.0 Time_ms 0.00 655350.0 FORMAT "%8.1" /end CHARACTERISTIC
/begin CHARACTERISTIC CTSCD_DebSRCLowDef_C "WTF Fehlerentprellzeit fuer SRC-Low" VALUE 0x1C98FC Kw_Wu16 655350.0 Time_ms 0.00 655350.0 FORMAT "%8.1" /end CHARACTERISTIC
/begin CHARACTERISTIC CTSCD_DebSRCLowOk_C "WTF Heilungsentprellzeit fuer SRC-Low" VALUE 0x1C98FE Kw_Wu16 655350.0 Time_ms 0.00 655350.0 FORMAT "%8.1" /end CHARACTERISTIC
/begin CHARACTERISTIC CTSCD_dtClntDelta_C "Offset für Ersatzwert Wassertemperatur über ADC" VALUE 0x1C992C Kw_Ws16 25.00000 TempDiff_Kelv 0.00 25.00000 FORMAT "%8.5" EXTENDED_LIMITS -3276.800 3276.700 /end CHARACTERISTIC
/begin CHARACTERISTIC CTSCD_FTS4CTS_C "Verwendung eines anderen Sensorwertes für defekten Wassertemperatursensor" VALUE 0x1C992E Kw_Wu8 1.000 OneToOne 0.00 1.000 FORMAT "%5.3" EXTENDED_LIMITS 0.00 255.0 /end CHARACTERISTIC
/begin CHARACTERISTIC CTSCD_dtRmpSlpUp_C "Rampensteigung bei Heilung/Vorgabewert für WTF" VALUE 0x1C9900 Kw_Wu32 6553599.99847 RmpTemp 0.00 6553599.99847 FORMAT "%13.5" /end CHARACTERISTIC
/begin CHARACTERISTIC CTSCD_dtRmpSlpDwn_C "Rampensteigung bei Heilung/Vorgabewert für WTF" VALUE 0x1C9904 Kw_Wu32 6553599.99847 RmpTemp 0.00 6553599.99847 FORMAT "%13.5" /end CHARACTERISTIC
/begin CHARACTERISTIC CTSCD_stInvPullup_C "Hardware-Ausgang Invertierung Pullup-Widerstand" VALUE 0x1C9908 Kw_Wu8 1.000 OneToOne 0.00 1.000 FORMAT "%5.3" EXTENDED_LIMITS 0.00 255.0 /end CHARACTERISTIC
/begin CHARACTERISTIC CTSCD_swtPullupOn_C "Schalter Zoom-Funktion aktivieren" VALUE 0x1C9909 Kw_Wu8 1.000 OneToOne 0.00 1.000 FORMAT "%5.3" EXTENDED_LIMITS 0.00 255.0 /end CHARACTERISTIC
/begin CHARACTERISTIC CTSCD_swtSigVal_C "Signalquelle ADC/CAN" VALUE 0x1C990A Kw_Wu8 1.000 OneToOne 0.00 1.000 FORMAT "%5.3" EXTENDED_LIMITS 0.00 255.0 /end CHARACTERISTIC
/begin CHARACTERISTIC CTSCD_swtTempDflVal_C "Schalter zur Verwendung von FTS oder OTS für defekten CTS" VALUE 0x1C990B Kw_Wu8 1.000 OneToOne 0.00 1.000 FORMAT "%5.3" EXTENDED_LIMITS 0.00 255.0 /end CHARACTERISTIC
/begin CHARACTERISTIC CTSCD_swtTempDflType_C "Schaltertyp für CTSCD_swtTempDflVal_C" VALUE 0x1C990C Kw_Wu8 2.000 OneToOne 0.00 2.000 FORMAT "%5.3" EXTENDED_LIMITS 0.00 255.0 /end CHARACTERISTIC
/begin CHARACTERISTIC CTSCD_tCTSACOffMax_C "Obergrenze für Anforderung Kühlwassertemperatur-Klimakompressor AUS" VALUE 0x1C990E Kw_Ws16 100.0000 Temp_Cels -0.04000000 99.96000 FORMAT "%8.4" EXTENDED_LIMITS -3549.940 3003.560 /end CHARACTERISTIC
/begin CHARACTERISTIC CTSCD_tCTSACOffMin_C "Untergrenze für Anforderung Kühlwassertemperatur- Klimakompressor AUS" VALUE 0x1C9910 Kw_Ws16 100.0000 Temp_Cels -0.04000000 99.96000 FORMAT "%8.4" EXTENDED_LIMITS -3549.940 3003.560 /end CHARACTERISTIC
/begin CHARACTERISTIC CTSCD_tCTSACRedMax_C "Obergrenze für Anforderung Kühlwassertemperatur-Klimakompressor Leistungsreduzierung" VALUE 0x1C9912 Kw_Ws16 100.0000 Temp_Cels -0.04000000 99.96000 FORMAT "%8.4" EXTENDED_LIMITS -3549.940 3003.560 /end CHARACTERISTIC
/begin CHARACTERISTIC CTSCD_tCTSACRedMin_C "Untergrenze für Anforderung Kühlwassertemperatur- Klimakompressor Leistungsreduzierung" VALUE 0x1C9914 Kw_Ws16 100.0000 Temp_Cels -0.04000000 99.96000 FORMAT "%8.4" EXTENDED_LIMITS -3549.940 3003.560 /end CHARACTERISTIC
/begin CHARACTERISTIC CTSCD_tCTSPrtMax_C "Obergrenze für Anforderung Kühlwassertemperatur-Heißleuchte" VALUE 0x1C9916 Kw_Ws16 100.0000 Temp_Cels -0.04000000 99.96000 FORMAT "%8.4" EXTENDED_LIMITS -3549.940 3003.560 /end CHARACTERISTIC
/begin CHARACTERISTIC CTSCD_tCTSPrtMin_C "Untergrenze für Anforderung Kühlwassertemperatur-Heißleuchte" VALUE 0x1C9918 Kw_Ws16 100.0000 Temp_Cels -0.04000000 99.96000 FORMAT "%8.4" EXTENDED_LIMITS -3549.940 3003.560 /end CHARACTERISTIC
/begin CHARACTERISTIC CTSCD_tCTSWrnMax_C "Obergrenze für Anforderung Kühlwassertemperatur-Heißleuchtenvorwarnung" VALUE 0x1C991A Kw_Ws16 100.0000 Temp_Cels -0.04000000 99.96000 FORMAT "%8.4" EXTENDED_LIMITS -3549.940 3003.560 /end CHARACTERISTIC
/begin CHARACTERISTIC CTSCD_tCTSWrnMin_C "Untergrenze für Anforderung Kühlwassertemperatur-Heißleuchtenvorwarnung" VALUE 0x1C991C Kw_Ws16 100.0000 Temp_Cels -0.04000000 99.96000 FORMAT "%8.4" EXTENDED_LIMITS -3549.940 3003.560 /end CHARACTERISTIC
/begin CHARACTERISTIC CTSCD_tCTSZoomOnMax_C "Zoom-Funktion obere Hystereseschwelle" VALUE 0x1C991E Kw_Ws16 100.0000 Temp_Cels -0.04000000 99.96000 FORMAT "%8.4" EXTENDED_LIMITS -3549.940 3003.560 /end CHARACTERISTIC
/begin CHARACTERISTIC CTSCD_tCTSZoomOnMin_C "Zoom-Funktion untere Hystereseschwelle" VALUE 0x1C9920 Kw_Ws16 100.0000 Temp_Cels -0.04000000 99.96000 FORMAT "%8.4" EXTENDED_LIMITS -3549.940 3003.560 /end CHARACTERISTIC
/begin CHARACTERISTIC CTSCD_tiZoomOFF_C "Sensorschutz-Timer: Sensor inaktiv" VALUE 0x1C9922 Kw_Wu16 200000.0 Time_ms 0.00 200000.0 FORMAT "%8.1" EXTENDED_LIMITS 0.00 655350.0 /end CHARACTERISTIC
/begin CHARACTERISTIC CTSCD_tiZoomON_C "Sensorschutz-Timer: Sensor aktiv" VALUE 0x1C9924 Kw_Wu16 200000.0 Time_ms 0.00 200000.0 FORMAT "%8.1" EXTENDED_LIMITS 0.00 655350.0 /end CHARACTERISTIC
/begin CHARACTERISTIC CTSCD_stSensIDWord_C "Geberkennwort WTF-Sensor" VALUE 0x1C9926 Kw_Wu16 65535.00 OneToOne 0.00 65535.00 FORMAT "%8.2" /end CHARACTERISTIC
/begin CHARACTERISTIC CTSCD_tDfl_C "Vorgabewert bei defektem WTF-Sensor" VALUE 0x1C9928 Kw_Ws16 200.0000 Temp_Cels -50.14000 149.8600 FORMAT "%8.4" EXTENDED_LIMITS -3549.940 3003.560 /end CHARACTERISTIC
/begin CHARACTERISTIC CtTCD_DebExcTempDef_C "Fehlerentprellzeit für Übertemperatur" VALUE 0x1C9A8C Kw_Wu16 655350.0 Time_ms 0.00 655350.0 FORMAT "%8.1" /end CHARACTERISTIC
/begin CHARACTERISTIC CtTCD_DebExcTempOk_C "Heilungsentprellzeit für Übertemperatur" VALUE 0x1C9A8E Kw_Wu16 655350.0 Time_ms 0.00 655350.0 FORMAT "%8.1" /end CHARACTERISTIC
/begin CHARACTERISTIC CtTCD_DebNoLoadDef_C "Fehlerentprellzeit für Lastabfall" VALUE 0x1C9A90 Kw_Wu16 655350.0 Time_ms 0.00 655350.0 FORMAT "%8.1" /end CHARACTERISTIC
/begin CHARACTERISTIC CtTCD_DebNoLoadOk_C "Heilungsentprellzeit für Lastabfall" VALUE 0x1C9A92 Kw_Wu16 655350.0 Time_ms 0.00 655350.0 FORMAT "%8.1" /end CHARACTERISTIC
/begin CHARACTERISTIC CtTCD_DebShortCircBatDef_C "Fehlerentprellzeitzeit für Kurzschluß nach Batteriespannung" VALUE 0x1C9A94 Kw_Wu16 655350.0 Time_ms 0.00 655350.0 FORMAT "%8.1" /end CHARACTERISTIC
/begin CHARACTERISTIC CtTCD_DebShortCircBatOk_C "Heilungsentprellzeit für Kurzschluß nach Batteriespannung" VALUE 0x1C9A96 Kw_Wu16 655350.0 Time_ms 0.00 655350.0 FORMAT "%8.1" /end CHARACTERISTIC
/begin CHARACTERISTIC CtTCD_DebShortCircGndDef_C "Fehlerentprellzeit für Kurzschluß nach Masse" VALUE 0x1C9A98 Kw_Wu16 655350.0 Time_ms 0.00 655350.0 FORMAT "%8.1" /end CHARACTERISTIC
/begin CHARACTERISTIC CtTCD_DebShortCircGndOk_C "Heilungsentprellzeit für Kurzschluß nach Masse" VALUE 0x1C9A9A Kw_Wu16 655350.0 Time_ms 0.00 655350.0 FORMAT "%8.1" /end CHARACTERISTIC
/begin CHARACTERISTIC CtTCD_stInvOut_C "Invertierung des Ausgangssignals" VALUE 0x1C9A9C Kw_Wu8 1.000 OneToOne 0.00 1.000 FORMAT "%5.3" EXTENDED_LIMITS 0.00 255.0 /end CHARACTERISTIC
/begin CHARACTERISTIC CtTCD_tiPer_C "Periodendauer des Ausgangssignal der Kühlmitteltermostatendstufe" VALUE 0x1C9A9E Kw_Ws16 10.60000 Period 1.100000 11.70000 FORMAT "%8.5" EXTENDED_LIMITS -3276.800 3276.700 /end CHARACTERISTIC
/begin CHARACTERISTIC CtTCD_rTst_C "Tastverhältnis für Endstufentest bei erkanntem Endstufenfehler, um festzustellen, ob der Fehler noch vorhanden ist" VALUE 0x1C9AA0 Kw_Ws16 100.0000 DtyCyc 0.00 100.0000 FORMAT "%8.4" EXTENDED_LIMITS -327.6800 327.6700 /end CHARACTERISTIC
/begin CHARACTERISTIC CtTCD_tiBtwTst_C "Zeit zwischen Endstufentest bei erkanntem Endstufenfehler" VALUE 0x1C9AA2 Kw_Wu16 29900.00 Time_ms 100.0000 30000.00 FORMAT "%8.2" EXTENDED_LIMITS 0.00 655350.0 /end CHARACTERISTIC
/begin CHARACTERISTIC CtTCtl_dcycCtl_MAP "Steuertastverhältnis des Kühlmittelthermostaten" MAP 0x1C9AA4 Kf_Xs16_Ys16_Ws16 100.0000 DtyCyc 0.00 100.0000 FORMAT "%8.4" EXTENDED_LIMITS -327.6800 327.6700
 /begin AXIS_DESCR STD_AXIS CtTCtl_tClntDes Temp_Cels 8 -53.14000 226.8600 FORMAT "%8.4" EXTENDED_LIMITS -3549.940 3003.560 DEPOSIT ABSOLUTE /end AXIS_DESCR
 /begin AXIS_DESCR STD_AXIS CtTCtl_dtClntDiff TempDiff_Kelv 8 -100.0000 300.0000 FORMAT "%8.4" EXTENDED_LIMITS -3276.800 3276.700 DEPOSIT ABSOLUTE /end AXIS_DESCR
/end CHARACTERISTIC
/begin CHARACTERISTIC CtTCtl_dcycIHiLim_C "oberes Limit des I-Glieds" VALUE 0x1C9B48 Kw_Ws16 200.0000 DtyCyc -100.0000 100.0000 FORMAT "%8.4" EXTENDED_LIMITS -327.6800 327.6700 /end CHARACTERISTIC
/begin CHARACTERISTIC CtTCtl_dcycILoLim_C "unteres Limit des I-Glieds" VALUE 0x1C9B4A Kw_Ws16 200.0000 DtyCyc -100.0000 100.0000 FORMAT "%8.4" EXTENDED_LIMITS -327.6800 327.6700 /end CHARACTERISTIC
/begin CHARACTERISTIC CtTCtl_dcycThstHiLim_C "oberes Limit des Ansteuertastverhältnisses" VALUE 0x1C9B4C Kw_Ws16 100.0000 DtyCyc 0.00 100.0000 FORMAT "%8.4" EXTENDED_LIMITS -327.6800 327.6700 /end CHARACTERISTIC
/begin CHARACTERISTIC CtTCtl_dcycThstLoLim_C "unteres Limit des Ansteuertastverhältnisses" VALUE 0x1C9B4E Kw_Ws16 100.0000 DtyCyc 0.00 100.0000 FORMAT "%8.4" EXTENDED_LIMITS -327.6800 327.6700 /end CHARACTERISTIC
/begin CHARACTERISTIC CtTCtl_dcycPreset_C "Vorgabewert bei Status ""AFTERRUN"" des Kühlerlüfters" VALUE 0x1C9B50 Kw_Ws16 100.0000 DtyCyc 0.00 100.0000 FORMAT "%8.4" EXTENDED_LIMITS -327.6800 327.6700 /end CHARACTERISTIC
/begin CHARACTERISTIC CtTCtl_dcycShutOff_C "Vorgabewert bei Status ""POSTAFTERRUN"" der Kühlerlüftersteuerung" VALUE 0x1C9B52 Kw_Ws16 100.0000 DtyCyc 0.00 100.0000 FORMAT "%8.4" EXTENDED_LIMITS -327.6800 327.6700 /end CHARACTERISTIC
/begin CHARACTERISTIC CtTCtl_dcycStrt_C "Vorgabewert bei Motorstart" VALUE 0x1C9B54 Kw_Ws16 100.0000 DtyCyc 0.00 100.0000 FORMAT "%8.4" EXTENDED_LIMITS -327.6800 327.6700 /end CHARACTERISTIC
/begin CHARACTERISTIC CtTCtl_dcycThst_Vector "Konfigurationslabel für Bypass message" VALUE 0x1C0A62 Kw_Wu8 255.0 OneToOne 0.00 255.0 FORMAT "%5.1" /end CHARACTERISTIC
/begin CHARACTERISTIC CtTCtl_dcycThst_Channel "Konfigurationslabel für Bypass message" VALUE 0x1C0A63 Kw_Wu8 255.0 OneToOne 0.00 255.0 FORMAT "%5.1" /end CHARACTERISTIC
/begin CHARACTERISTIC CtTCtl_RglIKi_C "Ki für Eingangssignale innerhalb des Fensters" VALUE 0x1C9B58 Kw_Wu32 9000.00000838 Ki_Temp2Dcyc 0.00 9000.00000838 FORMAT "%13.8" EXTENDED_LIMITS 0.00 99999.9999767 /end CHARACTERISTIC
/begin CHARACTERISTIC CtTCtl_RglIKiPos_C "Ki für Eingangssignaländerungen über die positive Fenstergrenze" VALUE 0x1C9B5C Kw_Wu32 9000.00000838 Ki_Temp2Dcyc 0.00 9000.00000838 FORMAT "%13.8" EXTENDED_LIMITS 0.00 99999.9999767 /end CHARACTERISTIC
/begin CHARACTERISTIC CtTCtl_RglIKiNeg_C "Ki für Eingangssignaländerungen über die negative Fenstergrenze" VALUE 0x1C9B60 Kw_Wu32 9000.00000838 Ki_Temp2Dcyc 0.00 9000.00000838 FORMAT "%13.8" EXTENDED_LIMITS 0.00 99999.9999767 /end CHARACTERISTIC
/begin CHARACTERISTIC CtTCtl_RglIWinPos_C "Positive Fenstergrenze des I-Gliedes" VALUE 0x1C9B64 Kw_Ws16 400.0000 TempDiff_Kelv -200.0000 200.0000 FORMAT "%8.4" EXTENDED_LIMITS -3276.800 3276.700 /end CHARACTERISTIC
/begin CHARACTERISTIC CtTCtl_RglIWinNeg_C "Negative Fenstergrenze des I-Gliedes" VALUE 0x1C9B66 Kw_Ws16 400.0000 TempDiff_Kelv -200.0000 200.0000 FORMAT "%8.4" EXTENDED_LIMITS -3276.800 3276.700 /end CHARACTERISTIC
/begin CHARACTERISTIC CtTCtl_tiPT1Neg_C "Zeitkonstante für negative Signaländerungen des PT1-Glieds" VALUE 0x1C9B68 Kw_Wu32 4294.9673 TimeDelay_s 0.0000010000000 4294.9673 FORMAT "%9.4" /end CHARACTERISTIC
/begin CHARACTERISTIC CtTCtl_tiPT1Pos_C "Zeitkonstante für positive Signaländerungen des PT1-Glieds" VALUE 0x1C9B6C Kw_Wu32 4294.9673 TimeDelay_s 0.0000010000000 4294.9673 FORMAT "%9.4" /end CHARACTERISTIC
/begin CHARACTERISTIC CtTCtl_swtCtlVal_C "Aktivierung/Deaktivierung der Kühlmittelthermostatsteuerung" VALUE 0x1C9B70 Kw_Wu8 1.000 OneToOne 0.00 1.000 FORMAT "%5.3" EXTENDED_LIMITS 0.00 255.0 /end CHARACTERISTIC
/begin CHARACTERISTIC CtTCtl_swtCtlType_C "Type des Softwareschalters für die Aktivierung/Deaktivierung der Kühlmittelthermostatsteuerung" VALUE 0x1C9B71 Kw_Wu8 0.00 OneToOne 2.000 2.000 FORMAT "%5.3" EXTENDED_LIMITS 0.00 255.0 /end CHARACTERISTIC
/begin CHARACTERISTIC CtTCtl_tBase_MAP "Drehzahl- und Einspritzmengenabhängiger Kühlmitteltemp.sollwert" MAP 0x1C9B72 Kf_Xs16_Ys16_Ws16 280.0000 Temp_Cels -53.14000 226.8600 FORMAT "%8.4" EXTENDED_LIMITS -3549.940 3003.560
 /begin AXIS_DESCR STD_AXIS Eng_nAvrg EngN 8 0.00 6500.000 FORMAT "%8.3" EXTENDED_LIMITS -32768.00 32767.00 DEPOSIT ABSOLUTE /end AXIS_DESCR
 /begin AXIS_DESCR STD_AXIS CoEng_trqInrSet Trq 8 0.00 1000.000 FORMAT "%8.3" EXTENDED_LIMITS -3276.800 3276.700 DEPOSIT ABSOLUTE /end AXIS_DESCR
/end CHARACTERISTIC
/begin CHARACTERISTIC CtTCtl_tClntCor2_MAP "Korrekturkennfeld Geschwindigkeit vs. Lufttemperatur" MAP 0x1C9C16 Kf_Xs16_Ys16_Ws16 280.0000 Temp_Cels -53.14000 226.8600 FORMAT "%8.4" EXTENDED_LIMITS -3549.940 3003.560
 /begin AXIS_DESCR STD_AXIS VSSCD_v Vel 8 0.00 260.0000 FORMAT "%8.4" EXTENDED_LIMITS -327.6800 327.6700 DEPOSIT ABSOLUTE /end AXIS_DESCR
 /begin AXIS_DESCR STD_AXIS CtTCtl_tAirCurr_mp Temp_Cels 8 -53.14000 76.86000 FORMAT "%8.5" EXTENDED_LIMITS -3549.940 3003.560 DEPOSIT ABSOLUTE /end AXIS_DESCR
/end CHARACTERISTIC
/begin CHARACTERISTIC CtTCtl_tClntCor3_CUR "Korrekturkennlinie: Öltemperatur" CURVE 0x1C9CBA Kl_Xs16_Ws16 280.0000 Temp_Cels -53.14000 226.8600 FORMAT "%8.4" EXTENDED_LIMITS -3549.940 3003.560
 /begin AXIS_DESCR STD_AXIS OTSCD_tEngOil Temp_Cels 5 -53.14000 276.8600 FORMAT "%8.4" EXTENDED_LIMITS -3549.940 3003.560 DEPOSIT ABSOLUTE /end AXIS_DESCR
/end CHARACTERISTIC
/begin CHARACTERISTIC CtTCtl_tClntCor4_CUR "Korrekturkennlinie: Heizungsanforderung" CURVE 0x1C9CD0 Kl_Xs16_Ws16 280.0000 Temp_Cels -53.14000 226.8600 FORMAT "%8.4" EXTENDED_LIMITS -3549.940 3003.560
 /begin AXIS_DESCR STD_AXIS HDSCD_prcAir Prc 5 0.00 100.0000 FORMAT "%8.4" EXTENDED_LIMITS -327.6800 327.6700 DEPOSIT ABSOLUTE /end AXIS_DESCR
/end CHARACTERISTIC
/begin CHARACTERISTIC CtTCtl_tClntCor5_CUR "2. Korrekturkennlinie: Heizungsanforderung" CURVE 0x1C9CE6 Kl_Xs16_Ws16 280.0000 Temp_Cels -53.14000 226.8600 FORMAT "%8.4" EXTENDED_LIMITS -3549.940 3003.560
 /begin AXIS_DESCR STD_AXIS HDSCD_prcAir Prc 5 0.00 100.0000 FORMAT "%8.4" EXTENDED_LIMITS -327.6800 327.6700 DEPOSIT ABSOLUTE /end AXIS_DESCR
/end CHARACTERISTIC
/begin CHARACTERISTIC CtTCtl_tClntCor6_CUR "Korrekturkennlinie: gestufte Kühlleistungsanhebung vom Getriebesteuergerät" CURVE 0x1C9CFC Kl_Xs16_Ws16 200.0000 Temp_Cels -50.14000 149.8600 FORMAT "%8.4" EXTENDED_LIMITS -3549.940 3003.560
 /begin AXIS_DESCR STD_AXIS FrmMng_stClgGearbx OneToOne 4 0.00 3.000 FORMAT "%5.3" EXTENDED_LIMITS 0.00 255.0 DEPOSIT ABSOLUTE /end AXIS_DESCR
/end CHARACTERISTIC
/begin CHARACTERISTIC CtTCtl_tClntCurrPreset_C "Vorgabewert der Kühlmitteltemperatur bei angezeigtem Fehler durch Fid_CtTCtl_tClntCur_Err" VALUE 0x1C9D0E Kw_Ws16 280.0000 Temp_Cels -53.14000 226.8600 FORMAT "%8.4" EXTENDED_LIMITS -3549.940 3003.560 /end CHARACTERISTIC
/begin CHARACTERISTIC CtTCtl_tClntDes3Preset_C "Vorgabewert anstelle der Kennlinie CtTCtl_tClntCor3_CUR wenn die Serviceintervallberechnung abgeschalten ist" VALUE 0x1C9D10 Kw_Ws16 280.0000 Temp_Cels -53.14000 226.8600 FORMAT "%8.4" EXTENDED_LIMITS -3549.940 3003.560 /end CHARACTERISTIC
/begin CHARACTERISTIC CtTCtl_tClntDes4Preset_C "Vorgabewert des Kühlmitteltemp.sollwertes wenn keine Serviceintervallauswertung vorhanden ist" VALUE 0x1C9D12 Kw_Ws16 280.0000 Temp_Cels -53.14000 226.8600 FORMAT "%8.4" EXTENDED_LIMITS -3549.940 3003.560 /end CHARACTERISTIC
/begin CHARACTERISTIC CtTCtl_tClntDes5Preset_C "Vorgabewert des Kühlmitteltemp.sollwertes wenn eine Klimaanlage vorhanden ist" VALUE 0x1C9D14 Kw_Ws16 280.0000 Temp_Cels -53.14000 226.8600 FORMAT "%8.4" EXTENDED_LIMITS -3549.940 3003.560 /end CHARACTERISTIC
/begin CHARACTERISTIC CtTCtl_tClntDes6Preset_C "Vorgabewert wenn keine gestufte Kühlleistungsanhebung vom Getriebesteuergerät vorhanden sein soll" VALUE 0x1C9D16 Kw_Ws16 280.0000 Temp_Cels -53.14000 226.8600 FORMAT "%8.4" EXTENDED_LIMITS -3549.940 3003.560 /end CHARACTERISTIC
/begin CHARACTERISTIC CtTCtl_tClntDesPreset_C "Vorgabewert für Kühlmittelthermostat" VALUE 0x1C9D18 Kw_Ws16 280.0000 Temp_Cels -53.14000 226.8600 FORMAT "%8.4" EXTENDED_LIMITS -3549.940 3003.560 /end CHARACTERISTIC
/begin CHARACTERISTIC CtTCtl_tCOTmax_C "Temperaturschwellwert des Kühlmittelsensors am Kühlerauslaß (COTS)" VALUE 0x1C9D1A Kw_Ws16 280.0000 Temp_Cels -53.14000 226.8600 FORMAT "%8.4" EXTENDED_LIMITS -3549.940 3003.560 /end CHARACTERISTIC
/begin CHARACTERISTIC CtTCtl_tCOTSHysHi_C "Oberer Hysterseschwelle für die Wassertemperatur am Kühleraustritt" VALUE 0x1C9D1C Kw_Ws16 200.0000 Temp_Cels -50.14000 149.8600 FORMAT "%8.4" EXTENDED_LIMITS -3549.940 3003.560 /end CHARACTERISTIC
/begin CHARACTERISTIC CtTCtl_tCOTSHysLo_C "Untere Hysterseschwelle für die Wassertemperatur am Kühleraustritt" VALUE 0x1C9D1E Kw_Ws16 200.0000 Temp_Cels -50.14000 149.8600 FORMAT "%8.4" EXTENDED_LIMITS -3549.940 3003.560 /end CHARACTERISTIC
/begin CHARACTERISTIC CtT_dtConsum_CUR "Wärmezufuhrinkremente verbrauchsabhängig" CURVE 0x1C9930 Kl_Xs16_Ws16 0.7999756 Temp_Kelv_Sec_CtT_Mod 0.00 0.7999756 FORMAT "%9.7" EXTENDED_LIMITS -0.8000000 0.7999756
 /begin AXIS_DESCR STD_AXIS CtT_dvolFlConsumPT1_mp FlConsum_l_h 12 0.00 200.0000 FORMAT "%8.4" EXTENDED_LIMITS -327.6800 327.6700 DEPOSIT ABSOLUTE /end AXIS_DESCR
/end CHARACTERISTIC
/begin CHARACTERISTIC CtT_dtEnv_CUR "Wärmeabfuhrinkremente abhängig von Wärmeabgabe an Umgebung" CURVE 0x1C9962 Kl_Xs16_Ws16 0.7999756 Temp_Kelv_Sec_CtT_Mod 0.00 0.7999756 FORMAT "%9.7" EXTENDED_LIMITS -0.8000000 0.7999756
 /begin AXIS_DESCR STD_AXIS CtT_tAir_mp Temp_Cels 15 -50.14000 199.8600 FORMAT "%8.4" EXTENDED_LIMITS -3549.940 3003.560 DEPOSIT ABSOLUTE /end AXIS_DESCR
/end CHARACTERISTIC
/begin CHARACTERISTIC CtT_dtHt1_C "Wärmezufuhrinkrement für aktiven Zuheizer 1" VALUE 0x1C99A0 Kw_Ws16 0.7999756 Temp_Kelv_Sec_CtT_Mod 0.00 0.7999756 FORMAT "%9.7" EXTENDED_LIMITS -0.8000000 0.7999756 /end CHARACTERISTIC
/begin CHARACTERISTIC CtT_dtHt2_C "Wärmezufuhrinkrement für aktiven Zuheizer 2" VALUE 0x1C99A2 Kw_Ws16 0.7999756 Temp_Kelv_Sec_CtT_Mod 0.00 0.7999756 FORMAT "%9.7" EXTENDED_LIMITS -0.8000000 0.7999756 /end CHARACTERISTIC
/begin CHARACTERISTIC CtT_dtHt3_C "Waermezufuhrinkrement für aktiven Zuheizer 3" VALUE 0x1C99A4 Kw_Ws16 0.7999756 Temp_Kelv_Sec_CtT_Mod 0.00 0.7999756 FORMAT "%9.7" EXTENDED_LIMITS -0.8000000 0.7999756 /end CHARACTERISTIC
/begin CHARACTERISTIC CtT_MonDebNplDef_C "Fehlerentprellzeit für Npl" VALUE 0x1C99A6 Kw_Wu16 655140.0 Time_ms 0.00 655140.0 FORMAT "%8.1" EXTENDED_LIMITS 0.00 655350.0 /end CHARACTERISTIC
/begin CHARACTERISTIC CtT_MonDebNplOK_C "Fehlerheilzeit für Npl" VALUE 0x1C99A8 Kw_Wu16 655140.0 Time_ms 0.00 655140.0 FORMAT "%8.1" EXTENDED_LIMITS 0.00 655350.0 /end CHARACTERISTIC
/begin CHARACTERISTIC CtT_nThres_C "Minimale Drehzahl zur Freigabe der Thermostatdiagnose" VALUE 0x1C99AA Kw_Ws16 5960.000 EngN 40.00000 6000.000 FORMAT "%8.3" EXTENDED_LIMITS -32768.00 32767.00 /end CHARACTERISTIC
/begin CHARACTERISTIC CtT_tAirCorr_MAP "Druckkorrektur Lufttemperatur Ansaugtrakt" MAP 0x1C99AC Kf_Xs16_Ys16_Ws16 250.0000 Temp_Cels -50.14000 199.8600 FORMAT "%8.4" EXTENDED_LIMITS -3549.940 3003.560
 /begin AXIS_DESCR STD_AXIS IATSCD_tAir Temp_Cels 8 -50.14000 199.8600 FORMAT "%8.4" EXTENDED_LIMITS -3549.940 3003.560 DEPOSIT ABSOLUTE /end AXIS_DESCR
 /begin AXIS_DESCR STD_AXIS BPSCD_pLin Pres_hPa 8 0.00 3500.000 FORMAT "%8.3" EXTENDED_LIMITS -32768.00 32767.00 DEPOSIT ABSOLUTE /end AXIS_DESCR
/end CHARACTERISTIC
/begin CHARACTERISTIC CtT_tClntLo_C "Min. Grenze für Wassertemperaturüberprüfung OK" VALUE 0x1C9A50 Kw_Ws16 200.0000 Temp_Cels -50.14000 149.8600 FORMAT "%8.4" EXTENDED_LIMITS -3549.940 3003.560 /end CHARACTERISTIC
/begin CHARACTERISTIC CtT_tClntMod_C "Modelltemperaturschwelle Start Wassertemperaturüberprüfung" VALUE 0x1C9A52 Kw_Ws16 200.0000 Temp_Cels -50.14000 149.8600 FORMAT "%8.4" EXTENDED_LIMITS -3549.940 3003.560 /end CHARACTERISTIC
/begin CHARACTERISTIC CtT_tClntMod_CUR "Einflussveränderung Wassertemperatur für Umgebungstemperaturmodell" CURVE 0x1C9A54 Kl_Xs16_Ws16 250.0000 Temp_Cels -50.14000 199.8600 FORMAT "%8.4" EXTENDED_LIMITS -3549.940 3003.560
 /begin AXIS_DESCR STD_AXIS CtT_tClntPT1_mp Temp_Cels 8 -50.14000 149.8600 FORMAT "%8.4" EXTENDED_LIMITS -3549.940 3003.560 DEPOSIT ABSOLUTE /end AXIS_DESCR
/end CHARACTERISTIC
/begin CHARACTERISTIC CtT_tiConsumPT1_C "PT1 Filter für Verbrauch" VALUE 0x1C9A78 Kw_Wu32 4294.9673 TimeDelay_s 0.0000010000000 4294.9673 FORMAT "%9.4" /end CHARACTERISTIC
/begin CHARACTERISTIC CtT_tiTempAirPT1_C "PT1 Filter Lufttemperatur Ansaugtrakt" VALUE 0x1C9A7C Kw_Wu32 4294.9673 TimeDelay_s 0.0000010000000 4294.9673 FORMAT "%9.4" /end CHARACTERISTIC
/begin CHARACTERISTIC CtT_tiTempClntPT1_C "PT1 Filter Wassertemperatur" VALUE 0x1C9A80 Kw_Wu32 4294.9673 TimeDelay_s 0.0000010000000 4294.9673 FORMAT "%9.4" /end CHARACTERISTIC
/begin CHARACTERISTIC CtT_tiTst_C "Max. Zeit für Thermostatdiagnose nach Init EDC" VALUE 0x1C9A84 Kw_Wu32 42949672950.0 Time_ms 0.00 42949672950.0 FORMAT "%13.1" /end CHARACTERISTIC
/begin CHARACTERISTIC CtT_tThresHi_C "Max. Wassertemperatur nach Init EDC Freigabe Thermostatdiagnose" VALUE 0x1C9A88 Kw_Ws16 200.0000 Temp_Cels -50.14000 149.8600 FORMAT "%8.4" EXTENDED_LIMITS -3549.940 3003.560 /end CHARACTERISTIC
/begin CHARACTERISTIC CtT_tThresLo_C "Min. Wassertemperatur Freigabe Thermostatdiagnose" VALUE 0x1C9A8A Kw_Ws16 200.0000 Temp_Cels -50.14000 149.8600 FORMAT "%8.4" EXTENDED_LIMITS -3549.940 3003.560 /end CHARACTERISTIC
/begin CHARACTERISTIC Diff_tiDebtrqLimErrPatDef_C "Debounce Dauer" VALUE 0x1C9D20 Kw_Wu16 655350.0 Time_ms 0.00 655350.0 FORMAT "%8.1" /end CHARACTERISTIC
/begin CHARACTERISTIC Diff_tiDebtrqLimErrPatOk_C "Fehlerheilungserkennungszeit" VALUE 0x1C9D22 Kw_Wu16 655350.0 Time_ms 0.00 655350.0 FORMAT "%8.1" /end CHARACTERISTIC
/begin CHARACTERISTIC Diff_dtrqCANerrPos_C "positive Rampensteigung bei CAN Fehler" VALUE 0x1C9D24 Kw_Wu32 65535949.9817 RmpTrqPrp 50.0030517578 65535999.9847 FORMAT "%13.4" EXTENDED_LIMITS 0.00 65535999.9847 /end CHARACTERISTIC
/begin CHARACTERISTIC Diff_dtrqCANerrNeg_C "negative Rampensteigung bei Heilung des CAN Fehlers" VALUE 0x1C9D28 Kw_Wu32 65535949.9817 RmpTrqPrp 50.0030517578 65535999.9847 FORMAT "%13.4" EXTENDED_LIMITS 0.00 65535999.9847 /end CHARACTERISTIC
/begin CHARACTERISTIC Diff_trqCANerrMax_C "Begrenzungsmoment bei CAN Fehler" VALUE 0x1C9D2C Kw_Ws16 65534.00 TrqPrp -32767.00 32767.00 FORMAT "%8.2" EXTENDED_LIMITS -32768.00 32767.00 /end CHARACTERISTIC
/begin CHARACTERISTIC DrvTrn_drSlpPos_C "Positive Rampensteigung für das Triebstrangübersetzungsverhältnis" VALUE 0x1C9D30 Kw_Wu32 655359.899902 RmpTransR 0.0999450683594 655359.999847 FORMAT "%13.6" EXTENDED_LIMITS 0.00 655359.999847 /end CHARACTERISTIC
/begin CHARACTERISTIC DrvTrn_drSlpNeg_C "Negative Rampensteigung für das Triebstrangübersetzungsverhältnis" VALUE 0x1C9D34 Kw_Wu32 655359.899902 RmpTransR 0.0999450683594 655359.999847 FORMAT "%13.6" EXTENDED_LIMITS 0.00 655359.999847 /end CHARACTERISTIC
/begin CHARACTERISTIC DrvTrn_rTransDTInit_C "Triebstrangübersetzungs-Vorgabewert (Radmoment pro Motormoment)" VALUE 0x1C9D38 Kw_Ws16 99.00000 TransR 1.000000 100.0000 FORMAT "%8.4" EXTENDED_LIMITS -327.6800 327.6700 /end CHARACTERISTIC
/begin CHARACTERISTIC DrvTrn_swtNotFrozen_C "Schalter zum deaktivieren der Einfrierfunktion vom Übersetzungsverhältnis" VALUE 0x1C9D3A Kw_Wu8 1.000 OneToOne 0.00 1.000 FORMAT "%5.3" EXTENDED_LIMITS 0.00 255.0 /end CHARACTERISTIC
/begin CHARACTERISTIC DrvTrn_swtSigVal_C "Signalquelle ADC/CAN" VALUE 0x1C9D3B Kw_Wu8 1.000 OneToOne 0.00 1.000 FORMAT "%5.3" EXTENDED_LIMITS 0.00 255.0 /end CHARACTERISTIC
/begin CHARACTERISTIC DSCHED_numSelFID_C "FID auswählbar zur Anzeige der defekten und nicht defekten DFPs welche den ausgewählten FID verriegeln" VALUE 0x1C9D3C Kw_Wu16 61798.0000000 FidName 0.00 61798.0000000 FORMAT "%13.7" /end CHARACTERISTIC
/begin CHARACTERISTIC DSMDur_DfctDur1Mode_C "Betriebsart des globalen Fehlerdauerzählers 1" VALUE 0x1CD934 Kw_Wu8 2.000 OneToOne 0.00 2.000 FORMAT "%5.3" EXTENDED_LIMITS 0.00 255.0 /end CHARACTERISTIC
/begin CHARACTERISTIC DSMDur_DfctDur2Mode_C "Betriebsart des globalen Fehlerdauerzählers 2" VALUE 0x1CD935 Kw_Wu8 2.000 OneToOne 0.00 2.000 FORMAT "%5.3" EXTENDED_LIMITS 0.00 255.0 /end CHARACTERISTIC
/begin CHARACTERISTIC DSMDur_stDfctDur1Enable_C "Aktivierungsbedingungen für den globalen Defektdauerzähler 1" VALUE 0x1CD936 Kw_Wu8 255.0 OneToOne 0.00 255.0 FORMAT "%5.1" /end CHARACTERISTIC
/begin CHARACTERISTIC DSMDur_stDfctDur2Enable_C "Aktivierungsbedingungen für den globalen Defektdauerzähler 2" VALUE 0x1CD937 Kw_Wu8 255.0 OneToOne 0.00 255.0 FORMAT "%5.1" /end CHARACTERISTIC
/begin CHARACTERISTIC DSMDur_stDfctDur1Reset_C "Rücksetzbedingungen für den globalen Defektdauerzähler 1" VALUE 0x1CD938 Kw_Wu8 255.0 OneToOne 0.00 255.0 FORMAT "%5.1" /end CHARACTERISTIC
/begin CHARACTERISTIC DSMDur_stDfctDur2Reset_C "Rücksetzbedingungen für den globalen Defektdauerzähler 2" VALUE 0x1CD939 Kw_Wu8 255.0 OneToOne 0.00 255.0 FORMAT "%5.1" /end CHARACTERISTIC
/begin CHARACTERISTIC DSMDur_FcmDfctDur1Mode_C "Betriebsart des Fehlerspeichereintrags  Dauerzählers 1" VALUE 0x1CD93A Kw_Wu8 2.000 OneToOne 0.00 2.000 FORMAT "%5.3" EXTENDED_LIMITS 0.00 255.0 /end CHARACTERISTIC
/begin CHARACTERISTIC DSMDur_FcmDfctDur2Mode_C "Betriebsart des Fehlerspeichereintrags  Dauerzählers 2" VALUE 0x1CD93B Kw_Wu8 2.000 OneToOne 0.00 2.000 FORMAT "%5.3" EXTENDED_LIMITS 0.00 255.0 /end CHARACTERISTIC
/begin CHARACTERISTIC DSMDur_stFcmDfctDur1Enable_C "Aktivierungsbedingung des Fehlerspeichereintrags  Dauerzählers 1" VALUE 0x1CD93C Kw_Wu16 65535.00 OneToOne 0.00 65535.00 FORMAT "%8.2" /end CHARACTERISTIC
/begin CHARACTERISTIC DSMDur_stFcmDfctDur2Enable_C "Aktivierungsbedingung des Fehlerspeichereintrags  Dauerzählers 2" VALUE 0x1CD93E Kw_Wu16 65535.00 OneToOne 0.00 65535.00 FORMAT "%8.2" /end CHARACTERISTIC
/begin CHARACTERISTIC DSMDur_stFcmDfctDur1Reset_C "Rücksetzbedingung des Fehlerspeichereintrags  Dauerzählers 1" VALUE 0x1CD940 Kw_Wu8 255.0 OneToOne 0.00 255.0 FORMAT "%5.1" /end CHARACTERISTIC
/begin CHARACTERISTIC DSMDur_stFcmDfctDur2Reset_C "Rücksetzbedingung des Fehlerspeichereintrags  Dauerzählers 2" VALUE 0x1CD941 Kw_Wu8 255.0 OneToOne 0.00 255.0 FORMAT "%5.1" /end CHARACTERISTIC
/begin CHARACTERISTIC DSM_Class1Mil_C "Art der MIL Ansteuerung" VALUE 0x1C9D3E Kw_Wu8 2.00000000000 Mil 0.00 2.00000000000 FORMAT "%13.11" /end CHARACTERISTIC
/begin CHARACTERISTIC DSM_Class1TFlc_C "Trigger Art für Fehlereintrags Bestätigungsentprellung (->Lampe an)" VALUE 0x1C9D3F Kw_Wu8 3.00000000000 ClassTrigger 0.00 3.00000000000 FORMAT "%13.11" /end CHARACTERISTIC
/begin CHARACTERISTIC DSM_Class1Flc_C "Anzahl Triggerereignisse für Fehlereintrags Bestätigungsentprellung (->Lampe an)" VALUE 0x1C9D40 Kw_Wu8 255.0 OneToOne 0.00 255.0 FORMAT "%5.1" /end CHARACTERISTIC
/begin CHARACTERISTIC DSM_Class1THlc_C "Trigger Art für Fehlerheilung (->Lampe aus)" VALUE 0x1C9D41 Kw_Wu8 3.00000000000 ClassTrigger 0.00 3.00000000000 FORMAT "%13.11" /end CHARACTERISTIC
/begin CHARACTERISTIC DSM_Class1Hlc_C "Anzahl Triggerereignisse für Fehlerheilung (->Lampe aus)" VALUE 0x1C9D42 Kw_Wu8 255.0 OneToOne 0.00 255.0 FORMAT "%5.1" /end CHARACTERISTIC
/begin CHARACTERISTIC DSM_Class1Scatt_C "Fehler ist lesbar für OBD Scan tool tester (SCATT) wenn Wert = 1" VALUE 0x1C9D43 Kw_Wu8 1.00000000000 Scatt 0.00 1.00000000000 FORMAT "%13.11" /end CHARACTERISTIC
/begin CHARACTERISTIC DSM_Class1TDlcPen_C "Trigger Art für Löschentprellung von nicht bestätigten Fehlern (pending)" VALUE 0x1C9D44 Kw_Wu8 3.00000000000 ClassTriggerTDlc 0.00 3.00000000000 FORMAT "%13.11" /end CHARACTERISTIC
/begin CHARACTERISTIC DSM_Class1DlcPen_C "Anzahl Triggerereignisse für die Löschung von nicht bestätigten Fehlern (pending)" VALUE 0x1C9D45 Kw_Wu8 255.0 OneToOne 0.00 255.0 FORMAT "%5.1" /end CHARACTERISTIC
/begin CHARACTERISTIC DSM_Class1TDlc_C "Trigger Art für Löschentprellung" VALUE 0x1C9D46 Kw_Wu8 3.00000000000 ClassTriggerTDlc 0.00 3.00000000000 FORMAT "%13.11" /end CHARACTERISTIC
/begin CHARACTERISTIC DSM_Class1DlcKd_C "Anzahl Triggerereignisse für die Löschung von Fehlereinträgen mit Status Kundendienst" VALUE 0x1C9D47 Kw_Wu8 255.0 OneToOne 0.00 255.0 FORMAT "%5.1" /end CHARACTERISTIC
/begin CHARACTERISTIC DSM_Class1Dlc_C "Anzahl Triggerereignisse für die Löschung von Fehlereinträgen" VALUE 0x1C9D48 Kw_Wu8 255.0 OneToOne 0.00 255.0 FORMAT "%5.1" /end CHARACTERISTIC
/begin CHARACTERISTIC DSM_Class1Prio_C "Priorität des Fehlereintrages für Verdrängung und freeze frame Zuordnung" VALUE 0x1C9D49 Kw_Wu8 255.0 OneToOne 0.00 255.0 FORMAT "%5.1" /end CHARACTERISTIC
/begin CHARACTERISTIC DSM_Class1SysLamp_C "Art der Systemlampenansteuerung" VALUE 0x1C9D4A Kw_Wu8 2.00000000000 SysLamp 0.00 2.00000000000 FORMAT "%13.11" /end CHARACTERISTIC
/begin CHARACTERISTIC DSM_Class1ResErf_C "Verhalten Fehlerflags bei Reset und abgebrochenem Nachlauf" VALUE 0x1C9D4B Kw_Wu8 3.00000000000 ResErf 0.00 3.00000000000 FORMAT "%13.11" /end CHARACTERISTIC
/begin CHARACTERISTIC DSM_Class1Readiness_C "Zuordnung Entprellklasse zu Readiness Flags" VALUE 0x1C9D4C Kw_Wu8 64.0000000000 Readiness 0.00 64.0000000000 FORMAT "%13.10" /end CHARACTERISTIC
/begin CHARACTERISTIC DSM_Class2Mil_C "Art der MIL Ansteuerung" VALUE 0x1C9D4D Kw_Wu8 2.00000000000 Mil 0.00 2.00000000000 FORMAT "%13.11" /end CHARACTERISTIC
/begin CHARACTERISTIC DSM_Class2TFlc_C "Trigger Art für Fehlereintrags Bestätigungsentprellung (->Lampe an)" VALUE 0x1C9D4E Kw_Wu8 3.00000000000 ClassTrigger 0.00 3.00000000000 FORMAT "%13.11" /end CHARACTERISTIC
/begin CHARACTERISTIC DSM_Class2Flc_C "Anzahl Triggerereignisse für Fehlereintrags Bestätigungsentprellung (->Lampe an)" VALUE 0x1C9D4F Kw_Wu8 255.0 OneToOne 0.00 255.0 FORMAT "%5.1" /end CHARACTERISTIC
/begin CHARACTERISTIC DSM_Class2THlc_C "Trigger Art für Fehlerheilung (->Lampe aus)" VALUE 0x1C9D50 Kw_Wu8 3.00000000000 ClassTrigger 0.00 3.00000000000 FORMAT "%13.11" /end CHARACTERISTIC
/begin CHARACTERISTIC DSM_Class2Hlc_C "Anzahl Triggerereignisse für Fehlerheilung (->Lampe aus)" VALUE 0x1C9D51 Kw_Wu8 255.0 OneToOne 0.00 255.0 FORMAT "%5.1" /end CHARACTERISTIC
/begin CHARACTERISTIC DSM_Class2Scatt_C "Fehler ist lesbar für OBD Scan tool tester (SCATT) wenn Wert = 1" VALUE 0x1C9D52 Kw_Wu8 1.00000000000 Scatt 0.00 1.00000000000 FORMAT "%13.11" /end CHARACTERISTIC
/begin CHARACTERISTIC DSM_Class2TDlcPen_C "Trigger Art für Löschentprellung von nicht bestätigten Fehlern (pending)" VALUE 0x1C9D53 Kw_Wu8 3.00000000000 ClassTriggerTDlc 0.00 3.00000000000 FORMAT "%13.11" /end CHARACTERISTIC
/begin CHARACTERISTIC DSM_Class2DlcPen_C "Anzahl Triggerereignisse für die Löschung von nicht bestätigten Fehlern (pending)" VALUE 0x1C9D54 Kw_Wu8 255.0 OneToOne 0.00 255.0 FORMAT "%5.1" /end CHARACTERISTIC
/begin CHARACTERISTIC DSM_Class2TDlc_C "Trigger Art für Löschentprellung" VALUE 0x1C9D55 Kw_Wu8 3.00000000000 ClassTriggerTDlc 0.00 3.00000000000 FORMAT "%13.11" /end CHARACTERISTIC
/begin CHARACTERISTIC DSM_Class2DlcKd_C "Anzahl Triggerereignisse für die Löschung von Fehlereinträgen mit Status Kundendienst" VALUE 0x1C9D56 Kw_Wu8 255.0 OneToOne 0.00 255.0 FORMAT "%5.1" /end CHARACTERISTIC
/begin CHARACTERISTIC DSM_Class2Dlc_C "Anzahl Triggerereignisse für die Löschung von Fehlereinträgen" VALUE 0x1C9D57 Kw_Wu8 255.0 OneToOne 0.00 255.0 FORMAT "%5.1" /end CHARACTERISTIC
/begin CHARACTERISTIC DSM_Class2Prio_C "Priorität des Fehlereintrages für Verdrängung und freeze frame Zuordnung" VALUE 0x1C9D58 Kw_Wu8 255.0 OneToOne 0.00 255.0 FORMAT "%5.1" /end CHARACTERISTIC
/begin CHARACTERISTIC DSM_Class2SysLamp_C "Art der Systemlampenansteuerung" VALUE 0x1C9D59 Kw_Wu8 2.00000000000 SysLamp 0.00 2.00000000000 FORMAT "%13.11" /end CHARACTERISTIC
/begin CHARACTERISTIC DSM_Class2ResErf_C "Verhalten Fehlerflags bei Reset und abgebrochenem Nachlauf" VALUE 0x1C9D5A Kw_Wu8 3.00000000000 ResErf 0.00 3.00000000000 FORMAT "%13.11" /end CHARACTERISTIC
/begin CHARACTERISTIC DSM_Class2Readiness_C "Zuordnung Entprellklasse zu Readiness Flags" VALUE 0x1C9D5B Kw_Wu8 64.0000000000 Readiness 0.00 64.0000000000 FORMAT "%13.10" /end CHARACTERISTIC
/begin CHARACTERISTIC DSM_Class3Mil_C "Art der MIL Ansteuerung" VALUE 0x1C9D5C Kw_Wu8 2.00000000000 Mil 0.00 2.00000000000 FORMAT "%13.11" /end CHARACTERISTIC
/begin CHARACTERISTIC DSM_Class3TFlc_C "Trigger Art für Fehlereintrags Bestätigungsentprellung (->Lampe an)" VALUE 0x1C9D5D Kw_Wu8 3.00000000000 ClassTrigger 0.00 3.00000000000 FORMAT "%13.11" /end CHARACTERISTIC
/begin CHARACTERISTIC DSM_Class3Flc_C "Anzahl Triggerereignisse für Fehlereintrags Bestätigungsentprellung (->Lampe an)" VALUE 0x1C9D5E Kw_Wu8 255.0 OneToOne 0.00 255.0 FORMAT "%5.1" /end CHARACTERISTIC
/begin CHARACTERISTIC DSM_Class3THlc_C "Trigger Art für Fehlerheilung (->Lampe aus)" VALUE 0x1C9D5F Kw_Wu8 3.00000000000 ClassTrigger 0.00 3.00000000000 FORMAT "%13.11" /end CHARACTERISTIC
/begin CHARACTERISTIC DSM_Class3Hlc_C "Anzahl Triggerereignisse für Fehlerheilung (->Lampe aus)" VALUE 0x1C9D60 Kw_Wu8 255.0 OneToOne 0.00 255.0 FORMAT "%5.1" /end CHARACTERISTIC
/begin CHARACTERISTIC DSM_Class3Scatt_C "Fehler ist lesbar für OBD Scan tool tester (SCATT) wenn Wert = 1" VALUE 0x1C9D61 Kw_Wu8 1.00000000000 Scatt 0.00 1.00000000000 FORMAT "%13.11" /end CHARACTERISTIC
/begin CHARACTERISTIC DSM_Class3TDlcPen_C "Trigger Art für Löschentprellung von nicht bestätigten Fehlern (pending)" VALUE 0x1C9D62 Kw_Wu8 3.00000000000 ClassTriggerTDlc 0.00 3.00000000000 FORMAT "%13.11" /end CHARACTERISTIC
/begin CHARACTERISTIC DSM_Class3DlcPen_C "Anzahl Triggerereignisse für die Löschung von nicht bestätigten Fehlern (pending)" VALUE 0x1C9D63 Kw_Wu8 255.0 OneToOne 0.00 255.0 FORMAT "%5.1" /end CHARACTERISTIC
/begin CHARACTERISTIC DSM_Class3TDlc_C "Trigger Art für Löschentprellung" VALUE 0x1C9D64 Kw_Wu8 3.00000000000 ClassTriggerTDlc 0.00 3.00000000000 FORMAT "%13.11" /end CHARACTERISTIC
/begin CHARACTERISTIC DSM_Class3DlcKd_C "Anzahl Triggerereignisse für die Löschung von Fehlereinträgen mit Status Kundendienst" VALUE 0x1C9D65 Kw_Wu8 255.0 OneToOne 0.00 255.0 FORMAT "%5.1" /end CHARACTERISTIC
/begin CHARACTERISTIC DSM_Class3Dlc_C "Anzahl Triggerereignisse für die Löschung von Fehlereinträgen" VALUE 0x1C9D66 Kw_Wu8 255.0 OneToOne 0.00 255.0 FORMAT "%5.1" /end CHARACTERISTIC
/begin CHARACTERISTIC DSM_Class3Prio_C "Priorität des Fehlereintrages für Verdrängung und freeze frame Zuordnung" VALUE 0x1C9D67 Kw_Wu8 255.0 OneToOne 0.00 255.0 FORMAT "%5.1" /end CHARACTERISTIC
/begin CHARACTERISTIC DSM_Class3SysLamp_C "Art der Systemlampenansteuerung" VALUE 0x1C9D68 Kw_Wu8 2.00000000000 SysLamp 0.00 2.00000000000 FORMAT "%13.11" /end CHARACTERISTIC
/begin CHARACTERISTIC DSM_Class3ResErf_C "Verhalten Fehlerflags bei Reset und abgebrochenem Nachlauf" VALUE 0x1C9D69 Kw_Wu8 3.00000000000 ResErf 0.00 3.00000000000 FORMAT "%13.11" /end CHARACTERISTIC
/begin CHARACTERISTIC DSM_Class3Readiness_C "Zuordnung Entprellklasse zu Readiness Flags" VALUE 0x1C9D6A Kw_Wu8 64.0000000000 Readiness 0.00 64.0000000000 FORMAT "%13.10" /end CHARACTERISTIC
/begin CHARACTERISTIC DSM_Class4Mil_C "Art der MIL Ansteuerung" VALUE 0x1C9D6B Kw_Wu8 2.00000000000 Mil 0.00 2.00000000000 FORMAT "%13.11" /end CHARACTERISTIC
/begin CHARACTERISTIC DSM_Class4TFlc_C "Trigger Art für Fehlereintrags Bestätigungsentprellung (->Lampe an)" VALUE 0x1C9D6C Kw_Wu8 3.00000000000 ClassTrigger 0.00 3.00000000000 FORMAT "%13.11" /end CHARACTERISTIC
/begin CHARACTERISTIC DSM_Class4Flc_C "Anzahl Triggerereignisse für Fehlereintrags Bestätigungsentprellung (->Lampe an)" VALUE 0x1C9D6D Kw_Wu8 255.0 OneToOne 0.00 255.0 FORMAT "%5.1" /end CHARACTERISTIC
/begin CHARACTERISTIC DSM_Class4THlc_C "Trigger Art für Fehlerheilung (->Lampe aus)" VALUE 0x1C9D6E Kw_Wu8 3.00000000000 ClassTrigger 0.00 3.00000000000 FORMAT "%13.11" /end CHARACTERISTIC
/begin CHARACTERISTIC DSM_Class4Hlc_C "Anzahl Triggerereignisse für Fehlerheilung (->Lampe aus)" VALUE 0x1C9D6F Kw_Wu8 255.0 OneToOne 0.00 255.0 FORMAT "%5.1" /end CHARACTERISTIC
/begin CHARACTERISTIC DSM_Class4Scatt_C "Fehler ist lesbar für OBD Scan tool tester (SCATT) wenn Wert = 1" VALUE 0x1C9D70 Kw_Wu8 1.00000000000 Scatt 0.00 1.00000000000 FORMAT "%13.11" /end CHARACTERISTIC
/begin CHARACTERISTIC DSM_Class4TDlcPen_C "Trigger Art für Löschentprellung von nicht bestätigten Fehlern (pending)" VALUE 0x1C9D71 Kw_Wu8 3.00000000000 ClassTriggerTDlc 0.00 3.00000000000 FORMAT "%13.11" /end CHARACTERISTIC
/begin CHARACTERISTIC DSM_Class4DlcPen_C "Anzahl Triggerereignisse für die Löschung von nicht bestätigten Fehlern (pending)" VALUE 0x1C9D72 Kw_Wu8 255.0 OneToOne 0.00 255.0 FORMAT "%5.1" /end CHARACTERISTIC
/begin CHARACTERISTIC DSM_Class4TDlc_C "Trigger Art für Löschentprellung" VALUE 0x1C9D73 Kw_Wu8 3.00000000000 ClassTriggerTDlc 0.00 3.00000000000 FORMAT "%13.11" /end CHARACTERISTIC
/begin CHARACTERISTIC DSM_Class4DlcKd_C "Anzahl Triggerereignisse für die Löschung von Fehlereinträgen mit Status Kundendienst" VALUE 0x1C9D74 Kw_Wu8 255.0 OneToOne 0.00 255.0 FORMAT "%5.1" /end CHARACTERISTIC
/begin CHARACTERISTIC DSM_Class4Dlc_C "Anzahl Triggerereignisse für die Löschung von Fehlereinträgen" VALUE 0x1C9D75 Kw_Wu8 255.0 OneToOne 0.00 255.0 FORMAT "%5.1" /end CHARACTERISTIC
/begin CHARACTERISTIC DSM_Class4Prio_C "Priorität des Fehlereintrages für Verdrängung und freeze frame Zuordnung" VALUE 0x1C9D76 Kw_Wu8 255.0 OneToOne 0.00 255.0 FORMAT "%5.1" /end CHARACTERISTIC
/begin CHARACTERISTIC DSM_Class4SysLamp_C "Art der Systemlampenansteuerung" VALUE 0x1C9D77 Kw_Wu8 2.00000000000 SysLamp 0.00 2.00000000000 FORMAT "%13.11" /end CHARACTERISTIC
/begin CHARACTERISTIC DSM_Class4ResErf_C "Verhalten Fehlerflags bei Reset und abgebrochenem Nachlauf" VALUE 0x1C9D78 Kw_Wu8 3.00000000000 ResErf 0.00 3.00000000000 FORMAT "%13.11" /end CHARACTERISTIC
/begin CHARACTERISTIC DSM_Class4Readiness_C "Zuordnung Entprellklasse zu Readiness Flags" VALUE 0x1C9D79 Kw_Wu8 64.0000000000 Readiness 0.00 64.0000000000 FORMAT "%13.10" /end CHARACTERISTIC
/begin CHARACTERISTIC DSM_Class5Mil_C "Art der MIL Ansteuerung" VALUE 0x1C9D7A Kw_Wu8 2.00000000000 Mil 0.00 2.00000000000 FORMAT "%13.11" /end CHARACTERISTIC
/begin CHARACTERISTIC DSM_Class5TFlc_C "Trigger Art für Fehlereintrags Bestätigungsentprellung (->Lampe an)" VALUE 0x1C9D7B Kw_Wu8 3.00000000000 ClassTrigger 0.00 3.00000000000 FORMAT "%13.11" /end CHARACTERISTIC
/begin CHARACTERISTIC DSM_Class5Flc_C "Anzahl Triggerereignisse für Fehlereintrags Bestätigungsentprellung (->Lampe an)" VALUE 0x1C9D7C Kw_Wu8 255.0 OneToOne 0.00 255.0 FORMAT "%5.1" /end CHARACTERISTIC
/begin CHARACTERISTIC DSM_Class5THlc_C "Trigger Art für Fehlerheilung (->Lampe aus)" VALUE 0x1C9D7D Kw_Wu8 3.00000000000 ClassTrigger 0.00 3.00000000000 FORMAT "%13.11" /end CHARACTERISTIC
/begin CHARACTERISTIC DSM_Class5Hlc_C "Anzahl Triggerereignisse für Fehlerheilung (->Lampe aus)" VALUE 0x1C9D7E Kw_Wu8 255.0 OneToOne 0.00 255.0 FORMAT "%5.1" /end CHARACTERISTIC
/begin CHARACTERISTIC DSM_Class5Scatt_C "Fehler ist lesbar für OBD Scan tool tester (SCATT) wenn Wert = 1" VALUE 0x1C9D7F Kw_Wu8 1.00000000000 Scatt 0.00 1.00000000000 FORMAT "%13.11" /end CHARACTERISTIC
/begin CHARACTERISTIC DSM_Class5TDlcPen_C "Trigger Art für Löschentprellung von nicht bestätigten Fehlern (pending)" VALUE 0x1C9D80 Kw_Wu8 3.00000000000 ClassTriggerTDlc 0.00 3.00000000000 FORMAT "%13.11" /end CHARACTERISTIC
/begin CHARACTERISTIC DSM_Class5DlcPen_C "Anzahl Triggerereignisse für die Löschung von nicht bestätigten Fehlern (pending)" VALUE 0x1C9D81 Kw_Wu8 255.0 OneToOne 0.00 255.0 FORMAT "%5.1" /end CHARACTERISTIC
/begin CHARACTERISTIC DSM_Class5TDlc_C "Trigger Art für Löschentprellung" VALUE 0x1C9D82 Kw_Wu8 3.00000000000 ClassTriggerTDlc 0.00 3.00000000000 FORMAT "%13.11" /end CHARACTERISTIC
/begin CHARACTERISTIC DSM_Class5DlcKd_C "Anzahl Triggerereignisse für die Löschung von Fehlereinträgen mit Status Kundendienst" VALUE 0x1C9D83 Kw_Wu8 255.0 OneToOne 0.00 255.0 FORMAT "%5.1" /end CHARACTERISTIC
/begin CHARACTERISTIC DSM_Class5Dlc_C "Anzahl Triggerereignisse für die Löschung von Fehlereinträgen" VALUE 0x1C9D84 Kw_Wu8 255.0 OneToOne 0.00 255.0 FORMAT "%5.1" /end CHARACTERISTIC
/begin CHARACTERISTIC DSM_Class5Prio_C "Priorität des Fehlereintrages für Verdrängung und freeze frame Zuordnung" VALUE 0x1C9D85 Kw_Wu8 255.0 OneToOne 0.00 255.0 FORMAT "%5.1" /end CHARACTERISTIC
/begin CHARACTERISTIC DSM_Class5SysLamp_C "Art der Systemlampenansteuerung" VALUE 0x1C9D86 Kw_Wu8 2.00000000000 SysLamp 0.00 2.00000000000 FORMAT "%13.11" /end CHARACTERISTIC
/begin CHARACTERISTIC DSM_Class5ResErf_C "Verhalten Fehlerflags bei Reset und abgebrochenem Nachlauf" VALUE 0x1C9D87 Kw_Wu8 3.00000000000 ResErf 0.00 3.00000000000 FORMAT "%13.11" /end CHARACTERISTIC
/begin CHARACTERISTIC DSM_Class5Readiness_C "Zuordnung Entprellklasse zu Readiness Flags" VALUE 0x1C9D88 Kw_Wu8 64.0000000000 Readiness 0.00 64.0000000000 FORMAT "%13.10" /end CHARACTERISTIC
/begin CHARACTERISTIC DSM_Class6Mil_C "Art der MIL Ansteuerung" VALUE 0x1C9D89 Kw_Wu8 2.00000000000 Mil 0.00 2.00000000000 FORMAT "%13.11" /end CHARACTERISTIC
/begin CHARACTERISTIC DSM_Class6TFlc_C "Trigger Art für Fehlereintrags Bestätigungsentprellung (->Lampe an)" VALUE 0x1C9D8A Kw_Wu8 3.00000000000 ClassTrigger 0.00 3.00000000000 FORMAT "%13.11" /end CHARACTERISTIC
/begin CHARACTERISTIC DSM_Class6Flc_C "Anzahl Triggerereignisse für Fehlereintrags Bestätigungsentprellung (->Lampe an)" VALUE 0x1C9D8B Kw_Wu8 255.0 OneToOne 0.00 255.0 FORMAT "%5.1" /end CHARACTERISTIC
/begin CHARACTERISTIC DSM_Class6THlc_C "Trigger Art für Fehlerheilung (->Lampe aus)" VALUE 0x1C9D8C Kw_Wu8 3.00000000000 ClassTrigger 0.00 3.00000000000 FORMAT "%13.11" /end CHARACTERISTIC
/begin CHARACTERISTIC DSM_Class6Hlc_C "Anzahl Triggerereignisse für Fehlerheilung (->Lampe aus)" VALUE 0x1C9D8D Kw_Wu8 255.0 OneToOne 0.00 255.0 FORMAT "%5.1" /end CHARACTERISTIC
/begin CHARACTERISTIC DSM_Class6Scatt_C "Fehler ist lesbar für OBD Scan tool tester (SCATT) wenn Wert = 1" VALUE 0x1C9D8E Kw_Wu8 1.00000000000 Scatt 0.00 1.00000000000 FORMAT "%13.11" /end CHARACTERISTIC
/begin CHARACTERISTIC DSM_Class6TDlcPen_C "Trigger Art für Löschentprellung von nicht bestätigten Fehlern (pending)" VALUE 0x1C9D8F Kw_Wu8 3.00000000000 ClassTriggerTDlc 0.00 3.00000000000 FORMAT "%13.11" /end CHARACTERISTIC
/begin CHARACTERISTIC DSM_Class6DlcPen_C "Anzahl Triggerereignisse für die Löschung von nicht bestätigten Fehlern (pending)" VALUE 0x1C9D90 Kw_Wu8 255.0 OneToOne 0.00 255.0 FORMAT "%5.1" /end CHARACTERISTIC
/begin CHARACTERISTIC DSM_Class6TDlc_C "Trigger Art für Löschentprellung" VALUE 0x1C9D91 Kw_Wu8 3.00000000000 ClassTriggerTDlc 0.00 3.00000000000 FORMAT "%13.11" /end CHARACTERISTIC
/begin CHARACTERISTIC DSM_Class6DlcKd_C "Anzahl Triggerereignisse für die Löschung von Fehlereinträgen mit Status Kundendienst" VALUE 0x1C9D92 Kw_Wu8 255.0 OneToOne 0.00 255.0 FORMAT "%5.1" /end CHARACTERISTIC
/begin CHARACTERISTIC DSM_Class6Dlc_C "Anzahl Triggerereignisse für die Löschung von Fehlereinträgen" VALUE 0x1C9D93 Kw_Wu8 255.0 OneToOne 0.00 255.0 FORMAT "%5.1" /end CHARACTERISTIC
/begin CHARACTERISTIC DSM_Class6Prio_C "Priorität des Fehlereintrages für Verdrängung und freeze frame Zuordnung" VALUE 0x1C9D94 Kw_Wu8 255.0 OneToOne 0.00 255.0 FORMAT "%5.1" /end CHARACTERISTIC
/begin CHARACTERISTIC DSM_Class6SysLamp_C "Art der Systemlampenansteuerung" VALUE 0x1C9D95 Kw_Wu8 2.00000000000 SysLamp 0.00 2.00000000000 FORMAT "%13.11" /end CHARACTERISTIC
/begin CHARACTERISTIC DSM_Class6ResErf_C "Verhalten Fehlerflags bei Reset und abgebrochenem Nachlauf" VALUE 0x1C9D96 Kw_Wu8 3.00000000000 ResErf 0.00 3.00000000000 FORMAT "%13.11" /end CHARACTERISTIC
/begin CHARACTERISTIC DSM_Class6Readiness_C "Zuordnung Entprellklasse zu Readiness Flags" VALUE 0x1C9D97 Kw_Wu8 64.0000000000 Readiness 0.00 64.0000000000 FORMAT "%13.10" /end CHARACTERISTIC
/begin CHARACTERISTIC DSM_Class7Mil_C "Art der MIL Ansteuerung" VALUE 0x1C9D98 Kw_Wu8 2.00000000000 Mil 0.00 2.00000000000 FORMAT "%13.11" /end CHARACTERISTIC
/begin CHARACTERISTIC DSM_Class7TFlc_C "Trigger Art für Fehlereintrags Bestätigungsentprellung (->Lampe an)" VALUE 0x1C9D99 Kw_Wu8 3.00000000000 ClassTrigger 0.00 3.00000000000 FORMAT "%13.11" /end CHARACTERISTIC
/begin CHARACTERISTIC DSM_Class7Flc_C "Anzahl Triggerereignisse für Fehlereintrags Bestätigungsentprellung (->Lampe an)" VALUE 0x1C9D9A Kw_Wu8 255.0 OneToOne 0.00 255.0 FORMAT "%5.1" /end CHARACTERISTIC
/begin CHARACTERISTIC DSM_Class7THlc_C "Trigger Art für Fehlerheilung (->Lampe aus)" VALUE 0x1C9D9B Kw_Wu8 3.00000000000 ClassTrigger 0.00 3.00000000000 FORMAT "%13.11" /end CHARACTERISTIC
/begin CHARACTERISTIC DSM_Class7Hlc_C "Anzahl Triggerereignisse für Fehlerheilung (->Lampe aus)" VALUE 0x1C9D9C Kw_Wu8 255.0 OneToOne 0.00 255.0 FORMAT "%5.1" /end CHARACTERISTIC
/begin CHARACTERISTIC DSM_Class7Scatt_C "Fehler ist lesbar für OBD Scan tool tester (SCATT) wenn Wert = 1" VALUE 0x1C9D9D Kw_Wu8 1.00000000000 Scatt 0.00 1.00000000000 FORMAT "%13.11" /end CHARACTERISTIC
/begin CHARACTERISTIC DSM_Class7TDlcPen_C "Trigger Art für Löschentprellung von nicht bestätigten Fehlern (pending)" VALUE 0x1C9D9E Kw_Wu8 3.00000000000 ClassTriggerTDlc 0.00 3.00000000000 FORMAT "%13.11" /end CHARACTERISTIC
/begin CHARACTERISTIC DSM_Class7DlcPen_C "Anzahl Triggerereignisse für die Löschung von nicht bestätigten Fehlern (pending)" VALUE 0x1C9D9F Kw_Wu8 255.0 OneToOne 0.00 255.0 FORMAT "%5.1" /end CHARACTERISTIC
/begin CHARACTERISTIC DSM_Class7TDlc_C "Trigger Art für Löschentprellung" VALUE 0x1C9DA0 Kw_Wu8 3.00000000000 ClassTriggerTDlc 0.00 3.00000000000 FORMAT "%13.11" /end CHARACTERISTIC
/begin CHARACTERISTIC DSM_Class7DlcKd_C "Anzahl Triggerereignisse für die Löschung von Fehlereinträgen mit Status Kundendienst" VALUE 0x1C9DA1 Kw_Wu8 255.0 OneToOne 0.00 255.0 FORMAT "%5.1" /end CHARACTERISTIC
/begin CHARACTERISTIC DSM_Class7Dlc_C "Anzahl Triggerereignisse für die Löschung von Fehlereinträgen" VALUE 0x1C9DA2 Kw_Wu8 255.0 OneToOne 0.00 255.0 FORMAT "%5.1" /end CHARACTERISTIC
/begin CHARACTERISTIC DSM_Class7Prio_C "Priorität des Fehlereintrages für Verdrängung und freeze frame Zuordnung" VALUE 0x1C9DA3 Kw_Wu8 255.0 OneToOne 0.00 255.0 FORMAT "%5.1" /end CHARACTERISTIC
/begin CHARACTERISTIC DSM_Class7SysLamp_C "Art der Systemlampenansteuerung" VALUE 0x1C9DA4 Kw_Wu8 2.00000000000 SysLamp 0.00 2.00000000000 FORMAT "%13.11" /end CHARACTERISTIC
/begin CHARACTERISTIC DSM_Class7ResErf_C "Verhalten Fehlerflags bei Reset und abgebrochenem Nachlauf" VALUE 0x1C9DA5 Kw_Wu8 3.00000000000 ResErf 0.00 3.00000000000 FORMAT "%13.11" /end CHARACTERISTIC
/begin CHARACTERISTIC DSM_Class7Readiness_C "Zuordnung Entprellklasse zu Readiness Flags" VALUE 0x1C9DA6 Kw_Wu8 64.0000000000 Readiness 0.00 64.0000000000 FORMAT "%13.10" /end CHARACTERISTIC
/begin CHARACTERISTIC DSM_Class8Mil_C "Art der MIL Ansteuerung" VALUE 0x1C9DA7 Kw_Wu8 2.00000000000 Mil 0.00 2.00000000000 FORMAT "%13.11" /end CHARACTERISTIC
/begin CHARACTERISTIC DSM_Class8TFlc_C "Trigger Art für Fehlereintrags Bestätigungsentprellung (->Lampe an)" VALUE 0x1C9DA8 Kw_Wu8 3.00000000000 ClassTrigger 0.00 3.00000000000 FORMAT "%13.11" /end CHARACTERISTIC
/begin CHARACTERISTIC DSM_Class8Flc_C "Anzahl Triggerereignisse für Fehlereintrags Bestätigungsentprellung (->Lampe an)" VALUE 0x1C9DA9 Kw_Wu8 255.0 OneToOne 0.00 255.0 FORMAT "%5.1" /end CHARACTERISTIC
/begin CHARACTERISTIC DSM_Class8THlc_C "Trigger Art für Fehlerheilung (->Lampe aus)" VALUE 0x1C9DAA Kw_Wu8 3.00000000000 ClassTrigger 0.00 3.00000000000 FORMAT "%13.11" /end CHARACTERISTIC
/begin CHARACTERISTIC DSM_Class8Hlc_C "Anzahl Triggerereignisse für Fehlerheilung (->Lampe aus)" VALUE 0x1C9DAB Kw_Wu8 255.0 OneToOne 0.00 255.0 FORMAT "%5.1" /end CHARACTERISTIC
/begin CHARACTERISTIC DSM_Class8Scatt_C "Fehler ist lesbar für OBD Scan tool tester (SCATT) wenn Wert = 1" VALUE 0x1C9DAC Kw_Wu8 1.00000000000 Scatt 0.00 1.00000000000 FORMAT "%13.11" /end CHARACTERISTIC
/begin CHARACTERISTIC DSM_Class8TDlcPen_C "Trigger Art für Löschentprellung von nicht bestätigten Fehlern (pending)" VALUE 0x1C9DAD Kw_Wu8 3.00000000000 ClassTriggerTDlc 0.00 3.00000000000 FORMAT "%13.11" /end CHARACTERISTIC
/begin CHARACTERISTIC DSM_Class8DlcPen_C "Anzahl Triggerereignisse für die Löschung von nicht bestätigten Fehlern (pending)" VALUE 0x1C9DAE Kw_Wu8 255.0 OneToOne 0.00 255.0 FORMAT "%5.1" /end CHARACTERISTIC
/begin CHARACTERISTIC DSM_Class8TDlc_C "Trigger Art für Löschentprellung" VALUE 0x1C9DAF Kw_Wu8 3.00000000000 ClassTriggerTDlc 0.00 3.00000000000 FORMAT "%13.11" /end CHARACTERISTIC
/begin CHARACTERISTIC DSM_Class8DlcKd_C "Anzahl Triggerereignisse für die Löschung von Fehlereinträgen mit Status Kundendienst" VALUE 0x1C9DB0 Kw_Wu8 255.0 OneToOne 0.00 255.0 FORMAT "%5.1" /end CHARACTERISTIC
/begin CHARACTERISTIC DSM_Class8Dlc_C "Anzahl Triggerereignisse für die Löschung von Fehlereinträgen" VALUE 0x1C9DB1 Kw_Wu8 255.0 OneToOne 0.00 255.0 FORMAT "%5.1" /end CHARACTERISTIC
/begin CHARACTERISTIC DSM_Class8Prio_C "Priorität des Fehlereintrages für Verdrängung und freeze frame Zuordnung" VALUE 0x1C9DB2 Kw_Wu8 255.0 OneToOne 0.00 255.0 FORMAT "%5.1" /end CHARACTERISTIC
/begin CHARACTERISTIC DSM_Class8SysLamp_C "Art der Systemlampenansteuerung" VALUE 0x1C9DB3 Kw_Wu8 2.00000000000 SysLamp 0.00 2.00000000000 FORMAT "%13.11" /end CHARACTERISTIC
/begin CHARACTERISTIC DSM_Class8ResErf_C "Verhalten Fehlerflags bei Reset und abgebrochenem Nachlauf" VALUE 0x1C9DB4 Kw_Wu8 3.00000000000 ResErf 0.00 3.00000000000 FORMAT "%13.11" /end CHARACTERISTIC
/begin CHARACTERISTIC DSM_Class8Readiness_C "Zuordnung Entprellklasse zu Readiness Flags" VALUE 0x1C9DB5 Kw_Wu8 64.0000000000 Readiness 0.00 64.0000000000 FORMAT "%13.10" /end CHARACTERISTIC
/begin CHARACTERISTIC DSM_Class9Mil_C "Art der MIL Ansteuerung" VALUE 0x1C9DB6 Kw_Wu8 2.00000000000 Mil 0.00 2.00000000000 FORMAT "%13.11" /end CHARACTERISTIC
/begin CHARACTERISTIC DSM_Class9TFlc_C "Trigger Art für Fehlereintrags Bestätigungsentprellung (->Lampe an)" VALUE 0x1C9DB7 Kw_Wu8 3.00000000000 ClassTrigger 0.00 3.00000000000 FORMAT "%13.11" /end CHARACTERISTIC
/begin CHARACTERISTIC DSM_Class9Flc_C "Anzahl Triggerereignisse für Fehlereintrags Bestätigungsentprellung (->Lampe an)" VALUE 0x1C9DB8 Kw_Wu8 255.0 OneToOne 0.00 255.0 FORMAT "%5.1" /end CHARACTERISTIC
/begin CHARACTERISTIC DSM_Class9THlc_C "Trigger Art für Fehlerheilung (->Lampe aus)" VALUE 0x1C9DB9 Kw_Wu8 3.00000000000 ClassTrigger 0.00 3.00000000000 FORMAT "%13.11" /end CHARACTERISTIC
/begin CHARACTERISTIC DSM_Class9Hlc_C "Anzahl Triggerereignisse für Fehlerheilung (->Lampe aus)" VALUE 0x1C9DBA Kw_Wu8 255.0 OneToOne 0.00 255.0 FORMAT "%5.1" /end CHARACTERISTIC
/begin CHARACTERISTIC DSM_Class9Scatt_C "Fehler ist lesbar für OBD Scan tool tester (SCATT) wenn Wert = 1" VALUE 0x1C9DBB Kw_Wu8 1.00000000000 Scatt 0.00 1.00000000000 FORMAT "%13.11" /end CHARACTERISTIC
/begin CHARACTERISTIC DSM_Class9TDlcPen_C "Trigger Art für Löschentprellung von nicht bestätigten Fehlern (pending)" VALUE 0x1C9DBC Kw_Wu8 3.00000000000 ClassTriggerTDlc 0.00 3.00000000000 FORMAT "%13.11" /end CHARACTERISTIC
/begin CHARACTERISTIC DSM_Class9DlcPen_C "Anzahl Triggerereignisse für die Löschung von nicht bestätigten Fehlern (pending)" VALUE 0x1C9DBD Kw_Wu8 255.0 OneToOne 0.00 255.0 FORMAT "%5.1" /end CHARACTERISTIC
/begin CHARACTERISTIC DSM_Class9TDlc_C "Trigger Art für Löschentprellung" VALUE 0x1C9DBE Kw_Wu8 3.00000000000 ClassTriggerTDlc 0.00 3.00000000000 FORMAT "%13.11" /end CHARACTERISTIC
/begin CHARACTERISTIC DSM_Class9DlcKd_C "Anzahl Triggerereignisse für die Löschung von Fehlereinträgen mit Status Kundendienst" VALUE 0x1C9DBF Kw_Wu8 255.0 OneToOne 0.00 255.0 FORMAT "%5.1" /end CHARACTERISTIC
/begin CHARACTERISTIC DSM_Class9Dlc_C "Anzahl Triggerereignisse für die Löschung von Fehlereinträgen" VALUE 0x1C9DC0 Kw_Wu8 255.0 OneToOne 0.00 255.0 FORMAT "%5.1" /end CHARACTERISTIC
/begin CHARACTERISTIC DSM_Class9Prio_C "Priorität des Fehlereintrages für Verdrängung und freeze frame Zuordnung" VALUE 0x1C9DC1 Kw_Wu8 255.0 OneToOne 0.00 255.0 FORMAT "%5.1" /end CHARACTERISTIC
/begin CHARACTERISTIC DSM_Class9SysLamp_C "Art der Systemlampenansteuerung" VALUE 0x1C9DC2 Kw_Wu8 2.00000000000 SysLamp 0.00 2.00000000000 FORMAT "%13.11" /end CHARACTERISTIC
/begin CHARACTERISTIC DSM_Class9ResErf_C "Verhalten Fehlerflags bei Reset und abgebrochenem Nachlauf" VALUE 0x1C9DC3 Kw_Wu8 3.00000000000 ResErf 0.00 3.00000000000 FORMAT "%13.11" /end CHARACTERISTIC
/begin CHARACTERISTIC DSM_Class9Readiness_C "Zuordnung Entprellklasse zu Readiness Flags" VALUE 0x1C9DC4 Kw_Wu8 64.0000000000 Readiness 0.00 64.0000000000 FORMAT "%13.10" /end CHARACTERISTIC
/begin CHARACTERISTIC DSM_Class10Mil_C "Art der MIL Ansteuerung" VALUE 0x1C9DC5 Kw_Wu8 2.00000000000 Mil 0.00 2.00000000000 FORMAT "%13.11" /end CHARACTERISTIC
/begin CHARACTERISTIC DSM_Class10TFlc_C "Trigger Art für Fehlereintrags Bestätigungsentprellung (->Lampe an)" VALUE 0x1C9DC6 Kw_Wu8 3.00000000000 ClassTrigger 0.00 3.00000000000 FORMAT "%13.11" /end CHARACTERISTIC
/begin CHARACTERISTIC DSM_Class10Flc_C "Anzahl Triggerereignisse für Fehlereintrags Bestätigungsentprellung (->Lampe an)" VALUE 0x1C9DC7 Kw_Wu8 255.0 OneToOne 0.00 255.0 FORMAT "%5.1" /end CHARACTERISTIC
/begin CHARACTERISTIC DSM_Class10THlc_C "Trigger Art für Fehlerheilung (->Lampe aus)" VALUE 0x1C9DC8 Kw_Wu8 3.00000000000 ClassTrigger 0.00 3.00000000000 FORMAT "%13.11" /end CHARACTERISTIC
/begin CHARACTERISTIC DSM_Class10Hlc_C "Anzahl Triggerereignisse für Fehlerheilung (->Lampe aus)" VALUE 0x1C9DC9 Kw_Wu8 255.0 OneToOne 0.00 255.0 FORMAT "%5.1" /end CHARACTERISTIC
/begin CHARACTERISTIC DSM_Class10Scatt_C "Fehler ist lesbar für OBD Scan tool tester (SCATT) wenn Wert = 1" VALUE 0x1C9DCA Kw_Wu8 1.00000000000 Scatt 0.00 1.00000000000 FORMAT "%13.11" /end CHARACTERISTIC
/begin CHARACTERISTIC DSM_Class10TDlcPen_C "Trigger Art für Löschentprellung von nicht bestätigten Fehlern (pending)" VALUE 0x1C9DCB Kw_Wu8 3.00000000000 ClassTriggerTDlc 0.00 3.00000000000 FORMAT "%13.11" /end CHARACTERISTIC
/begin CHARACTERISTIC DSM_Class10DlcPen_C "Anzahl Triggerereignisse für die Löschung von nicht bestätigten Fehlern (pending)" VALUE 0x1C9DCC Kw_Wu8 255.0 OneToOne 0.00 255.0 FORMAT "%5.1" /end CHARACTERISTIC
/begin CHARACTERISTIC DSM_Class10TDlc_C "Trigger Art für Löschentprellung" VALUE 0x1C9DCD Kw_Wu8 3.00000000000 ClassTriggerTDlc 0.00 3.00000000000 FORMAT "%13.11" /end CHARACTERISTIC
/begin CHARACTERISTIC DSM_Class10DlcKd_C "Anzahl Triggerereignisse für die Löschung von Fehlereinträgen mit Status Kundendienst" VALUE 0x1C9DCE Kw_Wu8 255.0 OneToOne 0.00 255.0 FORMAT "%5.1" /end CHARACTERISTIC
/begin CHARACTERISTIC DSM_Class10Dlc_C "Anzahl Triggerereignisse für die Löschung von Fehlereinträgen" VALUE 0x1C9DCF Kw_Wu8 255.0 OneToOne 0.00 255.0 FORMAT "%5.1" /end CHARACTERISTIC
/begin CHARACTERISTIC DSM_Class10Prio_C "Priorität des Fehlereintrages für Verdrängung und freeze frame Zuordnung" VALUE 0x1C9DD0 Kw_Wu8 255.0 OneToOne 0.00 255.0 FORMAT "%5.1" /end CHARACTERISTIC
/begin CHARACTERISTIC DSM_Class10SysLamp_C "Art der Systemlampenansteuerung" VALUE 0x1C9DD1 Kw_Wu8 2.00000000000 SysLamp 0.00 2.00000000000 FORMAT "%13.11" /end CHARACTERISTIC
/begin CHARACTERISTIC DSM_Class10ResErf_C "Verhalten Fehlerflags bei Reset und abgebrochenem Nachlauf" VALUE 0x1C9DD2 Kw_Wu8 3.00000000000 ResErf 0.00 3.00000000000 FORMAT "%13.11" /end CHARACTERISTIC
/begin CHARACTERISTIC DSM_Class10Readiness_C "Zuordnung Entprellklasse zu Readiness Flags" VALUE 0x1C9DD3 Kw_Wu8 64.0000000000 Readiness 0.00 64.0000000000 FORMAT "%13.10" /end CHARACTERISTIC
/begin CHARACTERISTIC DSM_Class11Mil_C "Art der MIL Ansteuerung" VALUE 0x1C9DD4 Kw_Wu8 2.00000000000 Mil 0.00 2.00000000000 FORMAT "%13.11" /end CHARACTERISTIC
/begin CHARACTERISTIC DSM_Class11TFlc_C "Trigger Art für Fehlereintrags Bestätigungsentprellung (->Lampe an)" VALUE 0x1C9DD5 Kw_Wu8 3.00000000000 ClassTrigger 0.00 3.00000000000 FORMAT "%13.11" /end CHARACTERISTIC
/begin CHARACTERISTIC DSM_Class11Flc_C "Anzahl Triggerereignisse für Fehlereintrags Bestätigungsentprellung (->Lampe an)" VALUE 0x1C9DD6 Kw_Wu8 255.0 OneToOne 0.00 255.0 FORMAT "%5.1" /end CHARACTERISTIC
/begin CHARACTERISTIC DSM_Class11THlc_C "Trigger Art für Fehlerheilung (->Lampe aus)" VALUE 0x1C9DD7 Kw_Wu8 3.00000000000 ClassTrigger 0.00 3.00000000000 FORMAT "%13.11" /end CHARACTERISTIC
/begin CHARACTERISTIC DSM_Class11Hlc_C "Anzahl Triggerereignisse für Fehlerheilung (->Lampe aus)" VALUE 0x1C9DD8 Kw_Wu8 255.0 OneToOne 0.00 255.0 FORMAT "%5.1" /end CHARACTERISTIC
/begin CHARACTERISTIC DSM_Class11Scatt_C "Fehler ist lesbar für OBD Scan tool tester (SCATT) wenn Wert = 1" VALUE 0x1C9DD9 Kw_Wu8 1.00000000000 Scatt 0.00 1.00000000000 FORMAT "%13.11" /end CHARACTERISTIC
/begin CHARACTERISTIC DSM_Class11TDlcPen_C "Trigger Art für Löschentprellung von nicht bestätigten Fehlern (pending)" VALUE 0x1C9DDA Kw_Wu8 3.00000000000 ClassTriggerTDlc 0.00 3.00000000000 FORMAT "%13.11" /end CHARACTERISTIC
/begin CHARACTERISTIC DSM_Class11DlcPen_C "Anzahl Triggerereignisse für die Löschung von nicht bestätigten Fehlern (pending)" VALUE 0x1C9DDB Kw_Wu8 255.0 OneToOne 0.00 255.0 FORMAT "%5.1" /end CHARACTERISTIC
/begin CHARACTERISTIC DSM_Class11TDlc_C "Trigger Art für Löschentprellung" VALUE 0x1C9DDC Kw_Wu8 3.00000000000 ClassTriggerTDlc 0.00 3.00000000000 FORMAT "%13.11" /end CHARACTERISTIC
/begin CHARACTERISTIC DSM_Class11DlcKd_C "Anzahl Triggerereignisse für die Löschung von Fehlereinträgen mit Status Kundendienst" VALUE 0x1C9DDD Kw_Wu8 255.0 OneToOne 0.00 255.0 FORMAT "%5.1" /end CHARACTERISTIC
/begin CHARACTERISTIC DSM_Class11Dlc_C "Anzahl Triggerereignisse für die Löschung von Fehlereinträgen" VALUE 0x1C9DDE Kw_Wu8 255.0 OneToOne 0.00 255.0 FORMAT "%5.1" /end CHARACTERISTIC
/begin CHARACTERISTIC DSM_Class11Prio_C "Priorität des Fehlereintrages für Verdrängung und freeze frame Zuordnung" VALUE 0x1C9DDF Kw_Wu8 255.0 OneToOne 0.00 255.0 FORMAT "%5.1" /end CHARACTERISTIC
/begin CHARACTERISTIC DSM_Class11SysLamp_C "Art der Systemlampenansteuerung" VALUE 0x1C9DE0 Kw_Wu8 2.00000000000 SysLamp 0.00 2.00000000000 FORMAT "%13.11" /end CHARACTERISTIC
/begin CHARACTERISTIC DSM_Class11ResErf_C "Verhalten Fehlerflags bei Reset und abgebrochenem Nachlauf" VALUE 0x1C9DE1 Kw_Wu8 3.00000000000 ResErf 0.00 3.00000000000 FORMAT "%13.11" /end CHARACTERISTIC
/begin CHARACTERISTIC DSM_Class11Readiness_C "Zuordnung Entprellklasse zu Readiness Flags" VALUE 0x1C9DE2 Kw_Wu8 64.0000000000 Readiness 0.00 64.0000000000 FORMAT "%13.10" /end CHARACTERISTIC
/begin CHARACTERISTIC DSM_Class12Mil_C "Art der MIL Ansteuerung" VALUE 0x1C9DE3 Kw_Wu8 2.00000000000 Mil 0.00 2.00000000000 FORMAT "%13.11" /end CHARACTERISTIC
/begin CHARACTERISTIC DSM_Class12TFlc_C "Trigger Art für Fehlereintrags Bestätigungsentprellung (->Lampe an)" VALUE 0x1C9DE4 Kw_Wu8 3.00000000000 ClassTrigger 0.00 3.00000000000 FORMAT "%13.11" /end CHARACTERISTIC
/begin CHARACTERISTIC DSM_Class12Flc_C "Anzahl Triggerereignisse für Fehlereintrags Bestätigungsentprellung (->Lampe an)" VALUE 0x1C9DE5 Kw_Wu8 255.0 OneToOne 0.00 255.0 FORMAT "%5.1" /end CHARACTERISTIC
/begin CHARACTERISTIC DSM_Class12THlc_C "Trigger Art für Fehlerheilung (->Lampe aus)" VALUE 0x1C9DE6 Kw_Wu8 3.00000000000 ClassTrigger 0.00 3.00000000000 FORMAT "%13.11" /end CHARACTERISTIC
/begin CHARACTERISTIC DSM_Class12Hlc_C "Anzahl Triggerereignisse für Fehlerheilung (->Lampe aus)" VALUE 0x1C9DE7 Kw_Wu8 255.0 OneToOne 0.00 255.0 FORMAT "%5.1" /end CHARACTERISTIC
/begin CHARACTERISTIC DSM_Class12Scatt_C "Fehler ist lesbar für OBD Scan tool tester (SCATT) wenn Wert = 1" VALUE 0x1C9DE8 Kw_Wu8 1.00000000000 Scatt 0.00 1.00000000000 FORMAT "%13.11" /end CHARACTERISTIC
/begin CHARACTERISTIC DSM_Class12TDlcPen_C "Trigger Art für Löschentprellung von nicht bestätigten Fehlern (pending)" VALUE 0x1C9DE9 Kw_Wu8 3.00000000000 ClassTriggerTDlc 0.00 3.00000000000 FORMAT "%13.11" /end CHARACTERISTIC
/begin CHARACTERISTIC DSM_Class12DlcPen_C "Anzahl Triggerereignisse für die Löschung von nicht bestätigten Fehlern (pending)" VALUE 0x1C9DEA Kw_Wu8 255.0 OneToOne 0.00 255.0 FORMAT "%5.1" /end CHARACTERISTIC
/begin CHARACTERISTIC DSM_Class12TDlc_C "Trigger Art für Löschentprellung" VALUE 0x1C9DEB Kw_Wu8 3.00000000000 ClassTriggerTDlc 0.00 3.00000000000 FORMAT "%13.11" /end CHARACTERISTIC
/begin CHARACTERISTIC DSM_Class12DlcKd_C "Anzahl Triggerereignisse für die Löschung von Fehlereinträgen mit Status Kundendienst" VALUE 0x1C9DEC Kw_Wu8 255.0 OneToOne 0.00 255.0 FORMAT "%5.1" /end CHARACTERISTIC
/begin CHARACTERISTIC DSM_Class12Dlc_C "Anzahl Triggerereignisse für die Löschung von Fehlereinträgen" VALUE 0x1C9DED Kw_Wu8 255.0 OneToOne 0.00 255.0 FORMAT "%5.1" /end CHARACTERISTIC
/begin CHARACTERISTIC DSM_Class12Prio_C "Priorität des Fehlereintrages für Verdrängung und freeze frame Zuordnung" VALUE 0x1C9DEE Kw_Wu8 255.0 OneToOne 0.00 255.0 FORMAT "%5.1" /end CHARACTERISTIC
/begin CHARACTERISTIC DSM_Class12SysLamp_C "Art der Systemlampenansteuerung" VALUE 0x1C9DEF Kw_Wu8 2.00000000000 SysLamp 0.00 2.00000000000 FORMAT "%13.11" /end CHARACTERISTIC
/begin CHARACTERISTIC DSM_Class12ResErf_C "Verhalten Fehlerflags bei Reset und abgebrochenem Nachlauf" VALUE 0x1C9DF0 Kw_Wu8 3.00000000000 ResErf 0.00 3.00000000000 FORMAT "%13.11" /end CHARACTERISTIC
/begin CHARACTERISTIC DSM_Class12Readiness_C "Zuordnung Entprellklasse zu Readiness Flags" VALUE 0x1C9DF1 Kw_Wu8 64.0000000000 Readiness 0.00 64.0000000000 FORMAT "%13.10" /end CHARACTERISTIC
/begin CHARACTERISTIC DSM_Class13Mil_C "Art der MIL Ansteuerung" VALUE 0x1C9DF2 Kw_Wu8 2.00000000000 Mil 0.00 2.00000000000 FORMAT "%13.11" /end CHARACTERISTIC
/begin CHARACTERISTIC DSM_Class13TFlc_C "Trigger Art für Fehlereintrags Bestätigungsentprellung (->Lampe an)" VALUE 0x1C9DF3 Kw_Wu8 3.00000000000 ClassTrigger 0.00 3.00000000000 FORMAT "%13.11" /end CHARACTERISTIC
/begin CHARACTERISTIC DSM_Class13Flc_C "Anzahl Triggerereignisse für Fehlereintrags Bestätigungsentprellung (->Lampe an)" VALUE 0x1C9DF4 Kw_Wu8 255.0 OneToOne 0.00 255.0 FORMAT "%5.1" /end CHARACTERISTIC
/begin CHARACTERISTIC DSM_Class13THlc_C "Trigger Art für Fehlerheilung (->Lampe aus)" VALUE 0x1C9DF5 Kw_Wu8 3.00000000000 ClassTrigger 0.00 3.00000000000 FORMAT "%13.11" /end CHARACTERISTIC
/begin CHARACTERISTIC DSM_Class13Hlc_C "Anzahl Triggerereignisse für Fehlerheilung (->Lampe aus)" VALUE 0x1C9DF6 Kw_Wu8 255.0 OneToOne 0.00 255.0 FORMAT "%5.1" /end CHARACTERISTIC
/begin CHARACTERISTIC DSM_Class13Scatt_C "Fehler ist lesbar für OBD Scan tool tester (SCATT) wenn Wert = 1" VALUE 0x1C9DF7 Kw_Wu8 1.00000000000 Scatt 0.00 1.00000000000 FORMAT "%13.11" /end CHARACTERISTIC
/begin CHARACTERISTIC DSM_Class13TDlcPen_C "Trigger Art für Löschentprellung von nicht bestätigten Fehlern (pending)" VALUE 0x1C9DF8 Kw_Wu8 3.00000000000 ClassTriggerTDlc 0.00 3.00000000000 FORMAT "%13.11" /end CHARACTERISTIC
/begin CHARACTERISTIC DSM_Class13DlcPen_C "Anzahl Triggerereignisse für die Löschung von nicht bestätigten Fehlern (pending)" VALUE 0x1C9DF9 Kw_Wu8 255.0 OneToOne 0.00 255.0 FORMAT "%5.1" /end CHARACTERISTIC
/begin CHARACTERISTIC DSM_Class13TDlc_C "Trigger Art für Löschentprellung" VALUE 0x1C9DFA Kw_Wu8 3.00000000000 ClassTriggerTDlc 0.00 3.00000000000 FORMAT "%13.11" /end CHARACTERISTIC
/begin CHARACTERISTIC DSM_Class13DlcKd_C "Anzahl Triggerereignisse für die Löschung von Fehlereinträgen mit Status Kundendienst" VALUE 0x1C9DFB Kw_Wu8 255.0 OneToOne 0.00 255.0 FORMAT "%5.1" /end CHARACTERISTIC
/begin CHARACTERISTIC DSM_Class13Dlc_C "Anzahl Triggerereignisse für die Löschung von Fehlereinträgen" VALUE 0x1C9DFC Kw_Wu8 255.0 OneToOne 0.00 255.0 FORMAT "%5.1" /end CHARACTERISTIC
/begin CHARACTERISTIC DSM_Class13Prio_C "Priorität des Fehlereintrages für Verdrängung und freeze frame Zuordnung" VALUE 0x1C9DFD Kw_Wu8 255.0 OneToOne 0.00 255.0 FORMAT "%5.1" /end CHARACTERISTIC
/begin CHARACTERISTIC DSM_Class13SysLamp_C "Art der Systemlampenansteuerung" VALUE 0x1C9DFE Kw_Wu8 2.00000000000 SysLamp 0.00 2.00000000000 FORMAT "%13.11" /end CHARACTERISTIC
/begin CHARACTERISTIC DSM_Class13ResErf_C "Verhalten Fehlerflags bei Reset und abgebrochenem Nachlauf" VALUE 0x1C9DFF Kw_Wu8 3.00000000000 ResErf 0.00 3.00000000000 FORMAT "%13.11" /end CHARACTERISTIC
/begin CHARACTERISTIC DSM_Class13Readiness_C "Zuordnung Entprellklasse zu Readiness Flags" VALUE 0x1C9E00 Kw_Wu8 64.0000000000 Readiness 0.00 64.0000000000 FORMAT "%13.10" /end CHARACTERISTIC
/begin CHARACTERISTIC DSM_Class14Mil_C "Art der MIL Ansteuerung" VALUE 0x1C9E01 Kw_Wu8 2.00000000000 Mil 0.00 2.00000000000 FORMAT "%13.11" /end CHARACTERISTIC
/begin CHARACTERISTIC DSM_Class14TFlc_C "Trigger Art für Fehlereintrags Bestätigungsentprellung (->Lampe an)" VALUE 0x1C9E02 Kw_Wu8 3.00000000000 ClassTrigger 0.00 3.00000000000 FORMAT "%13.11" /end CHARACTERISTIC
/begin CHARACTERISTIC DSM_Class14Flc_C "Anzahl Triggerereignisse für Fehlereintrags Bestätigungsentprellung (->Lampe an)" VALUE 0x1C9E03 Kw_Wu8 255.0 OneToOne 0.00 255.0 FORMAT "%5.1" /end CHARACTERISTIC
/begin CHARACTERISTIC DSM_Class14THlc_C "Trigger Art für Fehlerheilung (->Lampe aus)" VALUE 0x1C9E04 Kw_Wu8 3.00000000000 ClassTrigger 0.00 3.00000000000 FORMAT "%13.11" /end CHARACTERISTIC
/begin CHARACTERISTIC DSM_Class14Hlc_C "Anzahl Triggerereignisse für Fehlerheilung (->Lampe aus)" VALUE 0x1C9E05 Kw_Wu8 255.0 OneToOne 0.00 255.0 FORMAT "%5.1" /end CHARACTERISTIC
/begin CHARACTERISTIC DSM_Class14Scatt_C "Fehler ist lesbar für OBD Scan tool tester (SCATT) wenn Wert = 1" VALUE 0x1C9E06 Kw_Wu8 1.00000000000 Scatt 0.00 1.00000000000 FORMAT "%13.11" /end CHARACTERISTIC
/begin CHARACTERISTIC DSM_Class14TDlcPen_C "Trigger Art für Löschentprellung von nicht bestätigten Fehlern (pending)" VALUE 0x1C9E07 Kw_Wu8 3.00000000000 ClassTriggerTDlc 0.00 3.00000000000 FORMAT "%13.11" /end CHARACTERISTIC
/begin CHARACTERISTIC DSM_Class14DlcPen_C "Anzahl Triggerereignisse für die Löschung von nicht bestätigten Fehlern (pending)" VALUE 0x1C9E08 Kw_Wu8 255.0 OneToOne 0.00 255.0 FORMAT "%5.1" /end CHARACTERISTIC
/begin CHARACTERISTIC DSM_Class14TDlc_C "Trigger Art für Löschentprellung" VALUE 0x1C9E09 Kw_Wu8 3.00000000000 ClassTriggerTDlc 0.00 3.00000000000 FORMAT "%13.11" /end CHARACTERISTIC
/begin CHARACTERISTIC DSM_Class14DlcKd_C "Anzahl Triggerereignisse für die Löschung von Fehlereinträgen mit Status Kundendienst" VALUE 0x1C9E0A Kw_Wu8 255.0 OneToOne 0.00 255.0 FORMAT "%5.1" /end CHARACTERISTIC
/begin CHARACTERISTIC DSM_Class14Dlc_C "Anzahl Triggerereignisse für die Löschung von Fehlereinträgen" VALUE 0x1C9E0B Kw_Wu8 255.0 OneToOne 0.00 255.0 FORMAT "%5.1" /end CHARACTERISTIC
/begin CHARACTERISTIC DSM_Class14Prio_C "Priorität des Fehlereintrages für Verdrängung und freeze frame Zuordnung" VALUE 0x1C9E0C Kw_Wu8 255.0 OneToOne 0.00 255.0 FORMAT "%5.1" /end CHARACTERISTIC
/begin CHARACTERISTIC DSM_Class14SysLamp_C "Art der Systemlampenansteuerung" VALUE 0x1C9E0D Kw_Wu8 2.00000000000 SysLamp 0.00 2.00000000000 FORMAT "%13.11" /end CHARACTERISTIC
/begin CHARACTERISTIC DSM_Class14ResErf_C "Verhalten Fehlerflags bei Reset und abgebrochenem Nachlauf" VALUE 0x1C9E0E Kw_Wu8 3.00000000000 ResErf 0.00 3.00000000000 FORMAT "%13.11" /end CHARACTERISTIC
/begin CHARACTERISTIC DSM_Class14Readiness_C "Zuordnung Entprellklasse zu Readiness Flags" VALUE 0x1C9E0F Kw_Wu8 64.0000000000 Readiness 0.00 64.0000000000 FORMAT "%13.10" /end CHARACTERISTIC
/begin CHARACTERISTIC DSM_Class15Mil_C "Art der MIL Ansteuerung" VALUE 0x1C9E10 Kw_Wu8 2.00000000000 Mil 0.00 2.00000000000 FORMAT "%13.11" /end CHARACTERISTIC
/begin CHARACTERISTIC DSM_Class15TFlc_C "Trigger Art für Fehlereintrags Bestätigungsentprellung (->Lampe an)" VALUE 0x1C9E11 Kw_Wu8 3.00000000000 ClassTrigger 0.00 3.00000000000 FORMAT "%13.11" /end CHARACTERISTIC
/begin CHARACTERISTIC DSM_Class15Flc_C "Anzahl Triggerereignisse für Fehlereintrags Bestätigungsentprellung (->Lampe an)" VALUE 0x1C9E12 Kw_Wu8 255.0 OneToOne 0.00 255.0 FORMAT "%5.1" /end CHARACTERISTIC
/begin CHARACTERISTIC DSM_Class15THlc_C "Trigger Art für Fehlerheilung (->Lampe aus)" VALUE 0x1C9E13 Kw_Wu8 3.00000000000 ClassTrigger 0.00 3.00000000000 FORMAT "%13.11" /end CHARACTERISTIC
/begin CHARACTERISTIC DSM_Class15Hlc_C "Anzahl Triggerereignisse für Fehlerheilung (->Lampe aus)" VALUE 0x1C9E14 Kw_Wu8 255.0 OneToOne 0.00 255.0 FORMAT "%5.1" /end CHARACTERISTIC
/begin CHARACTERISTIC DSM_Class15Scatt_C "Fehler ist lesbar für OBD Scan tool tester (SCATT) wenn Wert = 1" VALUE 0x1C9E15 Kw_Wu8 1.00000000000 Scatt 0.00 1.00000000000 FORMAT "%13.11" /end CHARACTERISTIC
/begin CHARACTERISTIC DSM_Class15TDlcPen_C "Trigger Art für Löschentprellung von nicht bestätigten Fehlern (pending)" VALUE 0x1C9E16 Kw_Wu8 3.00000000000 ClassTriggerTDlc 0.00 3.00000000000 FORMAT "%13.11" /end CHARACTERISTIC
/begin CHARACTERISTIC DSM_Class15DlcPen_C "Anzahl Triggerereignisse für die Löschung von nicht bestätigten Fehlern (pending)" VALUE 0x1C9E17 Kw_Wu8 255.0 OneToOne 0.00 255.0 FORMAT "%5.1" /end CHARACTERISTIC
/begin CHARACTERISTIC DSM_Class15TDlc_C "Trigger Art für Löschentprellung" VALUE 0x1C9E18 Kw_Wu8 3.00000000000 ClassTriggerTDlc 0.00 3.00000000000 FORMAT "%13.11" /end CHARACTERISTIC
/begin CHARACTERISTIC DSM_Class15DlcKd_C "Anzahl Triggerereignisse für die Löschung von Fehlereinträgen mit Status Kundendienst" VALUE 0x1C9E19 Kw_Wu8 255.0 OneToOne 0.00 255.0 FORMAT "%5.1" /end CHARACTERISTIC
/begin CHARACTERISTIC DSM_Class15Dlc_C "Anzahl Triggerereignisse für die Löschung von Fehlereinträgen" VALUE 0x1C9E1A Kw_Wu8 255.0 OneToOne 0.00 255.0 FORMAT "%5.1" /end CHARACTERISTIC
/begin CHARACTERISTIC DSM_Class15Prio_C "Priorität des Fehlereintrages für Verdrängung und freeze frame Zuordnung" VALUE 0x1C9E1B Kw_Wu8 255.0 OneToOne 0.00 255.0 FORMAT "%5.1" /end CHARACTERISTIC
/begin CHARACTERISTIC DSM_Class15SysLamp_C "Art der Systemlampenansteuerung" VALUE 0x1C9E1C Kw_Wu8 2.00000000000 SysLamp 0.00 2.00000000000 FORMAT "%13.11" /end CHARACTERISTIC
/begin CHARACTERISTIC DSM_Class15ResErf_C "Verhalten Fehlerflags bei Reset und abgebrochenem Nachlauf" VALUE 0x1C9E1D Kw_Wu8 3.00000000000 ResErf 0.00 3.00000000000 FORMAT "%13.11" /end CHARACTERISTIC
/begin CHARACTERISTIC DSM_Class15Readiness_C "Zuordnung Entprellklasse zu Readiness Flags" VALUE 0x1C9E1E Kw_Wu8 64.0000000000 Readiness 0.00 64.0000000000 FORMAT "%13.10" /end CHARACTERISTIC
/begin CHARACTERISTIC DSM_Class16Mil_C "Art der MIL Ansteuerung" VALUE 0x1C9E1F Kw_Wu8 2.00000000000 Mil 0.00 2.00000000000 FORMAT "%13.11" /end CHARACTERISTIC
/begin CHARACTERISTIC DSM_Class16TFlc_C "Trigger Art für Fehlereintrags Bestätigungsentprellung (->Lampe an)" VALUE 0x1C9E20 Kw_Wu8 3.00000000000 ClassTrigger 0.00 3.00000000000 FORMAT "%13.11" /end CHARACTERISTIC
/begin CHARACTERISTIC DSM_Class16Flc_C "Anzahl Triggerereignisse für Fehlereintrags Bestätigungsentprellung (->Lampe an)" VALUE 0x1C9E21 Kw_Wu8 255.0 OneToOne 0.00 255.0 FORMAT "%5.1" /end CHARACTERISTIC
/begin CHARACTERISTIC DSM_Class16THlc_C "Trigger Art für Fehlerheilung (->Lampe aus)" VALUE 0x1C9E22 Kw_Wu8 3.00000000000 ClassTrigger 0.00 3.00000000000 FORMAT "%13.11" /end CHARACTERISTIC
/begin CHARACTERISTIC DSM_Class16Hlc_C "Anzahl Triggerereignisse für Fehlerheilung (->Lampe aus)" VALUE 0x1C9E23 Kw_Wu8 255.0 OneToOne 0.00 255.0 FORMAT "%5.1" /end CHARACTERISTIC
/begin CHARACTERISTIC DSM_Class16Scatt_C "Fehler ist lesbar für OBD Scan tool tester (SCATT) wenn Wert = 1" VALUE 0x1C9E24 Kw_Wu8 1.00000000000 Scatt 0.00 1.00000000000 FORMAT "%13.11" /end CHARACTERISTIC
/begin CHARACTERISTIC DSM_Class16TDlcPen_C "Trigger Art für Löschentprellung von nicht bestätigten Fehlern (pending)" VALUE 0x1C9E25 Kw_Wu8 3.00000000000 ClassTriggerTDlc 0.00 3.00000000000 FORMAT "%13.11" /end CHARACTERISTIC
/begin CHARACTERISTIC DSM_Class16DlcPen_C "Anzahl Triggerereignisse für die Löschung von nicht bestätigten Fehlern (pending)" VALUE 0x1C9E26 Kw_Wu8 255.0 OneToOne 0.00 255.0 FORMAT "%5.1" /end CHARACTERISTIC
/begin CHARACTERISTIC DSM_Class16TDlc_C "Trigger Art für Löschentprellung" VALUE 0x1C9E27 Kw_Wu8 3.00000000000 ClassTriggerTDlc 0.00 3.00000000000 FORMAT "%13.11" /end CHARACTERISTIC
/begin CHARACTERISTIC DSM_Class16DlcKd_C "Anzahl Triggerereignisse für die Löschung von Fehlereinträgen mit Status Kundendienst" VALUE 0x1C9E28 Kw_Wu8 255.0 OneToOne 0.00 255.0 FORMAT "%5.1" /end CHARACTERISTIC
/begin CHARACTERISTIC DSM_Class16Dlc_C "Anzahl Triggerereignisse für die Löschung von Fehlereinträgen" VALUE 0x1C9E29 Kw_Wu8 255.0 OneToOne 0.00 255.0 FORMAT "%5.1" /end CHARACTERISTIC
/begin CHARACTERISTIC DSM_Class16Prio_C "Priorität des Fehlereintrages für Verdrängung und freeze frame Zuordnung" VALUE 0x1C9E2A Kw_Wu8 255.0 OneToOne 0.00 255.0 FORMAT "%5.1" /end CHARACTERISTIC
/begin CHARACTERISTIC DSM_Class16SysLamp_C "Art der Systemlampenansteuerung" VALUE 0x1C9E2B Kw_Wu8 2.00000000000 SysLamp 0.00 2.00000000000 FORMAT "%13.11" /end CHARACTERISTIC
/begin CHARACTERISTIC DSM_Class16ResErf_C "Verhalten Fehlerflags bei Reset und abgebrochenem Nachlauf" VALUE 0x1C9E2C Kw_Wu8 3.00000000000 ResErf 0.00 3.00000000000 FORMAT "%13.11" /end CHARACTERISTIC
/begin CHARACTERISTIC DSM_Class16Readiness_C "Zuordnung Entprellklasse zu Readiness Flags" VALUE 0x1C9E2D Kw_Wu8 64.0000000000 Readiness 0.00 64.0000000000 FORMAT "%13.10" /end CHARACTERISTIC
/begin CHARACTERISTIC DSM_Class17Mil_C "Art der MIL Ansteuerung" VALUE 0x1C9E2E Kw_Wu8 2.00000000000 Mil 0.00 2.00000000000 FORMAT "%13.11" /end CHARACTERISTIC
/begin CHARACTERISTIC DSM_Class17TFlc_C "Trigger Art für Fehlereintrags Bestätigungsentprellung (->Lampe an)" VALUE 0x1C9E2F Kw_Wu8 3.00000000000 ClassTrigger 0.00 3.00000000000 FORMAT "%13.11" /end CHARACTERISTIC
/begin CHARACTERISTIC DSM_Class17Flc_C "Anzahl Triggerereignisse für Fehlereintrags Bestätigungsentprellung (->Lampe an)" VALUE 0x1C9E30 Kw_Wu8 255.0 OneToOne 0.00 255.0 FORMAT "%5.1" /end CHARACTERISTIC
/begin CHARACTERISTIC DSM_Class17THlc_C "Trigger Art für Fehlerheilung (->Lampe aus)" VALUE 0x1C9E31 Kw_Wu8 3.00000000000 ClassTrigger 0.00 3.00000000000 FORMAT "%13.11" /end CHARACTERISTIC
/begin CHARACTERISTIC DSM_Class17Hlc_C "Anzahl Triggerereignisse für Fehlerheilung (->Lampe aus)" VALUE 0x1C9E32 Kw_Wu8 255.0 OneToOne 0.00 255.0 FORMAT "%5.1" /end CHARACTERISTIC
/begin CHARACTERISTIC DSM_Class17Scatt_C "Fehler ist lesbar für OBD Scan tool tester (SCATT) wenn Wert = 1" VALUE 0x1C9E33 Kw_Wu8 1.00000000000 Scatt 0.00 1.00000000000 FORMAT "%13.11" /end CHARACTERISTIC
/begin CHARACTERISTIC DSM_Class17TDlcPen_C "Trigger Art für Löschentprellung von nicht bestätigten Fehlern (pending)" VALUE 0x1C9E34 Kw_Wu8 3.00000000000 ClassTriggerTDlc 0.00 3.00000000000 FORMAT "%13.11" /end CHARACTERISTIC
/begin CHARACTERISTIC DSM_Class17DlcPen_C "Anzahl Triggerereignisse für die Löschung von nicht bestätigten Fehlern (pending)" VALUE 0x1C9E35 Kw_Wu8 255.0 OneToOne 0.00 255.0 FORMAT "%5.1" /end CHARACTERISTIC
/begin CHARACTERISTIC DSM_Class17TDlc_C "Trigger Art für Löschentprellung" VALUE 0x1C9E36 Kw_Wu8 3.00000000000 ClassTriggerTDlc 0.00 3.00000000000 FORMAT "%13.11" /end CHARACTERISTIC
/begin CHARACTERISTIC DSM_Class17DlcKd_C "Anzahl Triggerereignisse für die Löschung von Fehlereinträgen mit Status Kundendienst" VALUE 0x1C9E37 Kw_Wu8 255.0 OneToOne 0.00 255.0 FORMAT "%5.1" /end CHARACTERISTIC
/begin CHARACTERISTIC DSM_Class17Dlc_C "Anzahl Triggerereignisse für die Löschung von Fehlereinträgen" VALUE 0x1C9E38 Kw_Wu8 255.0 OneToOne 0.00 255.0 FORMAT "%5.1" /end CHARACTERISTIC
/begin CHARACTERISTIC DSM_Class17Prio_C "Priorität des Fehlereintrages für Verdrängung und freeze frame Zuordnung" VALUE 0x1C9E39 Kw_Wu8 255.0 OneToOne 0.00 255.0 FORMAT "%5.1" /end CHARACTERISTIC
/begin CHARACTERISTIC DSM_Class17SysLamp_C "Art der Systemlampenansteuerung" VALUE 0x1C9E3A Kw_Wu8 2.00000000000 SysLamp 0.00 2.00000000000 FORMAT "%13.11" /end CHARACTERISTIC
/begin CHARACTERISTIC DSM_Class17ResErf_C "Verhalten Fehlerflags bei Reset und abgebrochenem Nachlauf" VALUE 0x1C9E3B Kw_Wu8 3.00000000000 ResErf 0.00 3.00000000000 FORMAT "%13.11" /end CHARACTERISTIC
/begin CHARACTERISTIC DSM_Class17Readiness_C "Zuordnung Entprellklasse zu Readiness Flags" VALUE 0x1C9E3C Kw_Wu8 64.0000000000 Readiness 0.00 64.0000000000 FORMAT "%13.10" /end CHARACTERISTIC
/begin CHARACTERISTIC DSM_Class18Mil_C "Art der MIL Ansteuerung" VALUE 0x1C9E3D Kw_Wu8 2.00000000000 Mil 0.00 2.00000000000 FORMAT "%13.11" /end CHARACTERISTIC
/begin CHARACTERISTIC DSM_Class18TFlc_C "Trigger Art für Fehlereintrags Bestätigungsentprellung (->Lampe an)" VALUE 0x1C9E3E Kw_Wu8 3.00000000000 ClassTrigger 0.00 3.00000000000 FORMAT "%13.11" /end CHARACTERISTIC
/begin CHARACTERISTIC DSM_Class18Flc_C "Anzahl Triggerereignisse für Fehlereintrags Bestätigungsentprellung (->Lampe an)" VALUE 0x1C9E3F Kw_Wu8 255.0 OneToOne 0.00 255.0 FORMAT "%5.1" /end CHARACTERISTIC
/begin CHARACTERISTIC DSM_Class18THlc_C "Trigger Art für Fehlerheilung (->Lampe aus)" VALUE 0x1C9E40 Kw_Wu8 3.00000000000 ClassTrigger 0.00 3.00000000000 FORMAT "%13.11" /end CHARACTERISTIC
/begin CHARACTERISTIC DSM_Class18Hlc_C "Anzahl Triggerereignisse für Fehlerheilung (->Lampe aus)" VALUE 0x1C9E41 Kw_Wu8 255.0 OneToOne 0.00 255.0 FORMAT "%5.1" /end CHARACTERISTIC
/begin CHARACTERISTIC DSM_Class18Scatt_C "Fehler ist lesbar für OBD Scan tool tester (SCATT) wenn Wert = 1" VALUE 0x1C9E42 Kw_Wu8 1.00000000000 Scatt 0.00 1.00000000000 FORMAT "%13.11" /end CHARACTERISTIC
/begin CHARACTERISTIC DSM_Class18TDlcPen_C "Trigger Art für Löschentprellung von nicht bestätigten Fehlern (pending)" VALUE 0x1C9E43 Kw_Wu8 3.00000000000 ClassTriggerTDlc 0.00 3.00000000000 FORMAT "%13.11" /end CHARACTERISTIC
/begin CHARACTERISTIC DSM_Class18DlcPen_C "Anzahl Triggerereignisse für die Löschung von nicht bestätigten Fehlern (pending)" VALUE 0x1C9E44 Kw_Wu8 255.0 OneToOne 0.00 255.0 FORMAT "%5.1" /end CHARACTERISTIC
/begin CHARACTERISTIC DSM_Class18TDlc_C "Trigger Art für Löschentprellung" VALUE 0x1C9E45 Kw_Wu8 3.00000000000 ClassTriggerTDlc 0.00 3.00000000000 FORMAT "%13.11" /end CHARACTERISTIC
/begin CHARACTERISTIC DSM_Class18DlcKd_C "Anzahl Triggerereignisse für die Löschung von Fehlereinträgen mit Status Kundendienst" VALUE 0x1C9E46 Kw_Wu8 255.0 OneToOne 0.00 255.0 FORMAT "%5.1" /end CHARACTERISTIC
/begin CHARACTERISTIC DSM_Class18Dlc_C "Anzahl Triggerereignisse für die Löschung von Fehlereinträgen" VALUE 0x1C9E47 Kw_Wu8 255.0 OneToOne 0.00 255.0 FORMAT "%5.1" /end CHARACTERISTIC
/begin CHARACTERISTIC DSM_Class18Prio_C "Priorität des Fehlereintrages für Verdrängung und freeze frame Zuordnung" VALUE 0x1C9E48 Kw_Wu8 255.0 OneToOne 0.00 255.0 FORMAT "%5.1" /end CHARACTERISTIC
/begin CHARACTERISTIC DSM_Class18SysLamp_C "Art der Systemlampenansteuerung" VALUE 0x1C9E49 Kw_Wu8 2.00000000000 SysLamp 0.00 2.00000000000 FORMAT "%13.11" /end CHARACTERISTIC
/begin CHARACTERISTIC DSM_Class18ResErf_C "Verhalten Fehlerflags bei Reset und abgebrochenem Nachlauf" VALUE 0x1C9E4A Kw_Wu8 3.00000000000 ResErf 0.00 3.00000000000 FORMAT "%13.11" /end CHARACTERISTIC
/begin CHARACTERISTIC DSM_Class18Readiness_C "Zuordnung Entprellklasse zu Readiness Flags" VALUE 0x1C9E4B Kw_Wu8 64.0000000000 Readiness 0.00 64.0000000000 FORMAT "%13.10" /end CHARACTERISTIC
/begin CHARACTERISTIC DSM_Class19Mil_C "Art der MIL Ansteuerung" VALUE 0x1C9E4C Kw_Wu8 2.00000000000 Mil 0.00 2.00000000000 FORMAT "%13.11" /end CHARACTERISTIC
/begin CHARACTERISTIC DSM_Class19TFlc_C "Trigger Art für Fehlereintrags Bestätigungsentprellung (->Lampe an)" VALUE 0x1C9E4D Kw_Wu8 3.00000000000 ClassTrigger 0.00 3.00000000000 FORMAT "%13.11" /end CHARACTERISTIC
/begin CHARACTERISTIC DSM_Class19Flc_C "Anzahl Triggerereignisse für Fehlereintrags Bestätigungsentprellung (->Lampe an)" VALUE 0x1C9E4E Kw_Wu8 255.0 OneToOne 0.00 255.0 FORMAT "%5.1" /end CHARACTERISTIC
/begin CHARACTERISTIC DSM_Class19THlc_C "Trigger Art für Fehlerheilung (->Lampe aus)" VALUE 0x1C9E4F Kw_Wu8 3.00000000000 ClassTrigger 0.00 3.00000000000 FORMAT "%13.11" /end CHARACTERISTIC
/begin CHARACTERISTIC DSM_Class19Hlc_C "Anzahl Triggerereignisse für Fehlerheilung (->Lampe aus)" VALUE 0x1C9E50 Kw_Wu8 255.0 OneToOne 0.00 255.0 FORMAT "%5.1" /end CHARACTERISTIC
/begin CHARACTERISTIC DSM_Class19Scatt_C "Fehler ist lesbar für OBD Scan tool tester (SCATT) wenn Wert = 1" VALUE 0x1C9E51 Kw_Wu8 1.00000000000 Scatt 0.00 1.00000000000 FORMAT "%13.11" /end CHARACTERISTIC
/begin CHARACTERISTIC DSM_Class19TDlcPen_C "Trigger Art für Löschentprellung von nicht bestätigten Fehlern (pending)" VALUE 0x1C9E52 Kw_Wu8 3.00000000000 ClassTriggerTDlc 0.00 3.00000000000 FORMAT "%13.11" /end CHARACTERISTIC
/begin CHARACTERISTIC DSM_Class19DlcPen_C "Anzahl Triggerereignisse für die Löschung von nicht bestätigten Fehlern (pending)" VALUE 0x1C9E53 Kw_Wu8 255.0 OneToOne 0.00 255.0 FORMAT "%5.1" /end CHARACTERISTIC
/begin CHARACTERISTIC DSM_Class19TDlc_C "Trigger Art für Löschentprellung" VALUE 0x1C9E54 Kw_Wu8 3.00000000000 ClassTriggerTDlc 0.00 3.00000000000 FORMAT "%13.11" /end CHARACTERISTIC
/begin CHARACTERISTIC DSM_Class19DlcKd_C "Anzahl Triggerereignisse für die Löschung von Fehlereinträgen mit Status Kundendienst" VALUE 0x1C9E55 Kw_Wu8 255.0 OneToOne 0.00 255.0 FORMAT "%5.1" /end CHARACTERISTIC
/begin CHARACTERISTIC DSM_Class19Dlc_C "Anzahl Triggerereignisse für die Löschung von Fehlereinträgen" VALUE 0x1C9E56 Kw_Wu8 255.0 OneToOne 0.00 255.0 FORMAT "%5.1" /end CHARACTERISTIC
/begin CHARACTERISTIC DSM_Class19Prio_C "Priorität des Fehlereintrages für Verdrängung und freeze frame Zuordnung" VALUE 0x1C9E57 Kw_Wu8 255.0 OneToOne 0.00 255.0 FORMAT "%5.1" /end CHARACTERISTIC
/begin CHARACTERISTIC DSM_Class19SysLamp_C "Art der Systemlampenansteuerung" VALUE 0x1C9E58 Kw_Wu8 2.00000000000 SysLamp 0.00 2.00000000000 FORMAT "%13.11" /end CHARACTERISTIC
/begin CHARACTERISTIC DSM_Class19ResErf_C "Verhalten Fehlerflags bei Reset und abgebrochenem Nachlauf" VALUE 0x1C9E59 Kw_Wu8 3.00000000000 ResErf 0.00 3.00000000000 FORMAT "%13.11" /end CHARACTERISTIC
/begin CHARACTERISTIC DSM_Class19Readiness_C "Zuordnung Entprellklasse zu Readiness Flags" VALUE 0x1C9E5A Kw_Wu8 64.0000000000 Readiness 0.00 64.0000000000 FORMAT "%13.10" /end CHARACTERISTIC
/begin CHARACTERISTIC DSM_Class20Mil_C "Art der MIL Ansteuerung" VALUE 0x1C9E5B Kw_Wu8 2.00000000000 Mil 0.00 2.00000000000 FORMAT "%13.11" /end CHARACTERISTIC
/begin CHARACTERISTIC DSM_Class20TFlc_C "Trigger Art für Fehlereintrags Bestätigungsentprellung (->Lampe an)" VALUE 0x1C9E5C Kw_Wu8 3.00000000000 ClassTrigger 0.00 3.00000000000 FORMAT "%13.11" /end CHARACTERISTIC
/begin CHARACTERISTIC DSM_Class20Flc_C "Anzahl Triggerereignisse für Fehlereintrags Bestätigungsentprellung (->Lampe an)" VALUE 0x1C9E5D Kw_Wu8 255.0 OneToOne 0.00 255.0 FORMAT "%5.1" /end CHARACTERISTIC
/begin CHARACTERISTIC DSM_Class20THlc_C "Trigger Art für Fehlerheilung (->Lampe aus)" VALUE 0x1C9E5E Kw_Wu8 3.00000000000 ClassTrigger 0.00 3.00000000000 FORMAT "%13.11" /end CHARACTERISTIC
/begin CHARACTERISTIC DSM_Class20Hlc_C "Anzahl Triggerereignisse für Fehlerheilung (->Lampe aus)" VALUE 0x1C9E5F Kw_Wu8 255.0 OneToOne 0.00 255.0 FORMAT "%5.1" /end CHARACTERISTIC
/begin CHARACTERISTIC DSM_Class20Scatt_C "Fehler ist lesbar für OBD Scan tool tester (SCATT) wenn Wert = 1" VALUE 0x1C9E60 Kw_Wu8 1.00000000000 Scatt 0.00 1.00000000000 FORMAT "%13.11" /end CHARACTERISTIC
/begin CHARACTERISTIC DSM_Class20TDlcPen_C "Trigger Art für Löschentprellung von nicht bestätigten Fehlern (pending)" VALUE 0x1C9E61 Kw_Wu8 3.00000000000 ClassTriggerTDlc 0.00 3.00000000000 FORMAT "%13.11" /end CHARACTERISTIC
/begin CHARACTERISTIC DSM_Class20DlcPen_C "Anzahl Triggerereignisse für die Löschung von nicht bestätigten Fehlern (pending)" VALUE 0x1C9E62 Kw_Wu8 255.0 OneToOne 0.00 255.0 FORMAT "%5.1" /end CHARACTERISTIC
/begin CHARACTERISTIC DSM_Class20TDlc_C "Trigger Art für Löschentprellung" VALUE 0x1C9E63 Kw_Wu8 3.00000000000 ClassTriggerTDlc 0.00 3.00000000000 FORMAT "%13.11" /end CHARACTERISTIC
/begin CHARACTERISTIC DSM_Class20DlcKd_C "Anzahl Triggerereignisse für die Löschung von Fehlereinträgen mit Status Kundendienst" VALUE 0x1C9E64 Kw_Wu8 255.0 OneToOne 0.00 255.0 FORMAT "%5.1" /end CHARACTERISTIC
/begin CHARACTERISTIC DSM_Class20Dlc_C "Anzahl Triggerereignisse für die Löschung von Fehlereinträgen" VALUE 0x1C9E65 Kw_Wu8 255.0 OneToOne 0.00 255.0 FORMAT "%5.1" /end CHARACTERISTIC
/begin CHARACTERISTIC DSM_Class20Prio_C "Priorität des Fehlereintrages für Verdrängung und freeze frame Zuordnung" VALUE 0x1C9E66 Kw_Wu8 255.0 OneToOne 0.00 255.0 FORMAT "%5.1" /end CHARACTERISTIC
/begin CHARACTERISTIC DSM_Class20SysLamp_C "Art der Systemlampenansteuerung" VALUE 0x1C9E67 Kw_Wu8 2.00000000000 SysLamp 0.00 2.00000000000 FORMAT "%13.11" /end CHARACTERISTIC
/begin CHARACTERISTIC DSM_Class20ResErf_C "Verhalten Fehlerflags bei Reset und abgebrochenem Nachlauf" VALUE 0x1C9E68 Kw_Wu8 3.00000000000 ResErf 0.00 3.00000000000 FORMAT "%13.11" /end CHARACTERISTIC
/begin CHARACTERISTIC DSM_Class20Readiness_C "Zuordnung Entprellklasse zu Readiness Flags" VALUE 0x1C9E69 Kw_Wu8 64.0000000000 Readiness 0.00 64.0000000000 FORMAT "%13.10" /end CHARACTERISTIC
/begin CHARACTERISTIC DSM_FCMClear_C "Fehlerspeicher löschen über Label" VALUE 0x1C9E6A Kw_Wu8 1.000 OneToOne 0.00 1.000 FORMAT "%5.3" EXTENDED_LIMITS 0.00 255.0 /end CHARACTERISTIC
/begin CHARACTERISTIC DSM_FrzFrEnvironment_C "Freeze frame, Auswahl der Umweltbedingungen" VAL_BLK 0x1C9E6C Kwb_Wu16 602.000000000 SigName 0.00 602.000000000 FORMAT "%13.9" NUMBER 11 /end CHARACTERISTIC
/begin CHARACTERISTIC DSM_stStepWidth_CA "Schrittweite der Ereignisentprellung der up/down counter" VAL_BLK 0x1C9E82 Kwb_Wu8 255.0 OneToOne 0.00 255.0 FORMAT "%5.1" NUMBER 4 /end CHARACTERISTIC
/begin CHARACTERISTIC DSM_SysLampMode_C "Aktivierungsbedingung der System Lampe (1= aktuelle Fehler, 0 = bestätigte Fehlerspeichereinträge)" VALUE 0x1C9E86 Kw_Wu8 2.00000000000 SysLampMode 0.00 2.00000000000 FORMAT "%13.11" /end CHARACTERISTIC
/begin CHARACTERISTIC DSM_tiDCMin_C "Mindestzeit für driving cycle Erkennung (Maximalwert = Nachlauf)" VALUE 0x1C9E88 Kw_Wu16 65535.00 TimeDsmDC 0.00 65535.00 FORMAT "%8.2" /end CHARACTERISTIC
/begin CHARACTERISTIC DSM_tiWucDelay_C "Zeitverzögerung für die Abtasung der Kühlwassertemperatur bei Start zur Warm Up Cycle Ermittlung" VALUE 0x1C9E8A Kw_Wu16 655350.0 Time_ms 0.00 655350.0 FORMAT "%8.1" /end CHARACTERISTIC
/begin CHARACTERISTIC DSM_WucMinDiff_C "Minimale Differenztemperatur für warm up cycle" VALUE 0x1C9E8C Kw_Ws16 6553.500 TempDiff_Kelv -3276.800 3276.700 FORMAT "%8.3" /end CHARACTERISTIC
/begin CHARACTERISTIC DSM_WucMinTemp_C "Minimaltemperatur für warm up cycle" VALUE 0x1C9E8E Kw_Ws16 6553.500 Temp_Cels -3549.940 3003.560 FORMAT "%8.3" /end CHARACTERISTIC
/begin MEASUREMENT CTSCD_stCanSndTemp "Status Kühlmitteltemperatur für CAN" UBYTE OneToOne 1 100 0.00 255.0 FORMAT "%5.1" ECU_ADDRESS 0x7F9338 /end MEASUREMENT
/begin MEASUREMENT CTSCD_stCTSPrt "Ansteuerung der Kühlwassertemperatur-Heißleuchte" UBYTE OneToOne 1 100 0.00 255.0 FORMAT "%5.1" ECU_ADDRESS 0x7F9337 /end MEASUREMENT
/begin MEASUREMENT CTSCD_stCTSZoomOn_mp "Meßpunkt für Status Zoom-Funktion Hysterese" UBYTE OneToOne 1 100 0.00 255.0 FORMAT "%5.1" ECU_ADDRESS 0x80236E /end MEASUREMENT
/begin MEASUREMENT CTSCD_stPullup "Status Zoom-Anforderung" UBYTE OneToOne 1 100 0.00 255.0 FORMAT "%5.1" ECU_ADDRESS 0x7F9339 /end MEASUREMENT
/begin MEASUREMENT CTSCD_stPullupDem_mp "Meßpunkt für Zoom-Funktion Anforderung" UBYTE OneToOne 1 100 0.00 255.0 FORMAT "%5.1" ECU_ADDRESS 0x80236F /end MEASUREMENT
/begin MEASUREMENT CTSCD_swtSig "Wassertemperatur über CAN oder ADC" UBYTE OneToOne 1 100 0.00 255.0 FORMAT "%5.1" ECU_ADDRESS 0x7F933A /end MEASUREMENT
/begin MEASUREMENT CTSCD_swtTempDfl "Schalterwert für Ersatzwert von FTS/OTS" UBYTE OneToOne 1 100 0.00 255.0 FORMAT "%5.1" ECU_ADDRESS 0x7F933B /end MEASUREMENT
/begin MEASUREMENT CTSCD_tClnt "Kühlmitteltemperatur" SWORD Temp_Cels 1 100 -3549.940 3003.560 FORMAT "%8.3" ECU_ADDRESS 0x7F9666 /end MEASUREMENT
/begin MEASUREMENT CTSCD_tClntCan "Kühlmitteltemperatur über CAN" SWORD Temp_Cels 1 100 -3549.940 3003.560 FORMAT "%8.3" ECU_ADDRESS 0x7F9668 /end MEASUREMENT
/begin MEASUREMENT CTSCD_tClntLin "linearisierter Wert aus HWK vorm Aufruf der Übergangsfunktion" SWORD Temp_Cels 1 100 -3549.940 3003.560 FORMAT "%8.3" ECU_ADDRESS 0x7F966A /end MEASUREMENT
/begin MEASUREMENT CTSCD_tClntLinZoom "linearisierter Wert aus HWK vor dem Aufruf der Übergangsfunktion bei zoom-in" SWORD Temp_Cels 1 100 -3549.940 3003.560 FORMAT "%8.3" ECU_ADDRESS 0x7F966C /end MEASUREMENT
/begin MEASUREMENT CTSCD_tClntNoZoom_mp "Meßpunkt für Temperatur ohne Zoom-in" SWORD Temp_Cels 1 100 -3549.940 3003.560 FORMAT "%8.3" ECU_ADDRESS 0x802370 /end MEASUREMENT
/begin MEASUREMENT CTSCD_uRaw "Wassertemperatur Spannungsrohwert" SWORD Volt 1 100 -160156.4 160151.5 FORMAT "%8.1" ECU_ADDRESS 0x7F966E /end MEASUREMENT
/begin MEASUREMENT CTSCD_uRawZoom "Wassertemperatur Spannungsrohwert für Zoom-in" SWORD Volt 1 100 -160156.4 160151.5 FORMAT "%8.1" ECU_ADDRESS 0x7F9670 /end MEASUREMENT
/begin MEASUREMENT CtTCD_rHWE_mp "Ausgabetastverhältnis zur HWK" SWORD DtyCyc 1 100 -327.6800 327.6700 FORMAT "%8.4" ECU_ADDRESS 0x802392 /end MEASUREMENT
/begin MEASUREMENT CtTCtl_dcycDes_mp "Sollwert des Tastverhältnisses" SWORD DtyCyc 1 100 -327.6800 327.6700 FORMAT "%8.4" ECU_ADDRESS 0x802394 /end MEASUREMENT
/begin MEASUREMENT CtTCtl_dcycI_mp "begrenzter Wert des I-Glieds" SWORD DtyCyc 1 100 -327.6800 327.6700 FORMAT "%8.4" ECU_ADDRESS 0x802396 /end MEASUREMENT
/begin MEASUREMENT CtTCtl_dcycThst "Ansteuertastverhältnis für den Komponententreiber" SWORD DtyCyc 1 100 -327.6800 327.6700 FORMAT "%8.4" ECU_ADDRESS 0x7F9782 /end MEASUREMENT
/begin MEASUREMENT CtTCtl_dcycThstByp_mp "Bypass message für  CtTCtl_dcycThst" SWORD DtyCyc 1 100 -327.6800 327.6700 FORMAT "%8.4" ECU_ADDRESS 0x802398 /end MEASUREMENT
/begin MEASUREMENT CtTCtl_dtClntDiff "Regelabweichen der Kühlmittelsolltemperatur" SWORD TempDiff_Kelv 1 100 -3276.800 3276.700 FORMAT "%8.3" ECU_ADDRESS 0x7F9784 /end MEASUREMENT
/begin MEASUREMENT CtTCtl_stCOTSHys_mp "Status der Hysterese COTSCD_tClnt, Umschaltung auf Vorgabewert bei Wert true" UBYTE OneToOne 1 100 0.00 255.0 FORMAT "%5.1" ECU_ADDRESS 0x80239A /end MEASUREMENT
/begin MEASUREMENT CtTCtl_stCtl "bitcodierter Status der Kühlmittelthermostatsteuerung" UBYTE OneToOne 1 100 0.00 255.0 FORMAT "%5.1" ECU_ADDRESS 0x7F9380 /end MEASUREMENT
/begin MEASUREMENT CtTCtl_tAirCurr_mp "Lufttemperatur des verwendeten Sensors" SWORD Temp_Cels 1 100 -3549.940 3003.560 FORMAT "%8.3" ECU_ADDRESS 0x80239C /end MEASUREMENT
/begin MEASUREMENT CtTCtl_tClntCurr_mp "aktuelle Kühlmitteltemperatur" SWORD Temp_Cels 1 100 -3549.940 3003.560 FORMAT "%8.3" ECU_ADDRESS 0x80239E /end MEASUREMENT
/begin MEASUREMENT CtTCtl_tClntDes "Sollkühlmitteltemperatur" SWORD Temp_Cels 1 100 -3549.940 3003.560 FORMAT "%8.3" ECU_ADDRESS 0x7F9786 /end MEASUREMENT
/begin MEASUREMENT CtTCtl_tClntDes1_mp "Kühlmittelsollwert aus CtTCtl_tBase_MAP" SWORD Temp_Cels 1 100 -3549.940 3003.560 FORMAT "%8.3" ECU_ADDRESS 0x8023A0 /end MEASUREMENT
/begin MEASUREMENT CtTCtl_tClntDes2_mp "Kühlmittelsollwert aus CtTCtl_tClntKor1_MAP" SWORD Temp_Cels 1 100 -3549.940 3003.560 FORMAT "%8.3" ECU_ADDRESS 0x8023A2 /end MEASUREMENT
/begin MEASUREMENT CtTCtl_tClntDes3_mp "Kühlmittelsollwert aus CtTCtl_tClntKor2_CUR" SWORD Temp_Cels 1 100 -3549.940 3003.560 FORMAT "%8.3" ECU_ADDRESS 0x8023A4 /end MEASUREMENT
/begin MEASUREMENT CtTCtl_tClntDes4_mp "Kühlmittelsollwert aus CtTCtl_tClntKor2_CUR oder Vorgabewert" SWORD Temp_Cels 1 100 -3549.940 3003.560 FORMAT "%8.3" ECU_ADDRESS 0x8023A6 /end MEASUREMENT
/begin MEASUREMENT CtTCtl_tClntDes5_mp "maximaler Wert oder Vorgabewert" SWORD Temp_Cels 1 100 -3549.940 3003.560 FORMAT "%8.3" ECU_ADDRESS 0x8023A8 /end MEASUREMENT
/begin MEASUREMENT CtTCtl_tClntDes6_mp "gestufte Kühlleistungsanhebung vom Getriebesteuergerät" SWORD Temp_Cels 1 100 -3549.940 3003.560 FORMAT "%8.3" ECU_ADDRESS 0x8023AA /end MEASUREMENT
/begin MEASUREMENT CtTCtl_tClntDes7_mp "Ungefilterter Wert des Kühlmitteltemperatursollwertes" SWORD Temp_Cels 1 100 -3549.940 3003.560 FORMAT "%8.3" ECU_ADDRESS 0x8023AC /end MEASUREMENT
/begin MEASUREMENT CtT_dtDec_mp "Summe Dekremente Wärmeabfuhr vom Wassertemperaturmodell" SLONG Temp_Kelv_Sec_CtT_Mod 1 100 -52428.8000000 52428.7999756 FORMAT "%13.7" ECU_ADDRESS 0x802374 /end MEASUREMENT
/begin MEASUREMENT CtT_dtInc_mp "Summe Inkremente Wärmezufuhr zum Wassertemperaturmodell" SLONG Temp_Kelv_Sec_CtT_Mod 1 100 -52428.8000000 52428.7999756 FORMAT "%13.7" ECU_ADDRESS 0x802378 /end MEASUREMENT
/begin MEASUREMENT CtT_dt_mp "Inkrement für Integration Wassertemperaturmodell" SLONG Temp_Kelv_Sec_CtT_Mod 1 100 -52428.8000000 52428.7999756 FORMAT "%13.7" ECU_ADDRESS 0x80237C /end MEASUREMENT
/begin MEASUREMENT CtT_dvolFlConsumPT1_mp "Gefilterter Verbrauch für Thermostatdiagnose" SWORD FlConsum_l_h 1 100 -327.6800 327.6700 FORMAT "%8.4" ECU_ADDRESS 0x802380 /end MEASUREMENT
/begin MEASUREMENT CtT_stCondMon_mp "Abschaltbedingungen Thermostatdiagnose" UWORD OneToOne 1 100 0.00 65535.00 FORMAT "%8.2" ECU_ADDRESS 0x802382 /end MEASUREMENT
/begin MEASUREMENT CtT_stNumMon_mp "Status der Thermostatdiagnose" UWORD OneToOne 1 100 0.00 65535.00 FORMAT "%8.2" ECU_ADDRESS 0x802384 /end MEASUREMENT
/begin MEASUREMENT CtT_tAirCorrPT1_mp "Gefilterte druckkorrigierte Ansauglufttemperatur" SWORD Temp_Cels 1 100 -3549.940 3003.560 FORMAT "%8.3" ECU_ADDRESS 0x802386 /end MEASUREMENT
/begin MEASUREMENT CtT_tAirCorr_mp "Druckkorrigierte Ansauglufttemperatur" SWORD Temp_Cels 1 100 -3549.940 3003.560 FORMAT "%8.3" ECU_ADDRESS 0x802388 /end MEASUREMENT
/begin MEASUREMENT CtT_tAirMod "Modellberechnung der Umgebungstemperatur EATSCD_tAir" SWORD Temp_Cels 1 100 -3549.940 3003.560 FORMAT "%8.3" ECU_ADDRESS 0x7F9788 /end MEASUREMENT
/begin MEASUREMENT CtT_tAir_mp "Differenz Wassertemperatur - Umgebungstemperatur" SWORD Temp_Cels 1 100 -3549.940 3003.560 FORMAT "%8.3" ECU_ADDRESS 0x80238A /end MEASUREMENT
/begin MEASUREMENT CtT_tClntEDCInitVal_mp "1. gültiger Wert der Wassertemperatur nach Init EDC" SWORD Temp_Cels 1 100 -3549.940 3003.560 FORMAT "%8.3" ECU_ADDRESS 0x80238C /end MEASUREMENT
/begin MEASUREMENT CtT_tClntMod "Modellberechnung der Wassertemperatur CTSCD_tClnt" SWORD Temp_Cels 1 100 -3549.940 3003.560 FORMAT "%8.3" ECU_ADDRESS 0x7F978A /end MEASUREMENT
/begin MEASUREMENT CtT_tClntModCur_mp "Wassertemperatureinfluss auf Umgebungstemperaturmodell" SWORD Temp_Cels 1 100 -3549.940 3003.560 FORMAT "%8.3" ECU_ADDRESS 0x80238E /end MEASUREMENT
/begin MEASUREMENT CtT_tClntPT1_mp "Gefilterte Wassertemperatur" SWORD Temp_Cels 1 100 -3549.940 3003.560 FORMAT "%8.3" ECU_ADDRESS 0x802390 /end MEASUREMENT
/begin MEASUREMENT Diff_trqMax "Begrenzungsmoment durch Allradsteuergerät" SWORD TrqPrp 1 100 -32768.00 32767.00 FORMAT "%8.2" ECU_ADDRESS 0x7F9798 /end MEASUREMENT
/begin MEASUREMENT DrvTrn_rTransDT "Triebstrang-Übersetzung (Radmoment pro Motormoment)" SWORD TransR 1 100 -327.6800 327.6700 FORMAT "%8.4" ECU_ADDRESS 0x7F979A /end MEASUREMENT
/begin MEASUREMENT DrvTrn_rTrans_mp "Messpunkt der Triebstrang-Übersetzung" SWORD TransR 1 100 -327.6800 327.6700 FORMAT "%8.4" ECU_ADDRESS 0x8023AE /end MEASUREMENT
/begin MEASUREMENT DrvTrn_swtSig "Signalquelle für Triebstrangübersetzung bei stehendem Fahrzeug" UBYTE OneToOne 1 100 0.00 255.0 FORMAT "%5.1" ECU_ADDRESS 0x7F939E /end MEASUREMENT
/begin MEASUREMENT DSC_stTstTrigger_mp "Zustand Testeranforderung an DSM Scheduler" UBYTE OneToOne 1 100 0.00 255.0 FORMAT "%5.1" ECU_ADDRESS 0x8023B0 /end MEASUREMENT
/begin MEASUREMENT DSMDur_ctDfctDur1 "Wert Fehlerdauerzähler" UWORD OneToOne 1 100 0.00 65535.00 FORMAT "%8.2" ECU_ADDRESS 0x7F978C /end MEASUREMENT
/begin MEASUREMENT DSMDur_ctDfctDur2 "Wert Fehlerdauerzähler 2" UWORD OneToOne 1 100 0.00 65535.00 FORMAT "%8.2" ECU_ADDRESS 0x7F978E /end MEASUREMENT
/begin MEASUREMENT DSMDur_stGlobalDefCnt_mp "Aktivierungs und Resetzustand der beiden globalen Fehlerdauerzähler" UBYTE OneToOne 1 100 0.00 255.0 FORMAT "%5.1" ECU_ADDRESS 0x802A14 /end MEASUREMENT
/begin FUNCTION ctscd "Wassertemperaturfühler Komponententreiber"
 /begin DEF_CHARACTERISTIC CTSCD_uSRCMinZoom_C CTSCD_uSRCMaxZoom_C CTSCD_tLinZoom_CUR CTSCD_uSRCMin_C CTSCD_uSRCMax_C CTSCD_tLin_CUR CTSCD_DebCanDefDef_C CTSCD_DebCanDefOk_C CTSCD_DebCanInacDef_C CTSCD_DebCanInacOk_C CTSCD_DebCanNotImplDef_C CTSCD_DebCanNotImplOk_C CTSCD_DebSRCHighDef_C CTSCD_DebSRCHighOk_C CTSCD_DebSRCLowDef_C CTSCD_DebSRCLowOk_C CTSCD_dtRmpSlpUp_C CTSCD_dtRmpSlpDwn_C CTSCD_stInvPullup_C CTSCD_swtPullupOn_C CTSCD_swtSigVal_C CTSCD_swtTempDflVal_C CTSCD_swtTempDflType_C CTSCD_tCTSACOffMax_C CTSCD_tCTSACOffMin_C CTSCD_tCTSACRedMax_C CTSCD_tCTSACRedMin_C CTSCD_tCTSPrtMax_C CTSCD_tCTSPrtMin_C CTSCD_tCTSWrnMax_C CTSCD_tCTSWrnMin_C CTSCD_tCTSZoomOnMax_C CTSCD_tCTSZoomOnMin_C CTSCD_tiZoomOFF_C CTSCD_tiZoomON_C CTSCD_stSensIDWord_C CTSCD_tDfl_C /end DEF_CHARACTERISTIC
 /begin IN_MEASUREMENT CTSCD_uRaw CTSCD_uRawZoom /end IN_MEASUREMENT
/end FUNCTION
/begin FUNCTION ctscd_msg ""
 /begin OUT_MEASUREMENT CTSCD_stCTSPrt CTSCD_stPullup CTSCD_swtSig CTSCD_swtTempDfl CTSCD_tClnt CTSCD_tClntCan CTSCD_tClntLin CTSCD_tClntLinZoom CTSCD_uRaw CTSCD_uRawZoom /end OUT_MEASUREMENT
/end FUNCTION
/begin FUNCTION ctscd_uic ""
 /begin OUT_MEASUREMENT CTSCD_stCTSZoomOn_mp CTSCD_stPullupDem_mp CTSCD_tClntNoZoom_mp /end OUT_MEASUREMENT
/end FUNCTION
/begin FUNCTION ctscd_var "" /begin DEF_CHARACTERISTIC CTSCD_dtClntDelta_C CTSCD_FTS4CTS_C /end DEF_CHARACTERISTIC /end FUNCTION
/begin FUNCTION ctscd_var_msg "" /begin OUT_MEASUREMENT CTSCD_stCanSndTemp /end OUT_MEASUREMENT /end FUNCTION
/begin FUNCTION cttcd "Komponententreiber des Drehschieberthermostates"
 /begin DEF_CHARACTERISTIC CtTCD_DebExcTempDef_C CtTCD_DebExcTempOk_C CtTCD_DebNoLoadDef_C CtTCD_DebNoLoadOk_C CtTCD_DebShortCircBatDef_C CtTCD_DebShortCircBatOk_C CtTCD_DebShortCircGndDef_C CtTCD_DebShortCircGndOk_C CtTCD_stInvOut_C CtTCD_tiPer_C CtTCD_rTst_C CtTCD_tiBtwTst_C /end DEF_CHARACTERISTIC
/end FUNCTION
/begin FUNCTION cttcd_uic "" /begin OUT_MEASUREMENT CtTCD_rHWE_mp /end OUT_MEASUREMENT /end FUNCTION
/begin FUNCTION cttctl "Komponententreiber des Drehschieberthermostates"
 /begin DEF_CHARACTERISTIC CtTCtl_dcycCtl_MAP CtTCtl_dcycIHiLim_C CtTCtl_dcycILoLim_C CtTCtl_dcycThstHiLim_C CtTCtl_dcycThstLoLim_C CtTCtl_dcycPreset_C CtTCtl_dcycShutOff_C CtTCtl_dcycStrt_C CtTCtl_RglIKi_C CtTCtl_RglIKiPos_C CtTCtl_RglIKiNeg_C CtTCtl_RglIWinPos_C CtTCtl_RglIWinNeg_C CtTCtl_tiPT1Neg_C CtTCtl_tiPT1Pos_C CtTCtl_swtCtlVal_C CtTCtl_swtCtlType_C CtTCtl_tBase_MAP CtTCtl_tClntCor2_MAP CtTCtl_tClntCor3_CUR CtTCtl_tClntCor4_CUR CtTCtl_tClntCor5_CUR CtTCtl_tClntCor6_CUR CtTCtl_tClntCurrPreset_C CtTCtl_tClntDes3Preset_C CtTCtl_tClntDes4Preset_C CtTCtl_tClntDes5Preset_C CtTCtl_tClntDes6Preset_C CtTCtl_tClntDesPreset_C CtTCtl_tCOTmax_C CtTCtl_tCOTSHysHi_C CtTCtl_tCOTSHysLo_C /end DEF_CHARACTERISTIC
 /begin IN_MEASUREMENT CoEng_trqInrSet CtTCtl_dtClntDiff CtTCtl_tAirCurr_mp CtTCtl_tClntDes Eng_nAvrg FrmMng_stClgGearbx HDSCD_prcAir OTSCD_tEngOil VSSCD_v /end IN_MEASUREMENT
/end FUNCTION
/begin FUNCTION cttctl_msg ""
 /begin OUT_MEASUREMENT CtTCtl_dcycThst CtTCtl_dtClntDiff CtTCtl_stCtl CtTCtl_tClntDes /end OUT_MEASUREMENT
/end FUNCTION
/begin FUNCTION cttctl_uic "" /begin DEF_CHARACTERISTIC CtTCtl_dcycThst_Vector CtTCtl_dcycThst_Channel /end DEF_CHARACTERISTIC
 /begin OUT_MEASUREMENT CtTCtl_dcycDes_mp CtTCtl_dcycI_mp CtTCtl_dcycThstByp_mp CtTCtl_stCOTSHys_mp CtTCtl_tAirCurr_mp CtTCtl_tClntCurr_mp CtTCtl_tClntDes1_mp CtTCtl_tClntDes2_mp CtTCtl_tClntDes3_mp CtTCtl_tClntDes4_mp CtTCtl_tClntDes5_mp CtTCtl_tClntDes6_mp CtTCtl_tClntDes7_mp /end OUT_MEASUREMENT
/end FUNCTION
/begin FUNCTION ctt_mon ""
 /begin DEF_CHARACTERISTIC CtT_dtConsum_CUR CtT_dtEnv_CUR CtT_dtHt1_C CtT_dtHt2_C CtT_dtHt3_C CtT_MonDebNplDef_C CtT_MonDebNplOK_C CtT_nThres_C CtT_tAirCorr_MAP CtT_tClntLo_C CtT_tClntMod_C CtT_tClntMod_CUR CtT_tiConsumPT1_C CtT_tiTempAirPT1_C CtT_tiTempClntPT1_C CtT_tiTst_C CtT_tThresHi_C CtT_tThresLo_C /end DEF_CHARACTERISTIC
 /begin IN_MEASUREMENT BPSCD_pLin CtT_dvolFlConsumPT1_mp CtT_tAir_mp CtT_tClntPT1_mp IATSCD_tAir /end IN_MEASUREMENT
/end FUNCTION
/begin FUNCTION ctt_mon_msg "" /begin OUT_MEASUREMENT CtT_tAirMod CtT_tClntMod /end OUT_MEASUREMENT /end FUNCTION
/begin FUNCTION ctt_mon_uic ""
 /begin OUT_MEASUREMENT CtT_dtDec_mp CtT_dtInc_mp CtT_dt_mp CtT_dvolFlConsumPT1_mp CtT_stCondMon_mp CtT_stNumMon_mp CtT_tAirCorrPT1_mp CtT_tAirCorr_mp CtT_tAir_mp CtT_tClntEDCInitVal_mp CtT_tClntModCur_mp CtT_tClntPT1_mp /end OUT_MEASUREMENT
/end FUNCTION
/begin FUNCTION curmap_size_base "" /end FUNCTION
/begin FUNCTION curmap_size_proj "" /end FUNCTION
/begin FUNCTION curmap_size_sys "" /end FUNCTION
/begin FUNCTION diff_msg "" /begin OUT_MEASUREMENT Diff_trqMax /end OUT_MEASUREMENT /end FUNCTION
/begin FUNCTION diff_trqlim "Momentenlimitierung für Planentennachgelege"
 /begin DEF_CHARACTERISTIC Diff_tiDebtrqLimErrPatDef_C Diff_tiDebtrqLimErrPatOk_C Diff_dtrqCANerrPos_C Diff_dtrqCANerrNeg_C Diff_trqCANerrMax_C /end DEF_CHARACTERISTIC
/end FUNCTION
/begin FUNCTION diff_trqlim_uic "" /end FUNCTION
/begin FUNCTION drvtrn "Antriebsstrang"
 /begin DEF_CHARACTERISTIC DrvTrn_drSlpPos_C DrvTrn_drSlpNeg_C DrvTrn_rTransDTInit_C DrvTrn_swtNotFrozen_C DrvTrn_swtSigVal_C /end DEF_CHARACTERISTIC
/end FUNCTION
/begin FUNCTION drvtrn_msg "" /begin OUT_MEASUREMENT DrvTrn_rTransDT DrvTrn_swtSig /end OUT_MEASUREMENT /end FUNCTION
/begin FUNCTION drvtrn_uic "" /begin OUT_MEASUREMENT DrvTrn_rTrans_mp /end OUT_MEASUREMENT /end FUNCTION
/begin FUNCTION dsched "" /begin DEF_CHARACTERISTIC DSCHED_numSelFID_C /end DEF_CHARACTERISTIC /end FUNCTION
/begin FUNCTION dsched_msg "" /end FUNCTION
/begin FUNCTION dsched_uic "" /begin OUT_MEASUREMENT DSC_stTstTrigger_mp /end OUT_MEASUREMENT /end FUNCTION
/begin FUNCTION dsm ""
 /begin DEF_CHARACTERISTIC DSM_Class1Mil_C DSM_Class1TFlc_C DSM_Class1Flc_C DSM_Class1THlc_C DSM_Class1Hlc_C DSM_Class1Scatt_C DSM_Class1TDlcPen_C DSM_Class1DlcPen_C DSM_Class1TDlc_C DSM_Class1DlcKd_C DSM_Class1Dlc_C DSM_Class1Prio_C DSM_Class1SysLamp_C DSM_Class1ResErf_C DSM_Class1Readiness_C DSM_Class2Mil_C DSM_Class2TFlc_C DSM_Class2Flc_C DSM_Class2THlc_C DSM_Class2Hlc_C DSM_Class2Scatt_C DSM_Class2TDlcPen_C DSM_Class2DlcPen_C DSM_Class2TDlc_C DSM_Class2DlcKd_C DSM_Class2Dlc_C DSM_Class2Prio_C DSM_Class2SysLamp_C DSM_Class2ResErf_C DSM_Class2Readiness_C DSM_Class3Mil_C DSM_Class3TFlc_C DSM_Class3Flc_C DSM_Class3THlc_C DSM_Class3Hlc_C DSM_Class3Scatt_C DSM_Class3TDlcPen_C DSM_Class3DlcPen_C DSM_Class3TDlc_C DSM_Class3DlcKd_C DSM_Class3Dlc_C DSM_Class3Prio_C DSM_Class3SysLamp_C DSM_Class3ResErf_C DSM_Class3Readiness_C DSM_Class4Mil_C DSM_Class4TFlc_C DSM_Class4Flc_C DSM_Class4THlc_C DSM_Class4Hlc_C DSM_Class4Scatt_C DSM_Class4TDlcPen_C DSM_Class4DlcPen_C DSM_Class4TDlc_C DSM_Class4DlcKd_C DSM_Class4Dlc_C DSM_Class4Prio_C DSM_Class4SysLamp_C DSM_Class4ResErf_C DSM_Class4Readiness_C DSM_Class5Mil_C DSM_Class5TFlc_C DSM_Class5Flc_C DSM_Class5THlc_C DSM_Class5Hlc_C DSM_Class5Scatt_C DSM_Class5TDlcPen_C DSM_Class5DlcPen_C DSM_Class5TDlc_C DSM_Class5DlcKd_C DSM_Class5Dlc_C DSM_Class5Prio_C DSM_Class5SysLamp_C DSM_Class5ResErf_C DSM_Class5Readiness_C DSM_Class6Mil_C DSM_Class6TFlc_C DSM_Class6Flc_C DSM_Class6THlc_C DSM_Class6Hlc_C DSM_Class6Scatt_C DSM_Class6TDlcPen_C DSM_Class6DlcPen_C DSM_Class6TDlc_C DSM_Class6DlcKd_C DSM_Class6Dlc_C DSM_Class6Prio_C DSM_Class6SysLamp_C DSM_Class6ResErf_C DSM_Class6Readiness_C DSM_Class7Mil_C DSM_Class7TFlc_C DSM_Class7Flc_C DSM_Class7THlc_C DSM_Class7Hlc_C DSM_Class7Scatt_C DSM_Class7TDlcPen_C DSM_Class7DlcPen_C DSM_Class7TDlc_C DSM_Class7DlcKd_C DSM_Class7Dlc_C DSM_Class7Prio_C DSM_Class7SysLamp_C DSM_Class7ResErf_C DSM_Class7Readiness_C DSM_Class8Mil_C DSM_Class8TFlc_C DSM_Class8Flc_C DSM_Class8THlc_C DSM_Class8Hlc_C DSM_Class8Scatt_C DSM_Class8TDlcPen_C DSM_Class8DlcPen_C DSM_Class8TDlc_C DSM_Class8DlcKd_C DSM_Class8Dlc_C DSM_Class8Prio_C DSM_Class8SysLamp_C DSM_Class8ResErf_C DSM_Class8Readiness_C DSM_Class9Mil_C DSM_Class9TFlc_C DSM_Class9Flc_C DSM_Class9THlc_C DSM_Class9Hlc_C DSM_Class9Scatt_C DSM_Class9TDlcPen_C DSM_Class9DlcPen_C DSM_Class9TDlc_C DSM_Class9DlcKd_C DSM_Class9Dlc_C DSM_Class9Prio_C DSM_Class9SysLamp_C DSM_Class9ResErf_C DSM_Class9Readiness_C DSM_Class10Mil_C DSM_Class10TFlc_C DSM_Class10Flc_C DSM_Class10THlc_C DSM_Class10Hlc_C DSM_Class10Scatt_C DSM_Class10TDlcPen_C DSM_Class10DlcPen_C DSM_Class10TDlc_C DSM_Class10DlcKd_C DSM_Class10Dlc_C DSM_Class10Prio_C DSM_Class10SysLamp_C DSM_Class10ResErf_C DSM_Class10Readiness_C DSM_Class11Mil_C DSM_Class11TFlc_C DSM_Class11Flc_C DSM_Class11THlc_C DSM_Class11Hlc_C DSM_Class11Scatt_C DSM_Class11TDlcPen_C DSM_Class11DlcPen_C DSM_Class11TDlc_C DSM_Class11DlcKd_C DSM_Class11Dlc_C DSM_Class11Prio_C DSM_Class11SysLamp_C DSM_Class11ResErf_C DSM_Class11Readiness_C DSM_Class12Mil_C DSM_Class12TFlc_C DSM_Class12Flc_C DSM_Class12THlc_C DSM_Class12Hlc_C DSM_Class12Scatt_C DSM_Class12TDlcPen_C DSM_Class12DlcPen_C DSM_Class12TDlc_C DSM_Class12DlcKd_C DSM_Class12Dlc_C DSM_Class12Prio_C DSM_Class12SysLamp_C DSM_Class12ResErf_C DSM_Class12Readiness_C DSM_Class13Mil_C DSM_Class13TFlc_C DSM_Class13Flc_C DSM_Class13THlc_C DSM_Class13Hlc_C DSM_Class13Scatt_C DSM_Class13TDlcPen_C DSM_Class13DlcPen_C DSM_Class13TDlc_C DSM_Class13DlcKd_C DSM_Class13Dlc_C DSM_Class13Prio_C DSM_Class13SysLamp_C DSM_Class13ResErf_C DSM_Class13Readiness_C DSM_Class14Mil_C DSM_Class14TFlc_C DSM_Class14Flc_C DSM_Class14THlc_C DSM_Class14Hlc_C DSM_Class14Scatt_C DSM_Class14TDlcPen_C DSM_Class14DlcPen_C DSM_Class14TDlc_C DSM_Class14DlcKd_C DSM_Class14Dlc_C DSM_Class14Prio_C DSM_Class14SysLamp_C DSM_Class14ResErf_C DSM_Class14Readiness_C DSM_Class15Mil_C DSM_Class15TFlc_C DSM_Class15Flc_C DSM_Class15THlc_C DSM_Class15Hlc_C DSM_Class15Scatt_C DSM_Class15TDlcPen_C DSM_Class15DlcPen_C DSM_Class15TDlc_C DSM_Class15DlcKd_C DSM_Class15Dlc_C DSM_Class15Prio_C DSM_Class15SysLamp_C DSM_Class15ResErf_C DSM_Class15Readiness_C DSM_Class16Mil_C DSM_Class16TFlc_C DSM_Class16Flc_C DSM_Class16THlc_C DSM_Class16Hlc_C DSM_Class16Scatt_C DSM_Class16TDlcPen_C DSM_Class16DlcPen_C DSM_Class16TDlc_C DSM_Class16DlcKd_C DSM_Class16Dlc_C DSM_Class16Prio_C DSM_Class16SysLamp_C DSM_Class16ResErf_C DSM_Class16Readiness_C DSM_Class17Mil_C DSM_Class17TFlc_C DSM_Class17Flc_C DSM_Class17THlc_C DSM_Class17Hlc_C DSM_Class17Scatt_C DSM_Class17TDlcPen_C DSM_Class17DlcPen_C DSM_Class17TDlc_C DSM_Class17DlcKd_C DSM_Class17Dlc_C DSM_Class17Prio_C DSM_Class17SysLamp_C DSM_Class17ResErf_C DSM_Class17Readiness_C DSM_Class18Mil_C DSM_Class18TFlc_C DSM_Class18Flc_C DSM_Class18THlc_C DSM_Class18Hlc_C DSM_Class18Scatt_C DSM_Class18TDlcPen_C DSM_Class18DlcPen_C DSM_Class18TDlc_C DSM_Class18DlcKd_C DSM_Class18Dlc_C DSM_Class18Prio_C DSM_Class18SysLamp_C DSM_Class18ResErf_C DSM_Class18Readiness_C DSM_Class19Mil_C DSM_Class19TFlc_C DSM_Class19Flc_C DSM_Class19THlc_C DSM_Class19Hlc_C DSM_Class19Scatt_C DSM_Class19TDlcPen_C DSM_Class19DlcPen_C DSM_Class19TDlc_C DSM_Class19DlcKd_C DSM_Class19Dlc_C DSM_Class19Prio_C DSM_Class19SysLamp_C DSM_Class19ResErf_C DSM_Class19Readiness_C DSM_Class20Mil_C DSM_Class20TFlc_C DSM_Class20Flc_C DSM_Class20THlc_C DSM_Class20Hlc_C DSM_Class20Scatt_C DSM_Class20TDlcPen_C DSM_Class20DlcPen_C DSM_Class20TDlc_C DSM_Class20DlcKd_C DSM_Class20Dlc_C DSM_Class20Prio_C DSM_Class20SysLamp_C DSM_Class20ResErf_C DSM_Class20Readiness_C DSM_FCMClear_C DSM_FrzFrEnvironment_C DSM_stStepWidth_CA DSM_SysLampMode_C DSM_tiDCMin_C DSM_tiWucDelay_C DSM_WucMinDiff_C DSM_WucMinTemp_C /end DEF_CHARACTERISTIC
/end FUNCTION
/begin FUNCTION dsmdur ""
 /begin DEF_CHARACTERISTIC DSMDur_DfctDur1Mode_C DSMDur_DfctDur2Mode_C DSMDur_stDfctDur1Enable_C DSMDur_stDfctDur2Enable_C DSMDur_stDfctDur1Reset_C DSMDur_stDfctDur2Reset_C DSMDur_FcmDfctDur1Mode_C DSMDur_FcmDfctDur2Mode_C DSMDur_stFcmDfctDur1Enable_C DSMDur_stFcmDfctDur2Enable_C DSMDur_stFcmDfctDur1Reset_C DSMDur_stFcmDfctDur2Reset_C /end DEF_CHARACTERISTIC
/end FUNCTION
/begin FUNCTION dsmdur_msg "" /begin OUT_MEASUREMENT DSMDur_ctDfctDur1 DSMDur_ctDfctDur2 /end OUT_MEASUREMENT /end FUNCTION
/begin FUNCTION dsmdur_uic "" /begin OUT_MEASUREMENT DSMDur_stGlobalDefCnt_mp /end OUT_MEASUREMENT /end FUNCTION
/begin COMPU_METHOD ClassTrigger "Verbale Umrechnung für DSM_Class%TFlc_C und DSM_Class%THlc_C" TAB_VERB "%6.3" "" COMPU_TAB_REF ClassTrigger /end COMPU_METHOD
/begin COMPU_VTAB ClassTrigger "Verbale Umrechnung für DSM_Class%TFlc_C und DSM_Class%THlc_C" TAB_VERB 4 0 "no handling" 1 "time quantum" 2 "driving cycle" 3 "warm up cycle" /end COMPU_VTAB
/begin COMPU_METHOD ClassTriggerTDlc "Verbale Umrechnung für DSM_Class%TDlc_C und DSM_Class%TDlcPen_C" TAB_VERB "%6.3" "" COMPU_TAB_REF ClassTriggerTDlc /end COMPU_METHOD
/begin COMPU_VTAB ClassTriggerTDlc "Verbale Umrechnung für DSM_Class%TDlc_C und DSM_Class%TDlcPen_C" TAB_VERB 4 0 "no handling" 1 "each afterrun_1" 2 "each afterrun_2" 3 "warm up cycle" /end COMPU_VTAB
/begin COMPU_METHOD DtyCyc "Tastverhaeltnis" RAT_FUNC "%6.4" "[%]" COEFFS 0 100 0 0 0 1 /end COMPU_METHOD
/begin COMPU_METHOD EngN "Motordrehzahl" RAT_FUNC "%6.2" "[rpm]" COEFFS 0 1 0 0 0 1 /end COMPU_METHOD
/begin COMPU_METHOD Fact2 "Faktor mit Auflösung 0.001, für einen Faktorenbereich 0...5,46117 verwendet" RAT_FUNC "%6.4" "-" COEFFS 0 16 0 0 0 1 /end COMPU_METHOD
/begin COMPU_METHOD FidName "Verbale Umrechnung für Fid-Namen" TAB_VERB "%6.3" "[-]" COMPU_TAB_REF FidName /end COMPU_METHOD
/begin COMPU_VTAB FidName "Verbale Umrechnung für Fid-Namen" TAB_VERB 1791 0 "Fid_unused" 4097 "Fid_AC1Can_MAX" 4098 "Fid_AC1PresCan_MAX" 4099 "Fid_AC1TrqCan_MAX" 4100 "Fid_ACCAccPed_MAX" 4101 "Fid_ACCAirbCDCrash_MAX" 4102 "Fid_ACCCDCan_MAX" 4103 "Fid_ACCECUIntErr_MAX" 4104 "Fid_ACCMsgErr_MAX" 4105 "Fid_ACCPlCheck_MAX" 4106 "Fid_ACCtl_ACP_MAX" 4107 "Fid_ACCtl_EATSCD_MAX" 4108 "Fid_ACCtl_ESCUCan_MAX" 4109 "Fid_ACCtl_FanCtl1_MAX" 4110 "Fid_ACCtl_FanCtl2_MAX" 4111 "Fid_ACCtl_SysErr_MAX" 4112 "Fid_ACCtl_TSC1Can_MAX" 4113 "Fid_ACCtl_VehStand_MAX" 4114 "Fid_AFSCD_MAX" 4115 "Fid_AFSCD2_MAX" 4116 "Fid_AFSCD_AirPerTime_MAX" 4117 "Fid_AFSCD_AirPerTime2_MAX" 4118 "Fid_AFSCD_PlAirPerCylDiff_MAX" 4119 "Fid_AFSCD_PlOffsDrft_MAX" 4120 "Fid_AFSCD_PlOffsDrft2_MAX" 4121 "Fid_AFSCD_PlSetyDrft_MAX" 4122 "Fid_AFSCD_PlSetyDrft2_MAX" 4123 "Fid_AFSCD_SRCAirm_MAX" 4124 "Fid_AFSCD_SRCAirm2_MAX" 4125 "Fid_AFSCD_SRCCorrAirm_MAX" 4126 "Fid_AFSCD_SRCDcyc_MAX" 4127 "Fid_AFSCD_SRCRawAirm_MAX" 4128 "Fid_AFSCD_SRCRefSig_MAX" 4129 "Fid_AFVCtlSigErr_MAX" 4130 "Fid_AOHTCanAC1_MAX" 4131 "Fid_AOHTCanESCU_MAX" 4132 "Fid_AOHt_AltSRC_MAX" 4133 "Fid_AOHt_CDHt1_MAX" 4134 "Fid_AOHt_CDHt2_MAX" 4135 "Fid_AOHt_ErrHt_MAX" 4136 "Fid_APP1_MAX" 4137 "Fid_APP1_FiltOffRampOn_MAX" 4138 "Fid_APP1_Sens_MAX" 4139 "Fid_APP2_MAX" 4140 "Fid_APP2_Sens_MAX" 4141 "Fid_APPKickDown_VSS_MAX" 4142 "Fid_APPKickdown_MAX" 4143 "Fid_APSCD_MAX" 4144 "Fid_ASDdc_MAX" 4145 "Fid_ASDdcNGvnr_MAX" 4146 "Fid_ASModSwtOffEng_MAX" 4147 "Fid_ASModSwtOffExhMnf_MAX" 4148 "Fid_ASModSwtOffIndVol_MAX" 4149 "Fid_ASModSwtOffObsvrPIndVol_MAX" 4150 "Fid_AccPed_MAX" 4151 "Fid_AccPedVel_MAX" 4152 "Fid_AccPed_Brk_MAX" 4153 "Fid_AddPmpTnkDef_MAX" 4154 "Fid_AirCtl_MAX" 4155 "Fid_AirbCDCan_MAX" 4156 "Fid_Alt_PwrCan_MAX" 4157 "Fid_Alt_T15_MAX" 4158 "Fid_BPSErr_MAX" 4159 "Fid_BrkCDCan_MAX" 4160 "Fid_CCtlCan_MAX" 4161 "Fid_CRCCDCan_MAX" 4162 "Fid_CRCCDTo_MAX" 4163 "Fid_CTSCDCan_MAX" 4164 "Fid_CTSCDCanInac_MAX" 4165 "Fid_CTSCDCanSig_MAX" 4166 "Fid_CTSCDOTSErr_MAX" 4167 "Fid_CTSCDPullup_MAX" 4168 "Fid_CTSErr_MAX" 4169 "Fid_ClgDynTst_MAX" 4170 "Fid_CmbChb_MAX" 4171 "Fid_CoDT_GripDeb_MAX" 4172 "Fid_CoEngAirbCDCrash_MAX" 4173 "Fid_CoEngGW1TO_MAX" 4174 "Fid_CoEng_ActrPrt_MAX" 4175 "Fid_CoEng_FrmMngAWD1_MAX" 4176 "Fid_CoEng_IRevSys_MAX" 4177 "Fid_CoEng_IRevVeh_MAX" 4178 "Fid_CoEng_KickDown_MAX" 4179 "Fid_CoEng_PwrStgEnable_MAX" 4180 "Fid_CoEng_RevSys_MAX" 4181 "Fid_CoEng_RevVeh_MAX" 4182 "Fid_CoEng_T15CD_MAX" 4183 "Fid_CoEng_TMFWShOff_MAX" 4184 "Fid_CoEng_trqLimBiTurbo_MAX" 4185 "Fid_CoEng_trqLimErr_MAX" 4186 "Fid_CoVM_DCSh_MAX" 4187 "Fid_CoVM_DCSp_MAX" 4188 "Fid_CoVehEcoCan_MAX" 4189 "Fid_CoVehIdleStop_MAX" 4190 "Fid_CoVehPnlFunc_MAX" 4191 "Fid_CoVehtrqLimErr_MAX" 4192 "Fid_ConvCDCan_MAX" 4193 "Fid_CrCtlACCErr_MAX" 4194 "Fid_CrCtlAirbCDCrash_MAX" 4195 "Fid_CrCtlCanBrk1_MAX" 4196 "Fid_CrCtlMsgErrBRK8_MAX" 4197 "Fid_CrCtlPAAGTlrDef_MAX" 4198 "Fid_CrCtlPIrevShutoff_MAX" 4199 "Fid_CrCtl_CTSLPRES_MAX" 4200 "Fid_CrCtl_EngMCaS1_MAX" 4201 "Fid_CrCtl_EngMCrS1_MAX" 4202 "Fid_CrCtl_stBrk_MAX" 4203 "Fid_CrCtl_stSpeedSensor_MAX" 4204 "Fid_CrCtl_stSystem_MAX" 4205 "Fid_CtApCDActrErr_MAX" 4206 "Fid_CtTCtl_stStageErr_MAX" 4207 "Fid_CtTCtl_tClntDs1_Err_MAX" 4208 "Fid_CtTCtl_tClntDs2_Err_MAX" 4209 "Fid_CtTCtl_tClntDs3_Err_MAX" 4210 "Fid_CtTCtl_tClntDs4_Err_MAX" 4211 "Fid_CtT_SwtOff_MAX" 4212 "Fid_CtT_SwtOff_EAT_MAX" 4213 "Fid_CtT_SwtOff_EATMod_MAX" 4214 "Fid_DSM_Wuc_MAX" 4215 "Fid_DiffCANerr_MAX" 4216 "Fid_EATSCDCan_MAX" 4217 "Fid_EATSCDCanInac_MAX" 4218 "Fid_EATSCDCanSig_MAX" 4219 "Fid_EGSysCoLSU0_MAX" 4220 "Fid_EGSysCoNSC_MAX" 4221 "Fid_EGSysCoOxi_MAX" 4222 "Fid_EGSysCoTrbn_MAX" 4223 "Fid_EGSysCoTube0_MAX" 4224 "Fid_EGSysHtgDel_MAX" 4225 "Fid_EGSysNSC_MAX" 4226 "Fid_EGSysOxiCat_MAX" 4227 "Fid_EGSysPresEnv_MAX" 4228 "Fid_EGSysStrt_MAX" 4229 "Fid_EGSysTemp_MAX" 4230 "Fid_EGSysTrbn_MAX" 4231 "Fid_EGSysTube_MAX" 4232 "Fid_EGSys_AP_MAX" 4233 "Fid_EMCCD_G2Err_MAX" 4234 "Fid_EMCCD_M1Err_MAX" 4235 "Fid_ETClbCorActv_MAX" 4236 "Fid_EcuBoot_MAX" 4237 "Fid_EcuInitTimestamp_MAX" 4238 "Fid_EngMCaSBackUp_MAX" 4239 "Fid_EngMCrSBackUp_MAX" 4240 "Fid_EngM_ChkStrtSpd_MAX" 4241 "Fid_EngMon_Actv_MAX" 4242 "Fid_EngOvrSpd_MAX" 4243 "Fid_EngPOpCalc1_MAX" 4244 "Fid_EngPOpCalc2_MAX" 4245 "Fid_EngPrtCaS_MAX" 4246 "Fid_EngPrtCrS_MAX" 4247 "Fid_EngPrt_KickDown_MAX" 4248 "Fid_EngPrt_nLimErr_MAX" 4249 "Fid_EngSpdCrS_MAX" 4250 "Fid_EngdtEng_MAX" 4251 "Fid_FBC_MAX" 4252 "Fid_FMASwtOff1_MAX" 4253 "Fid_FMASwtOff3_MAX" 4254 "Fid_FTSCDNpl_MAX" 4255 "Fid_FTSErr_MAX" 4256 "Fid_FanCDActrErr_MAX" 4257 "Fid_FanCtlCanAC1_MAX" 4258 "Fid_FanCtl_COTSErr_MAX" 4259 "Fid_FanCtl_tClntErr_MAX" 4260 "Fid_FanCtl_vCurrErr_MAX" 4261 "Fid_FlMngFullLdRglOff_MAX" 4262 "Fid_FlPpCDErr_MAX" 4263 "Fid_FlSysCTSSens_MAX" 4264 "Fid_FlSysDens_MAX" 4265 "Fid_FlSysFTSSens_MAX" 4266 "Fid_FlSysvVeh_MAX" 4267 "Fid_FlSysvolTotal_MAX" 4268 "Fid_FrmMngAC_MAX" 4269 "Fid_FrmMngAC1Npl_MAX" 4270 "Fid_FrmMngAC1TO_MAX" 4271 "Fid_FrmMngACCNpl_MAX" 4272 "Fid_FrmMngACCTO_MAX" 4273 "Fid_FrmMngAIRBGNpl_MAX" 4274 "Fid_FrmMngAIRBGTO_MAX" 4275 "Fid_FrmMngALTCD_Load_MAX" 4276 "Fid_FrmMngAPP_MAX" 4277 "Fid_FrmMngAPPRAW_MAX" 4278 "Fid_FrmMngAPS_MAX" 4279 "Fid_FrmMngAWD1Npl_MAX" 4280 "Fid_FrmMngAWD1TO_MAX" 4281 "Fid_FrmMngAWDTO_MAX" 4282 "Fid_FrmMngBEM1Npl_MAX" 4283 "Fid_FrmMngBEM1TO_MAX" 4284 "Fid_FrmMngBPSCD_IntVal_MAX" 4285 "Fid_FrmMngBRK1Npl_MAX" 4286 "Fid_FrmMngBRK1TO_MAX" 4287 "Fid_FrmMngBRK2Npl_MAX" 4288 "Fid_FrmMngBRK2TO_MAX" 4289 "Fid_FrmMngBRK8Npl_MAX" 4290 "Fid_FrmMngBRK8TO_MAX" 4291 "Fid_FrmMngCCTLNpl_MAX" 4292 "Fid_FrmMngCCTLTO_MAX" 4293 "Fid_FrmMngCHRGR1Npl_MAX" 4294 "Fid_FrmMngCHRGR1TO_MAX" 4295 "Fid_FrmMngCHRGR2Npl_MAX" 4296 "Fid_FrmMngCHRGR2TO_MAX" 4297 "Fid_FrmMngDIA1Npl_MAX" 4298 "Fid_FrmMngDIA1TO_MAX" 4299 "Fid_FrmMngDSP1Npl_MAX" 4300 "Fid_FrmMngDSP1TO_MAX" 4301 "Fid_FrmMngDSP2Npl_MAX" 4302 "Fid_FrmMngDSP2TO_MAX" 4303 "Fid_FrmMngESCUNpl_MAX" 4304 "Fid_FrmMngESCUTO_MAX" 4305 "Fid_FrmMngFlxTOSTO_MAX" 4306 "Fid_FrmMngGW1Npl_MAX" 4307 "Fid_FrmMngGW1TO_MAX" 4308 "Fid_FrmMngIATS_MAX" 4309 "Fid_FrmMngNIVEAU1Npl_MAX" 4310 "Fid_FrmMngNIVEAU1TO_MAX" 4311 "Fid_FrmMngPrcFan_MAX" 4312 "Fid_FrmMngSTIGNNpl_MAX" 4313 "Fid_FrmMngSTIGNTO_MAX" 4314 "Fid_FrmMngTCSTO_MAX" 4315 "Fid_FrmMngTOSNpl_MAX" 4316 "Fid_FrmMngTOSTO_MAX" 4317 "Fid_FrmMngTSC1Npl_MAX" 4318 "Fid_FrmMngTSC1TO_MAX" 4319 "Fid_FrmMngTSC2Npl_MAX" 4320 "Fid_FrmMngTSC2TO_MAX" 4321 "Fid_FrmMngTSC3Npl_MAX" 4322 "Fid_FrmMngTSC3TO_MAX" 4323 "Fid_FrmMngVCurEng2_MAX" 4324 "Fid_FrmMngVDemCrCtl_MAX" 4325 "Fid_FrmMng_AltPwrCan_MAX" 4326 "Fid_FrmMng_GlwCD_Actr_MAX" 4327 "Fid_FrmMng_GlwCtl_Rly_MAX" 4328 "Fid_FrmMng_KickDown_MAX" 4329 "Fid_FrmMngrxChrgr1_MAX" 4330 "Fid_FrmMngrxChrgr2_MAX" 4331 "Fid_FrmMngtxEngActr_MAX" 4332 "Fid_GearbxASTh_MAX" 4333 "Fid_GearbxASTl_MAX" 4334 "Fid_GearbxTrqLimErr_MAX" 4335 "Fid_Gearbx_CANerr_MAX" 4336 "Fid_Gearbx_Eng_MAX" 4337 "Fid_Gearbx_EngCTS_MAX" 4338 "Fid_Gearbx_EngOTS_MAX" 4339 "Fid_Gearbx_FrmMngAWD1_MAX" 4340 "Fid_Gearbx_GearDet_MAX" 4341 "Fid_Gearbx_TSC3Err_MAX" 4342 "Fid_GlwCDActrErr_MAX" 4343 "Fid_GlwCDCan_MAX" 4344 "Fid_GlwCDCod_MAX" 4345 "Fid_GlwCtl1_MAX" 4346 "Fid_GlwCtl2_MAX" 4347 "Fid_HDSCD_SSpMon1_MAX" 4348 "Fid_IATSErr_MAX" 4349 "Fid_IFCD_Err_MAX" 4350 "Fid_IndSys_MonVac_MAX" 4351 "Fid_IndSys_pAdj_MAX" 4352 "Fid_InjCrvCoErr_MAX" 4353 "Fid_InjCtl_qLimErr_MAX" 4354 "Fid_InjUnCaS_MAX" 4355 "Fid_InjUnCrS_MAX" 4356 "Fid_InjUnEgrErr_MAX" 4357 "Fid_InjUnLimErr_MAX" 4358 "Fid_InjUnPcrErr_MAX" 4359 "Fid_InjUnTrqErr_MAX" 4360 "Fid_InjVCDCls_MAX" 4361 "Fid_InjVlvActrTemp_MAX" 4362 "Fid_InjVlvInjLim_MAX" 4363 "Fid_InjVlvMon_MAX" 4364 "Fid_InjVlvNVC_MAX" 4365 "Fid_InjVlvSetUpVolt_MAX" 4366 "Fid_InjVlvWvCorOff_MAX" 4367 "Fid_LIGovDriveAway_MAX" 4368 "Fid_LIGovUbr_MAX" 4369 "Fid_LIGovnSetPointErr_MAX" 4370 "Fid_LSUCDMon0_MAX" 4371 "Fid_LSUCDO20_MAX" 4372 "Fid_LSUCDRi0_MAX" 4373 "Fid_LSUCDactiv0_MAX" 4374 "Fid_LSUCDlsu0_MAX" 4375 "Fid_LSUCtl0_MAX" 4376 "Fid_LSUMonAllChecks_MAX" 4377 "Fid_LSUMonPlausChk_MAX" 4378 "Fid_MeUnCDCalcI_MAX" 4379 "Fid_OTSCDCTSErr_MAX" 4380 "Fid_OTSCDCan_MAX" 4381 "Fid_OTSCDCanDSP2_MAX" 4382 "Fid_OTSCDCanInac_MAX" 4383 "Fid_OTSCDCanSig_MAX" 4384 "Fid_OTSCDErr_MAX" 4385 "Fid_OTSCDPlausCTSCD_MAX" 4386 "Fid_OvRMonTSC2CNT_MAX" 4387 "Fid_OvRMonTSC2TO_MAX" 4388 "Fid_OvRMonTSC3CNTCS_MAX" 4389 "Fid_OvRMonTSC3TO_MAX" 4390 "Fid_PCR_MAX" 4391 "Fid_PCRpLim_MAX" 4392 "Fid_PCVCDCalcI_MAX" 4393 "Fid_PFltChar_MAX" 4394 "Fid_PFltDynChk_MAX" 4395 "Fid_PFltHsLnChk_MAX" 4396 "Fid_PFltPlausPres_MAX" 4397 "Fid_PFltPlausTemp_MAX" 4398 "Fid_PFltPresSensDiff_MAX" 4399 "Fid_PFltPresSensHsLn_MAX" 4400 "Fid_PFltPresSensPre_MAX" 4401 "Fid_PFltRgnShOff_MAX" 4402 "Fid_PFltSRCPres_MAX" 4403 "Fid_PFltSRCTemp_MAX" 4404 "Fid_PFltSotSimPresPerm_MAX" 4405 "Fid_PFltSotSimPresTmp_MAX" 4406 "Fid_PFltTempOxiPre_MAX" 4407 "Fid_PFltTempSens_MAX" 4408 "Fid_PSPCDActrErr_MAX" 4409 "Fid_PrpCtl_AWD1_MAX" 4410 "Fid_PrpCtl_CANVerErr_MAX" 4411 "Fid_PrpCtl_KickDown_MAX" 4412 "Fid_PrpCtl_NIVEAU1_MAX" 4413 "Fid_PrpCtl_VSSCD_MAX" 4414 "Fid_RailCDRPSErrChk_MAX" 4415 "Fid_RailCDSubstVal_MAX" 4416 "Fid_RailCtlMode_MAX" 4417 "Fid_RailMeUn0Blk_MAX" 4418 "Fid_RailMeUn0Rls_MAX" 4419 "Fid_RailMeUn1Blk_MAX" 4420 "Fid_RailMeUn1Rls_MAX" 4421 "Fid_RailMeUn2Blk_MAX" 4422 "Fid_RailMeUn2Rls_MAX" 4423 "Fid_RailMeUn3Blk_MAX" 4424 "Fid_RailMeUn3Rls_MAX" 4425 "Fid_RailMeUn4Blk_MAX" 4426 "Fid_RailMeUn4Rls_MAX" 4427 "Fid_RailMeUnCtlMode_MAX" 4428 "Fid_RailPCV0Blk_MAX" 4429 "Fid_RailPCV0Rls_MAX" 4430 "Fid_RailPCV1Blk_MAX" 4431 "Fid_RailPCV1Rls_MAX" 4432 "Fid_RailPCV2Blk_MAX" 4433 "Fid_RailPCV2Rls_MAX" 4434 "Fid_RailPCV3Blk_MAX" 4435 "Fid_RailPCV3Rls_MAX" 4436 "Fid_RailPCV4Blk_MAX" 4437 "Fid_RailPCV4Rls_MAX" 4438 "Fid_RailPCV5Blk_MAX" 4439 "Fid_RailPCV5Rls_MAX" 4440 "Fid_RailPCVCtlMode_MAX" 4441 "Fid_RailSetPointLim_MAX" 4442 "Fid_RailSetPointRed_MAX" 4443 "Fid_SignalsTstNLim_MAX" 4444 "Fid_StSysCtl_RlyErr_MAX" 4445 "Fid_StSysCtl_VSSCD_MAX" 4446 "Fid_StSysCtltiThrsAddCr_MAX" 4447 "Fid_StSystrqStrtAddCor_MAX" 4448 "Fid_SvLpBRK2TO_MAX" 4449 "Fid_SvLpCDTOSTO_MAX" 4450 "Fid_SvLpTOSTO_MAX" 4451 "Fid_VSSCDBRK1Err_MAX" 4452 "Fid_VSSCDDSP1Err_MAX" 4453 "Fid_ZFCClbActv_MAX" 4454 "Fid_ZFCCldCmbCham_MAX" 8193 "Fid_AC1Can_MIN" 8194 "Fid_AC1PresCan_MIN" 8195 "Fid_AC1TrqCan_MIN" 8196 "Fid_ACCAccPed_MIN" 8197 "Fid_ACCAirbCDCrash_MIN" 8198 "Fid_ACCCDCan_MIN" 8199 "Fid_ACCECUIntErr_MIN" 8200 "Fid_ACCMsgErr_MIN" 8201 "Fid_ACCPlCheck_MIN" 8202 "Fid_ACCtl_ACP_MIN" 8203 "Fid_ACCtl_EATSCD_MIN" 8204 "Fid_ACCtl_ESCUCan_MIN" 8205 "Fid_ACCtl_FanCtl1_MIN" 8206 "Fid_ACCtl_FanCtl2_MIN" 8207 "Fid_ACCtl_SysErr_MIN" 8208 "Fid_ACCtl_TSC1Can_MIN" 8209 "Fid_ACCtl_VehStand_MIN" 8210 "Fid_AFSCD_MIN" 8211 "Fid_AFSCD2_MIN" 8212 "Fid_AFSCD_AirPerTime_MIN" 8213 "Fid_AFSCD_AirPerTime2_MIN" 8214 "Fid_AFSCD_PlAirPerCylDiff_MIN" 8215 "Fid_AFSCD_PlOffsDrft_MIN" 8216 "Fid_AFSCD_PlOffsDrft2_MIN" 8217 "Fid_AFSCD_PlSetyDrft_MIN" 8218 "Fid_AFSCD_PlSetyDrft2_MIN" 8219 "Fid_AFSCD_SRCAirm_MIN" 8220 "Fid_AFSCD_SRCAirm2_MIN" 8221 "Fid_AFSCD_SRCCorrAirm_MIN" 8222 "Fid_AFSCD_SRCDcyc_MIN" 8223 "Fid_AFSCD_SRCRawAirm_MIN" 8224 "Fid_AFSCD_SRCRefSig_MIN" 8225 "Fid_AFVCtlSigErr_MIN" 8226 "Fid_AOHTCanAC1_MIN" 8227 "Fid_AOHTCanESCU_MIN" 8228 "Fid_AOHt_AltSRC_MIN" 8229 "Fid_AOHt_CDHt1_MIN" 8230 "Fid_AOHt_CDHt2_MIN" 8231 "Fid_AOHt_ErrHt_MIN" 8232 "Fid_APP1_MIN" 8233 "Fid_APP1_FiltOffRampOn_MIN" 8234 "Fid_APP1_Sens_MIN" 8235 "Fid_APP2_MIN" 8236 "Fid_APP2_Sens_MIN" 8237 "Fid_APPKickDown_VSS_MIN" 8238 "Fid_APPKickdown_MIN" 8239 "Fid_APSCD_MIN" 8240 "Fid_ASDdc_MIN" 8241 "Fid_ASDdcNGvnr_MIN" 8242 "Fid_ASModSwtOffEng_MIN" 8243 "Fid_ASModSwtOffExhMnf_MIN" 8244 "Fid_ASModSwtOffIndVol_MIN" 8245 "Fid_ASModSwtOffObsvrPIndVol_MIN" 8246 "Fid_AccPed_MIN" 8247 "Fid_AccPedVel_MIN" 8248 "Fid_AccPed_Brk_MIN" 8249 "Fid_AddPmpTnkDef_MIN" 8250 "Fid_AirCtl_MIN" 8251 "Fid_AirbCDCan_MIN" 8252 "Fid_Alt_PwrCan_MIN" 8253 "Fid_Alt_T15_MIN" 8254 "Fid_BPSErr_MIN" 8255 "Fid_BrkCDCan_MIN" 8256 "Fid_CCtlCan_MIN" 8257 "Fid_CRCCDCan_MIN" 8258 "Fid_CRCCDTo_MIN" 8259 "Fid_CTSCDCan_MIN" 8260 "Fid_CTSCDCanInac_MIN" 8261 "Fid_CTSCDCanSig_MIN" 8262 "Fid_CTSCDOTSErr_MIN" 8263 "Fid_CTSCDPullup_MIN" 8264 "Fid_CTSErr_MIN" 8265 "Fid_ClgDynTst_MIN" 8266 "Fid_CmbChb_MIN" 8267 "Fid_CoDT_GripDeb_MIN" 8268 "Fid_CoEngAirbCDCrash_MIN" 8269 "Fid_CoEngGW1TO_MIN" 8270 "Fid_CoEng_ActrPrt_MIN" 8271 "Fid_CoEng_FrmMngAWD1_MIN" 8272 "Fid_CoEng_IRevSys_MIN" 8273 "Fid_CoEng_IRevVeh_MIN" 8274 "Fid_CoEng_KickDown_MIN" 8275 "Fid_CoEng_PwrStgEnable_MIN" 8276 "Fid_CoEng_RevSys_MIN" 8277 "Fid_CoEng_RevVeh_MIN" 8278 "Fid_CoEng_T15CD_MIN" 8279 "Fid_CoEng_TMFWShOff_MIN" 8280 "Fid_CoEng_trqLimBiTurbo_MIN" 8281 "Fid_CoEng_trqLimErr_MIN" 8282 "Fid_CoVM_DCSh_MIN" 8283 "Fid_CoVM_DCSp_MIN" 8284 "Fid_CoVehEcoCan_MIN" 8285 "Fid_CoVehIdleStop_MIN" 8286 "Fid_CoVehPnlFunc_MIN" 8287 "Fid_CoVehtrqLimErr_MIN" 8288 "Fid_ConvCDCan_MIN" 8289 "Fid_CrCtlACCErr_MIN" 8290 "Fid_CrCtlAirbCDCrash_MIN" 8291 "Fid_CrCtlCanBrk1_MIN" 8292 "Fid_CrCtlMsgErrBRK8_MIN" 8293 "Fid_CrCtlPAAGTlrDef_MIN" 8294 "Fid_CrCtlPIrevShutoff_MIN" 8295 "Fid_CrCtl_CTSLPRES_MIN" 8296 "Fid_CrCtl_EngMCaS1_MIN" 8297 "Fid_CrCtl_EngMCrS1_MIN" 8298 "Fid_CrCtl_stBrk_MIN" 8299 "Fid_CrCtl_stSpeedSensor_MIN" 8300 "Fid_CrCtl_stSystem_MIN" 8301 "Fid_CtApCDActrErr_MIN" 8302 "Fid_CtTCtl_stStageErr_MIN" 8303 "Fid_CtTCtl_tClntDs1_Err_MIN" 8304 "Fid_CtTCtl_tClntDs2_Err_MIN" 8305 "Fid_CtTCtl_tClntDs3_Err_MIN" 8306 "Fid_CtTCtl_tClntDs4_Err_MIN" 8307 "Fid_CtT_SwtOff_MIN" 8308 "Fid_CtT_SwtOff_EAT_MIN" 8309 "Fid_CtT_SwtOff_EATMod_MIN" 8310 "Fid_DSM_Wuc_MIN" 8311 "Fid_DiffCANerr_MIN" 8312 "Fid_EATSCDCan_MIN" 8313 "Fid_EATSCDCanInac_MIN" 8314 "Fid_EATSCDCanSig_MIN" 8315 "Fid_EGSysCoLSU0_MIN" 8316 "Fid_EGSysCoNSC_MIN" 8317 "Fid_EGSysCoOxi_MIN" 8318 "Fid_EGSysCoTrbn_MIN" 8319 "Fid_EGSysCoTube0_MIN" 8320 "Fid_EGSysHtgDel_MIN" 8321 "Fid_EGSysNSC_MIN" 8322 "Fid_EGSysOxiCat_MIN" 8323 "Fid_EGSysPresEnv_MIN" 8324 "Fid_EGSysStrt_MIN" 8325 "Fid_EGSysTemp_MIN" 8326 "Fid_EGSysTrbn_MIN" 8327 "Fid_EGSysTube_MIN" 8328 "Fid_EGSys_AP_MIN" 8329 "Fid_EMCCD_G2Err_MIN" 8330 "Fid_EMCCD_M1Err_MIN" 8331 "Fid_ETClbCorActv_MIN" 8332 "Fid_EcuBoot_MIN" 8333 "Fid_EcuInitTimestamp_MIN" 8334 "Fid_EngMCaSBackUp_MIN" 8335 "Fid_EngMCrSBackUp_MIN" 8336 "Fid_EngM_ChkStrtSpd_MIN" 8337 "Fid_EngMon_Actv_MIN" 8338 "Fid_EngOvrSpd_MIN" 8339 "Fid_EngPOpCalc1_MIN" 8340 "Fid_EngPOpCalc2_MIN" 8341 "Fid_EngPrtCaS_MIN" 8342 "Fid_EngPrtCrS_MIN" 8343 "Fid_EngPrt_KickDown_MIN" 8344 "Fid_EngPrt_nLimErr_MIN" 8345 "Fid_EngSpdCrS_MIN" 8346 "Fid_EngdtEng_MIN" 8347 "Fid_FBC_MIN" 8348 "Fid_FMASwtOff1_MIN" 8349 "Fid_FMASwtOff3_MIN" 8350 "Fid_FTSCDNpl_MIN" 8351 "Fid_FTSErr_MIN" 8352 "Fid_FanCDActrErr_MIN" 8353 "Fid_FanCtlCanAC1_MIN" 8354 "Fid_FanCtl_COTSErr_MIN" 8355 "Fid_FanCtl_tClntErr_MIN" 8356 "Fid_FanCtl_vCurrErr_MIN" 8357 "Fid_FlMngFullLdRglOff_MIN" 8358 "Fid_FlPpCDErr_MIN" 8359 "Fid_FlSysCTSSens_MIN" 8360 "Fid_FlSysDens_MIN" 8361 "Fid_FlSysFTSSens_MIN" 8362 "Fid_FlSysvVeh_MIN" 8363 "Fid_FlSysvolTotal_MIN" 8364 "Fid_FrmMngAC_MIN" 8365 "Fid_FrmMngAC1Npl_MIN" 8366 "Fid_FrmMngAC1TO_MIN" 8367 "Fid_FrmMngACCNpl_MIN" 8368 "Fid_FrmMngACCTO_MIN" 8369 "Fid_FrmMngAIRBGNpl_MIN" 8370 "Fid_FrmMngAIRBGTO_MIN" 8371 "Fid_FrmMngALTCD_Load_MIN" 8372 "Fid_FrmMngAPP_MIN" 8373 "Fid_FrmMngAPPRAW_MIN" 8374 "Fid_FrmMngAPS_MIN" 8375 "Fid_FrmMngAWD1Npl_MIN" 8376 "Fid_FrmMngAWD1TO_MIN" 8377 "Fid_FrmMngAWDTO_MIN" 8378 "Fid_FrmMngBEM1Npl_MIN" 8379 "Fid_FrmMngBEM1TO_MIN" 8380 "Fid_FrmMngBPSCD_IntVal_MIN" 8381 "Fid_FrmMngBRK1Npl_MIN" 8382 "Fid_FrmMngBRK1TO_MIN" 8383 "Fid_FrmMngBRK2Npl_MIN" 8384 "Fid_FrmMngBRK2TO_MIN" 8385 "Fid_FrmMngBRK8Npl_MIN" 8386 "Fid_FrmMngBRK8TO_MIN" 8387 "Fid_FrmMngCCTLNpl_MIN" 8388 "Fid_FrmMngCCTLTO_MIN" 8389 "Fid_FrmMngCHRGR1Npl_MIN" 8390 "Fid_FrmMngCHRGR1TO_MIN" 8391 "Fid_FrmMngCHRGR2Npl_MIN" 8392 "Fid_FrmMngCHRGR2TO_MIN" 8393 "Fid_FrmMngDIA1Npl_MIN" 8394 "Fid_FrmMngDIA1TO_MIN" 8395 "Fid_FrmMngDSP1Npl_MIN" 8396 "Fid_FrmMngDSP1TO_MIN" 8397 "Fid_FrmMngDSP2Npl_MIN" 8398 "Fid_FrmMngDSP2TO_MIN" 8399 "Fid_FrmMngESCUNpl_MIN" 8400 "Fid_FrmMngESCUTO_MIN" 8401 "Fid_FrmMngFlxTOSTO_MIN" 8402 "Fid_FrmMngGW1Npl_MIN" 8403 "Fid_FrmMngGW1TO_MIN" 8404 "Fid_FrmMngIATS_MIN" 8405 "Fid_FrmMngNIVEAU1Npl_MIN" 8406 "Fid_FrmMngNIVEAU1TO_MIN" 8407 "Fid_FrmMngPrcFan_MIN" 8408 "Fid_FrmMngSTIGNNpl_MIN" 8409 "Fid_FrmMngSTIGNTO_MIN" 8410 "Fid_FrmMngTCSTO_MIN" 8411 "Fid_FrmMngTOSNpl_MIN" 8412 "Fid_FrmMngTOSTO_MIN" 8413 "Fid_FrmMngTSC1Npl_MIN" 8414 "Fid_FrmMngTSC1TO_MIN" 8415 "Fid_FrmMngTSC2Npl_MIN" 8416 "Fid_FrmMngTSC2TO_MIN" 8417 "Fid_FrmMngTSC3Npl_MIN" 8418 "Fid_FrmMngTSC3TO_MIN" 8419 "Fid_FrmMngVCurEng2_MIN" 8420 "Fid_FrmMngVDemCrCtl_MIN" 8421 "Fid_FrmMng_AltPwrCan_MIN" 8422 "Fid_FrmMng_GlwCD_Actr_MIN" 8423 "Fid_FrmMng_GlwCtl_Rly_MIN" 8424 "Fid_FrmMng_KickDown_MIN" 8425 "Fid_FrmMngrxChrgr1_MIN" 8426 "Fid_FrmMngrxChrgr2_MIN" 8427 "Fid_FrmMngtxEngActr_MIN" 8428 "Fid_GearbxASTh_MIN" 8429 "Fid_GearbxASTl_MIN" 8430 "Fid_GearbxTrqLimErr_MIN" 8431 "Fid_Gearbx_CANerr_MIN" 8432 "Fid_Gearbx_Eng_MIN" 8433 "Fid_Gearbx_EngCTS_MIN" 8434 "Fid_Gearbx_EngOTS_MIN" 8435 "Fid_Gearbx_FrmMngAWD1_MIN" 8436 "Fid_Gearbx_GearDet_MIN" 8437 "Fid_Gearbx_TSC3Err_MIN" 8438 "Fid_GlwCDActrErr_MIN" 8439 "Fid_GlwCDCan_MIN" 8440 "Fid_GlwCDCod_MIN" 8441 "Fid_GlwCtl1_MIN" 8442 "Fid_GlwCtl2_MIN" 8443 "Fid_HDSCD_SSpMon1_MIN" 8444 "Fid_IATSErr_MIN" 8445 "Fid_IFCD_Err_MIN" 8446 "Fid_IndSys_MonVac_MIN" 8447 "Fid_IndSys_pAdj_MIN" 8448 "Fid_InjCrvCoErr_MIN" 8449 "Fid_InjCtl_qLimErr_MIN" 8450 "Fid_InjUnCaS_MIN" 8451 "Fid_InjUnCrS_MIN" 8452 "Fid_InjUnEgrErr_MIN" 8453 "Fid_InjUnLimErr_MIN" 8454 "Fid_InjUnPcrErr_MIN" 8455 "Fid_InjUnTrqErr_MIN" 8456 "Fid_InjVCDCls_MIN" 8457 "Fid_InjVlvActrTemp_MIN" 8458 "Fid_InjVlvInjLim_MIN" 8459 "Fid_InjVlvMon_MIN" 8460 "Fid_InjVlvNVC_MIN" 8461 "Fid_InjVlvSetUpVolt_MIN" 8462 "Fid_InjVlvWvCorOff_MIN" 8463 "Fid_LIGovDriveAway_MIN" 8464 "Fid_LIGovUbr_MIN" 8465 "Fid_LIGovnSetPointErr_MIN" 8466 "Fid_LSUCDMon0_MIN" 8467 "Fid_LSUCDO20_MIN" 8468 "Fid_LSUCDRi0_MIN" 8469 "Fid_LSUCDactiv0_MIN" 8470 "Fid_LSUCDlsu0_MIN" 8471 "Fid_LSUCtl0_MIN" 8472 "Fid_LSUMonAllChecks_MIN" 8473 "Fid_LSUMonPlausChk_MIN" 8474 "Fid_MeUnCDCalcI_MIN" 8475 "Fid_OTSCDCTSErr_MIN" 8476 "Fid_OTSCDCan_MIN" 8477 "Fid_OTSCDCanDSP2_MIN" 8478 "Fid_OTSCDCanInac_MIN" 8479 "Fid_OTSCDCanSig_MIN" 8480 "Fid_OTSCDErr_MIN" 8481 "Fid_OTSCDPlausCTSCD_MIN" 8482 "Fid_OvRMonTSC2CNT_MIN" 8483 "Fid_OvRMonTSC2TO_MIN" 8484 "Fid_OvRMonTSC3CNTCS_MIN" 8485 "Fid_OvRMonTSC3TO_MIN" 8486 "Fid_PCR_MIN" 8487 "Fid_PCRpLim_MIN" 8488 "Fid_PCVCDCalcI_MIN" 8489 "Fid_PFltChar_MIN" 8490 "Fid_PFltDynChk_MIN" 8491 "Fid_PFltHsLnChk_MIN" 8492 "Fid_PFltPlausPres_MIN" 8493 "Fid_PFltPlausTemp_MIN" 8494 "Fid_PFltPresSensDiff_MIN" 8495 "Fid_PFltPresSensHsLn_MIN" 8496 "Fid_PFltPresSensPre_MIN" 8497 "Fid_PFltRgnShOff_MIN" 8498 "Fid_PFltSRCPres_MIN" 8499 "Fid_PFltSRCTemp_MIN" 8500 "Fid_PFltSotSimPresPerm_MIN" 8501 "Fid_PFltSotSimPresTmp_MIN" 8502 "Fid_PFltTempOxiPre_MIN" 8503 "Fid_PFltTempSens_MIN" 8504 "Fid_PSPCDActrErr_MIN" 8505 "Fid_PrpCtl_AWD1_MIN" 8506 "Fid_PrpCtl_CANVerErr_MIN" 8507 "Fid_PrpCtl_KickDown_MIN" 8508 "Fid_PrpCtl_NIVEAU1_MIN" 8509 "Fid_PrpCtl_VSSCD_MIN" 8510 "Fid_RailCDRPSErrChk_MIN" 8511 "Fid_RailCDSubstVal_MIN" 8512 "Fid_RailCtlMode_MIN" 8513 "Fid_RailMeUn0Blk_MIN" 8514 "Fid_RailMeUn0Rls_MIN" 8515 "Fid_RailMeUn1Blk_MIN" 8516 "Fid_RailMeUn1Rls_MIN" 8517 "Fid_RailMeUn2Blk_MIN" 8518 "Fid_RailMeUn2Rls_MIN" 8519 "Fid_RailMeUn3Blk_MIN" 8520 "Fid_RailMeUn3Rls_MIN" 8521 "Fid_RailMeUn4Blk_MIN" 8522 "Fid_RailMeUn4Rls_MIN" 8523 "Fid_RailMeUnCtlMode_MIN" 8524 "Fid_RailPCV0Blk_MIN" 8525 "Fid_RailPCV0Rls_MIN" 8526 "Fid_RailPCV1Blk_MIN" 8527 "Fid_RailPCV1Rls_MIN" 8528 "Fid_RailPCV2Blk_MIN" 8529 "Fid_RailPCV2Rls_MIN" 8530 "Fid_RailPCV3Blk_MIN" 8531 "Fid_RailPCV3Rls_MIN" 8532 "Fid_RailPCV4Blk_MIN" 8533 "Fid_RailPCV4Rls_MIN" 8534 "Fid_RailPCV5Blk_MIN" 8535 "Fid_RailPCV5Rls_MIN" 8536 "Fid_RailPCVCtlMode_MIN" 8537 "Fid_RailSetPointLim_MIN" 8538 "Fid_RailSetPointRed_MIN" 8539 "Fid_SignalsTstNLim_MIN" 8540 "Fid_StSysCtl_RlyErr_MIN" 8541 "Fid_StSysCtl_VSSCD_MIN" 8542 "Fid_StSysCtltiThrsAddCr_MIN" 8543 "Fid_StSystrqStrtAddCor_MIN" 8544 "Fid_SvLpBRK2TO_MIN" 8545 "Fid_SvLpCDTOSTO_MIN" 8546 "Fid_SvLpTOSTO_MIN" 8547 "Fid_VSSCDBRK1Err_MIN" 8548 "Fid_VSSCDDSP1Err_MIN" 8549 "Fid_ZFCClbActv_MIN" 8550 "Fid_ZFCCldCmbCham_MIN" 16385 "Fid_AC1Can_SIG" 16386 "Fid_AC1PresCan_SIG" 16387 "Fid_AC1TrqCan_SIG" 16388 "Fid_ACCAccPed_SIG" 16389 "Fid_ACCAirbCDCrash_SIG" 16390 "Fid_ACCCDCan_SIG" 16391 "Fid_ACCECUIntErr_SIG" 16392 "Fid_ACCMsgErr_SIG" 16393 "Fid_ACCPlCheck_SIG" 16394 "Fid_ACCtl_ACP_SIG" 16395 "Fid_ACCtl_EATSCD_SIG" 16396 "Fid_ACCtl_ESCUCan_SIG" 16397 "Fid_ACCtl_FanCtl1_SIG" 16398 "Fid_ACCtl_FanCtl2_SIG" 16399 "Fid_ACCtl_SysErr_SIG" 16400 "Fid_ACCtl_TSC1Can_SIG" 16401 "Fid_ACCtl_VehStand_SIG" 16402 "Fid_AFSCD_SIG" 16403 "Fid_AFSCD2_SIG" 16404 "Fid_AFSCD_AirPerTime_SIG" 16405 "Fid_AFSCD_AirPerTime2_SIG" 16406 "Fid_AFSCD_PlAirPerCylDiff_SIG" 16407 "Fid_AFSCD_PlOffsDrft_SIG" 16408 "Fid_AFSCD_PlOffsDrft2_SIG" 16409 "Fid_AFSCD_PlSetyDrft_SIG" 16410 "Fid_AFSCD_PlSetyDrft2_SIG" 16411 "Fid_AFSCD_SRCAirm_SIG" 16412 "Fid_AFSCD_SRCAirm2_SIG" 16413 "Fid_AFSCD_SRCCorrAirm_SIG" 16414 "Fid_AFSCD_SRCDcyc_SIG" 16415 "Fid_AFSCD_SRCRawAirm_SIG" 16416 "Fid_AFSCD_SRCRefSig_SIG" 16417 "Fid_AFVCtlSigErr_SIG" 16418 "Fid_AOHTCanAC1_SIG" 16419 "Fid_AOHTCanESCU_SIG" 16420 "Fid_AOHt_AltSRC_SIG" 16421 "Fid_AOHt_CDHt1_SIG" 16422 "Fid_AOHt_CDHt2_SIG" 16423 "Fid_AOHt_ErrHt_SIG" 16424 "Fid_APP1_SIG" 16425 "Fid_APP1_FiltOffRampOn_SIG" 16426 "Fid_APP1_Sens_SIG" 16427 "Fid_APP2_SIG" 16428 "Fid_APP2_Sens_SIG" 16429 "Fid_APPKickDown_VSS_SIG" 16430 "Fid_APPKickdown_SIG" 16431 "Fid_APSCD_SIG" 16432 "Fid_ASDdc_SIG" 16433 "Fid_ASDdcNGvnr_SIG" 16434 "Fid_ASModSwtOffEng_SIG" 16435 "Fid_ASModSwtOffExhMnf_SIG" 16436 "Fid_ASModSwtOffIndVol_SIG" 16437 "Fid_ASModSwtOffObsvrPIndVol_SIG" 16438 "Fid_AccPed_SIG" 16439 "Fid_AccPedVel_SIG" 16440 "Fid_AccPed_Brk_SIG" 16441 "Fid_AddPmpTnkDef_SIG" 16442 "Fid_AirCtl_SIG" 16443 "Fid_AirbCDCan_SIG" 16444 "Fid_Alt_PwrCan_SIG" 16445 "Fid_Alt_T15_SIG" 16446 "Fid_BPSErr_SIG" 16447 "Fid_BrkCDCan_SIG" 16448 "Fid_CCtlCan_SIG" 16449 "Fid_CRCCDCan_SIG" 16450 "Fid_CRCCDTo_SIG" 16451 "Fid_CTSCDCan_SIG" 16452 "Fid_CTSCDCanInac_SIG" 16453 "Fid_CTSCDCanSig_SIG" 16454 "Fid_CTSCDOTSErr_SIG" 16455 "Fid_CTSCDPullup_SIG" 16456 "Fid_CTSErr_SIG" 16457 "Fid_ClgDynTst_SIG" 16458 "Fid_CmbChb_SIG" 16459 "Fid_CoDT_GripDeb_SIG" 16460 "Fid_CoEngAirbCDCrash_SIG" 16461 "Fid_CoEngGW1TO_SIG" 16462 "Fid_CoEng_ActrPrt_SIG" 16463 "Fid_CoEng_FrmMngAWD1_SIG" 16464 "Fid_CoEng_IRevSys_SIG" 16465 "Fid_CoEng_IRevVeh_SIG" 16466 "Fid_CoEng_KickDown_SIG" 16467 "Fid_CoEng_PwrStgEnable_SIG" 16468 "Fid_CoEng_RevSys_SIG" 16469 "Fid_CoEng_RevVeh_SIG" 16470 "Fid_CoEng_T15CD_SIG" 16471 "Fid_CoEng_TMFWShOff_SIG" 16472 "Fid_CoEng_trqLimBiTurbo_SIG" 16473 "Fid_CoEng_trqLimErr_SIG" 16474 "Fid_CoVM_DCSh_SIG" 16475 "Fid_CoVM_DCSp_SIG" 16476 "Fid_CoVehEcoCan_SIG" 16477 "Fid_CoVehIdleStop_SIG" 16478 "Fid_CoVehPnlFunc_SIG" 16479 "Fid_CoVehtrqLimErr_SIG" 16480 "Fid_ConvCDCan_SIG" 16481 "Fid_CrCtlACCErr_SIG" 16482 "Fid_CrCtlAirbCDCrash_SIG" 16483 "Fid_CrCtlCanBrk1_SIG" 16484 "Fid_CrCtlMsgErrBRK8_SIG" 16485 "Fid_CrCtlPAAGTlrDef_SIG" 16486 "Fid_CrCtlPIrevShutoff_SIG" 16487 "Fid_CrCtl_CTSLPRES_SIG" 16488 "Fid_CrCtl_EngMCaS1_SIG" 16489 "Fid_CrCtl_EngMCrS1_SIG" 16490 "Fid_CrCtl_stBrk_SIG" 16491 "Fid_CrCtl_stSpeedSensor_SIG" 16492 "Fid_CrCtl_stSystem_SIG" 16493 "Fid_CtApCDActrErr_SIG" 16494 "Fid_CtTCtl_stStageErr_SIG" 16495 "Fid_CtTCtl_tClntDs1_Err_SIG" 16496 "Fid_CtTCtl_tClntDs2_Err_SIG" 16497 "Fid_CtTCtl_tClntDs3_Err_SIG" 16498 "Fid_CtTCtl_tClntDs4_Err_SIG" 16499 "Fid_CtT_SwtOff_SIG" 16500 "Fid_CtT_SwtOff_EAT_SIG" 16501 "Fid_CtT_SwtOff_EATMod_SIG" 16502 "Fid_DSM_Wuc_SIG" 16503 "Fid_DiffCANerr_SIG" 16504 "Fid_EATSCDCan_SIG" 16505 "Fid_EATSCDCanInac_SIG" 16506 "Fid_EATSCDCanSig_SIG" 16507 "Fid_EGSysCoLSU0_SIG" 16508 "Fid_EGSysCoNSC_SIG" 16509 "Fid_EGSysCoOxi_SIG" 16510 "Fid_EGSysCoTrbn_SIG" 16511 "Fid_EGSysCoTube0_SIG" 16512 "Fid_EGSysHtgDel_SIG" 16513 "Fid_EGSysNSC_SIG" 16514 "Fid_EGSysOxiCat_SIG" 16515 "Fid_EGSysPresEnv_SIG" 16516 "Fid_EGSysStrt_SIG" 16517 "Fid_EGSysTemp_SIG" 16518 "Fid_EGSysTrbn_SIG" 16519 "Fid_EGSysTube_SIG" 16520 "Fid_EGSys_AP_SIG" 16521 "Fid_EMCCD_G2Err_SIG" 16522 "Fid_EMCCD_M1Err_SIG" 16523 "Fid_ETClbCorActv_SIG" 16524 "Fid_EcuBoot_SIG" 16525 "Fid_EcuInitTimestamp_SIG" 16526 "Fid_EngMCaSBackUp_SIG" 16527 "Fid_EngMCrSBackUp_SIG" 16528 "Fid_EngM_ChkStrtSpd_SIG" 16529 "Fid_EngMon_Actv_SIG" 16530 "Fid_EngOvrSpd_SIG" 16531 "Fid_EngPOpCalc1_SIG" 16532 "Fid_EngPOpCalc2_SIG" 16533 "Fid_EngPrtCaS_SIG" 16534 "Fid_EngPrtCrS_SIG" 16535 "Fid_EngPrt_KickDown_SIG" 16536 "Fid_EngPrt_nLimErr_SIG" 16537 "Fid_EngSpdCrS_SIG" 16538 "Fid_EngdtEng_SIG" 16539 "Fid_FBC_SIG" 16540 "Fid_FMASwtOff1_SIG" 16541 "Fid_FMASwtOff3_SIG" 16542 "Fid_FTSCDNpl_SIG" 16543 "Fid_FTSErr_SIG" 16544 "Fid_FanCDActrErr_SIG" 16545 "Fid_FanCtlCanAC1_SIG" 16546 "Fid_FanCtl_COTSErr_SIG" 16547 "Fid_FanCtl_tClntErr_SIG" 16548 "Fid_FanCtl_vCurrErr_SIG" 16549 "Fid_FlMngFullLdRglOff_SIG" 16550 "Fid_FlPpCDErr_SIG" 16551 "Fid_FlSysCTSSens_SIG" 16552 "Fid_FlSysDens_SIG" 16553 "Fid_FlSysFTSSens_SIG" 16554 "Fid_FlSysvVeh_SIG" 16555 "Fid_FlSysvolTotal_SIG" 16556 "Fid_FrmMngAC_SIG" 16557 "Fid_FrmMngAC1Npl_SIG" 16558 "Fid_FrmMngAC1TO_SIG" 16559 "Fid_FrmMngACCNpl_SIG" 16560 "Fid_FrmMngACCTO_SIG" 16561 "Fid_FrmMngAIRBGNpl_SIG" 16562 "Fid_FrmMngAIRBGTO_SIG" 16563 "Fid_FrmMngALTCD_Load_SIG" 16564 "Fid_FrmMngAPP_SIG" 16565 "Fid_FrmMngAPPRAW_SIG" 16566 "Fid_FrmMngAPS_SIG" 16567 "Fid_FrmMngAWD1Npl_SIG" 16568 "Fid_FrmMngAWD1TO_SIG" 16569 "Fid_FrmMngAWDTO_SIG" 16570 "Fid_FrmMngBEM1Npl_SIG" 16571 "Fid_FrmMngBEM1TO_SIG" 16572 "Fid_FrmMngBPSCD_IntVal_SIG" 16573 "Fid_FrmMngBRK1Npl_SIG" 16574 "Fid_FrmMngBRK1TO_SIG" 16575 "Fid_FrmMngBRK2Npl_SIG" 16576 "Fid_FrmMngBRK2TO_SIG" 16577 "Fid_FrmMngBRK8Npl_SIG" 16578 "Fid_FrmMngBRK8TO_SIG" 16579 "Fid_FrmMngCCTLNpl_SIG" 16580 "Fid_FrmMngCCTLTO_SIG" 16581 "Fid_FrmMngCHRGR1Npl_SIG" 16582 "Fid_FrmMngCHRGR1TO_SIG" 16583 "Fid_FrmMngCHRGR2Npl_SIG" 16584 "Fid_FrmMngCHRGR2TO_SIG" 16585 "Fid_FrmMngDIA1Npl_SIG" 16586 "Fid_FrmMngDIA1TO_SIG" 16587 "Fid_FrmMngDSP1Npl_SIG" 16588 "Fid_FrmMngDSP1TO_SIG" 16589 "Fid_FrmMngDSP2Npl_SIG" 16590 "Fid_FrmMngDSP2TO_SIG" 16591 "Fid_FrmMngESCUNpl_SIG" 16592 "Fid_FrmMngESCUTO_SIG" 16593 "Fid_FrmMngFlxTOSTO_SIG" 16594 "Fid_FrmMngGW1Npl_SIG" 16595 "Fid_FrmMngGW1TO_SIG" 16596 "Fid_FrmMngIATS_SIG" 16597 "Fid_FrmMngNIVEAU1Npl_SIG" 16598 "Fid_FrmMngNIVEAU1TO_SIG" 16599 "Fid_FrmMngPrcFan_SIG" 16600 "Fid_FrmMngSTIGNNpl_SIG" 16601 "Fid_FrmMngSTIGNTO_SIG" 16602 "Fid_FrmMngTCSTO_SIG" 16603 "Fid_FrmMngTOSNpl_SIG" 16604 "Fid_FrmMngTOSTO_SIG" 16605 "Fid_FrmMngTSC1Npl_SIG" 16606 "Fid_FrmMngTSC1TO_SIG" 16607 "Fid_FrmMngTSC2Npl_SIG" 16608 "Fid_FrmMngTSC2TO_SIG" 16609 "Fid_FrmMngTSC3Npl_SIG" 16610 "Fid_FrmMngTSC3TO_SIG" 16611 "Fid_FrmMngVCurEng2_SIG" 16612 "Fid_FrmMngVDemCrCtl_SIG" 16613 "Fid_FrmMng_AltPwrCan_SIG" 16614 "Fid_FrmMng_GlwCD_Actr_SIG" 16615 "Fid_FrmMng_GlwCtl_Rly_SIG" 16616 "Fid_FrmMng_KickDown_SIG" 16617 "Fid_FrmMngrxChrgr1_SIG" 16618 "Fid_FrmMngrxChrgr2_SIG" 16619 "Fid_FrmMngtxEngActr_SIG" 16620 "Fid_GearbxASTh_SIG" 16621 "Fid_GearbxASTl_SIG" 16622 "Fid_GearbxTrqLimErr_SIG" 16623 "Fid_Gearbx_CANerr_SIG" 16624 "Fid_Gearbx_Eng_SIG" 16625 "Fid_Gearbx_EngCTS_SIG" 16626 "Fid_Gearbx_EngOTS_SIG" 16627 "Fid_Gearbx_FrmMngAWD1_SIG" 16628 "Fid_Gearbx_GearDet_SIG" 16629 "Fid_Gearbx_TSC3Err_SIG" 16630 "Fid_GlwCDActrErr_SIG" 16631 "Fid_GlwCDCan_SIG" 16632 "Fid_GlwCDCod_SIG" 16633 "Fid_GlwCtl1_SIG" 16634 "Fid_GlwCtl2_SIG" 16635 "Fid_HDSCD_SSpMon1_SIG" 16636 "Fid_IATSErr_SIG" 16637 "Fid_IFCD_Err_SIG" 16638 "Fid_IndSys_MonVac_SIG" 16639 "Fid_IndSys_pAdj_SIG" 16640 "Fid_InjCrvCoErr_SIG" 16641 "Fid_InjCtl_qLimErr_SIG" 16642 "Fid_InjUnCaS_SIG" 16643 "Fid_InjUnCrS_SIG" 16644 "Fid_InjUnEgrErr_SIG" 16645 "Fid_InjUnLimErr_SIG" 16646 "Fid_InjUnPcrErr_SIG" 16647 "Fid_InjUnTrqErr_SIG" 16648 "Fid_InjVCDCls_SIG" 16649 "Fid_InjVlvActrTemp_SIG" 16650 "Fid_InjVlvInjLim_SIG" 16651 "Fid_InjVlvMon_SIG" 16652 "Fid_InjVlvNVC_SIG" 16653 "Fid_InjVlvSetUpVolt_SIG" 16654 "Fid_InjVlvWvCorOff_SIG" 16655 "Fid_LIGovDriveAway_SIG" 16656 "Fid_LIGovUbr_SIG" 16657 "Fid_LIGovnSetPointErr_SIG" 16658 "Fid_LSUCDMon0_SIG" 16659 "Fid_LSUCDO20_SIG" 16660 "Fid_LSUCDRi0_SIG" 16661 "Fid_LSUCDactiv0_SIG" 16662 "Fid_LSUCDlsu0_SIG" 16663 "Fid_LSUCtl0_SIG" 16664 "Fid_LSUMonAllChecks_SIG" 16665 "Fid_LSUMonPlausChk_SIG" 16666 "Fid_MeUnCDCalcI_SIG" 16667 "Fid_OTSCDCTSErr_SIG" 16668 "Fid_OTSCDCan_SIG" 16669 "Fid_OTSCDCanDSP2_SIG" 16670 "Fid_OTSCDCanInac_SIG" 16671 "Fid_OTSCDCanSig_SIG" 16672 "Fid_OTSCDErr_SIG" 16673 "Fid_OTSCDPlausCTSCD_SIG" 16674 "Fid_OvRMonTSC2CNT_SIG" 16675 "Fid_OvRMonTSC2TO_SIG" 16676 "Fid_OvRMonTSC3CNTCS_SIG" 16677 "Fid_OvRMonTSC3TO_SIG" 16678 "Fid_PCR_SIG" 16679 "Fid_PCRpLim_SIG" 16680 "Fid_PCVCDCalcI_SIG" 16681 "Fid_PFltChar_SIG" 16682 "Fid_PFltDynChk_SIG" 16683 "Fid_PFltHsLnChk_SIG" 16684 "Fid_PFltPlausPres_SIG" 16685 "Fid_PFltPlausTemp_SIG" 16686 "Fid_PFltPresSensDiff_SIG" 16687 "Fid_PFltPresSensHsLn_SIG" 16688 "Fid_PFltPresSensPre_SIG" 16689 "Fid_PFltRgnShOff_SIG" 16690 "Fid_PFltSRCPres_SIG" 16691 "Fid_PFltSRCTemp_SIG" 16692 "Fid_PFltSotSimPresPerm_SIG" 16693 "Fid_PFltSotSimPresTmp_SIG" 16694 "Fid_PFltTempOxiPre_SIG" 16695 "Fid_PFltTempSens_SIG" 16696 "Fid_PSPCDActrErr_SIG" 16697 "Fid_PrpCtl_AWD1_SIG" 16698 "Fid_PrpCtl_CANVerErr_SIG" 16699 "Fid_PrpCtl_KickDown_SIG" 16700 "Fid_PrpCtl_NIVEAU1_SIG" 16701 "Fid_PrpCtl_VSSCD_SIG" 16702 "Fid_RailCDRPSErrChk_SIG" 16703 "Fid_RailCDSubstVal_SIG" 16704 "Fid_RailCtlMode_SIG" 16705 "Fid_RailMeUn0Blk_SIG" 16706 "Fid_RailMeUn0Rls_SIG" 16707 "Fid_RailMeUn1Blk_SIG" 16708 "Fid_RailMeUn1Rls_SIG" 16709 "Fid_RailMeUn2Blk_SIG" 16710 "Fid_RailMeUn2Rls_SIG" 16711 "Fid_RailMeUn3Blk_SIG" 16712 "Fid_RailMeUn3Rls_SIG" 16713 "Fid_RailMeUn4Blk_SIG" 16714 "Fid_RailMeUn4Rls_SIG" 16715 "Fid_RailMeUnCtlMode_SIG" 16716 "Fid_RailPCV0Blk_SIG" 16717 "Fid_RailPCV0Rls_SIG" 16718 "Fid_RailPCV1Blk_SIG" 16719 "Fid_RailPCV1Rls_SIG" 16720 "Fid_RailPCV2Blk_SIG" 16721 "Fid_RailPCV2Rls_SIG" 16722 "Fid_RailPCV3Blk_SIG" 16723 "Fid_RailPCV3Rls_SIG" 16724 "Fid_RailPCV4Blk_SIG" 16725 "Fid_RailPCV4Rls_SIG" 16726 "Fid_RailPCV5Blk_SIG" 16727 "Fid_RailPCV5Rls_SIG" 16728 "Fid_RailPCVCtlMode_SIG" 16729 "Fid_RailSetPointLim_SIG" 16730 "Fid_RailSetPointRed_SIG" 16731 "Fid_SignalsTstNLim_SIG" 16732 "Fid_StSysCtl_RlyErr_SIG" 16733 "Fid_StSysCtl_VSSCD_SIG" 16734 "Fid_StSysCtltiThrsAddCr_SIG" 16735 "Fid_StSystrqStrtAddCor_SIG" 16736 "Fid_SvLpBRK2TO_SIG" 16737 "Fid_SvLpCDTOSTO_SIG" 16738 "Fid_SvLpTOSTO_SIG" 16739 "Fid_VSSCDBRK1Err_SIG" 16740 "Fid_VSSCDDSP1Err_SIG" 16741 "Fid_ZFCClbActv_SIG" 16742 "Fid_ZFCCldCmbCham_SIG" 32769 "Fid_AC1Can_NPL" 32770 "Fid_AC1PresCan_NPL" 32771 "Fid_AC1TrqCan_NPL" 32772 "Fid_ACCAccPed_NPL" 32773 "Fid_ACCAirbCDCrash_NPL" 32774 "Fid_ACCCDCan_NPL" 32775 "Fid_ACCECUIntErr_NPL" 32776 "Fid_ACCMsgErr_NPL" 32777 "Fid_ACCPlCheck_NPL" 32778 "Fid_ACCtl_ACP_NPL" 32779 "Fid_ACCtl_EATSCD_NPL" 32780 "Fid_ACCtl_ESCUCan_NPL" 32781 "Fid_ACCtl_FanCtl1_NPL" 32782 "Fid_ACCtl_FanCtl2_NPL" 32783 "Fid_ACCtl_SysErr_NPL" 32784 "Fid_ACCtl_TSC1Can_NPL" 32785 "Fid_ACCtl_VehStand_NPL" 32786 "Fid_AFSCD_NPL" 32787 "Fid_AFSCD2_NPL" 32788 "Fid_AFSCD_AirPerTime_NPL" 32789 "Fid_AFSCD_AirPerTime2_NPL" 32790 "Fid_AFSCD_PlAirPerCylDiff_NPL" 32791 "Fid_AFSCD_PlOffsDrft_NPL" 32792 "Fid_AFSCD_PlOffsDrft2_NPL" 32793 "Fid_AFSCD_PlSetyDrft_NPL" 32794 "Fid_AFSCD_PlSetyDrft2_NPL" 32795 "Fid_AFSCD_SRCAirm_NPL" 32796 "Fid_AFSCD_SRCAirm2_NPL" 32797 "Fid_AFSCD_SRCCorrAirm_NPL" 32798 "Fid_AFSCD_SRCDcyc_NPL" 32799 "Fid_AFSCD_SRCRawAirm_NPL" 32800 "Fid_AFSCD_SRCRefSig_NPL" 32801 "Fid_AFVCtlSigErr_NPL" 32802 "Fid_AOHTCanAC1_NPL" 32803 "Fid_AOHTCanESCU_NPL" 32804 "Fid_AOHt_AltSRC_NPL" 32805 "Fid_AOHt_CDHt1_NPL" 32806 "Fid_AOHt_CDHt2_NPL" 32807 "Fid_AOHt_ErrHt_NPL" 32808 "Fid_APP1_NPL" 32809 "Fid_APP1_FiltOffRampOn_NPL" 32810 "Fid_APP1_Sens_NPL" 32811 "Fid_APP2_NPL" 32812 "Fid_APP2_Sens_NPL" 32813 "Fid_APPKickDown_VSS_NPL" 32814 "Fid_APPKickdown_NPL" 32815 "Fid_APSCD_NPL" 32816 "Fid_ASDdc_NPL" 32817 "Fid_ASDdcNGvnr_NPL" 32818 "Fid_ASModSwtOffEng_NPL" 32819 "Fid_ASModSwtOffExhMnf_NPL" 32820 "Fid_ASModSwtOffIndVol_NPL" 32821 "Fid_ASModSwtOffObsvrPIndVol_NPL" 32822 "Fid_AccPed_NPL" 32823 "Fid_AccPedVel_NPL" 32824 "Fid_AccPed_Brk_NPL" 32825 "Fid_AddPmpTnkDef_NPL" 32826 "Fid_AirCtl_NPL" 32827 "Fid_AirbCDCan_NPL" 32828 "Fid_Alt_PwrCan_NPL" 32829 "Fid_Alt_T15_NPL" 32830 "Fid_BPSErr_NPL" 32831 "Fid_BrkCDCan_NPL" 32832 "Fid_CCtlCan_NPL" 32833 "Fid_CRCCDCan_NPL" 32834 "Fid_CRCCDTo_NPL" 32835 "Fid_CTSCDCan_NPL" 32836 "Fid_CTSCDCanInac_NPL" 32837 "Fid_CTSCDCanSig_NPL" 32838 "Fid_CTSCDOTSErr_NPL" 32839 "Fid_CTSCDPullup_NPL" 32840 "Fid_CTSErr_NPL" 32841 "Fid_ClgDynTst_NPL" 32842 "Fid_CmbChb_NPL" 32843 "Fid_CoDT_GripDeb_NPL" 32844 "Fid_CoEngAirbCDCrash_NPL" 32845 "Fid_CoEngGW1TO_NPL" 32846 "Fid_CoEng_ActrPrt_NPL" 32847 "Fid_CoEng_FrmMngAWD1_NPL" 32848 "Fid_CoEng_IRevSys_NPL" 32849 "Fid_CoEng_IRevVeh_NPL" 32850 "Fid_CoEng_KickDown_NPL" 32851 "Fid_CoEng_PwrStgEnable_NPL" 32852 "Fid_CoEng_RevSys_NPL" 32853 "Fid_CoEng_RevVeh_NPL" 32854 "Fid_CoEng_T15CD_NPL" 32855 "Fid_CoEng_TMFWShOff_NPL" 32856 "Fid_CoEng_trqLimBiTurbo_NPL" 32857 "Fid_CoEng_trqLimErr_NPL" 32858 "Fid_CoVM_DCSh_NPL" 32859 "Fid_CoVM_DCSp_NPL" 32860 "Fid_CoVehEcoCan_NPL" 32861 "Fid_CoVehIdleStop_NPL" 32862 "Fid_CoVehPnlFunc_NPL" 32863 "Fid_CoVehtrqLimErr_NPL" 32864 "Fid_ConvCDCan_NPL" 32865 "Fid_CrCtlACCErr_NPL" 32866 "Fid_CrCtlAirbCDCrash_NPL" 32867 "Fid_CrCtlCanBrk1_NPL" 32868 "Fid_CrCtlMsgErrBRK8_NPL" 32869 "Fid_CrCtlPAAGTlrDef_NPL" 32870 "Fid_CrCtlPIrevShutoff_NPL" 32871 "Fid_CrCtl_CTSLPRES_NPL" 32872 "Fid_CrCtl_EngMCaS1_NPL" 32873 "Fid_CrCtl_EngMCrS1_NPL" 32874 "Fid_CrCtl_stBrk_NPL" 32875 "Fid_CrCtl_stSpeedSensor_NPL" 32876 "Fid_CrCtl_stSystem_NPL" 32877 "Fid_CtApCDActrErr_NPL" 32878 "Fid_CtTCtl_stStageErr_NPL" 32879 "Fid_CtTCtl_tClntDs1_Err_NPL" 32880 "Fid_CtTCtl_tClntDs2_Err_NPL" 32881 "Fid_CtTCtl_tClntDs3_Err_NPL" 32882 "Fid_CtTCtl_tClntDs4_Err_NPL" 32883 "Fid_CtT_SwtOff_NPL" 32884 "Fid_CtT_SwtOff_EAT_NPL" 32885 "Fid_CtT_SwtOff_EATMod_NPL" 32886 "Fid_DSM_Wuc_NPL" 32887 "Fid_DiffCANerr_NPL" 32888 "Fid_EATSCDCan_NPL" 32889 "Fid_EATSCDCanInac_NPL" 32890 "Fid_EATSCDCanSig_NPL" 32891 "Fid_EGSysCoLSU0_NPL" 32892 "Fid_EGSysCoNSC_NPL" 32893 "Fid_EGSysCoOxi_NPL" 32894 "Fid_EGSysCoTrbn_NPL" 32895 "Fid_EGSysCoTube0_NPL" 32896 "Fid_EGSysHtgDel_NPL" 32897 "Fid_EGSysNSC_NPL" 32898 "Fid_EGSysOxiCat_NPL" 32899 "Fid_EGSysPresEnv_NPL" 32900 "Fid_EGSysStrt_NPL" 32901 "Fid_EGSysTemp_NPL" 32902 "Fid_EGSysTrbn_NPL" 32903 "Fid_EGSysTube_NPL" 32904 "Fid_EGSys_AP_NPL" 32905 "Fid_EMCCD_G2Err_NPL" 32906 "Fid_EMCCD_M1Err_NPL" 32907 "Fid_ETClbCorActv_NPL" 32908 "Fid_EcuBoot_NPL" 32909 "Fid_EcuInitTimestamp_NPL" 32910 "Fid_EngMCaSBackUp_NPL" 32911 "Fid_EngMCrSBackUp_NPL" 32912 "Fid_EngM_ChkStrtSpd_NPL" 32913 "Fid_EngMon_Actv_NPL" 32914 "Fid_EngOvrSpd_NPL" 32915 "Fid_EngPOpCalc1_NPL" 32916 "Fid_EngPOpCalc2_NPL" 32917 "Fid_EngPrtCaS_NPL" 32918 "Fid_EngPrtCrS_NPL" 32919 "Fid_EngPrt_KickDown_NPL" 32920 "Fid_EngPrt_nLimErr_NPL" 32921 "Fid_EngSpdCrS_NPL" 32922 "Fid_EngdtEng_NPL" 32923 "Fid_FBC_NPL" 32924 "Fid_FMASwtOff1_NPL" 32925 "Fid_FMASwtOff3_NPL" 32926 "Fid_FTSCDNpl_NPL" 32927 "Fid_FTSErr_NPL" 32928 "Fid_FanCDActrErr_NPL" 32929 "Fid_FanCtlCanAC1_NPL" 32930 "Fid_FanCtl_COTSErr_NPL" 32931 "Fid_FanCtl_tClntErr_NPL" 32932 "Fid_FanCtl_vCurrErr_NPL" 32933 "Fid_FlMngFullLdRglOff_NPL" 32934 "Fid_FlPpCDErr_NPL" 32935 "Fid_FlSysCTSSens_NPL" 32936 "Fid_FlSysDens_NPL" 32937 "Fid_FlSysFTSSens_NPL" 32938 "Fid_FlSysvVeh_NPL" 32939 "Fid_FlSysvolTotal_NPL" 32940 "Fid_FrmMngAC_NPL" 32941 "Fid_FrmMngAC1Npl_NPL" 32942 "Fid_FrmMngAC1TO_NPL" 32943 "Fid_FrmMngACCNpl_NPL" 32944 "Fid_FrmMngACCTO_NPL" 32945 "Fid_FrmMngAIRBGNpl_NPL" 32946 "Fid_FrmMngAIRBGTO_NPL" 32947 "Fid_FrmMngALTCD_Load_NPL" 32948 "Fid_FrmMngAPP_NPL" 32949 "Fid_FrmMngAPPRAW_NPL" 32950 "Fid_FrmMngAPS_NPL" 32951 "Fid_FrmMngAWD1Npl_NPL" 32952 "Fid_FrmMngAWD1TO_NPL" 32953 "Fid_FrmMngAWDTO_NPL" 32954 "Fid_FrmMngBEM1Npl_NPL" 32955 "Fid_FrmMngBEM1TO_NPL" 32956 "Fid_FrmMngBPSCD_IntVal_NPL" 32957 "Fid_FrmMngBRK1Npl_NPL" 32958 "Fid_FrmMngBRK1TO_NPL" 32959 "Fid_FrmMngBRK2Npl_NPL" 32960 "Fid_FrmMngBRK2TO_NPL" 32961 "Fid_FrmMngBRK8Npl_NPL" 32962 "Fid_FrmMngBRK8TO_NPL" 32963 "Fid_FrmMngCCTLNpl_NPL" 32964 "Fid_FrmMngCCTLTO_NPL" 32965 "Fid_FrmMngCHRGR1Npl_NPL" 32966 "Fid_FrmMngCHRGR1TO_NPL" 32967 "Fid_FrmMngCHRGR2Npl_NPL" 32968 "Fid_FrmMngCHRGR2TO_NPL" 32969 "Fid_FrmMngDIA1Npl_NPL" 32970 "Fid_FrmMngDIA1TO_NPL" 32971 "Fid_FrmMngDSP1Npl_NPL" 32972 "Fid_FrmMngDSP1TO_NPL" 32973 "Fid_FrmMngDSP2Npl_NPL" 32974 "Fid_FrmMngDSP2TO_NPL" 32975 "Fid_FrmMngESCUNpl_NPL" 32976 "Fid_FrmMngESCUTO_NPL" 32977 "Fid_FrmMngFlxTOSTO_NPL" 32978 "Fid_FrmMngGW1Npl_NPL" 32979 "Fid_FrmMngGW1TO_NPL" 32980 "Fid_FrmMngIATS_NPL" 32981 "Fid_FrmMngNIVEAU1Npl_NPL" 32982 "Fid_FrmMngNIVEAU1TO_NPL" 32983 "Fid_FrmMngPrcFan_NPL" 32984 "Fid_FrmMngSTIGNNpl_NPL" 32985 "Fid_FrmMngSTIGNTO_NPL" 32986 "Fid_FrmMngTCSTO_NPL" 32987 "Fid_FrmMngTOSNpl_NPL" 32988 "Fid_FrmMngTOSTO_NPL" 32989 "Fid_FrmMngTSC1Npl_NPL" 32990 "Fid_FrmMngTSC1TO_NPL" 32991 "Fid_FrmMngTSC2Npl_NPL" 32992 "Fid_FrmMngTSC2TO_NPL" 32993 "Fid_FrmMngTSC3Npl_NPL" 32994 "Fid_FrmMngTSC3TO_NPL" 32995 "Fid_FrmMngVCurEng2_NPL" 32996 "Fid_FrmMngVDemCrCtl_NPL" 32997 "Fid_FrmMng_AltPwrCan_NPL" 32998 "Fid_FrmMng_GlwCD_Actr_NPL" 32999 "Fid_FrmMng_GlwCtl_Rly_NPL" 33000 "Fid_FrmMng_KickDown_NPL" 33001 "Fid_FrmMngrxChrgr1_NPL" 33002 "Fid_FrmMngrxChrgr2_NPL" 33003 "Fid_FrmMngtxEngActr_NPL" 33004 "Fid_GearbxASTh_NPL" 33005 "Fid_GearbxASTl_NPL" 33006 "Fid_GearbxTrqLimErr_NPL" 33007 "Fid_Gearbx_CANerr_NPL" 33008 "Fid_Gearbx_Eng_NPL" 33009 "Fid_Gearbx_EngCTS_NPL" 33010 "Fid_Gearbx_EngOTS_NPL" 33011 "Fid_Gearbx_FrmMngAWD1_NPL" 33012 "Fid_Gearbx_GearDet_NPL" 33013 "Fid_Gearbx_TSC3Err_NPL" 33014 "Fid_GlwCDActrErr_NPL" 33015 "Fid_GlwCDCan_NPL" 33016 "Fid_GlwCDCod_NPL" 33017 "Fid_GlwCtl1_NPL" 33018 "Fid_GlwCtl2_NPL" 33019 "Fid_HDSCD_SSpMon1_NPL" 33020 "Fid_IATSErr_NPL" 33021 "Fid_IFCD_Err_NPL" 33022 "Fid_IndSys_MonVac_NPL" 33023 "Fid_IndSys_pAdj_NPL" 33024 "Fid_InjCrvCoErr_NPL" 33025 "Fid_InjCtl_qLimErr_NPL" 33026 "Fid_InjUnCaS_NPL" 33027 "Fid_InjUnCrS_NPL" 33028 "Fid_InjUnEgrErr_NPL" 33029 "Fid_InjUnLimErr_NPL" 33030 "Fid_InjUnPcrErr_NPL" 33031 "Fid_InjUnTrqErr_NPL" 33032 "Fid_InjVCDCls_NPL" 33033 "Fid_InjVlvActrTemp_NPL" 33034 "Fid_InjVlvInjLim_NPL" 33035 "Fid_InjVlvMon_NPL" 33036 "Fid_InjVlvNVC_NPL" 33037 "Fid_InjVlvSetUpVolt_NPL" 33038 "Fid_InjVlvWvCorOff_NPL" 33039 "Fid_LIGovDriveAway_NPL" 33040 "Fid_LIGovUbr_NPL" 33041 "Fid_LIGovnSetPointErr_NPL" 33042 "Fid_LSUCDMon0_NPL" 33043 "Fid_LSUCDO20_NPL" 33044 "Fid_LSUCDRi0_NPL" 33045 "Fid_LSUCDactiv0_NPL" 33046 "Fid_LSUCDlsu0_NPL" 33047 "Fid_LSUCtl0_NPL" 33048 "Fid_LSUMonAllChecks_NPL" 33049 "Fid_LSUMonPlausChk_NPL" 33050 "Fid_MeUnCDCalcI_NPL" 33051 "Fid_OTSCDCTSErr_NPL" 33052 "Fid_OTSCDCan_NPL" 33053 "Fid_OTSCDCanDSP2_NPL" 33054 "Fid_OTSCDCanInac_NPL" 33055 "Fid_OTSCDCanSig_NPL" 33056 "Fid_OTSCDErr_NPL" 33057 "Fid_OTSCDPlausCTSCD_NPL" 33058 "Fid_OvRMonTSC2CNT_NPL" 33059 "Fid_OvRMonTSC2TO_NPL" 33060 "Fid_OvRMonTSC3CNTCS_NPL" 33061 "Fid_OvRMonTSC3TO_NPL" 33062 "Fid_PCR_NPL" 33063 "Fid_PCRpLim_NPL" 33064 "Fid_PCVCDCalcI_NPL" 33065 "Fid_PFltChar_NPL" 33066 "Fid_PFltDynChk_NPL" 33067 "Fid_PFltHsLnChk_NPL" 33068 "Fid_PFltPlausPres_NPL" 33069 "Fid_PFltPlausTemp_NPL" 33070 "Fid_PFltPresSensDiff_NPL" 33071 "Fid_PFltPresSensHsLn_NPL" 33072 "Fid_PFltPresSensPre_NPL" 33073 "Fid_PFltRgnShOff_NPL" 33074 "Fid_PFltSRCPres_NPL" 33075 "Fid_PFltSRCTemp_NPL" 33076 "Fid_PFltSotSimPresPerm_NPL" 33077 "Fid_PFltSotSimPresTmp_NPL" 33078 "Fid_PFltTempOxiPre_NPL" 33079 "Fid_PFltTempSens_NPL" 33080 "Fid_PSPCDActrErr_NPL" 33081 "Fid_PrpCtl_AWD1_NPL" 33082 "Fid_PrpCtl_CANVerErr_NPL" 33083 "Fid_PrpCtl_KickDown_NPL" 33084 "Fid_PrpCtl_NIVEAU1_NPL" 33085 "Fid_PrpCtl_VSSCD_NPL" 33086 "Fid_RailCDRPSErrChk_NPL" 33087 "Fid_RailCDSubstVal_NPL" 33088 "Fid_RailCtlMode_NPL" 33089 "Fid_RailMeUn0Blk_NPL" 33090 "Fid_RailMeUn0Rls_NPL" 33091 "Fid_RailMeUn1Blk_NPL" 33092 "Fid_RailMeUn1Rls_NPL" 33093 "Fid_RailMeUn2Blk_NPL" 33094 "Fid_RailMeUn2Rls_NPL" 33095 "Fid_RailMeUn3Blk_NPL" 33096 "Fid_RailMeUn3Rls_NPL" 33097 "Fid_RailMeUn4Blk_NPL" 33098 "Fid_RailMeUn4Rls_NPL" 33099 "Fid_RailMeUnCtlMode_NPL" 33100 "Fid_RailPCV0Blk_NPL" 33101 "Fid_RailPCV0Rls_NPL" 33102 "Fid_RailPCV1Blk_NPL" 33103 "Fid_RailPCV1Rls_NPL" 33104 "Fid_RailPCV2Blk_NPL" 33105 "Fid_RailPCV2Rls_NPL" 33106 "Fid_RailPCV3Blk_NPL" 33107 "Fid_RailPCV3Rls_NPL" 33108 "Fid_RailPCV4Blk_NPL" 33109 "Fid_RailPCV4Rls_NPL" 33110 "Fid_RailPCV5Blk_NPL" 33111 "Fid_RailPCV5Rls_NPL" 33112 "Fid_RailPCVCtlMode_NPL" 33113 "Fid_RailSetPointLim_NPL" 33114 "Fid_RailSetPointRed_NPL" 33115 "Fid_SignalsTstNLim_NPL" 33116 "Fid_StSysCtl_RlyErr_NPL" 33117 "Fid_StSysCtl_VSSCD_NPL" 33118 "Fid_StSysCtltiThrsAddCr_NPL" 33119 "Fid_StSystrqStrtAddCor_NPL" 33120 "Fid_SvLpBRK2TO_NPL" 33121 "Fid_SvLpCDTOSTO_NPL" 33122 "Fid_SvLpTOSTO_NPL" 33123 "Fid_VSSCDBRK1Err_NPL" 33124 "Fid_VSSCDDSP1Err_NPL" 33125 "Fid_ZFCClbActv_NPL" 33126 "Fid_ZFCCldCmbCham_NPL" 61441 "Fid_AC1Can" 61442 "Fid_AC1PresCan" 61443 "Fid_AC1TrqCan" 61444 "Fid_ACCAccPed" 61445 "Fid_ACCAirbCDCrash" 61446 "Fid_ACCCDCan" 61447 "Fid_ACCECUIntErr" 61448 "Fid_ACCMsgErr" 61449 "Fid_ACCPlCheck" 61450 "Fid_ACCtl_ACP" 61451 "Fid_ACCtl_EATSCD" 61452 "Fid_ACCtl_ESCUCan" 61453 "Fid_ACCtl_FanCtl1" 61454 "Fid_ACCtl_FanCtl2" 61455 "Fid_ACCtl_SysErr" 61456 "Fid_ACCtl_TSC1Can" 61457 "Fid_ACCtl_VehStand" 61458 "Fid_AFSCD" 61459 "Fid_AFSCD2" 61460 "Fid_AFSCD_AirPerTime" 61461 "Fid_AFSCD_AirPerTime2" 61462 "Fid_AFSCD_PlAirPerCylDiff" 61463 "Fid_AFSCD_PlOffsDrft" 61464 "Fid_AFSCD_PlOffsDrft2" 61465 "Fid_AFSCD_PlSetyDrft" 61466 "Fid_AFSCD_PlSetyDrft2" 61467 "Fid_AFSCD_SRCAirm" 61468 "Fid_AFSCD_SRCAirm2" 61469 "Fid_AFSCD_SRCCorrAirm" 61470 "Fid_AFSCD_SRCDcyc" 61471 "Fid_AFSCD_SRCRawAirm" 61472 "Fid_AFSCD_SRCRefSig" 61473 "Fid_AFVCtlSigErr" 61474 "Fid_AOHTCanAC1" 61475 "Fid_AOHTCanESCU" 61476 "Fid_AOHt_AltSRC" 61477 "Fid_AOHt_CDHt1" 61478 "Fid_AOHt_CDHt2" 61479 "Fid_AOHt_ErrHt" 61480 "Fid_APP1" 61481 "Fid_APP1_FiltOffRampOn" 61482 "Fid_APP1_Sens" 61483 "Fid_APP2" 61484 "Fid_APP2_Sens" 61485 "Fid_APPKickDown_VSS" 61486 "Fid_APPKickdown" 61487 "Fid_APSCD" 61488 "Fid_ASDdc" 61489 "Fid_ASDdcNGvnr" 61490 "Fid_ASModSwtOffEng" 61491 "Fid_ASModSwtOffExhMnf" 61492 "Fid_ASModSwtOffIndVol" 61493 "Fid_ASModSwtOffObsvrPIndVol" 61494 "Fid_AccPed" 61495 "Fid_AccPedVel" 61496 "Fid_AccPed_Brk" 61497 "Fid_AddPmpTnkDef" 61498 "Fid_AirCtl" 61499 "Fid_AirbCDCan" 61500 "Fid_Alt_PwrCan" 61501 "Fid_Alt_T15" 61502 "Fid_BPSErr" 61503 "Fid_BrkCDCan" 61504 "Fid_CCtlCan" 61505 "Fid_CRCCDCan" 61506 "Fid_CRCCDTo" 61507 "Fid_CTSCDCan" 61508 "Fid_CTSCDCanInac" 61509 "Fid_CTSCDCanSig" 61510 "Fid_CTSCDOTSErr" 61511 "Fid_CTSCDPullup" 61512 "Fid_CTSErr" 61513 "Fid_ClgDynTst" 61514 "Fid_CmbChb" 61515 "Fid_CoDT_GripDeb" 61516 "Fid_CoEngAirbCDCrash" 61517 "Fid_CoEngGW1TO" 61518 "Fid_CoEng_ActrPrt" 61519 "Fid_CoEng_FrmMngAWD1" 61520 "Fid_CoEng_IRevSys" 61521 "Fid_CoEng_IRevVeh" 61522 "Fid_CoEng_KickDown" 61523 "Fid_CoEng_PwrStgEnable" 61524 "Fid_CoEng_RevSys" 61525 "Fid_CoEng_RevVeh" 61526 "Fid_CoEng_T15CD" 61527 "Fid_CoEng_TMFWShOff" 61528 "Fid_CoEng_trqLimBiTurbo" 61529 "Fid_CoEng_trqLimErr" 61530 "Fid_CoVM_DCSh" 61531 "Fid_CoVM_DCSp" 61532 "Fid_CoVehEcoCan" 61533 "Fid_CoVehIdleStop" 61534 "Fid_CoVehPnlFunc" 61535 "Fid_CoVehtrqLimErr" 61536 "Fid_ConvCDCan" 61537 "Fid_CrCtlACCErr" 61538 "Fid_CrCtlAirbCDCrash" 61539 "Fid_CrCtlCanBrk1" 61540 "Fid_CrCtlMsgErrBRK8" 61541 "Fid_CrCtlPAAGTlrDef" 61542 "Fid_CrCtlPIrevShutoff" 61543 "Fid_CrCtl_CTSLPRES" 61544 "Fid_CrCtl_EngMCaS1" 61545 "Fid_CrCtl_EngMCrS1" 61546 "Fid_CrCtl_stBrk" 61547 "Fid_CrCtl_stSpeedSensor" 61548 "Fid_CrCtl_stSystem" 61549 "Fid_CtApCDActrErr" 61550 "Fid_CtTCtl_stStageErr" 61551 "Fid_CtTCtl_tClntDs1_Err" 61552 "Fid_CtTCtl_tClntDs2_Err" 61553 "Fid_CtTCtl_tClntDs3_Err" 61554 "Fid_CtTCtl_tClntDs4_Err" 61555 "Fid_CtT_SwtOff" 61556 "Fid_CtT_SwtOff_EAT" 61557 "Fid_CtT_SwtOff_EATMod" 61558 "Fid_DSM_Wuc" 61559 "Fid_DiffCANerr" 61560 "Fid_EATSCDCan" 61561 "Fid_EATSCDCanInac" 61562 "Fid_EATSCDCanSig" 61563 "Fid_EGSysCoLSU0" 61564 "Fid_EGSysCoNSC" 61565 "Fid_EGSysCoOxi" 61566 "Fid_EGSysCoTrbn" 61567 "Fid_EGSysCoTube0" 61568 "Fid_EGSysHtgDel" 61569 "Fid_EGSysNSC" 61570 "Fid_EGSysOxiCat" 61571 "Fid_EGSysPresEnv" 61572 "Fid_EGSysStrt" 61573 "Fid_EGSysTemp" 61574 "Fid_EGSysTrbn" 61575 "Fid_EGSysTube" 61576 "Fid_EGSys_AP" 61577 "Fid_EMCCD_G2Err" 61578 "Fid_EMCCD_M1Err" 61579 "Fid_ETClbCorActv" 61580 "Fid_EcuBoot" 61581 "Fid_EcuInitTimestamp" 61582 "Fid_EngMCaSBackUp" 61583 "Fid_EngMCrSBackUp" 61584 "Fid_EngM_ChkStrtSpd" 61585 "Fid_EngMon_Actv" 61586 "Fid_EngOvrSpd" 61587 "Fid_EngPOpCalc1" 61588 "Fid_EngPOpCalc2" 61589 "Fid_EngPrtCaS" 61590 "Fid_EngPrtCrS" 61591 "Fid_EngPrt_KickDown" 61592 "Fid_EngPrt_nLimErr" 61593 "Fid_EngSpdCrS" 61594 "Fid_EngdtEng" 61595 "Fid_FBC" 61596 "Fid_FMASwtOff1" 61597 "Fid_FMASwtOff3" 61598 "Fid_FTSCDNpl" 61599 "Fid_FTSErr" 61600 "Fid_FanCDActrErr" 61601 "Fid_FanCtlCanAC1" 61602 "Fid_FanCtl_COTSErr" 61603 "Fid_FanCtl_tClntErr" 61604 "Fid_FanCtl_vCurrErr" 61605 "Fid_FlMngFullLdRglOff" 61606 "Fid_FlPpCDErr" 61607 "Fid_FlSysCTSSens" 61608 "Fid_FlSysDens" 61609 "Fid_FlSysFTSSens" 61610 "Fid_FlSysvVeh" 61611 "Fid_FlSysvolTotal" 61612 "Fid_FrmMngAC" 61613 "Fid_FrmMngAC1Npl" 61614 "Fid_FrmMngAC1TO" 61615 "Fid_FrmMngACCNpl" 61616 "Fid_FrmMngACCTO" 61617 "Fid_FrmMngAIRBGNpl" 61618 "Fid_FrmMngAIRBGTO" 61619 "Fid_FrmMngALTCD_Load" 61620 "Fid_FrmMngAPP" 61621 "Fid_FrmMngAPPRAW" 61622 "Fid_FrmMngAPS" 61623 "Fid_FrmMngAWD1Npl" 61624 "Fid_FrmMngAWD1TO" 61625 "Fid_FrmMngAWDTO" 61626 "Fid_FrmMngBEM1Npl" 61627 "Fid_FrmMngBEM1TO" 61628 "Fid_FrmMngBPSCD_IntVal" 61629 "Fid_FrmMngBRK1Npl" 61630 "Fid_FrmMngBRK1TO" 61631 "Fid_FrmMngBRK2Npl" 61632 "Fid_FrmMngBRK2TO" 61633 "Fid_FrmMngBRK8Npl" 61634 "Fid_FrmMngBRK8TO" 61635 "Fid_FrmMngCCTLNpl" 61636 "Fid_FrmMngCCTLTO" 61637 "Fid_FrmMngCHRGR1Npl" 61638 "Fid_FrmMngCHRGR1TO" 61639 "Fid_FrmMngCHRGR2Npl" 61640 "Fid_FrmMngCHRGR2TO" 61641 "Fid_FrmMngDIA1Npl" 61642 "Fid_FrmMngDIA1TO" 61643 "Fid_FrmMngDSP1Npl" 61644 "Fid_FrmMngDSP1TO" 61645 "Fid_FrmMngDSP2Npl" 61646 "Fid_FrmMngDSP2TO" 61647 "Fid_FrmMngESCUNpl" 61648 "Fid_FrmMngESCUTO" 61649 "Fid_FrmMngFlxTOSTO" 61650 "Fid_FrmMngGW1Npl" 61651 "Fid_FrmMngGW1TO" 61652 "Fid_FrmMngIATS" 61653 "Fid_FrmMngNIVEAU1Npl" 61654 "Fid_FrmMngNIVEAU1TO" 61655 "Fid_FrmMngPrcFan" 61656 "Fid_FrmMngSTIGNNpl" 61657 "Fid_FrmMngSTIGNTO" 61658 "Fid_FrmMngTCSTO" 61659 "Fid_FrmMngTOSNpl" 61660 "Fid_FrmMngTOSTO" 61661 "Fid_FrmMngTSC1Npl" 61662 "Fid_FrmMngTSC1TO" 61663 "Fid_FrmMngTSC2Npl" 61664 "Fid_FrmMngTSC2TO" 61665 "Fid_FrmMngTSC3Npl" 61666 "Fid_FrmMngTSC3TO" 61667 "Fid_FrmMngVCurEng2" 61668 "Fid_FrmMngVDemCrCtl" 61669 "Fid_FrmMng_AltPwrCan" 61670 "Fid_FrmMng_GlwCD_Actr" 61671 "Fid_FrmMng_GlwCtl_Rly" 61672 "Fid_FrmMng_KickDown" 61673 "Fid_FrmMngrxChrgr1" 61674 "Fid_FrmMngrxChrgr2" 61675 "Fid_FrmMngtxEngActr" 61676 "Fid_GearbxASTh" 61677 "Fid_GearbxASTl" 61678 "Fid_GearbxTrqLimErr" 61679 "Fid_Gearbx_CANerr" 61680 "Fid_Gearbx_Eng" 61681 "Fid_Gearbx_EngCTS" 61682 "Fid_Gearbx_EngOTS" 61683 "Fid_Gearbx_FrmMngAWD1" 61684 "Fid_Gearbx_GearDet" 61685 "Fid_Gearbx_TSC3Err" 61686 "Fid_GlwCDActrErr" 61687 "Fid_GlwCDCan" 61688 "Fid_GlwCDCod" 61689 "Fid_GlwCtl1" 61690 "Fid_GlwCtl2" 61691 "Fid_HDSCD_SSpMon1" 61692 "Fid_IATSErr" 61693 "Fid_IFCD_Err" 61694 "Fid_IndSys_MonVac" 61695 "Fid_IndSys_pAdj" 61696 "Fid_InjCrvCoErr" 61697 "Fid_InjCtl_qLimErr" 61698 "Fid_InjUnCaS" 61699 "Fid_InjUnCrS" 61700 "Fid_InjUnEgrErr" 61701 "Fid_InjUnLimErr" 61702 "Fid_InjUnPcrErr" 61703 "Fid_InjUnTrqErr" 61704 "Fid_InjVCDCls" 61705 "Fid_InjVlvActrTemp" 61706 "Fid_InjVlvInjLim" 61707 "Fid_InjVlvMon" 61708 "Fid_InjVlvNVC" 61709 "Fid_InjVlvSetUpVolt" 61710 "Fid_InjVlvWvCorOff" 61711 "Fid_LIGovDriveAway" 61712 "Fid_LIGovUbr" 61713 "Fid_LIGovnSetPointErr" 61714 "Fid_LSUCDMon0" 61715 "Fid_LSUCDO20" 61716 "Fid_LSUCDRi0" 61717 "Fid_LSUCDactiv0" 61718 "Fid_LSUCDlsu0" 61719 "Fid_LSUCtl0" 61720 "Fid_LSUMonAllChecks" 61721 "Fid_LSUMonPlausChk" 61722 "Fid_MeUnCDCalcI" 61723 "Fid_OTSCDCTSErr" 61724 "Fid_OTSCDCan" 61725 "Fid_OTSCDCanDSP2" 61726 "Fid_OTSCDCanInac" 61727 "Fid_OTSCDCanSig" 61728 "Fid_OTSCDErr" 61729 "Fid_OTSCDPlausCTSCD" 61730 "Fid_OvRMonTSC2CNT" 61731 "Fid_OvRMonTSC2TO" 61732 "Fid_OvRMonTSC3CNTCS" 61733 "Fid_OvRMonTSC3TO" 61734 "Fid_PCR" 61735 "Fid_PCRpLim" 61736 "Fid_PCVCDCalcI" 61737 "Fid_PFltChar" 61738 "Fid_PFltDynChk" 61739 "Fid_PFltHsLnChk" 61740 "Fid_PFltPlausPres" 61741 "Fid_PFltPlausTemp" 61742 "Fid_PFltPresSensDiff" 61743 "Fid_PFltPresSensHsLn" 61744 "Fid_PFltPresSensPre" 61745 "Fid_PFltRgnShOff" 61746 "Fid_PFltSRCPres" 61747 "Fid_PFltSRCTemp" 61748 "Fid_PFltSotSimPresPerm" 61749 "Fid_PFltSotSimPresTmp" 61750 "Fid_PFltTempOxiPre" 61751 "Fid_PFltTempSens" 61752 "Fid_PSPCDActrErr" 61753 "Fid_PrpCtl_AWD1" 61754 "Fid_PrpCtl_CANVerErr" 61755 "Fid_PrpCtl_KickDown" 61756 "Fid_PrpCtl_NIVEAU1" 61757 "Fid_PrpCtl_VSSCD" 61758 "Fid_RailCDRPSErrChk" 61759 "Fid_RailCDSubstVal" 61760 "Fid_RailCtlMode" 61761 "Fid_RailMeUn0Blk" 61762 "Fid_RailMeUn0Rls" 61763 "Fid_RailMeUn1Blk" 61764 "Fid_RailMeUn1Rls" 61765 "Fid_RailMeUn2Blk" 61766 "Fid_RailMeUn2Rls" 61767 "Fid_RailMeUn3Blk" 61768 "Fid_RailMeUn3Rls" 61769 "Fid_RailMeUn4Blk" 61770 "Fid_RailMeUn4Rls" 61771 "Fid_RailMeUnCtlMode" 61772 "Fid_RailPCV0Blk" 61773 "Fid_RailPCV0Rls" 61774 "Fid_RailPCV1Blk" 61775 "Fid_RailPCV1Rls" 61776 "Fid_RailPCV2Blk" 61777 "Fid_RailPCV2Rls" 61778 "Fid_RailPCV3Blk" 61779 "Fid_RailPCV3Rls" 61780 "Fid_RailPCV4Blk" 61781 "Fid_RailPCV4Rls" 61782 "Fid_RailPCV5Blk" 61783 "Fid_RailPCV5Rls" 61784 "Fid_RailPCVCtlMode" 61785 "Fid_RailSetPointLim" 61786 "Fid_RailSetPointRed" 61787 "Fid_SignalsTstNLim" 61788 "Fid_StSysCtl_RlyErr" 61789 "Fid_StSysCtl_VSSCD" 61790 "Fid_StSysCtltiThrsAddCr" 61791 "Fid_StSystrqStrtAddCor" 61792 "Fid_SvLpBRK2TO" 61793 "Fid_SvLpCDTOSTO" 61794 "Fid_SvLpTOSTO" 61795 "Fid_VSSCDBRK1Err" 61796 "Fid_VSSCDDSP1Err" 61797 "Fid_ZFCClbActv" 61798 "Fid_ZFCCldCmbCham" /end COMPU_VTAB
/begin COMPU_METHOD FlConsum_l_h "Kraftstoffverbrauch" RAT_FUNC "%6.4" "[l/h]" COEFFS 0 100 0 0 0 1 /end COMPU_METHOD
/begin COMPU_METHOD Ki_Temp2Dcyc "Integralzunahme (Temperatur zu Tastverhältnis)" RAT_FUNC "%7.6" "[%/(deg C*s)]" COEFFS 0 42949.67296 0 0 0 1 /end COMPU_METHOD
/begin COMPU_METHOD Mil "Verbale Umrechnung für DSM_Class%Mil_C" TAB_VERB "%6.3" "" COMPU_TAB_REF Mil /end COMPU_METHOD
/begin COMPU_VTAB Mil "Verbale Umrechnung für DSM_Class%Mil_C" TAB_VERB 3 0 "Mil OFF" 1 "Mil ON" 2 "Mil BLINK" /end COMPU_VTAB
/begin COMPU_METHOD OneToOne "eins zu eins (physikalischer Wert ist gleich dem internen Wert)" RAT_FUNC "%6.2" "[-]" COEFFS 0 1 0 0 0 1 /end COMPU_METHOD
/begin COMPU_METHOD Period "Periodendauer" RAT_FUNC "%6.3" "[ms]" COEFFS 0 10 0 0 0 1 /end COMPU_METHOD
/begin COMPU_METHOD Prc "Prozent, gleiche interne Auflösung wie Fact, aber Darstellung in Prozent (0...100%)" RAT_FUNC "%6.4" "[%]" COEFFS 0 100 0 0 0 1 /end COMPU_METHOD
/begin COMPU_METHOD Pres_hPa "Druck (angezeigt in [hPa])" RAT_FUNC "%6.2" "[hPa]" COEFFS 0 1 0 0 0 1 /end COMPU_METHOD
/begin COMPU_METHOD Readiness "Verbale Umrechnung für DSM_Class%Readiness_C" TAB_VERB "%6.3" "" COMPU_TAB_REF Readiness /end COMPU_METHOD
/begin COMPU_VTAB Readiness "Verbale Umrechnung für DSM_Class%Readiness_C" TAB_VERB 8 0 "non" 1 "EGR system monitoring" 2 "catalyst monitoring" 4 "misfire monitoring" 8 "fuel system" 16 "comprehensive components" 32 "oxygen sensor" 64 "oxygen sensor heater" /end COMPU_VTAB
/begin COMPU_METHOD ResErf "Verbale Umrechnung für DSM_Class%ResErf_C" TAB_VERB "%6.3" "" COMPU_TAB_REF ResErf /end COMPU_METHOD
/begin COMPU_VTAB ResErf "Verbale Umrechnung für DSM_Class%ResErf_C" TAB_VERB 4 0 "no Reset" 1 "Reset on Init" 2 "Reset on Restart" 3 "Reset on Init or Restart" /end COMPU_VTAB
/begin COMPU_METHOD RmpTemp "Rampengradient für Temperatur" RAT_FUNC "%6.4" "[deg C/s]" COEFFS 0 655.36 0 0 0 1 /end COMPU_METHOD
/begin COMPU_METHOD RmpTransR "Umrechnung für die Rampensteigung des Triebstrangübersetzungverhältnisses" RAT_FUNC "%6.5" "[1/s]" COEFFS 0 6553.6 0 0 0 1 /end COMPU_METHOD
/begin COMPU_METHOD RmpTrqPrp "Rampenanstieg für Vortriebsmoment [Nm/s]" RAT_FUNC "%6.4" "[Nm/s]" COEFFS 0 65.536 0 0 0 1 /end COMPU_METHOD
/begin COMPU_METHOD Scatt "Verbale Umrechnugn für DSM_Class%Scatt_C" TAB_VERB "%6.3" "" COMPU_TAB_REF Scatt /end COMPU_METHOD
/begin COMPU_VTAB Scatt "Verbale Umrechnugn für DSM_Class%Scatt_C" TAB_VERB 2 0 "not visible for OBD-Tester" 1 "visible for OBD-Tester" /end COMPU_VTAB
/begin COMPU_METHOD SigName "Verbale Umrechnung für Signal Referenz Nummern" TAB_VERB "%6.3" "[-]" COMPU_TAB_REF SigName /end COMPU_METHOD
/begin COMPU_VTAB SigName "Verbale Umrechnung für Signal Referenz Nummern" TAB_VERB 333 0 "Sig_unused" 4 "CoEng_rTrq__Carb_r_DLen1" 5 "CTSCD_tClntLin__Carb_t_DLen1" 11 "BPSCD_pLin__Carb_p_DLen1" 12 "Eng_nAvrg__Carb_n_DLen2" 13 "VSSCD_vCarb1__Carb_v_DLen1" 15 "IATSCD_tAirLin__Carb_t_DLen1" 16 "AFSCD_dmAirRawPerTime__Carb_mAirTim_DLen2" 17 "TVACD_rOut__Carb_r_DLen1" 28 "Signals_PID0x1C_C__OneToOne_DLen1" 33 "DSMDur_ctDfctDur1__Carb_l_DLen2" 71 "ACCtl_stLogicOut__OneToOne_DLen1" 72 "AOHt_stHt1Out__OneToOne_DLen1" 73 "APPCD_stSwitchSig__OneToOne_DLen1" 74 "APSCD_pVal__p_DLen1" 75 "APSCD_uRaw__u_DLen1" 76 "IATSCD_tAirLin__t_DLen1" 77 "AFSCD_dmAirRawPerTime__mAirTim_DLen1" 78 "BattCD_uRaw__uBatt_DLen1" 79 "InjCtl_qSetUnBal__q_DLen1" 80 "BPACD_rOut__dcyc_DLen1" 81 "AFSCD_uRaw__u_DLen1" 82 "EGRCD_rOut__dcyc_DLen1" 85 "InjCtl_qCurr__q_DLen1" 88 "IndSys_rVSA__dcyc_DLen1" 90 "OTSCD_tEngOil__t_DLen1" 91 "FTSCD_tFuel__t_DLen1" 92 "BrkCD_stMnSwtRawVal__OneToOne_DLen1" 93 "BrkCD_stRedSwtRawVal__OneToOne_DLen1" 94 "ConvCD_stRawVal__OneToOne_DLen1" 95 "T15CD_stRawVal__OneToOne_DLen1" 97 "GlwCtl_stLampOut__OneToOne_DLen1" 98 "GlwCtl_stActrOut__OneToOne_DLen1" 100 "APPCD_uRawAPP1__u_DLen1" 101 "APPCD_uRawAPP2__u_DLen1" 103 "APPCD_rAPP1UnFlt__r_DLen1" 143 "CTSCD_uRaw__u_DLen1" 144 "CTSCD_tClnt__t_DLen1" 145 "Eng_nAvrg__n_DLen1" 146 "AFSCD_dmAirPerTime__mAirTim_DLen1" 150 "VSSCD_v__v_DLen1" 155 "IATSCD_uRaw__u_DLen1" 157 "BPSCD_uRawVal__u_DLen1" 158 "BPSCD_pOutVal__p_DLen1" 161 "T50CD_stRxDebVal__OneToOne_DLen1" 162 "CoEng_stEng__OneToOne_DLen1" 163 "StSysCtl_stStrtCncl__OneToOne_DLen1" 164 "PrpCtl_stSPTrack_mp__OneToOne_DLen1" 165 "ACCCD_stACC__OneToOne_DLen1" 166 "InjCrv_qLmbdCtl__q_DLen1" 167 "EGSys_stHtgLSU__OneToOne_DLen1" 168 "LSUCD_dcycHtCor__dcyc_DLen1" 169 "EGSys_pExhGas__p_DLen1" 170 "EGSys_dmEG__mAirTim_DLen1" 171 "LSUCD_drO2Adpt__OneToOne_DLen1" 172 "LSUCD_stCircModeNewLow__OneToOne_DLen1" 173 "LSU_stPlausChk_mp__OneToOne_DLen1" 174 "LSU_stO2Err_mp__OneToOne_DLen1" 175 "PFlt_pPre__p_DLen1" 176 "PFlt_pDiff__p_DLen1" 177 "PFlt_tPre__t_DLen1" 178 "PFlt_tFlt__t_DLen1" 179 "PFlt_mAshTrm_mp__m_DLen1" 180 "PFlt_mAshAdj_mp__m_DLen1" 181 "PFlt_rSotRatFlt_mp__r_DLen1" 182 "PFlt_stSucAftStrt_mp__OneToOne_DLen1" 183 "PFlt_pDiffOfsValAct_mp__p_DLen1" 184 "PFlt_qFl_mp__q_DLen1" 185 "PFlt_tiSnceRgn_mp__ti_DLen1" 186 "PFlt_lSnceRgn_mp__l_DLen1" 187 "PFlt_stSuc_mp__OneToOne_DLen1" 188 "PFlt_numEngPOp_mp__OneToOne_DLen1" 189 "FMA_qIC__q_DLen1" 190 "FMA_stSwtOff__OneToOne_DLen1" 192 "EEPCD_stErrSet__OneToOne_DLen1" 193 "EEPCD_stOptErrCodSet__OneToOne_DLen1" 194 "CtTCtl_dcycThst__dcyc_DLen1" 195 "CtTCtl_stCtl__OneToOne_DLen1" 196 "EATSCD_tAir__t_DLen1" 197 "HDSCD_prcAir__r_DLen1" 198 "TTSCD_tTnk__t_DLen1" 199 "LSUCD_uO2Raw__u_DLen1" 200 "LSUCD_rO2Adpt__r_DLen1" 230 "InjVlv_nCyl[0]__nCmpTst_DLen1" 231 "InjVlv_nCyl[1]__nCmpTst_DLen1" 232 "InjVlv_nCyl[2]__nCmpTst_DLen1" 233 "InjVlv_nCyl[3]__nCmpTst_DLen1" 234 "InjVlv_nCyl[4]__nCmpTst_DLen1" 235 "InjVlv_nCyl[5]__nCmpTst_DLen1" 236 "InjVlv_qFBCCyl[0]__q_DLen1" 237 "InjVlv_qFBCCyl[1]__q_DLen1" 238 "InjVlv_qFBCCyl[2]__q_DLen1" 239 "InjVlv_qFBCCyl[3]__q_DLen1" 240 "InjVlv_qFBCCyl[4]__q_DLen1" 241 "InjVlv_qFBCCyl[5]__q_DLen1" 242 "CaSCD_nPeriod__n_DLen1" 243 "FBC_qDvtCyl[0]__qdiff_DLen1" 244 "FBC_qDvtCyl[1]__qdiff_DLen1" 245 "FBC_qDvtCyl[2]__qdiff_DLen1" 246 "FBC_qDvtCyl[3]__qdiff_DLen1" 247 "FBC_qDvtCyl[4]__qdiff_DLen1" 248 "FBC_qDvtCyl[5]__qdiff_DLen1" 249 "FBC_qDvtCyl[6]__qdiff_DLen1" 250 "FBC_qDvtCyl[7]__qdiff_DLen1" 251 "FBC_qDvtCyl[8]__qdiff_DLen1" 252 "FBC_qDvtCyl[9]__qdiff_DLen1" 253 "InjCrv_phiMI1Des__phiHResol_DLen1" 254 "InjCrv_phiMI1EnvCor__phi_DLen1" 255 "PSP_stLogicOut__OneToOne_DLen1" 256 "ACCD_stMnSwtRawVal__OneToOne_DLen1" 257 "AOHt_stHt2Out__OneToOne_DLen1" 258 "AFSCD_mAirPerCyl__mAirCyl_DLen1" 259 "AFSCD_dmAirNorm__mAirTim_DLen1" 260 "AirCtl_mGovDev__mAirCyl_DLen1" 261 "AirCtl_rEGR__r_DLen1" 262 "PCR_rBPACD__r_DLen1" 263 "Dfp_LSUCDCircNernst0_Low__OneToOne_DLen1" 264 "GlwCD_stRawVal__OneToOne_DLen1" 265 "APPCD_rFlt__r_DLen1" 266 "HWEMon_numRecovery__OneToOne_DLen1" 267 "Clg_tiDynTstCARB__Carb_tiDyn_DLen4" 268 "Clg_dtDynTstCARB__Carb_dt_DLen2" 269 "Clg_tiMaxDynTstCARB__Carb_tiDyn_DLen4" 270 "Clg_tEndDynTstCARB__Carb_t_DLen2" 271 "Clg_dtMinDynTstCARB__Carb_dt_DLen2" 272 "Clg_tMinClntDynTstCARB__Carb_t_DLen2" 273 "FTSCD_tiTestCARB__Carb_ti_DLen4" 274 "FTSCD_tiMaxCARB__Carb_ti_DLen4" 275 "FTSCD_tDiffAbsCARB__Carb_dt_DLen2" 276 "FTSCD_tDiffMinCARB__Carb_dt_DLen2" 277 "FTSCD_tIntCARB__Carb_dt_DLen2" 278 "FTSCD_tIntMinCARB__Carb_dt_DLen2" 279 "BPSCD_pAvgDiff__Carb_p_DLen2" 280 "BPSCD_pDiffLim_mp__Carb_p_DLen2" 281 "DSM_stSysLamp__OneToOne_DLen1" 282 "DSM_stMIL__OneToOne_DLen1" 283 "BattCD_u__uBatt_DLen1" 284 "LIGov_nSetpoint__n_DLen1" 285 "VSSCD_a__a_DLen1" 286 "Tst_Zyklflag_SB5__OneToOne_DLen1" 287 "IATSCD_tAir__t_DLen1" 288 "AccPed_stPlaAPPBrk__OneToOne_DLen1" 289 "AccPed_trqDes__trqhigh_DLen1" 290 "COTSCD_tClnt__t_DLen1" 291 "AccPed_trqInrDesSig__trq_DLen1" 292 "Gearbx_stGear__OneToOne_DLen1" 293 "LSU_rLmbd[0]__OneToOne_DLen1" 294 "LSU_rLmbd[1]__OneToOne_DLen1" 295 "Tst_Zyklflag_SB1__OneToOne_DLen1" 296 "Tst_Zyklflag_SB2__OneToOne_DLen1" 297 "Tst_Zyklflag_SB3__OneToOne_DLen1" 298 "Tst_Zyklflag_SB4__OneToOne_DLen1" 299 "Tst_Zyklflag_SB6__OneToOne_DLen1" 300 "AirCtl_mDesVal__mAirCyl_DLen1" 301 "Tst_Zyklflag_SB7__OneToOne_DLen1" 302 "CtTCtl_tClntDes__t_DLen1" 303 "PCR_pBDes__p_DLen1" 304 "BPSCD_pFltVal__p_DLen1" 305 "FrmMng_lOil_mp__lLvl_DLen1" 306 "FlMng_stMon_mp__OneToOne_DLen1" 307 "FrmMng_stChrgr1Err1__OneToOne_DLen1" 308 "FrmMng_stChrgr1Err2__OneToOne_DLen1" 309 "FrmMng_stChrgr2Err1__OneToOne_DLen1" 310 "FrmMng_stChrgr2Err2__OneToOne_DLen1" 311 "FMTC_qStrt__q_DLen1" 312 "CrCtl_trqDes__trqhigh_DLen1" 313 "CoVM_trqInc__trqhigh_DLen1" 314 "CoEng_trqInrLim__trq_DLen1" 315 "FMTC_trqInrLimSmk__trq_DLen1" 316 "EngPrt_trqLim__trq_DLen1" 317 "CoVM_trqDec__trqhigh_DLen1" 318 "FlMng_qLimSmk__q_DLen1" 319 "CrCtl_vSetPointTrgt__v_DLen1" 320 "AltCD_rAltLoad__r_DLen1" 321 "CoEng_trqInrSet__trq_DLen1" 322 "CoEng_dvolFlConsum__Cnsmp_DLen1" 323 "AirCtl_stMonitor__OneToOne_DLen1" 324 "ACCtl_stLowByte_mp__OneToOne_DLen1" 325 "EngM_stSync__OneToOne_DLen1" 326 "NetMng_stCAN__OneToOne_DLen1" 327 "LSUCD_resRiClb__res_DLen1" 328 "LSUCD_uO2Clb__u_DLen1" 329 "FrmMng_stTSC__OneToOne_DLen1" 330 "FrmMng_stDCS__OneToOne_DLen1" 331 "LSUCD_stAdpt__OneToOne_DLen1" 332 "LSUCD_uRiRaw__u_DLen1" 333 "LSUCD_mAirAftOvrRun_mp__mAir_DLen1" 334 "GlwCtl_tiPost_mp__tiGlw_DLen1" 335 "PCR_stPCR_mp__OneToOne_DLen1" 336 "AOHt_stShutOff_mp__OneToOne_DLen1" 337 "FrmMng_stTCS__OneToOne_DLen1" 338 "FrmMng_trqTSC__trq_DLen1" 339 "FrmMng_trqDCS__trq_DLen1" 340 "CrCCD_stKeySig__OneToOne_DLen1" 341 "CrCtl_stKeyStateSig__OneToOne_DLen1" 342 "PrpCtl_vCurrTrack_mp__v_DLen1" 343 "CtApCD_rHWE_mp__dcyc_DLen1" 344 "Gearbx_trqDec__trq_DLen1" 345 "CrCtl_stShutOffrev__OneToOne_DLen1" 346 "AirCtl_stAirCtl_mp__OneToOne_DLen1" 347 "DSM_stRdyAB__OneToOne_DLen1" 348 "DSM_stRdyAB__HighByte_DLen1" 349 "DSM_stRdyCD__OneToOne_DLen1" 350 "DSM_stRdyCD__HighByte_DLen1" 351 "PrpBrk_trqDes__trq_DLen1" 352 "DSM_ctOBDPath__OneToOne_DLen1" 353 "DSM_ctRdyActCyc_mp__OneToOne_DLen1" 354 "GlwCtl_stLogic__OneToOne_DLen1" 355 "GlwCtl_tiPre__tiGlw_DLen1" 356 "FMTC_trqInr__trq_DLen1" 357 "ACCtl_stBitStructure__HighByte_DLen1" 358 "AOHt_stShutOff_mp__HighByte_DLen1" 359 "FrmMng_stTSC__HighByte_DLen1" 360 "FrmMng_stDCS__HighByte_DLen1" 361 "FrmMng_stTCS__HighByte_DLen1" 362 "CrCtl_stSwitchSig__OneToOne_DLen1" 363 "EGSys_tEGLSU__t_DLen1" 364 "AOHt_NumRly_mp__OneToOne_DLen1" 365 "DSM_ctFcmEntry__OneToOne_DLen1" 366 "ACCtl_stBitStructure__OneToOne_DLen2" 367 "AOHt_stShutOff_mp__OneToOne_DLen2" 368 "GlwCtl_stLogic__OneToOne_DLen2" 369 "Dfp_HWEMonUMinSupply_Low__OneToOne_DLen1" 370 "Dfp_HWEMonUMaxSupply_Low__OneToOne_DLen1" 371 "PCR_rBalGvnrDiff__r_DLen1" 372 "Dfp_SOPTst_Low__OneToOne_DLen1" 373 "UAcc_SWPartNum_cs__OneToOne_DLen1" 374 "UAcc_ECUIdentEep_cs__OneToOne_DLen1" 375 "Gearbx_stTSC__OneToOne_DLen1" 376 "CoVM_stActDem__OneToOne_DLen1" 377 "CrCCD_stKey__OneToOne_DLen1" 378 "CrCtl_stShutOff__OneToOne_DLen1" 379 "FanCtl_dcycFan1__dcyc_DLen1" 380 "FanCtl_dcycFan2__dcyc_DLen1" 381 "ACCD_p__pAC_DLen1" 382 "EngPrt_trqPrtLim__trq_DLen1" 383 "ImmCtl_tiLockCount__OneToOne_DLen1" 384 "UAcc_Vin_cs__OneToOne_DLen1" 385 "UAcc_dBGWVin_cs__OneToOne_DLen1" 386 "UAcc_SigBlk80_cs__OneToOne_DLen1" 387 "UAcc_SigBlk82_cs__OneToOne_DLen1" 388 "FlSys_stFlPp__OneToOne_DLen1" 389 "AOHtCD_volFlConsum__Cnsmp_DLen1" 390 "UAcc_MWB26sum_checksum_cs__OneToOne_DLen1" 391 "BPSCD_pLin__p_DLen1" 392 "CoEng_rTrq__r_DLen1" 393 "EngM_stEngMntCtl_MLS1__OneToOne_DLen1" 394 "EngM_stEngMntCtl_MLS2__OneToOne_DLen1" 395 "EngM_stEngMntCtl_GTL1__OneToOne_DLen1" 396 "EngM_stEngMntCtl_GTL2__OneToOne_DLen1" 397 "FanCD_rFan1HWE_mp__dcyc_DLen1" 398 "FanCD_rFan2HWE_mp__dcyc_DLen1" 399 "ACCD_trqCompr__trq_DLen1" 400 "TVACD_rOut__dcyc_DLen1" 401 "PFltCD_tPre__t_DLen1" 402 "PFltCD_pDiff__p_DLen1" 403 "EGPpCD_tPreTrbn__t_DLen1" 404 "AC_pwrDes__pwr_DLen1" 405 "Alt_pwrDes__pwr_DLen1" 406 "SrvPmp_pwrDes__pwr_DLen1" 407 "SvLp_dOilLoad__NoUnit_DLen1" 408 "SvLp_dSootLoad__NoUnit_DLen1" 409 "Dfp_LSUCDCircPumpCur0_Low__OneToOne_DLen1" 410 "Dfp_LSUCDCircVirtGnd0_Low__OneToOne_DLen1" 411 "Dfp_LSUCDHtCoup0_Low__OneToOne_DLen1" 412 "Dfp_LSUCDO20_Low__OneToOne_DLen1" 413 "Dfp_LSUCDHeater0_Low__OneToOne_DLen1" 414 "Dfp_LSUCDO2Clb0_Low__OneToOne_DLen1" 415 "Dfp_LSUCDRiClb0_Low__OneToOne_DLen1" 416 "Dfp_LSUCDSPI0_Low__OneToOne_DLen1" 417 "Dfp_LSUCDWireIP0_Low__OneToOne_DLen1" 418 "Dfp_LSUCtlRiExc0_Low__OneToOne_DLen1" 419 "Dfp_LSUMon1Sens_Low__OneToOne_DLen1" 420 "Dfp_LSUMon2Sens_Low__OneToOne_DLen1" 421 "Dfp_HWEMonEEPROM_Low__OneToOne_DLen1" 422 "Dfp_HWEMonCom_Low__OneToOne_DLen1" 423 "Ad_NumTyp_FreeApplic1_CSTR__FreeApplic1_DLen2" 424 "Ad_NumTyp_FreeApplic2_CSTR__FreeApplic2_DLen2" 425 "Ad_NumTyp_FreeApplic3_CSTR__FreeApplic3_DLen2" 426 "Ad_NumTyp_FreeApplic4_CSTR__FreeApplic4_DLen2" 427 "AFSCD_dmAirPerTime2__mAirTim_DLen1" 428 "AFSCD_mAirPerCyl1__mAirCyl_DLen1" 429 "AFSCD_mAirPerCyl2__mAirCyl_DLen1" 430 "AFSCD_uRaw2__u_DLen1" 431 "BPACD_rOut2__dcyc_DLen1" 468 "FrmMng_stNumTOOvrFlowECU[0]__OneToOne_DLen1" 469 "FrmMng_stNumTOOvrFlowECU[1]__OneToOne_DLen1" 470 "FrmMng_stNumTOOvrFlowECU[2]__OneToOne_DLen1" 471 "FrmMng_stNumTOOvrFlowECU[3]__OneToOne_DLen1" 472 "FrmMng_stNumTOOvrFlowECU[4]__OneToOne_DLen1" 473 "FrmMng_stNumTOOvrFlowECU[5]__OneToOne_DLen1" 474 "FrmMng_stNumTOOvrFlowECU[6]__OneToOne_DLen1" 475 "FrmMng_stNumTOOvrFlowECU[7]__OneToOne_DLen1" 476 "FrmMng_stNumTOOvrFlowECU[8]__OneToOne_DLen1" 477 "FrmMng_stNumTOOvrFlowECU[9]__OneToOne_DLen1" 478 "FrmMng_stNumTOOvrFlowECU[10]__OneToOne_DLen1" 479 "FrmMng_stNumTOOvrFlowECU[11]__OneToOne_DLen1" 480 "FrmMng_stNumTOOvrFlowECU[12]__OneToOne_DLen1" 481 "FrmMng_stNumTOOvrFlowECU[13]__OneToOne_DLen1" 482 "FrmMng_stNumTOOvrFlowECU[14]__OneToOne_DLen1" 483 "FrmMng_stNumTOOvrFlowECU[15]__OneToOne_DLen1" 484 "FrmMng_stNumTOOvrFlowECU[16]__OneToOne_DLen1" 485 "FrmMng_stNumTOOvrFlowECU[17]__OneToOne_DLen1" 486 "FrmMng_stNumTOOvrFlowECU[18]__OneToOne_DLen1" 487 "FrmMng_stNumTOOvrFlowECU[19]__OneToOne_DLen1" 488 "FrmMng_stNumTOOvrFlowECU[20]__OneToOne_DLen1" 489 "FrmMng_stNumTOOvrFlowECU[21]__OneToOne_DLen1" 490 "FrmMng_stNumTOOvrFlowECU[22]__OneToOne_DLen1" 491 "FrmMng_stNumTOOvrFlowECU[23]__OneToOne_DLen1" 492 "FrmMng_stNumTOOvrFlowECU[24]__OneToOne_DLen1" 493 "FrmMng_stNumTOOvrFlowECU[25]__OneToOne_DLen1" 494 "FrmMng_stNumTOOvrFlowECU[26]__OneToOne_DLen1" 495 "FrmMng_stNumTOOvrFlowECU[27]__OneToOne_DLen1" 496 "FrmMng_stNumTOOvrFlowECU[28]__OneToOne_DLen1" 497 "FrmMng_stNumTOOvrFlowECU[29]__OneToOne_DLen1" 498 "FrmMng_stNumTOOvrFlowECU[30]__OneToOne_DLen1" 499 "FrmMng_stNumTOOvrFlowECU[31]__OneToOne_DLen1" 515 "InjCrv_phiPiI1Des__phiHResol_DLen1" 518 "InjCrv_tiMI1ET__ti_DLen1" 519 "InjCrv_tiPiI1ET_mp__ti_DLen1" 520 "InjCrv_tiPiI2ET_mp__ti_DLen1" 521 "Rail_pSetPoint__pRail_DLen1" 522 "PCVCD_dcycOut_mp__dcyc_DLen1" 523 "MeUnCD_dcycOut_mp__dcyc_DLen1" 524 "RailCD_pPeak__pRail_DLen1" 525 "InjCrv_phiPiI2Des__phiHResol_DLen1" 532 "CaSCD_phiLstREdge_mp__phiCrS_DLen1" 533 "CaSCD_phiLstFEdge_mp__phiCrS_DLen1" 534 "VSASCD_dcycIn1__dcyc_DLen1" 535 "VSASCD_dcycIn2__dcyc_DLen1" 600 "AddPCD_numStrkRem_mp__stroke_DLen1" 601 "AddPmp_volAddTotDia_mp__vol_DLen1" 602 "AddPmp_volAddDia_mp__volHigh_DLen1" /end COMPU_VTAB
/begin COMPU_METHOD SysLamp "Verbale Umrechnung für DSM_Class%SysLamp_C" TAB_VERB "%6.3" "" COMPU_TAB_REF SysLamp /end COMPU_METHOD
/begin COMPU_VTAB SysLamp "Verbale Umrechnung für DSM_Class%SysLamp_C" TAB_VERB 3 0 "SysLamp OFF" 1 "SysLamp ON" 2 "SysLamp BLINK" /end COMPU_VTAB
/begin COMPU_METHOD SysLampMode "Verbale Umrechnung für DSM_SysLampMode_C" TAB_VERB "%6.3" "" COMPU_TAB_REF SysLampMode /end COMPU_METHOD
/begin COMPU_VTAB SysLampMode "Verbale Umrechnung für DSM_SysLampMode_C" TAB_VERB 3 0 "controlled by FCM Statemachine" 1 "controlled by entry defect Status" 2 "controlled by dfp Status" /end COMPU_VTAB
/begin COMPU_METHOD TempDiff_Kelv "Offsettemperatur dargestellt in [K]" RAT_FUNC "%6.3" "[ deg C ]" COEFFS 0 10 0 0 0 1 /end COMPU_METHOD
/begin COMPU_METHOD Temp_Cels "Temperatur dargestellt in °C (gleiche interne Darstellung wie Temp_Kelv)" RAT_FUNC "%6.1" "[deg C]" COEFFS 0 10 2731.4 0 0 1 /end COMPU_METHOD
/begin COMPU_METHOD Temp_Kelv_Sec_CtT_Mod "Temperaturerhöhung für Thermostatdiagnose" RAT_FUNC "%7.6" "[deg C/s]" COEFFS 0 40960 0 0 0 1 /end COMPU_METHOD
/begin COMPU_METHOD TimeDelay_s "Zeitkonstante T1 (in s) für PT1, DT1, etc." RAT_FUNC "%9.3" "[s]" COEFFS 0 0 1 0 0.00023283064365387 0 /end COMPU_METHOD
/begin COMPU_METHOD TimeDsmDC "Skalierung Zeit DSM Driving cycle Verzögerung" RAT_FUNC "%6.2" "[s]" COEFFS 0 1 0 0 0 1 /end COMPU_METHOD
/begin COMPU_METHOD Time_ms "Zeit in ms für Fehlerentprellung (DSM) und SW-Timer" RAT_FUNC "%6.1" "[ms]" COEFFS 0 0.1 0 0 0 1 /end COMPU_METHOD
/begin COMPU_METHOD TransR "Übersetzungsverhältnis (Getriebe etc.)" RAT_FUNC "%6.4" "[-]" COEFFS 0 100 0 0 0 1 /end COMPU_METHOD
/begin COMPU_METHOD Trq "Motormoment" RAT_FUNC "%6.3" "[Nm]" COEFFS 0 10 0 0 0 1 /end COMPU_METHOD
/begin COMPU_METHOD TrqPrp "Vortriebsmoment" RAT_FUNC "%6.2" "[Nm]" COEFFS 0 1 0 0 0 1 /end COMPU_METHOD
/begin COMPU_METHOD Vel "Fahrzeuggeschwindigkeit, gleiche interne Auflösung wie Vel_SI" RAT_FUNC "%6.4" "[km/h]" COEFFS 0 100 0 0 0 1 /end COMPU_METHOD
/begin COMPU_METHOD Volt "Spannung in V (von ADC)" RAT_FUNC "%6.2" "[mV]" COEFFS 0 0.2046 0 0 0 1 /end COMPU_METHOD
/begin RECORD_LAYOUT Kf_Xs16_Ys16_Ws16 NO_AXIS_PTS_X 1 SWORD NO_AXIS_PTS_Y 2 SWORD AXIS_PTS_X 3 SWORD INDEX_INCR DIRECT AXIS_PTS_Y 4 SWORD INDEX_INCR DIRECT FNC_VALUES 5 SWORD COLUMN_DIR DIRECT /end RECORD_LAYOUT
/begin RECORD_LAYOUT Kl_Xs16_Ws16 NO_AXIS_PTS_X 1 SWORD AXIS_PTS_X 2 SWORD INDEX_INCR DIRECT FNC_VALUES 3 SWORD COLUMN_DIR DIRECT /end RECORD_LAYOUT
/begin RECORD_LAYOUT Kwb_Wu16 FNC_VALUES 1 UWORD COLUMN_DIR DIRECT /end RECORD_LAYOUT
/begin RECORD_LAYOUT Kwb_Wu8 FNC_VALUES 1 UBYTE COLUMN_DIR DIRECT /end RECORD_LAYOUT
/begin RECORD_LAYOUT Kw_Ws16 FNC_VALUES 1 SWORD COLUMN_DIR DIRECT /end RECORD_LAYOUT
/begin RECORD_LAYOUT Kw_Wu16 FNC_VALUES 1 UWORD COLUMN_DIR DIRECT /end RECORD_LAYOUT
/begin RECORD_LAYOUT Kw_Wu32 FNC_VALUES 1 ULONG COLUMN_DIR DIRECT /end RECORD_LAYOUT
/begin RECORD_LAYOUT Kw_Wu8 FNC_VALUES 1 UBYTE COLUMN_DIR DIRECT /end RECORD_LAYOUT
/end MODULE
/end PROJECT
