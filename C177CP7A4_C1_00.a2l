ASAP2_VERSION 1 3
/begin PROJECT C177 "EDC16CP"
/begin HEADER "" VERSION "VCP7A3" PROJECT_NO C177 /end HEADER
/begin MODULE DIM ""
/begin MOD_COMMON "" BYTE_ORDER MSB_FIRST ALIGNMENT_BYTE 1 ALIGNMENT_WORD 2 ALIGNMENT_LONG 4 ALIGNMENT_FLOAT32_IEEE 4 /end MOD_COMMON
/begin CHARACTERISTIC AirCtl_facGovRgnRmpEGR_CUR "Kurve für die Rampenformung EGR für die Partikelfilter Regeneration" CURVE 0x1C4884 Kl_Xs16_Ws16 1.000000 facRmpEGT16 0.00 1.000000 FORMAT "%8.6" EXTENDED_LIMITS -1.024000 1.023969
 /begin AXIS_DESCR STD_AXIS AirCtl_facGovRgnRmp_mp facRmpEGT16 8 0.00 1.000000 FORMAT "%8.6" EXTENDED_LIMITS -1.024000 1.023969 DEPOSIT ABSOLUTE /end AXIS_DESCR
/end CHARACTERISTIC
/begin CHARACTERISTIC AirCtl_facGovRgnRmpTVA_CUR "Kurve für die Rampenformung TVA für die Partikelfilter Regeneration" CURVE 0x1C48A6 Kl_Xs16_Ws16 1.000000 facRmpEGT16 0.00 1.000000 FORMAT "%8.6" EXTENDED_LIMITS -1.024000 1.023969
 /begin AXIS_DESCR STD_AXIS AirCtl_facGovRgnRmp_mp facRmpEGT16 8 0.00 1.000000 FORMAT "%8.6" EXTENDED_LIMITS -1.024000 1.023969 DEPOSIT ABSOLUTE /end AXIS_DESCR
/end CHARACTERISTIC
/begin CHARACTERISTIC AirCtl_facMaxDevCor_MAP "Luftmassenabhängiger Korrekturfaktor der maximalen Regelabweichung" MAP 0x1C5708 Kf_Xs16_Ys16_Ws16 3.270020 Fact 0.00 3.270020 FORMAT "%8.6" EXTENDED_LIMITS -4.000000 3.999878
 /begin AXIS_DESCR STD_AXIS Eng_nAvrg EngN 13 0.00 6000.000 FORMAT "%8.3" EXTENDED_LIMITS -32768.00 32767.00 DEPOSIT ABSOLUTE /end AXIS_DESCR
 /begin AXIS_DESCR STD_AXIS AirCtl_qMon InjMass 16 0.00 327.6700 FORMAT "%8.4" EXTENDED_LIMITS -327.6800 327.6700 DEPOSIT ABSOLUTE /end AXIS_DESCR
/end CHARACTERISTIC
/begin CHARACTERISTIC AirCtl_facMinDevCor_MAP "Luftmassenabhängiger Korrekturfaktor der minimalen Regelabweichung" MAP 0x1C58E6 Kf_Xs16_Ys16_Ws16 3.270020 Fact 0.00 3.270020 FORMAT "%8.6" EXTENDED_LIMITS -4.000000 3.999878
 /begin AXIS_DESCR STD_AXIS Eng_nAvrg EngN 13 0.00 6000.000 FORMAT "%8.3" EXTENDED_LIMITS -32768.00 32767.00 DEPOSIT ABSOLUTE /end AXIS_DESCR
 /begin AXIS_DESCR STD_AXIS AirCtl_qMon InjMass 16 0.00 327.6700 FORMAT "%8.4" EXTENDED_LIMITS -327.6800 327.6700 DEPOSIT ABSOLUTE /end AXIS_DESCR
/end CHARACTERISTIC
/begin CHARACTERISTIC AirCtl_facP3Corr_MAP "Korrekturfaktor bei unterschiedlichem Druck vor Turbine" MAP 0x1C52F0 Kf_Xs16_Ys16_Ws16 4.000000 Fact 0.00 4.000000 FORMAT "%8.6" EXTENDED_LIMITS -4.000000 3.999878
 /begin AXIS_DESCR STD_AXIS AirCtl_pP3Corr_mp Pres_hPa 10 0.00 3500.000 FORMAT "%8.3" EXTENDED_LIMITS -32768.00 32767.00 DEPOSIT ABSOLUTE /end AXIS_DESCR
 /begin AXIS_DESCR STD_AXIS AirCtl_pP3Corr2_mp Pres_hPa 10 0.00 3500.000 FORMAT "%8.3" EXTENDED_LIMITS -32768.00 32767.00 DEPOSIT ABSOLUTE /end AXIS_DESCR
/end CHARACTERISTIC
/begin CHARACTERISTIC AirCtl_LmbdBalGvnrIKiNeg_C "Integratorverstärkung jenseits der negativen Fensterbegrenzung" VALUE 0x1C53E4 Kw_Wu32 159999999.963 KI_LMBD2PRC 0.00 159999999.963 FORMAT "%13.3" /end CHARACTERISTIC
/begin CHARACTERISTIC AirCtl_LmbdBalGvnrIKiPos_C "Integratorverstärkung jenseits der positiven Fensterbegrenzung" VALUE 0x1C53E8 Kw_Wu32 159999999.963 KI_LMBD2PRC 0.00 159999999.963 FORMAT "%13.3" /end CHARACTERISTIC
/begin CHARACTERISTIC AirCtl_LmbdBalGvnrIKi_C "Integratorverstärkung für Lambdagleichregler" VALUE 0x1C53EC Kw_Wu32 159999999.963 KI_LMBD2PRC 0.00 159999999.963 FORMAT "%13.3" /end CHARACTERISTIC
/begin CHARACTERISTIC AirCtl_LmbdBalGvnrIWinNeg_C "Negative Fensterbegrenzung des Integrators" VALUE 0x1C53F0 Kw_Ws16 60.00000 lambda -30.00000 30.00000 FORMAT "%8.5" EXTENDED_LIMITS -32.76800 32.76700 /end CHARACTERISTIC
/begin CHARACTERISTIC AirCtl_LmbdBalGvnrIWinPos_C "Positive Fensterbegrenzung des Integrators" VALUE 0x1C53F2 Kw_Ws16 60.00000 lambda -30.00000 30.00000 FORMAT "%8.5" EXTENDED_LIMITS -32.76800 32.76700 /end CHARACTERISTIC
/begin CHARACTERISTIC AirCtl_LmbdBalGvnrPKpNeg_C "Proportionalverstärkung jenseits der negativen Fensterbegrenzung" VALUE 0x1C53F4 Kw_Wu32 83886079.9805 KP_LMBD2PRC 0.00 83886079.9805 FORMAT "%13.4" /end CHARACTERISTIC
/begin CHARACTERISTIC AirCtl_LmbdBalGvnrPKpPos_C "Proportionalvesträrkung jenseits positiver Fensterbegrenzung" VALUE 0x1C53F8 Kw_Wu32 83886079.9805 KP_LMBD2PRC 0.00 83886079.9805 FORMAT "%13.4" /end CHARACTERISTIC
/begin CHARACTERISTIC AirCtl_LmbdBalGvnrPKp_C "Proportionalverstärkung des Lambdagleichreglers" VALUE 0x1C53FC Kw_Wu32 83886079.9805 KP_LMBD2PRC 0.00 83886079.9805 FORMAT "%13.4" /end CHARACTERISTIC
/begin CHARACTERISTIC AirCtl_LmbdBalGvnrPWinNeg_C "Negative Fensterbegrenzung des P-Reglers" VALUE 0x1C5400 Kw_Ws16 60.00000 lambda -30.00000 30.00000 FORMAT "%8.5" EXTENDED_LIMITS -32.76800 32.76700 /end CHARACTERISTIC
/begin CHARACTERISTIC AirCtl_LmbdBalGvnrPWinPos_C "Positive Fensterbegrenzung des P-Reglers" VALUE 0x1C5402 Kw_Ws16 60.00000 lambda -30.00000 30.00000 FORMAT "%8.5" EXTENDED_LIMITS -32.76800 32.76700 /end CHARACTERISTIC
/begin CHARACTERISTIC AirCtl_mMaxDev_MAP "Kennfeld der Grenzen für Erkennung bleibender Regelabweichung" MAP 0x1C5AC4 Kf_Xs16_Ys16_Ws16 2000.000 AirMassPerCyl 0.00 2000.000 FORMAT "%8.3" EXTENDED_LIMITS -3276.800 3276.700
 /begin AXIS_DESCR STD_AXIS Eng_nAvrg EngN 13 0.00 6000.000 FORMAT "%8.3" EXTENDED_LIMITS -32768.00 32767.00 DEPOSIT ABSOLUTE /end AXIS_DESCR
 /begin AXIS_DESCR STD_AXIS AirCtl_mDesVal AirMassPerCyl 16 0.00 2000.000 FORMAT "%8.3" EXTENDED_LIMITS -3276.800 3276.700 DEPOSIT ABSOLUTE /end AXIS_DESCR
/end CHARACTERISTIC
/begin CHARACTERISTIC AirCtl_mMinDev_MAP "Kennfeld der Grenzen für Erkennung bleibender Regelabweichung" MAP 0x1C5CA2 Kf_Xs16_Ys16_Ws16 2000.000 AirMassPerCyl 0.00 2000.000 FORMAT "%8.3" EXTENDED_LIMITS -3276.800 3276.700
 /begin AXIS_DESCR STD_AXIS Eng_nAvrg EngN 13 0.00 6000.000 FORMAT "%8.3" EXTENDED_LIMITS -32768.00 32767.00 DEPOSIT ABSOLUTE /end AXIS_DESCR
 /begin AXIS_DESCR STD_AXIS AirCtl_mDesVal AirMassPerCyl 16 0.00 2000.000 FORMAT "%8.3" EXTENDED_LIMITS -3276.800 3276.700 DEPOSIT ABSOLUTE /end AXIS_DESCR
/end CHARACTERISTIC
/begin CHARACTERISTIC AirCtl_mMonOffDev_C "Schwelle für erlaubte Regelabweichung, ab der keine Überwachung stattfindet" VALUE 0x1C5430 Kw_Ws16 10000.00 AirMassPerCyl 0.00 10000.00 FORMAT "%8.2" EXTENDED_LIMITS -3276.800 3276.700 /end CHARACTERISTIC
/begin CHARACTERISTIC AirCtl_nHealHi_C "obere Drehzahlgrenze des Heilungsbereichs" VALUE 0x1C5432 Kw_Ws16 6000.000 EngN 0.00 6000.000 FORMAT "%8.3" EXTENDED_LIMITS -32768.00 32767.00 /end CHARACTERISTIC
/begin CHARACTERISTIC AirCtl_nHealLo_C "untere Drehzahlgrenze des Heilungsbereichs" VALUE 0x1C5434 Kw_Ws16 6000.000 EngN 0.00 6000.000 FORMAT "%8.3" EXTENDED_LIMITS -32768.00 32767.00 /end CHARACTERISTIC
/begin CHARACTERISTIC AirCtl_nLI_C "Drehzahlgrenze für Leerlauferkennung" VALUE 0x1C5436 Kw_Ws16 6000.000 EngN 0.00 6000.000 FORMAT "%8.3" EXTENDED_LIMITS -32768.00 32767.00 /end CHARACTERISTIC
/begin CHARACTERISTIC AirCtl_nOvrRunDel_CUR "untere Drehzahschwelle zur Schuberkennung" CURVE 0x1C5438 Kl_Xs16_Ws16 6000.000 EngN 0.00 6000.000 FORMAT "%8.3" EXTENDED_LIMITS -32768.00 32767.00
 /begin AXIS_DESCR STD_AXIS Eng_tEng Temp_Cels 10 -50.14000 199.8600 FORMAT "%8.4" EXTENDED_LIMITS -3549.940 3003.560 DEPOSIT ABSOLUTE /end AXIS_DESCR
/end CHARACTERISTIC
/begin CHARACTERISTIC AirCtl_nOvrRun_CUR "Kenninie für Schubüberwachung" CURVE 0x1C5462 Kl_Xs16_Ws16 6000.000 EngN 0.00 6000.000 FORMAT "%8.3" EXTENDED_LIMITS -32768.00 32767.00
 /begin AXIS_DESCR STD_AXIS Eng_tEng Temp_Cels 10 -50.14000 199.8600 FORMAT "%8.4" EXTENDED_LIMITS -3549.940 3003.560 DEPOSIT ABSOLUTE /end AXIS_DESCR
/end CHARACTERISTIC
/begin CHARACTERISTIC AirCtl_pAirHi_C "obere Hysteresegrenze für Atmosphärendrucküberwachung" VALUE 0x1C548C Kw_Ws16 65535.00 Pres_hPa -32768.00 32767.00 FORMAT "%8.2" /end CHARACTERISTIC
/begin CHARACTERISTIC AirCtl_pAirLo_C "untere Hysteresegrenze für Atmosphärendrucküberwachung" VALUE 0x1C548E Kw_Ws16 65535.00 Pres_hPa -32768.00 32767.00 FORMAT "%8.2" /end CHARACTERISTIC
/begin CHARACTERISTIC AirCtl_qGovOff_CUR "Kennlinie für untere Schwelle der Abschalthysterese" CURVE 0x1C48C8 Kl_Xs16_Ws16 327.6700 InjMass 0.00 327.6700 FORMAT "%8.4" EXTENDED_LIMITS -327.6800 327.6700
 /begin AXIS_DESCR STD_AXIS Eng_nAvrg EngN 10 0.00 6000.000 FORMAT "%8.3" EXTENDED_LIMITS -32768.00 32767.00 DEPOSIT ABSOLUTE /end AXIS_DESCR
/end CHARACTERISTIC
/begin CHARACTERISTIC AirCtl_qGovOn_CUR "Kennlinie für obere Schwelle der Abschalthysterese" CURVE 0x1C48F2 Kl_Xs16_Ws16 327.6700 InjMass 0.00 327.6700 FORMAT "%8.4" EXTENDED_LIMITS -327.6800 327.6700
 /begin AXIS_DESCR STD_AXIS Eng_nAvrg EngN 10 0.00 6000.000 FORMAT "%8.3" EXTENDED_LIMITS -32768.00 32767.00 DEPOSIT ABSOLUTE /end AXIS_DESCR
/end CHARACTERISTIC
/begin CHARACTERISTIC AirCtl_qGovRgn1Off_CUR "Kennlinie für untere Schwelle der Abschalthysterese bei Regenerationsbetrieb 1" CURVE 0x1C491C Kl_Xs16_Ws16 327.6700 InjMass 0.00 327.6700 FORMAT "%8.4" EXTENDED_LIMITS -327.6800 327.6700
 /begin AXIS_DESCR STD_AXIS Eng_nAvrg EngN 10 0.00 6000.000 FORMAT "%8.3" EXTENDED_LIMITS -32768.00 32767.00 DEPOSIT ABSOLUTE /end AXIS_DESCR
/end CHARACTERISTIC
/begin CHARACTERISTIC AirCtl_qGovRgn1On_CUR "Kennlinie für obere Schwelle der Abschalthysterese bei Regenerationsbetrieb 1" CURVE 0x1C4946 Kl_Xs16_Ws16 327.6700 InjMass 0.00 327.6700 FORMAT "%8.4" EXTENDED_LIMITS -327.6800 327.6700
 /begin AXIS_DESCR STD_AXIS Eng_nAvrg EngN 10 0.00 6000.000 FORMAT "%8.3" EXTENDED_LIMITS -32768.00 32767.00 DEPOSIT ABSOLUTE /end AXIS_DESCR
/end CHARACTERISTIC
/begin CHARACTERISTIC AirCtl_qGovRgn2Off_CUR "Kennlinie für untere Schwelle der Abschalthysterese bei Regenerationsbetrieb 2" CURVE 0x1C4970 Kl_Xs16_Ws16 327.6700 InjMass 0.00 327.6700 FORMAT "%8.4" EXTENDED_LIMITS -327.6800 327.6700
 /begin AXIS_DESCR STD_AXIS Eng_nAvrg EngN 10 0.00 6000.000 FORMAT "%8.3" EXTENDED_LIMITS -32768.00 32767.00 DEPOSIT ABSOLUTE /end AXIS_DESCR
/end CHARACTERISTIC
/begin CHARACTERISTIC AirCtl_qGovRgn2On_CUR "Kennlinie für obere Schwelle der Abschalthysterese bei Regenerationsbetrieb 2" CURVE 0x1C499A Kl_Xs16_Ws16 327.6700 InjMass 0.00 327.6700 FORMAT "%8.4" EXTENDED_LIMITS -327.6800 327.6700
 /begin AXIS_DESCR STD_AXIS Eng_nAvrg EngN 10 0.00 6000.000 FORMAT "%8.3" EXTENDED_LIMITS -32768.00 32767.00 DEPOSIT ABSOLUTE /end AXIS_DESCR
/end CHARACTERISTIC
/begin CHARACTERISTIC AirCtl_qHealHi_C "obere Mengengrenze des Heilungsbereichs" VALUE 0x1C5490 Kw_Ws16 327.6700 InjMass 0.00 327.6700 FORMAT "%8.4" EXTENDED_LIMITS -327.6800 327.6700 /end CHARACTERISTIC
/begin CHARACTERISTIC AirCtl_qHealLo_C "untere Mengengrenze des Heilungsbereichs" VALUE 0x1C5492 Kw_Ws16 327.6700 InjMass 0.00 327.6700 FORMAT "%8.4" EXTENDED_LIMITS -327.6800 327.6700 /end CHARACTERISTIC
/begin CHARACTERISTIC AirCtl_qHigh1_CUR "Kennlinie für obere Hysteresegrenze für Abschaltung bei großer Einspritzmenge und EGT-Status gleich der Maske" CURVE 0x1C5494 Kl_Xs16_Ws16 327.6700 InjMass 0.00 327.6700 FORMAT "%8.4" EXTENDED_LIMITS -327.6800 327.6700
 /begin AXIS_DESCR STD_AXIS Eng_nAvrg EngN 10 0.00 6000.000 FORMAT "%8.3" EXTENDED_LIMITS -32768.00 32767.00 DEPOSIT ABSOLUTE /end AXIS_DESCR
/end CHARACTERISTIC
/begin CHARACTERISTIC AirCtl_qHigh_CUR "Kennlinie für obere Hysteresegrenze für Abschaltung bei großer Einspritzmenge" CURVE 0x1C54BE Kl_Xs16_Ws16 327.6700 InjMass 0.00 327.6700 FORMAT "%8.4" EXTENDED_LIMITS -327.6800 327.6700
 /begin AXIS_DESCR STD_AXIS Eng_nAvrg EngN 20 0.00 6000.000 FORMAT "%8.3" EXTENDED_LIMITS -32768.00 32767.00 DEPOSIT ABSOLUTE /end AXIS_DESCR
/end CHARACTERISTIC
/begin CHARACTERISTIC AirCtl_qLow_CUR "Kennlinie für untere Hysteresegrenze für Abschaltung bei großer Einspritzmenge" CURVE 0x1C5510 Kl_Xs16_Ws16 327.6700 InjMass 0.00 327.6700 FORMAT "%8.4" EXTENDED_LIMITS -327.6800 327.6700
 /begin AXIS_DESCR STD_AXIS Eng_nAvrg EngN 20 0.00 6000.000 FORMAT "%8.3" EXTENDED_LIMITS -32768.00 32767.00 DEPOSIT ABSOLUTE /end AXIS_DESCR
/end CHARACTERISTIC
/begin CHARACTERISTIC AirCtl_qMiddle1_CUR "Kennlinie für obere Hysteresegrenze für Abschaltung bei mittlerer Einspritzmenge und EGT-Status gleich der Maske" CURVE 0x1C5562 Kl_Xs16_Ws16 327.6700 InjMass 0.00 327.6700 FORMAT "%8.4" EXTENDED_LIMITS -327.6800 327.6700
 /begin AXIS_DESCR STD_AXIS Eng_nAvrg EngN 10 0.00 6000.000 FORMAT "%8.3" EXTENDED_LIMITS -32768.00 32767.00 DEPOSIT ABSOLUTE /end AXIS_DESCR
/end CHARACTERISTIC
/begin CHARACTERISTIC AirCtl_qMiddle_CUR "untere Hystereseschwelle für Mengenüberwachung" CURVE 0x1C558C Kl_Xs16_Ws16 327.6700 InjMass 0.00 327.6700 FORMAT "%8.4" EXTENDED_LIMITS -327.6800 327.6700
 /begin AXIS_DESCR STD_AXIS Eng_nAvrg EngN 20 0.00 6000.000 FORMAT "%8.3" EXTENDED_LIMITS -32768.00 32767.00 DEPOSIT ABSOLUTE /end AXIS_DESCR
/end CHARACTERISTIC
/begin CHARACTERISTIC AirCtl_qOvrRun_C "untere Mengengrenze für Schubabschaltung" VALUE 0x1C55DE Kw_Ws16 327.6700 InjMass 0.00 327.6700 FORMAT "%8.4" EXTENDED_LIMITS -327.6800 327.6700 /end CHARACTERISTIC
/begin CHARACTERISTIC AirCtl_rBalGvnrMAX_C "Maximale Regelgröße des PI-Gleichreglers" VALUE 0x1C5404 Kw_Ws16 100.0000 Prc 0.00 100.0000 FORMAT "%8.4" EXTENDED_LIMITS -327.6800 327.6700 /end CHARACTERISTIC
/begin CHARACTERISTIC AirCtl_rThresPointLow_C "Unterer Schwellwert der Hysterese des Steueranteils" VALUE 0x1C49C4 Kw_Ws16 100.0000 Prc 0.00 100.0000 FORMAT "%8.4" EXTENDED_LIMITS -327.6800 327.6700 /end CHARACTERISTIC
/begin CHARACTERISTIC AirCtl_rThresPointHigh_C "Oberer Schwellwert der Hysterese des Steueranteils" VALUE 0x1C49C6 Kw_Ws16 100.0000 Prc 0.00 100.0000 FORMAT "%8.4" EXTENDED_LIMITS -327.6800 327.6700 /end CHARACTERISTIC
/begin CHARACTERISTIC AirCtl_YLow_C "Ausgangswert der Steuerungshysterese bei LOW" VALUE 0x1C49C8 Kw_Ws16 100.0000 Prc 0.00 100.0000 FORMAT "%8.4" EXTENDED_LIMITS -327.6800 327.6700 /end CHARACTERISTIC
/begin CHARACTERISTIC AirCtl_YHigh_C "Ausgangswert der Steuerungshysterese bei HIGH" VALUE 0x1C49CA Kw_Ws16 100.0000 Prc 0.00 100.0000 FORMAT "%8.4" EXTENDED_LIMITS -327.6800 327.6700 /end CHARACTERISTIC
/begin CHARACTERISTIC AirCtl_rEGRAdd_Vector "Bypass-Label für additiven Bypass von AirCtl_rEGR (Nicht verstellen!)" VALUE 0x1C0A32 Kw_Wu8 255.0 OneToOne 0.00 255.0 FORMAT "%5.1" /end CHARACTERISTIC
/begin CHARACTERISTIC AirCtl_rEGRAdd_Channel "Bypass-Label für additiven Bypass von AirCtl_rEGR (Nicht verstellen!)" VALUE 0x1C0A33 Kw_Wu8 255.0 OneToOne 0.00 255.0 FORMAT "%5.1" /end CHARACTERISTIC
/begin CHARACTERISTIC AirCtl_rEGRDflBPDem_C "Vorgabewert für Stellgröße des ARF-Ventils bei Abschaltursache Ladedruckanforderung" VALUE 0x1C5E80 Kw_Ws16 300.0000 Prc -100.0000 200.0000 FORMAT "%8.4" EXTENDED_LIMITS -327.6800 327.6700 /end CHARACTERISTIC
/begin CHARACTERISTIC AirCtl_rEGRDflBPLoDet_C "Vorgabewert für Stellgröße des ARF-Ventils bei Abschaltursache Saugrohrunterdruck" VALUE 0x1C5E82 Kw_Ws16 300.0000 Prc -100.0000 200.0000 FORMAT "%8.4" EXTENDED_LIMITS -327.6800 327.6700 /end CHARACTERISTIC
/begin CHARACTERISTIC AirCtl_rEGRDflClsd_C "Vorgabewert fuer AGR Ventil im Nachlauf und Motor aus" VALUE 0x1C5E84 Kw_Ws16 300.0000 Prc -100.0000 200.0000 FORMAT "%8.4" EXTENDED_LIMITS -327.6800 327.6700 /end CHARACTERISTIC
/begin CHARACTERISTIC AirCtl_rEGRDflEngPrt_C "Vorgabewert für Stellgröße des ARF-Ventils bei Abschaltursache Überdrehzahlerkennung" VALUE 0x1C5E86 Kw_Ws16 300.0000 Prc -100.0000 200.0000 FORMAT "%8.4" EXTENDED_LIMITS -327.6800 327.6700 /end CHARACTERISTIC
/begin CHARACTERISTIC AirCtl_rEGRDflGearShft_C "Vorgabewert für Stellgröße des ARF-Ventils bei Abschaltursache Schaltvorgang" VALUE 0x1C55E0 Kw_Ws16 100.0000 Prc 0.00 100.0000 FORMAT "%8.4" EXTENDED_LIMITS -327.6800 327.6700 /end CHARACTERISTIC
/begin CHARACTERISTIC AirCtl_rEGRDflLoAirTemp_C "Vorgabewert für Stellgröße des ARF-Ventils bei Abschaltursache zu niedrige Lufttemperatur" VALUE 0x1C55E2 Kw_Ws16 100.0000 Prc 0.00 100.0000 FORMAT "%8.4" EXTENDED_LIMITS -327.6800 327.6700 /end CHARACTERISTIC
/begin CHARACTERISTIC AirCtl_rEGRDflLogin_C "VGW für Stellgröße des AGF -Ventils bei Abschaltung durch Login" VALUE 0x1C55E4 Kw_Ws16 100.0000 Prc 0.00 100.0000 FORMAT "%8.4" EXTENDED_LIMITS -327.6800 327.6700 /end CHARACTERISTIC
/begin CHARACTERISTIC AirCtl_rEGRDflOvrRun_C "Vorgabewert für Stellgröße des ARF-Ventils bei Abschaltursache Schubbetrieb" VALUE 0x1C55E6 Kw_Ws16 100.0000 Prc 0.00 100.0000 FORMAT "%8.4" EXTENDED_LIMITS -327.6800 327.6700 /end CHARACTERISTIC
/begin CHARACTERISTIC AirCtl_rEGRDflRgnShOff_C "Vorgabewert für Stellgröße des ARF-Ventils bei Abschaltursache Abgasnachbehandlung" VALUE 0x1C5E88 Kw_Ws16 300.0000 Prc -100.0000 200.0000 FORMAT "%8.4" EXTENDED_LIMITS -327.6800 327.6700 /end CHARACTERISTIC
/begin CHARACTERISTIC AirCtl_rEGRDflShOffCo_C "Vorgabewert für Stellgröße des ARF-Ventils bei Abschaltanforderung durch Abschaltkoordinator" VALUE 0x1C5E8A Kw_Ws16 300.0000 Prc -100.0000 200.0000 FORMAT "%8.4" EXTENDED_LIMITS -327.6800 327.6700 /end CHARACTERISTIC
/begin CHARACTERISTIC AirCtl_rEGRDflShOff_C "Vorgabewert für Stellgröße des ARF-Ventils bei Abschaltung" VALUE 0x1C55E8 Kw_Ws16 100.0000 Prc 0.00 100.0000 FORMAT "%8.4" EXTENDED_LIMITS -327.6800 327.6700 /end CHARACTERISTIC
/begin CHARACTERISTIC AirCtl_rEGRThres_C "Schwelle für Reglerausgang des ARF Tastverhältnis" VALUE 0x1C5406 Kw_Ws16 100.0000 Prc 0.00 100.0000 FORMAT "%8.4" EXTENDED_LIMITS -327.6800 327.6700 /end CHARACTERISTIC
/begin CHARACTERISTIC AirCtl_rEGR_Vector "Bypass-Label für AirCtl_rEGR (Nicht verstellen!)" VALUE 0x1C0A34 Kw_Wu8 255.0 OneToOne 0.00 255.0 FORMAT "%5.1" /end CHARACTERISTIC
/begin CHARACTERISTIC AirCtl_rEGR_Channel "Bypass-Label für AirCtl_rEGR (Nicht verstellen!)" VALUE 0x1C0A35 Kw_Wu8 255.0 OneToOne 0.00 255.0 FORMAT "%5.1" /end CHARACTERISTIC
/begin CHARACTERISTIC AirCtl_rEGR_MAP "Kennfeld für Abgasrückführventilstellgröße" MAP 0x1C49CC Kf_Xs16_Ys16_Ws16 300.0000 Prc -100.0000 200.0000 FORMAT "%8.4" EXTENDED_LIMITS -327.6800 327.6700
 /begin AXIS_DESCR STD_AXIS Eng_nAvrg EngN 10 0.00 6000.000 FORMAT "%8.3" EXTENDED_LIMITS -32768.00 32767.00 DEPOSIT ABSOLUTE /end AXIS_DESCR
 /begin AXIS_DESCR STD_AXIS AirCtl_rGovOut_mp Prc 10 -327.6800 327.6700 FORMAT "%8.4" DEPOSIT ABSOLUTE /end AXIS_DESCR
/end CHARACTERISTIC
/begin CHARACTERISTIC AirCtl_rGovEGRMax_C "maximal zulässige Abgasrückführventilstellgröße" VALUE 0x1C4AC0 Kw_Ws16 300.0000 Prc -100.0000 200.0000 FORMAT "%8.4" EXTENDED_LIMITS -327.6800 327.6700 /end CHARACTERISTIC
/begin CHARACTERISTIC AirCtl_rGovEGRMin_C "minimal zulässige Abgasrückführventilstellgröße" VALUE 0x1C4AC2 Kw_Ws16 300.0000 Prc -100.0000 200.0000 FORMAT "%8.4" EXTENDED_LIMITS -327.6800 327.6700 /end CHARACTERISTIC
/begin CHARACTERISTIC AirCtl_rGovThres1Low_C "Hystereseschwelle Low, 1. Teil von Dreifachhysterese" VALUE 0x1C4AC4 Kw_Ws16 100.0000 Prc 0.00 100.0000 FORMAT "%8.4" EXTENDED_LIMITS -327.6800 327.6700 /end CHARACTERISTIC
/begin CHARACTERISTIC AirCtl_rGovThres1High_C "Hystereseschwelle High, 1. Teil von Dreifachhysterese" VALUE 0x1C4AC6 Kw_Ws16 100.0000 Prc 0.00 100.0000 FORMAT "%8.4" EXTENDED_LIMITS -327.6800 327.6700 /end CHARACTERISTIC
/begin CHARACTERISTIC AirCtl_rGovY1Low_C "Hystereseausgang Low, 1. Teil von Dreifachhysterese" VALUE 0x1C4AC8 Kw_Ws16 100.0000 Prc 0.00 100.0000 FORMAT "%8.4" EXTENDED_LIMITS -327.6800 327.6700 /end CHARACTERISTIC
/begin CHARACTERISTIC AirCtl_rGovY1High_C "Hystereseausgang High, 1. Teil von Dreifachhysterese" VALUE 0x1C4ACA Kw_Ws16 100.0000 Prc 0.00 100.0000 FORMAT "%8.4" EXTENDED_LIMITS -327.6800 327.6700 /end CHARACTERISTIC
/begin CHARACTERISTIC AirCtl_rGovThres2Low_C "Hystereseschwelle Low, 2. Teil von Dreifachhysterese" VALUE 0x1C4ACC Kw_Ws16 100.0000 Prc 0.00 100.0000 FORMAT "%8.4" EXTENDED_LIMITS -327.6800 327.6700 /end CHARACTERISTIC
/begin CHARACTERISTIC AirCtl_rGovThres2High_C "Hystereseschwelle High, 2. Teil von Dreifachhysterese" VALUE 0x1C4ACE Kw_Ws16 100.0000 Prc 0.00 100.0000 FORMAT "%8.4" EXTENDED_LIMITS -327.6800 327.6700 /end CHARACTERISTIC
/begin CHARACTERISTIC AirCtl_rGovY2Low_C "Hystereseausgang Low, 2. Teil von Dreifachhysterese" VALUE 0x1C4AD0 Kw_Ws16 100.0000 Prc 0.00 100.0000 FORMAT "%8.4" EXTENDED_LIMITS -327.6800 327.6700 /end CHARACTERISTIC
/begin CHARACTERISTIC AirCtl_rGovY2High_C "Hystereseausgang High, 2. Teil von Dreifachhysterese" VALUE 0x1C4AD2 Kw_Ws16 100.0000 Prc 0.00 100.0000 FORMAT "%8.4" EXTENDED_LIMITS -327.6800 327.6700 /end CHARACTERISTIC
/begin CHARACTERISTIC AirCtl_rGovPCor_MAP "Luftdruckkorrekturkennfeld für Drosselklappe im Steuerungspfad" MAP 0x1C4AD4 Kf_Xs16_Ys16_Ws16 300.0000 Prc -100.0000 200.0000 FORMAT "%8.4" EXTENDED_LIMITS -327.6800 327.6700
 /begin AXIS_DESCR STD_AXIS InjCtl_qDes InjMass 9 0.00 327.6700 FORMAT "%8.4" EXTENDED_LIMITS -327.6800 327.6700 DEPOSIT ABSOLUTE /end AXIS_DESCR
 /begin AXIS_DESCR STD_AXIS AirCtl_pCor Pres_hPa 9 0.00 3500.000 FORMAT "%8.3" EXTENDED_LIMITS -32768.00 32767.00 DEPOSIT ABSOLUTE /end AXIS_DESCR
/end CHARACTERISTIC
/begin CHARACTERISTIC AirCtl_rGovQDes_MAP "Hauptkennfeld für Drosselklappe im Steuerungspfad" MAP 0x1C4B9E Kf_Xs16_Ys16_Ws16 300.0000 Prc -100.0000 200.0000 FORMAT "%8.4" EXTENDED_LIMITS -327.6800 327.6700
 /begin AXIS_DESCR STD_AXIS Eng_nAvrg EngN 10 0.00 6000.000 FORMAT "%8.3" EXTENDED_LIMITS -32768.00 32767.00 DEPOSIT ABSOLUTE /end AXIS_DESCR
 /begin AXIS_DESCR STD_AXIS InjCtl_qDes InjMass 10 0.00 327.6700 FORMAT "%8.4" EXTENDED_LIMITS -327.6800 327.6700 DEPOSIT ABSOLUTE /end AXIS_DESCR
/end CHARACTERISTIC
/begin CHARACTERISTIC AirCtl_rGovRgnMax_C "Maximale Luftmassenregelwert während Regeneration" VALUE 0x1C4C92 Kw_Ws16 300.0000 Prc -100.0000 200.0000 FORMAT "%8.4" EXTENDED_LIMITS -327.6800 327.6700 /end CHARACTERISTIC
/begin CHARACTERISTIC AirCtl_rGovRgnMin_MAP "Minimumwert der Luftmassenregelung während Regeneration" MAP 0x1C4C94 Kf_Xs16_Ys16_Ws16 300.0000 Prc -100.0000 200.0000 FORMAT "%8.4" EXTENDED_LIMITS -327.6800 327.6700
 /begin AXIS_DESCR STD_AXIS Eng_nAvrg EngN 8 0.00 6000.000 FORMAT "%8.3" EXTENDED_LIMITS -32768.00 32767.00 DEPOSIT ABSOLUTE /end AXIS_DESCR
 /begin AXIS_DESCR STD_AXIS InjCtl_qCurr InjMass 8 0.00 327.6700 FORMAT "%8.4" EXTENDED_LIMITS -327.6800 327.6700 DEPOSIT ABSOLUTE /end AXIS_DESCR
/end CHARACTERISTIC
/begin CHARACTERISTIC AirCtl_rGovTEngCor_MAP "Temperaturkorrekturkennfeld für Drosselklappe im Steuerungspfad" MAP 0x1C4D38 Kf_Xs16_Ys16_Ws16 300.0000 Prc -100.0000 200.0000 FORMAT "%8.4" EXTENDED_LIMITS -327.6800 327.6700
 /begin AXIS_DESCR STD_AXIS Eng_nAvrg EngN 10 0.00 6000.000 FORMAT "%8.3" EXTENDED_LIMITS -32768.00 32767.00 DEPOSIT ABSOLUTE /end AXIS_DESCR
 /begin AXIS_DESCR STD_AXIS Eng_tEng Temp_Cels 8 -50.14000 199.8600 FORMAT "%8.4" EXTENDED_LIMITS -3549.940 3003.560 DEPOSIT ABSOLUTE /end AXIS_DESCR
/end CHARACTERISTIC
/begin CHARACTERISTIC AirCtl_rGovTVA1Max_C "maximal zulässige Drosselklappenstellgröße im Steuerungspfad" VALUE 0x1C4E00 Kw_Ws16 300.0000 Prc -100.0000 200.0000 FORMAT "%8.4" EXTENDED_LIMITS -327.6800 327.6700 /end CHARACTERISTIC
/begin CHARACTERISTIC AirCtl_rGovTVA1Min_C "minimal zulässige Drosselklappenstellgröße im Steuerungspfad" VALUE 0x1C4E02 Kw_Ws16 300.0000 Prc -100.0000 200.0000 FORMAT "%8.4" EXTENDED_LIMITS -327.6800 327.6700 /end CHARACTERISTIC
/begin CHARACTERISTIC AirCtl_rGovTVAMax_C "maximal zulässige Drosselklappenstellgröße" VALUE 0x1C4E04 Kw_Ws16 300.0000 Prc -100.0000 200.0000 FORMAT "%8.4" EXTENDED_LIMITS -327.6800 327.6700 /end CHARACTERISTIC
/begin CHARACTERISTIC AirCtl_rGovTVAMin_C "minimal zulässige Drosselklappenstellgröße" VALUE 0x1C4E06 Kw_Ws16 300.0000 Prc -100.0000 200.0000 FORMAT "%8.4" EXTENDED_LIMITS -327.6800 327.6700 /end CHARACTERISTIC
/begin CHARACTERISTIC AirCtl_rIDflBPDem_C "Initialisierungswert des Reglers bei Abschaltursache Ladedruckanforderung" VALUE 0x1C4E08 Kw_Ws16 300.0000 Prc -100.0000 200.0000 FORMAT "%8.4" EXTENDED_LIMITS -327.6800 327.6700 /end CHARACTERISTIC
/begin CHARACTERISTIC AirCtl_rIDflDiaLrnVal_C "Initialisierungswert des Reglers in Diagnosefall" VALUE 0x1C4E0A Kw_Ws16 300.0000 Prc -100.0000 200.0000 FORMAT "%8.4" EXTENDED_LIMITS -327.6800 327.6700 /end CHARACTERISTIC
/begin CHARACTERISTIC AirCtl_rIDflShOffCo_C "Initialisierungswert des Reglers bei Abschaltanforderung durch Abschaltkoordinator" VALUE 0x1C4E0C Kw_Ws16 300.0000 Prc -100.0000 200.0000 FORMAT "%8.4" EXTENDED_LIMITS -327.6800 327.6700 /end CHARACTERISTIC
/begin CHARACTERISTIC AirCtl_rLmbdDiffThres_MAP "Schwellwert der Lambdadifferenz in Luftmassenregelung" MAP 0x1C5E8C Kf_Xs16_Ys16_Ws16 4.000000 lambda 0.00 4.000000 FORMAT "%8.6" EXTENDED_LIMITS -32.76800 32.76700
 /begin AXIS_DESCR STD_AXIS Eng_nAvrg EngN 6 0.00 6000.000 FORMAT "%8.3" EXTENDED_LIMITS -32768.00 32767.00 DEPOSIT ABSOLUTE /end AXIS_DESCR
 /begin AXIS_DESCR STD_AXIS InjCtl_qCurr InjMass 6 0.00 327.6700 FORMAT "%8.4" EXTENDED_LIMITS -327.6800 327.6700 DEPOSIT ABSOLUTE /end AXIS_DESCR
/end CHARACTERISTIC
/begin CHARACTERISTIC AirCtl_rRgn1EGR_MAP "Kennfeld für Abgasrückführventil - Stellgröße bei Regenerationsbetrieb 1" MAP 0x1C4E0E Kf_Xs16_Ys16_Ws16 300.0000 Prc -100.0000 200.0000 FORMAT "%8.4" EXTENDED_LIMITS -327.6800 327.6700
 /begin AXIS_DESCR STD_AXIS Eng_nAvrg EngN 8 0.00 6000.000 FORMAT "%8.3" EXTENDED_LIMITS -32768.00 32767.00 DEPOSIT ABSOLUTE /end AXIS_DESCR
 /begin AXIS_DESCR STD_AXIS AirCtl_rGovOut_mp Prc 10 -327.6800 327.6700 FORMAT "%8.4" DEPOSIT ABSOLUTE /end AXIS_DESCR
/end CHARACTERISTIC
/begin CHARACTERISTIC AirCtl_rRgn1TVA_MAP "Kennfeld für Drosselklappenstellgröße bei Regenerationsbetrieb 1" MAP 0x1C4ED6 Kf_Xs16_Ys16_Ws16 300.0000 Prc -100.0000 200.0000 FORMAT "%8.4" EXTENDED_LIMITS -327.6800 327.6700
 /begin AXIS_DESCR STD_AXIS Eng_nAvrg EngN 8 0.00 6000.000 FORMAT "%8.3" EXTENDED_LIMITS -32768.00 32767.00 DEPOSIT ABSOLUTE /end AXIS_DESCR
 /begin AXIS_DESCR STD_AXIS AirCtl_rGovOut_mp Prc 10 -327.6800 327.6700 FORMAT "%8.4" DEPOSIT ABSOLUTE /end AXIS_DESCR
/end CHARACTERISTIC
/begin CHARACTERISTIC AirCtl_rRgn2EGROpnLp_MAP "Kennfeld für das AGR-Ventil,wenn dieses sich im gesteuerten Betrieb befindet." MAP 0x1C4F9E Kf_Xs16_Ys16_Ws16 300.0000 Prc -100.0000 200.0000 FORMAT "%8.4" EXTENDED_LIMITS -327.6800 327.6700
 /begin AXIS_DESCR STD_AXIS Eng_nAvrg EngN 8 0.00 6000.000 FORMAT "%8.3" EXTENDED_LIMITS -32768.00 32767.00 DEPOSIT ABSOLUTE /end AXIS_DESCR
 /begin AXIS_DESCR STD_AXIS AirCtl_qCtl InjMass 8 0.00 327.6700 FORMAT "%8.4" EXTENDED_LIMITS -327.6800 327.6700 DEPOSIT ABSOLUTE /end AXIS_DESCR
/end CHARACTERISTIC
/begin CHARACTERISTIC AirCtl_rRgn2EGR_MAP "Kennfeld für Abgasrückführventil - Stellgröße bei Regenerationsbetrieb 2" MAP 0x1C5042 Kf_Xs16_Ys16_Ws16 300.0000 Prc -100.0000 200.0000 FORMAT "%8.4" EXTENDED_LIMITS -327.6800 327.6700
 /begin AXIS_DESCR STD_AXIS Eng_nAvrg EngN 8 0.00 6000.000 FORMAT "%8.3" EXTENDED_LIMITS -32768.00 32767.00 DEPOSIT ABSOLUTE /end AXIS_DESCR
 /begin AXIS_DESCR STD_AXIS AirCtl_rGovOut_mp Prc 10 -327.6800 327.6700 FORMAT "%8.4" DEPOSIT ABSOLUTE /end AXIS_DESCR
/end CHARACTERISTIC
/begin CHARACTERISTIC AirCtl_rRgn2TVA_MAP "Kennfeld für Drosselklappenstellgröße bei Regenerationsbetrieb 2" MAP 0x1C510A Kf_Xs16_Ys16_Ws16 300.0000 Prc -100.0000 200.0000 FORMAT "%8.4" EXTENDED_LIMITS -327.6800 327.6700
 /begin AXIS_DESCR STD_AXIS Eng_nAvrg EngN 8 0.00 6000.000 FORMAT "%8.3" EXTENDED_LIMITS -32768.00 32767.00 DEPOSIT ABSOLUTE /end AXIS_DESCR
 /begin AXIS_DESCR STD_AXIS AirCtl_rGovOut_mp Prc 10 -327.6800 327.6700 FORMAT "%8.4" DEPOSIT ABSOLUTE /end AXIS_DESCR
/end CHARACTERISTIC
/begin CHARACTERISTIC AirCtl_rTVAAdd_Vector "Bypass-Label für additiven Bypass von AirCtl_rTVA (Nicht verstellen!)" VALUE 0x1C0A36 Kw_Wu8 255.0 OneToOne 0.00 255.0 FORMAT "%5.1" /end CHARACTERISTIC
/begin CHARACTERISTIC AirCtl_rTVAAdd_Channel "Bypass-Label für additiven Bypass von AirCtl_rTVA (Nicht verstellen!)" VALUE 0x1C0A37 Kw_Wu8 255.0 OneToOne 0.00 255.0 FORMAT "%5.1" /end CHARACTERISTIC
/begin CHARACTERISTIC AirCtl_rTVADflBPDem_C "Vorgabewert für Stellgröße der Drosselklappe bei Abschaltursache Ladedruckanforderung" VALUE 0x1C5EF0 Kw_Ws16 300.0000 Prc -100.0000 200.0000 FORMAT "%8.4" EXTENDED_LIMITS -327.6800 327.6700 /end CHARACTERISTIC
/begin CHARACTERISTIC AirCtl_rTVADflBPLoDet_C "Vorgabewert für Stellgröße der Drosselklappe bei Abschaltursache Saugrohrunterdruck" VALUE 0x1C5EF2 Kw_Ws16 300.0000 Prc -100.0000 200.0000 FORMAT "%8.4" EXTENDED_LIMITS -327.6800 327.6700 /end CHARACTERISTIC
/begin CHARACTERISTIC AirCtl_rTVADflClsd_C "Drosselklappenstellung im Nachlauf und Motorstillstand" VALUE 0x1C55EA Kw_Ws16 100.0000 Prc 0.00 100.0000 FORMAT "%8.4" EXTENDED_LIMITS -327.6800 327.6700 /end CHARACTERISTIC
/begin CHARACTERISTIC AirCtl_rTVADflEngPrt_C "Vorgabewert für Stellgröße der Drosselklappe bei Abschaltursache Überdrehzahlerkennung" VALUE 0x1C5EF4 Kw_Ws16 300.0000 Prc -100.0000 200.0000 FORMAT "%8.4" EXTENDED_LIMITS -327.6800 327.6700 /end CHARACTERISTIC
/begin CHARACTERISTIC AirCtl_rTVADflGearShft_C "Vorgabewert für Stellgröße der Drosselklappe bei Abschaltursache Schaltvorgang" VALUE 0x1C5EF6 Kw_Ws16 300.0000 Prc -100.0000 200.0000 FORMAT "%8.4" EXTENDED_LIMITS -327.6800 327.6700 /end CHARACTERISTIC
/begin CHARACTERISTIC AirCtl_rTVADflLogin_C "VGW für Drosselklappe nach EGR Abschaltung durch Login" VALUE 0x1C55EC Kw_Ws16 100.0000 Prc 0.00 100.0000 FORMAT "%8.4" EXTENDED_LIMITS -327.6800 327.6700 /end CHARACTERISTIC
/begin CHARACTERISTIC AirCtl_rTVADflOvrRun_C "Vorgabewert für Stellgröße der Drosselklappe bei Abschaltursache Schubbetrieb" VALUE 0x1C5EF8 Kw_Ws16 300.0000 Prc -100.0000 200.0000 FORMAT "%8.4" EXTENDED_LIMITS -327.6800 327.6700 /end CHARACTERISTIC
/begin CHARACTERISTIC AirCtl_rTVADflRgnShOff_C "Vorgabewert für Stellgröße der Drosselklappe bei Abschaltursache Abgasnachbehandlung" VALUE 0x1C5EFA Kw_Ws16 300.0000 Prc -100.0000 200.0000 FORMAT "%8.4" EXTENDED_LIMITS -327.6800 327.6700 /end CHARACTERISTIC
/begin CHARACTERISTIC AirCtl_rTVADflShOffCo_C "Vorgabewert für Stellgröße der Drosselklappe bei Abschaltung durch Abschaltkoordinator" VALUE 0x1C5EFC Kw_Ws16 300.0000 Prc -100.0000 200.0000 FORMAT "%8.4" EXTENDED_LIMITS -327.6800 327.6700 /end CHARACTERISTIC
/begin CHARACTERISTIC AirCtl_rTVADflShOff_C "Vorgabewert für Stellgröße der Drosselklappe bei Abschaltung" VALUE 0x1C5EFE Kw_Ws16 300.0000 Prc -100.0000 200.0000 FORMAT "%8.4" EXTENDED_LIMITS -327.6800 327.6700 /end CHARACTERISTIC
/begin CHARACTERISTIC AirCtl_rTVA_Vector "Bypass-Label für AirCtl_rTVA (Nicht verstellen!)" VALUE 0x1C0A38 Kw_Wu8 255.0 OneToOne 0.00 255.0 FORMAT "%5.1" /end CHARACTERISTIC
/begin CHARACTERISTIC AirCtl_rTVA_Channel "Bypass-Label für AirCtl_rTVA (Nicht verstellen!)" VALUE 0x1C0A39 Kw_Wu8 255.0 OneToOne 0.00 255.0 FORMAT "%5.1" /end CHARACTERISTIC
/begin CHARACTERISTIC AirCtl_rTVA_MAP "Kennfeld für Drosselklappenstellgröße" MAP 0x1C51D2 Kf_Xs16_Ys16_Ws16 300.0000 Prc -100.0000 200.0000 FORMAT "%8.4" EXTENDED_LIMITS -327.6800 327.6700
 /begin AXIS_DESCR STD_AXIS Eng_nAvrg EngN 10 0.00 6000.000 FORMAT "%8.3" EXTENDED_LIMITS -32768.00 32767.00 DEPOSIT ABSOLUTE /end AXIS_DESCR
 /begin AXIS_DESCR STD_AXIS AirCtl_rGovOut_mp Prc 10 -327.6800 327.6700 FORMAT "%8.4" DEPOSIT ABSOLUTE /end AXIS_DESCR
/end CHARACTERISTIC
/begin CHARACTERISTIC AirCtl_stAirHiMsk_C "Übereinstimmung des EGT-Status mit entsprechender Maske" VALUE 0x1C55F0 Kw_Wu32 4294967295.00 OneToOne 0.00 4294967295.00 FORMAT "%13.2" /end CHARACTERISTIC
/begin CHARACTERISTIC AirCtl_stAirLoMsk_C "Übereinstimmung des EGT-Status mit entsprechender Maske" VALUE 0x1C55F4 Kw_Wu32 4294967295.00 OneToOne 0.00 4294967295.00 FORMAT "%13.2" /end CHARACTERISTIC
/begin CHARACTERISTIC AirCtl_stGovRgn1HysMsk_C "Bitmaske für Regenerationsanforderung 1 für Hysterese" VALUE 0x1C52C8 Kw_Wu32 4294967295.00 OneToOne 0.00 4294967295.00 FORMAT "%13.2" /end CHARACTERISTIC
/begin CHARACTERISTIC AirCtl_stGovRgn1Msk_C "Bitmaske für Regenerationsanforderung 1 für Aufteilung der Stellgröße" VALUE 0x1C52CC Kw_Wu32 4294967295.00 OneToOne 0.00 4294967295.00 FORMAT "%13.2" /end CHARACTERISTIC
/begin CHARACTERISTIC AirCtl_stGovRgn2HysMsk_C "Bitmaske für Regenerationsanforderung 2 für Hysterese" VALUE 0x1C52D0 Kw_Wu32 4294967295.00 OneToOne 0.00 4294967295.00 FORMAT "%13.2" /end CHARACTERISTIC
/begin CHARACTERISTIC AirCtl_stGovRgn2Msk_C "Bitmaske für Regenerationsanforderung 2 für Aufteilung der Stellgröße" VALUE 0x1C52D4 Kw_Wu32 4294967295.00 OneToOne 0.00 4294967295.00 FORMAT "%13.2" /end CHARACTERISTIC
/begin CHARACTERISTIC AirCtl_stHighMsk_C "Maske zur Erkennung Regenerationsstufe" VALUE 0x1C55F8 Kw_Wu32 4294967295.00 OneToOne 0.00 4294967295.00 FORMAT "%13.2" /end CHARACTERISTIC
/begin CHARACTERISTIC AirCtl_stMiddleMsk_C "Maske zur Erkennung Regenerationsstufe" VALUE 0x1C55FC Kw_Wu32 4294967295.00 OneToOne 0.00 4294967295.00 FORMAT "%13.2" /end CHARACTERISTIC
/begin CHARACTERISTIC AirCtl_stMonRgnMsk1_C "Maske zur Monitorumschaltung für Partikelfilter Regeneration 1" VALUE 0x1C5600 Kw_Wu32 4294967295.00 OneToOne 0.00 4294967295.00 FORMAT "%13.2" /end CHARACTERISTIC
/begin CHARACTERISTIC AirCtl_stMonRgnMsk2_C "Maske zur Monitorumschaltung für Partikelfilter Regeneration 2" VALUE 0x1C5604 Kw_Wu32 4294967295.00 OneToOne 0.00 4294967295.00 FORMAT "%13.2" /end CHARACTERISTIC
/begin CHARACTERISTIC AirCtl_stMonRgnMskOn_C "Maske zur Fehlerunterdrückung für Partikelfilter Regeneration" VALUE 0x1C5608 Kw_Wu32 4294967295.00 OneToOne 0.00 4294967295.00 FORMAT "%13.2" /end CHARACTERISTIC
/begin CHARACTERISTIC AirCtl_stParRgnMsk_C "Maske zur Umschaltung von Reglerparametern für Partikelfilter Regeneration" VALUE 0x1C52D8 Kw_Wu32 4294967295.00 OneToOne 0.00 4294967295.00 FORMAT "%13.2" /end CHARACTERISTIC
/begin CHARACTERISTIC AirCtl_swtCtlHys_C "Schalter für Hysterese des Steueranteils" VALUE 0x1C52DC Kw_Wu8 1.000 OneToOne 0.00 1.000 FORMAT "%5.3" EXTENDED_LIMITS 0.00 255.0 /end CHARACTERISTIC
/begin CHARACTERISTIC AirCtl_swtEGROpnLp_C "Schalter zur Auswahl des gesteuerten Betriebes für das AGR-Ventil" VALUE 0x1C52DD Kw_Wu8 1.000 OneToOne 0.00 1.000 FORMAT "%5.3" EXTENDED_LIMITS 0.00 255.0 /end CHARACTERISTIC
/begin CHARACTERISTIC AirCtl_swtGovCtl3Hys_C "Schalterwert für Auswahl von Dreifachhystereseausgang (=1) oder Begrenzerausgang (=0)" VALUE 0x1C52DE Kw_Wu8 1.000 OneToOne 0.00 1.000 FORMAT "%5.3" EXTENDED_LIMITS 0.00 255.0 /end CHARACTERISTIC
/begin CHARACTERISTIC AirCtl_swtGovCtlPath_C "Schalterwert für Pfadauswahl von AirCtl_rGovEGR (=0:Kennfeld, =1:direkt) und AirCtl_rGovTVA (=0:Regler, =1:Steuerung)" VALUE 0x1C52DF Kw_Wu8 2.000 OneToOne 0.00 2.000 FORMAT "%5.3" EXTENDED_LIMITS 0.00 255.0 /end CHARACTERISTIC
/begin CHARACTERISTIC AirCtl_swtTempStrtDelay_C "Schalter der Temperaturwert des Arrays auswählt" VALUE 0x1C560C Kw_Wu8 4.00000000000 EngTempFldSel 0.00 4.00000000000 FORMAT "%13.11" /end CHARACTERISTIC
/begin CHARACTERISTIC AirCtl_tAirHi1_C "untere Hysteresegrenze für Überwachung niedriger Umgebungstemperatur bei EGT-Status gleich Maske 1" VALUE 0x1C560E Kw_Ws16 250.0000 Temp_Cels -50.14000 199.8600 FORMAT "%8.4" EXTENDED_LIMITS -3549.940 3003.560 /end CHARACTERISTIC
/begin CHARACTERISTIC AirCtl_tAirHi_C "obere Hysteresegrenze für Überwachung niedriger Lufttemperatur" VALUE 0x1C5610 Kw_Ws16 250.0000 Temp_Cels -50.14000 199.8600 FORMAT "%8.4" EXTENDED_LIMITS -3549.940 3003.560 /end CHARACTERISTIC
/begin CHARACTERISTIC AirCtl_tAirLo1_C "untere Hysteresegrenze für Überwachung niedriger Umgebungstemperatur bei EGT-Status gleich Maske 1" VALUE 0x1C5612 Kw_Ws16 250.0000 Temp_Cels -50.14000 199.8600 FORMAT "%8.4" EXTENDED_LIMITS -3549.940 3003.560 /end CHARACTERISTIC
/begin CHARACTERISTIC AirCtl_tAirLo_C "untere Hysteresegrenze für Überwachung niedriger Lufttemperatur" VALUE 0x1C5614 Kw_Ws16 250.0000 Temp_Cels -50.14000 199.8600 FORMAT "%8.4" EXTENDED_LIMITS -3549.940 3003.560 /end CHARACTERISTIC
/begin CHARACTERISTIC AirCtl_tEngHHi_C "obere Hysteresegrenze für Überwachung hoher Kühlwassertemperatur" VALUE 0x1C5616 Kw_Ws16 250.0000 Temp_Cels -50.14000 199.8600 FORMAT "%8.4" EXTENDED_LIMITS -3549.940 3003.560 /end CHARACTERISTIC
/begin CHARACTERISTIC AirCtl_tEngHLo_C "untere Hysteresegrenze für Überwachung hoher Kühlwassertemperatur" VALUE 0x1C5618 Kw_Ws16 250.0000 Temp_Cels -50.14000 199.8600 FORMAT "%8.4" EXTENDED_LIMITS -3549.940 3003.560 /end CHARACTERISTIC
/begin CHARACTERISTIC AirCtl_tEngLHi_C "obere Hysteresegrenze für Überwachung niedriger Kühlwassertemperatur" VALUE 0x1C561A Kw_Ws16 250.0000 Temp_Cels -50.14000 199.8600 FORMAT "%8.4" EXTENDED_LIMITS -3549.940 3003.560 /end CHARACTERISTIC
/begin CHARACTERISTIC AirCtl_tEngLLo_C "untere Hysteresegrenze für Überwachung niedriger Kühlwassertemperatur" VALUE 0x1C561C Kw_Ws16 250.0000 Temp_Cels -50.14000 199.8600 FORMAT "%8.4" EXTENDED_LIMITS -3549.940 3003.560 /end CHARACTERISTIC
/begin CHARACTERISTIC AirCtl_tiClutch_C "maximale Zeit für Schaltvorgangerkennung" VALUE 0x1C561E Kw_Wu16 655350.0 TimeDeb 0.00 655350.0 FORMAT "%8.1" /end CHARACTERISTIC
/begin CHARACTERISTIC AirCtl_tiCoStrt_CUR "Kennlinie für Zeit, in der die Regelung nach Startabwurf abgeschaltet bleibt" CURVE 0x1C5620 Kl_Xs16_Ws16 33000.00 Time_ms 0.00 33000.00 FORMAT "%8.2" EXTENDED_LIMITS -327680.0 327670.0
 /begin AXIS_DESCR STD_AXIS AirCtl_tStrtDelay_mp Temp_Cels 25 -100.1400 199.8600 FORMAT "%8.4" EXTENDED_LIMITS -3549.940 3003.560 DEPOSIT ABSOLUTE /end AXIS_DESCR
/end CHARACTERISTIC
/begin CHARACTERISTIC AirCtl_tiDebHigh_C "Entprellzeit für erkannte Regelabweichung bei Lambdagleichregelung" VALUE 0x1C5686 Kw_Wu16 655140.0 TimeDeb 0.00 655140.0 FORMAT "%8.1" EXTENDED_LIMITS 0.00 655350.0 /end CHARACTERISTIC
/begin CHARACTERISTIC AirCtl_tiDebLow_C "Entprellzeit bei heilender Regelabweichung in Lambdagleichregelung" VALUE 0x1C5688 Kw_Wu16 655140.0 TimeDeb 0.00 655140.0 FORMAT "%8.1" EXTENDED_LIMITS 0.00 655350.0 /end CHARACTERISTIC
/begin CHARACTERISTIC AirCtl_tiMaxDef_C "Vorentprellzeit für Erkennung positiver bleibender Regelabweichung" VALUE 0x1C568A Kw_Wu16 65540.00 Time_ms 0.00 65540.00 FORMAT "%8.2" EXTENDED_LIMITS 0.00 655350.0 /end CHARACTERISTIC
/begin CHARACTERISTIC AirCtl_tiMaxOk_C "Vorentprellzeit für Heilung bei positiver bleibender Regelabweichung" VALUE 0x1C568C Kw_Wu16 65540.00 Time_ms 0.00 65540.00 FORMAT "%8.2" EXTENDED_LIMITS 0.00 655350.0 /end CHARACTERISTIC
/begin CHARACTERISTIC AirCtl_tiMinDef_C "Vorentprellzeit für Erkennung negativer bleibender Regelabweichung" VALUE 0x1C568E Kw_Wu16 65540.00 Time_ms 0.00 65540.00 FORMAT "%8.2" EXTENDED_LIMITS 0.00 655350.0 /end CHARACTERISTIC
/begin CHARACTERISTIC AirCtl_tiMinOk_C "Vorentprellzeit für Heilung bei neagtiver bleibender Regelabweichung" VALUE 0x1C5690 Kw_Wu16 65540.00 Time_ms 0.00 65540.00 FORMAT "%8.2" EXTENDED_LIMITS 0.00 655350.0 /end CHARACTERISTIC
/begin CHARACTERISTIC AirCtl_tiDly_CUR "Kennlinie für Verzögerungstimerwert" CURVE 0x1C5692 Kl_Xs16_Ws16 33000.00 Time_ms 0.00 33000.00 FORMAT "%8.2" EXTENDED_LIMITS -327680.0 327670.0
 /begin AXIS_DESCR STD_AXIS Eng_nAvrg EngN 25 0.00 6000.000 FORMAT "%8.3" EXTENDED_LIMITS -32768.00 32767.00 DEPOSIT ABSOLUTE /end AXIS_DESCR
/end CHARACTERISTIC
/begin CHARACTERISTIC AirCtl_tiFltNeg1_C "Zeitkonstante für Ladedruckfilter bei fallendem Ladedruck" VALUE 0x1C5408 Kw_Wu32 4294.9673 TimeDelay_s 0.0000010000000 4294.9673 FORMAT "%9.4" /end CHARACTERISTIC
/begin CHARACTERISTIC AirCtl_tiFltNeg2_C "Zeitkonstante für Druck vor Turbine Filter bei fallendem Druck vor Turbine linkes System" VALUE 0x1C540C Kw_Wu32 4294.9673 TimeDelay_s 0.0000010000000 4294.9673 FORMAT "%9.4" /end CHARACTERISTIC
/begin CHARACTERISTIC AirCtl_tiFltNeg3_C "Filterzeitkonstante für Druck vor Turbine bei fallendem Druck vor Turbine rechtes System" VALUE 0x1C5410 Kw_Wu32 4294.9673 TimeDelay_s 0.0000010000000 4294.9673 FORMAT "%9.4" /end CHARACTERISTIC
/begin CHARACTERISTIC AirCtl_tiFltNeg4_C "Zeitkonstante für Lambdawertfilter bei fallendem Lambdawert linkes System" VALUE 0x1C5414 Kw_Wu32 4294.9673 TimeDelay_s 0.0000010000000 4294.9673 FORMAT "%9.4" /end CHARACTERISTIC
/begin CHARACTERISTIC AirCtl_tiFltNeg5_C "Zeitkonstante für Lambdawertfilter bei fallendem Lambdawert rechtes System" VALUE 0x1C5418 Kw_Wu32 4294.9673 TimeDelay_s 0.0000010000000 4294.9673 FORMAT "%9.4" /end CHARACTERISTIC
/begin CHARACTERISTIC AirCtl_tiFltPos1_C "Zeitkonstante für Ladedruckfilter bei steigendem Ladedruck" VALUE 0x1C541C Kw_Wu32 4294.9673 TimeDelay_s 0.0000010000000 4294.9673 FORMAT "%9.4" /end CHARACTERISTIC
/begin CHARACTERISTIC AirCtl_tiFltPos2_C "Zeitkonstante für Druck vor Turbine Filter bei steigendem Druck vor Turbine linkes System" VALUE 0x1C5420 Kw_Wu32 4294.9673 TimeDelay_s 0.0000010000000 4294.9673 FORMAT "%9.4" /end CHARACTERISTIC
/begin CHARACTERISTIC AirCtl_tiFltPos3_C "Filterzeitkonstante für Druck vor Turbine bei steigendem Druck vor Turbine rechtes System" VALUE 0x1C5424 Kw_Wu32 4294.9673 TimeDelay_s 0.0000010000000 4294.9673 FORMAT "%9.4" /end CHARACTERISTIC
/begin CHARACTERISTIC AirCtl_tiFltPos4_C "Zeitkonstante für Lambdawertfilter bei steigendem Lambdawert linkes System" VALUE 0x1C5428 Kw_Wu32 4294.9673 TimeDelay_s 0.0000010000000 4294.9673 FORMAT "%9.4" /end CHARACTERISTIC
/begin CHARACTERISTIC AirCtl_tiFltPos5_C "Zeitkonstante für Lambdawertfilter bei steigendem Lambdawert rechtes System" VALUE 0x1C542C Kw_Wu32 4294.9673 TimeDelay_s 0.0000010000000 4294.9673 FORMAT "%9.4" /end CHARACTERISTIC
/begin CHARACTERISTIC AirCtl_tiGovRgnRmpNeg_C "Neg. Rampenzeit für die Umschaltung der EGR und TVA Stellgrößen für Partikelfilter Regeneration" VALUE 0x1C52E0 Kw_Wu32 65535999.9847 Rmp 0.00 65535999.9847 FORMAT "%13.4" /end CHARACTERISTIC
/begin CHARACTERISTIC AirCtl_tiGovRgnRmpPos_C "Pos. Rampenzeit für die Umschaltung der EGR und TVA Stellgrößen für Partikelfilter Regeneration" VALUE 0x1C52E4 Kw_Wu32 65535999.9847 Rmp 0.00 65535999.9847 FORMAT "%13.4" /end CHARACTERISTIC
/begin CHARACTERISTIC AirCtl_tiLowIdle_C "Grenzzeit für Leerlaufabschaltung" VALUE 0x1C56F8 Kw_Wu32 42949672950.0 Time_ms 0.00 42949672950.0 FORMAT "%13.1" /end CHARACTERISTIC
/begin CHARACTERISTIC AirCtl_tiMonRgn1_C "Verzögerungszeit für den Eingriff der Partikelfilter Regeneration 1" VALUE 0x1C56FC Kw_Wu32 42949672.9500 Time_s 0.00 42949672.9500 FORMAT "%13.4" /end CHARACTERISTIC
/begin CHARACTERISTIC AirCtl_tiMonRgn2_C "Verzögerungszeit für den Eingriff der Partikelfilter Regeneration 2" VALUE 0x1C5700 Kw_Wu32 42949672.9500 Time_s 0.00 42949672.9500 FORMAT "%13.4" /end CHARACTERISTIC
/begin CHARACTERISTIC AirCtl_tiOvrRunDel_C "Verzögerungszeit für Schuberkennung" VALUE 0x1C5704 Kw_Wu16 655350.0 Time_ms 0.00 655350.0 FORMAT "%8.1" /end CHARACTERISTIC
/begin CHARACTERISTIC AirCtl_tiParRgnRmpNeg_C "Neg. Rampenzeit für die Umschaltung Reglerparameter für Partikelfilter Regeneration" VALUE 0x1C52E8 Kw_Wu32 65535999.9847 Rmp 0.00 65535999.9847 FORMAT "%13.4" /end CHARACTERISTIC
/begin CHARACTERISTIC AirCtl_tiParRgnRmpPos_C "Pos. Rampenzeit für die Umschaltung Reglerparameter für Partikelfilter Regeneration" VALUE 0x1C52EC Kw_Wu32 65535999.9847 Rmp 0.00 65535999.9847 FORMAT "%13.4" /end CHARACTERISTIC
/begin CHARACTERISTIC AirCtl_trqCrCtloff_C "unterer AirCtl_trqCrCtloff Hystersenoffsetwert" VALUE 0x1C5F00 Kw_Ws16 1000.000 Trq 0.00 1000.000 FORMAT "%8.3" EXTENDED_LIMITS -3276.800 3276.700 /end CHARACTERISTIC
/begin CHARACTERISTIC AirCtl_uBattThres_C "Grenze für Batteriespannungsüberwachung" VALUE 0x1C5706 Kw_Ws16 1331328. Volt_Batt -665674.1 665653.8 FORMAT "%8.1" /end CHARACTERISTIC
/begin CHARACTERISTIC AltCD_tiDebAccessDef_C "Fehlerentprellzeit des Modulzugriffsfehlers" VALUE 0x1C6080 Kw_Wu16 65540.00 Time_ms 0.00 65540.00 FORMAT "%8.2" EXTENDED_LIMITS 0.00 655350.0 /end CHARACTERISTIC
/begin CHARACTERISTIC AltCD_tiDebAccessOk_C "Heilungsentprellzeit des Modulzugriffsfehler" VALUE 0x1C6082 Kw_Wu16 65540.00 Time_ms 0.00 65540.00 FORMAT "%8.2" EXTENDED_LIMITS 0.00 655350.0 /end CHARACTERISTIC
/begin CHARACTERISTIC AltCD_ctMeanPer_C "Anzahl der Perioden über die die Generatorlast gemittelt wird" VALUE 0x1C6084 Kw_Wu8 4.000 OneToOne 1.000 5.000 FORMAT "%5.3" EXTENDED_LIMITS 0.00 255.0 /end CHARACTERISTIC
/begin CHARACTERISTIC AltCD_tiDebDtyCycMaxDef_C "Fehlerentprellzeit bei SRC-HIGH des gemessenen TV" VALUE 0x1C6086 Kw_Wu16 65540.00 Time_ms 0.00 65540.00 FORMAT "%8.2" EXTENDED_LIMITS 0.00 655350.0 /end CHARACTERISTIC
/begin CHARACTERISTIC AltCD_tiDebDtyCycMaxOk_C "Heilungsentprellzeit bei SRC-HIGH des gemessenen TV" VALUE 0x1C6088 Kw_Wu16 65540.00 Time_ms 0.00 65540.00 FORMAT "%8.2" EXTENDED_LIMITS 0.00 655350.0 /end CHARACTERISTIC
/begin CHARACTERISTIC AltCD_tiDebDtyCycMinDef_C "Fehlerentprellzeit bei SRC-LOW des gemessenen TV" VALUE 0x1C608A Kw_Wu16 65540.00 Time_ms 0.00 65540.00 FORMAT "%8.2" EXTENDED_LIMITS 0.00 655350.0 /end CHARACTERISTIC
/begin CHARACTERISTIC AltCD_tiDebDtyCycMinOk_C "Heilungsentprellzeit bei SRC-LOW des gemessenen TV" VALUE 0x1C608C Kw_Wu16 65540.00 Time_ms 0.00 65540.00 FORMAT "%8.2" EXTENDED_LIMITS 0.00 655350.0 /end CHARACTERISTIC
/begin CHARACTERISTIC AltCD_tiDebPer2HiTransLo_C "Entprellzeit für zu kleine Periodendauer (1 -> 0 Erkennung)" VALUE 0x1C608E Kw_Wu16 655350.0 TimeDeb 0.00 655350.0 FORMAT "%8.1" /end CHARACTERISTIC
/begin CHARACTERISTIC AltCD_tiDebPer2HiTransHi_C "Entprellzeit für zu kleine Periodendauer (0 -> 1 Erkennung)" VALUE 0x1C6090 Kw_Wu16 655350.0 TimeDeb 0.00 655350.0 FORMAT "%8.1" /end CHARACTERISTIC
/begin CHARACTERISTIC AltCD_tiDebPer2LoTransLo_C "Entprellzeit für zu große Periodendauer (1 -> 0 Erkennung)" VALUE 0x1C6092 Kw_Wu16 655350.0 TimeDeb 0.00 655350.0 FORMAT "%8.1" /end CHARACTERISTIC
/begin CHARACTERISTIC AltCD_tiDebPer2LoTransHi_C "Entprellzeit für zu große Periodendauer (0 -> 1 Erkennung)" VALUE 0x1C6094 Kw_Wu16 655350.0 TimeDeb 0.00 655350.0 FORMAT "%8.1" /end CHARACTERISTIC
/begin CHARACTERISTIC AltCD_rLoadStepUp_C "Rampensteigung im Fehlerfall" VALUE 0x1C6098 Kw_Wu32 655359.999847 RmpPrc 0.00 655359.999847 FORMAT "%13.6" /end CHARACTERISTIC
/begin CHARACTERISTIC AltCD_rLoadStepDown_C "Rampensteigung im Fehlerfall" VALUE 0x1C609C Kw_Wu32 655359.999847 RmpPrc 0.00 655359.999847 FORMAT "%13.6" /end CHARACTERISTIC
/begin CHARACTERISTIC AltCD_stSensIDWord_C "Schalter der TransStagefunktion" VALUE 0x1C60A0 Kw_Wu16 65535.00 OneToOne 0.00 65535.00 FORMAT "%8.2" /end CHARACTERISTIC
/begin CHARACTERISTIC AltCD_rAltLoadDfl_C "Vorgabewert im Fehlerfall" VALUE 0x1C60A2 Kw_Ws16 100.0000 Prc 0.00 100.0000 FORMAT "%8.4" EXTENDED_LIMITS -327.6800 327.6700 /end CHARACTERISTIC
/begin CHARACTERISTIC AltCD_stLoadPwmInInv_C "Schalter zur Signalinvertierung" VALUE 0x1C60A4 Kw_Wu8 1.000 OneToOne 0.00 1.000 FORMAT "%5.3" EXTENDED_LIMITS 0.00 255.0 /end CHARACTERISTIC
/begin CHARACTERISTIC AltCD_tiLoadPwmInMinPer_C "SRC-min der gemessenen Periodendauer" VALUE 0x1C60A6 Kw_Ws16 3275.700 Period 1.000000 3276.700 FORMAT "%8.3" EXTENDED_LIMITS -3276.800 3276.700 /end CHARACTERISTIC
/begin CHARACTERISTIC AltCD_tiLoadPwmInMaxPer_C "SRC-high der gemessenen Periodendauer" VALUE 0x1C60A8 Kw_Ws16 719.2000 Period 100.0000 819.2000 FORMAT "%8.4" EXTENDED_LIMITS -3276.800 3276.700 /end CHARACTERISTIC
/begin CHARACTERISTIC AltCD_dcycLoadPwmInMin_C "SRC-low des gemessenen TV des Generatorsignals" VALUE 0x1C60AA Kw_Ws16 100.0000 DtyCyc 0.00 100.0000 FORMAT "%8.4" EXTENDED_LIMITS -327.6800 327.6700 /end CHARACTERISTIC
/begin CHARACTERISTIC AltCD_dcycLoadPwmInMax_C "SRC-high des gemessenen TV des Generatorsignals" VALUE 0x1C60AC Kw_Ws16 100.0000 DtyCyc 0.00 100.0000 FORMAT "%8.4" EXTENDED_LIMITS -327.6800 327.6700 /end CHARACTERISTIC
/begin CHARACTERISTIC AltCD_rLoadLin_CUR "Kennlinie zur Umrechnung von % TV in % Last" CURVE 0x1C60AE Kl_Xs16_Ws16 100.0000 Prc 0.00 100.0000 FORMAT "%8.4" EXTENDED_LIMITS -327.6800 327.6700
 /begin AXIS_DESCR STD_AXIS AltCD_dcycAltLoad DtyCyc 25 0.00 100.0000 FORMAT "%8.4" EXTENDED_LIMITS -327.6800 327.6700 DEPOSIT ABSOLUTE /end AXIS_DESCR
/end CHARACTERISTIC
/begin CHARACTERISTIC AltCD_rThresExc_C "Schwellwert der Generatorerregung" VALUE 0x1C606A Kw_Ws16 100.0000 Prc 0.00 100.0000 FORMAT "%8.4" EXTENDED_LIMITS -327.6800 327.6700 /end CHARACTERISTIC
/begin CHARACTERISTIC AltCD_stInvOutExc_C "Invertiertes Signal der Generatorerregung" VALUE 0x1C606C Kw_Wu8 1.000 OneToOne 0.00 1.000 FORMAT "%5.3" EXTENDED_LIMITS 0.00 255.0 /end CHARACTERISTIC
/begin CHARACTERISTIC AltCD_stPwrStgDiaExc_C "Abschaltbedingung der Generatorerregung" VALUE 0x1C606D Kw_Wu8 255.0 OneToOne 0.00 255.0 FORMAT "%5.1" /end CHARACTERISTIC
/begin CHARACTERISTIC AltCD_tiDebExcTempDefExc_C "Fehlerentprellzeit für Übertemperatur der Generatorerregung [ms]" VALUE 0x1C606E Kw_Wu16 655350.0 Time_ms 0.00 655350.0 FORMAT "%8.1" /end CHARACTERISTIC
/begin CHARACTERISTIC AltCD_tiDebExcTempOkExc_C "Heilungsentprellzeit für Übertemperatur der Generatorerregung [ms]" VALUE 0x1C6070 Kw_Wu16 655350.0 Time_ms 0.00 655350.0 FORMAT "%8.1" /end CHARACTERISTIC
/begin CHARACTERISTIC AltCD_tiDebNoLoadDefExc_C "Fehlerentprellzeit für Leerlauf der Generatorerregung [ms]" VALUE 0x1C6072 Kw_Wu16 655350.0 Time_ms 0.00 655350.0 FORMAT "%8.1" /end CHARACTERISTIC
/begin CHARACTERISTIC AltCD_tiDebNoLoadOkExc_C "Heilungsentprellzeit für Leerlauf der Generatorerregung [ms]" VALUE 0x1C6074 Kw_Wu16 655350.0 Time_ms 0.00 655350.0 FORMAT "%8.1" /end CHARACTERISTIC
/begin CHARACTERISTIC AltCD_tiDebShrtBatDefExc_C "Fehlerentprellzeit für Kurzschluß nach U-Batt der Generatorerregung [ms]" VALUE 0x1C6076 Kw_Wu16 655350.0 Time_ms 0.00 655350.0 FORMAT "%8.1" /end CHARACTERISTIC
/begin CHARACTERISTIC AltCD_tiDebShrtBatOkExc_C "Heilungsentprellzeit für Kurzschluß nach U-Batt der Generatorerregung [ms]" VALUE 0x1C6078 Kw_Wu16 655350.0 Time_ms 0.00 655350.0 FORMAT "%8.1" /end CHARACTERISTIC
/begin CHARACTERISTIC AltCD_tiDebShrtGndDefExc_C "Fehlerentprellzeit für Kurzschluß nach Masse der Generatorerregung [ms]" VALUE 0x1C607A Kw_Wu16 655350.0 Time_ms 0.00 655350.0 FORMAT "%8.1" /end CHARACTERISTIC
/begin CHARACTERISTIC AltCD_tiDebShrtGndOkExc_C "Heilungsentprellzeit für Kurzschluß nach Masse der Generatorerregung [ms]" VALUE 0x1C607C Kw_Wu16 655350.0 Time_ms 0.00 655350.0 FORMAT "%8.1" /end CHARACTERISTIC
/begin CHARACTERISTIC AltCD_tiPT1InAcc_C "Filter zur Mittelwertbildung des TV aus dem Pin-State" VALUE 0x1C6114 Kw_Wu32 4294967.3 TimeDelay_ms 0.0010000000 4294967.3 FORMAT "%9.1" /end CHARACTERISTIC
/begin CHARACTERISTIC AltCD_tiPT1_C "Filter des gemessenen TV" VALUE 0x1C6118 Kw_Wu32 4294967.3 TimeDelay_ms 0.0010000000 4294967.3 FORMAT "%9.1" /end CHARACTERISTIC
/begin CHARACTERISTIC Alt_tiDebPwrCanDef_C "Fehlerentprellzeit für Dfp_AltpPwrCan_mp" VALUE 0x1C5F02 Kw_Wu16 655350.0 Time_ms 0.00 655350.0 FORMAT "%8.1" /end CHARACTERISTIC
/begin CHARACTERISTIC Alt_tiDebPwrCanOk_C "Fehlerheilzeit für Dfp_AltpPwrCan_mp" VALUE 0x1C5F04 Kw_Wu16 655350.0 Time_ms 0.00 655350.0 FORMAT "%8.1" /end CHARACTERISTIC
/begin CHARACTERISTIC Alt_nThresERR_C "Drehzahlschwelle für Generatorerregung" VALUE 0x1C6012 Kw_Ws16 6000.000 EngN 0.00 6000.000 FORMAT "%8.3" EXTENDED_LIMITS -32768.00 32767.00 /end CHARACTERISTIC
/begin CHARACTERISTIC Alt_pwrAdjValDef_C "Standardwert für Abgleich Leistungsanforderung Generator" VALUE 0x1C5F06 Kw_Ws16 0.00 Fact 1.000000 1.000000 FORMAT "%8.6" EXTENDED_LIMITS -4.000000 3.999878 /end CHARACTERISTIC
/begin CHARACTERISTIC Alt_pwrAdjValMax_C "Maximalwert für Abgleich Leistungsanforderung Generator" VALUE 0x1C5F08 Kw_Ws16 3.199951 Fact 0.00 3.199951 FORMAT "%8.6" EXTENDED_LIMITS -4.000000 3.999878 /end CHARACTERISTIC
/begin CHARACTERISTIC Alt_pwrAdjValMin_C "Minimalwert für Abgleich Leistungsanforderung Generator" VALUE 0x1C5F0A Kw_Ws16 3.199951 Fact 0.00 3.199951 FORMAT "%8.6" EXTENDED_LIMITS -4.000000 3.999878 /end CHARACTERISTIC
/begin CHARACTERISTIC Alt_pwrAltLoad_MAP "Kennfeld der Generatorlast" MAP 0x1C5F0C Kf_Xs16_Ys16_Ws16 300000.1 Pwr 0.00 300000.1 FORMAT "%8.1" EXTENDED_LIMITS -308831.1 308821.7
 /begin AXIS_DESCR STD_AXIS Eng_nAvrg EngN 8 0.00 6000.000 FORMAT "%8.3" EXTENDED_LIMITS -32768.00 32767.00 DEPOSIT ABSOLUTE /end AXIS_DESCR
 /begin AXIS_DESCR STD_AXIS AltCD_rAltLoad Prc 8 0.00 100.0000 FORMAT "%8.4" EXTENDED_LIMITS -327.6800 327.6700 DEPOSIT ABSOLUTE /end AXIS_DESCR
/end CHARACTERISTIC
/begin CHARACTERISTIC Alt_pwrCanDef_MAP "Kennfeld von Vorgabewerten bei CAN-Fehler" MAP 0x1C5FB0 Kf_Xs16_Ys16_Ws16 300000.1 Pwr 0.00 300000.1 FORMAT "%8.1" EXTENDED_LIMITS -308831.1 308821.7
 /begin AXIS_DESCR STD_AXIS CTSCD_tClnt Temp_Cels 4 -3549.940 3003.560 FORMAT "%8.3" DEPOSIT ABSOLUTE /end AXIS_DESCR
 /begin AXIS_DESCR STD_AXIS Eng_nAvrg EngN 8 0.00 6000.000 FORMAT "%8.3" EXTENDED_LIMITS -32768.00 32767.00 DEPOSIT ABSOLUTE /end AXIS_DESCR
/end CHARACTERISTIC
/begin CHARACTERISTIC Alt_pwrCanMax_C "Maximale Generatorleistung" VALUE 0x1C600C Kw_Ws16 300000.1 Pwr 0.00 300000.1 FORMAT "%8.1" EXTENDED_LIMITS -308831.1 308821.7 /end CHARACTERISTIC
/begin CHARACTERISTIC Alt_pwrCanMin_C "Minimale Generatorleistung" VALUE 0x1C600E Kw_Ws16 300000.1 Pwr 0.00 300000.1 FORMAT "%8.1" EXTENDED_LIMITS -308831.1 308821.7 /end CHARACTERISTIC
/begin CHARACTERISTIC Alt_pwrDes_Vector "Bypass Label, nicht ändern!" VALUE 0x1C0A3A Kw_Wu8 255.0 OneToOne 0.00 255.0 FORMAT "%5.1" /end CHARACTERISTIC
/begin CHARACTERISTIC Alt_pwrDes_Channel "Bypass Label, nicht ändern!" VALUE 0x1C0A3B Kw_Wu8 255.0 OneToOne 0.00 255.0 FORMAT "%5.1" /end CHARACTERISTIC
/begin CHARACTERISTIC Alt_swtPwrCan_C "Schalter für Generatorleistung über CAN" VALUE 0x1C6010 Kw_Wu8 1.000 OneToOne 0.00 1.000 FORMAT "%5.3" EXTENDED_LIMITS 0.00 255.0 /end CHARACTERISTIC
/begin CHARACTERISTIC Alt_tiDelPT_MAP "Kennfeld (p,t) zur Verzögerungsbestimmung für Generatorerregung" MAP 0x1C6014 Kf_Xs16_Ys16_Ws16 60000.00 Time_ms 0.00 60000.00 FORMAT "%8.2" EXTENDED_LIMITS -327680.0 327670.0
 /begin AXIS_DESCR STD_AXIS APSCD_pVal Pres_hPa 4 0.00 3500.000 FORMAT "%8.3" EXTENDED_LIMITS -32768.00 32767.00 DEPOSIT ABSOLUTE /end AXIS_DESCR
 /begin AXIS_DESCR STD_AXIS Eng_tEng Temp_Cels 5 -50.14000 199.8600 FORMAT "%8.4" EXTENDED_LIMITS -3549.940 3003.560 DEPOSIT ABSOLUTE /end AXIS_DESCR
/end CHARACTERISTIC
/begin CHARACTERISTIC Alt_tiExcdur_C "Impulszeit der Generatorerregung" VALUE 0x1C6052 Kw_Wu16 655350.0 Time_ms 0.00 655350.0 FORMAT "%8.1" /end CHARACTERISTIC
/begin CHARACTERISTIC Alt_tiLdRespTi_CUR "Kennlinie zur Ermittlung der Lastreaktionszeit aus der Motor-temperatur" CURVE 0x1C6054 Kl_Xs16_Ws16 655.1400 Time_s 0.00 655.1400 FORMAT "%8.4" EXTENDED_LIMITS -327.6800 327.6700
 /begin AXIS_DESCR STD_AXIS Eng_tEng Temp_Cels 4 -50.14000 199.8600 FORMAT "%8.4" EXTENDED_LIMITS -3549.940 3003.560 DEPOSIT ABSOLUTE /end AXIS_DESCR
/end CHARACTERISTIC
/begin CHARACTERISTIC Alt_tiLdRespTi_ReqDur_C "Übermittlungsdauer der Lastreaktionszeit" VALUE 0x1C6066 Kw_Wu16 655350.0 Time_ms 0.00 655350.0 FORMAT "%8.1" /end CHARACTERISTIC
/begin CHARACTERISTIC Alt_uBattThres_C "Batteriespannungsschwelle zum Unterdrücken der Erregungs-Verzögerung" VALUE 0x1C6068 Kw_Ws16 665653.8 Volt_Batt 0.00 665653.8 FORMAT "%8.1" EXTENDED_LIMITS -665674.1 665653.8 /end CHARACTERISTIC
/begin CHARACTERISTIC AOHtCD_DebBattDefHt1_C "Defektzeit fuer Fehler ""Kurzschluß nach BATT"" (Zuheizer 1)" VALUE 0x1C6290 Kw_Wu16 655350.0 Time_ms 0.00 655350.0 FORMAT "%8.1" /end CHARACTERISTIC
/begin CHARACTERISTIC AOHtCD_DebBattOkHt1_C "Heilungszeit fuer Fehler ""Kurzschluß nach BATT"" (Zuheizer 1)" VALUE 0x1C6292 Kw_Wu16 655350.0 Time_ms 0.00 655350.0 FORMAT "%8.1" /end CHARACTERISTIC
/begin CHARACTERISTIC AOHtCD_DebBattDefHt2_C "Defektzeit fuer Fehler ""Kurzschluß nach BATT"" (Zuheizer 2)" VALUE 0x1C6294 Kw_Wu16 655350.0 Time_ms 0.00 655350.0 FORMAT "%8.1" /end CHARACTERISTIC
/begin CHARACTERISTIC AOHtCD_DebBattOkHt2_C "Heilungszeit fuer Fehler ""Kurzschluß nach BATT"" (Zuheizer 2)" VALUE 0x1C6296 Kw_Wu16 655350.0 Time_ms 0.00 655350.0 FORMAT "%8.1" /end CHARACTERISTIC
/begin CHARACTERISTIC AOHtCD_DebBattDefHt3_C "Defektzeit fuer Fehler ""Kurzschluß nach BATT"" (Zuheizer 3)" VALUE 0x1C6298 Kw_Wu16 655350.0 Time_ms 0.00 655350.0 FORMAT "%8.1" /end CHARACTERISTIC
/begin CHARACTERISTIC AOHtCD_DebBattOkHt3_C "Heilungszeit fuer Fehler ""Kurzschluß nach BATT"" (Zuheizer 3)" VALUE 0x1C629A Kw_Wu16 655350.0 Time_ms 0.00 655350.0 FORMAT "%8.1" /end CHARACTERISTIC
/begin CHARACTERISTIC AOHtCD_DebGndDefHt1_C "Defektzeit fuer Fehler ""Kurzschluß nach Masse"" (Zuheizer 1)" VALUE 0x1C629C Kw_Wu16 655350.0 Time_ms 0.00 655350.0 FORMAT "%8.1" /end CHARACTERISTIC
/begin CHARACTERISTIC AOHtCD_DebGndOkHt1_C "Heilungszeit fuer Fehler ""Kurzschluß nach Masse"" (Zuheizer 1)" VALUE 0x1C629E Kw_Wu16 655350.0 Time_ms 0.00 655350.0 FORMAT "%8.1" /end CHARACTERISTIC
/begin CHARACTERISTIC AOHtCD_DebGndDefHt2_C "Defektzeit fuer Fehler ""Kurzschluß nach Masse"" (Zuheizer 2)" VALUE 0x1C62A0 Kw_Wu16 655350.0 Time_ms 0.00 655350.0 FORMAT "%8.1" /end CHARACTERISTIC
/begin CHARACTERISTIC AOHtCD_DebGndOkHt2_C "Heilungszeit fuer Fehler ""Kurzschluß nach Masse"" (Zuheizer 2)" VALUE 0x1C62A2 Kw_Wu16 655350.0 Time_ms 0.00 655350.0 FORMAT "%8.1" /end CHARACTERISTIC
/begin CHARACTERISTIC AOHtCD_DebGndDefHt3_C "Defektzeit fuer Fehler ""Kurzschluß nach Masse"" (Zuheizer 3)" VALUE 0x1C62A4 Kw_Wu16 655350.0 Time_ms 0.00 655350.0 FORMAT "%8.1" /end CHARACTERISTIC
/begin CHARACTERISTIC AOHtCD_DebGndOkHt3_C "Heilungszeit fuer Fehler ""Kurzschluß nach Masse"" (Zuheizer 3)" VALUE 0x1C62A6 Kw_Wu16 655350.0 Time_ms 0.00 655350.0 FORMAT "%8.1" /end CHARACTERISTIC
/begin CHARACTERISTIC AOHtCD_DebNoLoadDefHt1_C "Defektzeit fuer Fehler ""Endstufe im Leerlauf"" (Zuheizer 1)" VALUE 0x1C62A8 Kw_Wu16 655350.0 Time_ms 0.00 655350.0 FORMAT "%8.1" /end CHARACTERISTIC
/begin CHARACTERISTIC AOHtCD_DebNoLoadOkHt1_C "Heilungszeit fuer Fehler ""Endstufe im Leerlauf"" (Zuheizer 1)" VALUE 0x1C62AA Kw_Wu16 655350.0 Time_ms 0.00 655350.0 FORMAT "%8.1" /end CHARACTERISTIC
/begin CHARACTERISTIC AOHtCD_DebNoLoadDefHt2_C "Defektzeit fuer Fehler ""Endstufe im Leerlauf"" (Zuheizer 2)" VALUE 0x1C62AC Kw_Wu16 655350.0 Time_ms 0.00 655350.0 FORMAT "%8.1" /end CHARACTERISTIC
/begin CHARACTERISTIC AOHtCD_DebNoLoadOkHt2_C "Heilungszeit fuer Fehler ""Endstufe im Leerlauf"" (Zuheizer 2)" VALUE 0x1C62AE Kw_Wu16 655350.0 Time_ms 0.00 655350.0 FORMAT "%8.1" /end CHARACTERISTIC
/begin CHARACTERISTIC AOHtCD_DebNoLoadDefHt3_C "Defektzeit fuer Fehler ""Endstufe im Leerlauf"" (Zuheizer 3)" VALUE 0x1C62B0 Kw_Wu16 655350.0 Time_ms 0.00 655350.0 FORMAT "%8.1" /end CHARACTERISTIC
/begin CHARACTERISTIC AOHtCD_DebNoLoadOkHt3_C "Heilungszeit fuer Fehler ""Endstufe im Leerlauf"" (Zuheizer 3)" VALUE 0x1C62B2 Kw_Wu16 655350.0 Time_ms 0.00 655350.0 FORMAT "%8.1" /end CHARACTERISTIC
/begin CHARACTERISTIC AOHtCD_DebTempDefHt1_C "Defektzeit für Fehler ""Endstufe mit Uebertemperatur"" (Zuheizer 1)" VALUE 0x1C62B4 Kw_Wu16 655350.0 Time_ms 0.00 655350.0 FORMAT "%8.1" /end CHARACTERISTIC
/begin CHARACTERISTIC AOHtCD_DebTempOkHt1_C "Heilungszeit für Fehler ""Endstufe mit Uebertemperatur"" (Zuheizer 1)" VALUE 0x1C62B6 Kw_Wu16 655350.0 Time_ms 0.00 655350.0 FORMAT "%8.1" /end CHARACTERISTIC
/begin CHARACTERISTIC AOHtCD_DebTempDefHt2_C "Defektzeit für Fehler ""Endstufe mit Uebertemperatur"" (Zuheizer 2)" VALUE 0x1C62B8 Kw_Wu16 655350.0 Time_ms 0.00 655350.0 FORMAT "%8.1" /end CHARACTERISTIC
/begin CHARACTERISTIC AOHtCD_DebTempOkHt2_C "Heilungszeit für Fehler ""Endstufe mit Uebertemperatur"" (Zuheizer 2)" VALUE 0x1C62BA Kw_Wu16 655350.0 Time_ms 0.00 655350.0 FORMAT "%8.1" /end CHARACTERISTIC
/begin CHARACTERISTIC AOHtCD_DebTempDefHt3_C "Defektzeit für Fehler ""Endstufe mit Uebertemperatur"" (Zuheizer 3)" VALUE 0x1C62BC Kw_Wu16 655350.0 Time_ms 0.00 655350.0 FORMAT "%8.1" /end CHARACTERISTIC
/begin CHARACTERISTIC AOHtCD_DebTempOkHt3_C "Heilungszeit für Fehler ""Endstufe mit Uebertemperatur"" (Zuheizer 3)" VALUE 0x1C62BE Kw_Wu16 655350.0 Time_ms 0.00 655350.0 FORMAT "%8.1" /end CHARACTERISTIC
/begin CHARACTERISTIC AOHtCD_stPwmInInv_C "Invertierungsparameter fuer das PWM Signal des Dieselzuheizers" VALUE 0x1C62C0 Kw_Wu8 1.000 OneToOne 0.00 1.000 FORMAT "%5.3" EXTENDED_LIMITS 0.00 255.0 /end CHARACTERISTIC
/begin CHARACTERISTIC AOHtCD_stDigInvHt1_C "Ausgangssignalinvertierung des Zuheizers 1" VALUE 0x1C62C1 Kw_Wu8 1.000 OneToOne 0.00 1.000 FORMAT "%5.3" EXTENDED_LIMITS 0.00 255.0 /end CHARACTERISTIC
/begin CHARACTERISTIC AOHtCD_stDigInvHt2_C "Ausgangssignalinvertierung des Zuheizers 2" VALUE 0x1C62C2 Kw_Wu8 1.000 OneToOne 0.00 1.000 FORMAT "%5.3" EXTENDED_LIMITS 0.00 255.0 /end CHARACTERISTIC
/begin CHARACTERISTIC AOHtCD_stDigInvHt3_C "Ausgangssignalinvertierung des Zuheizers 3" VALUE 0x1C62C3 Kw_Wu8 1.000 OneToOne 0.00 1.000 FORMAT "%5.3" EXTENDED_LIMITS 0.00 255.0 /end CHARACTERISTIC
/begin CHARACTERISTIC AOHtCD_swtHeater12EnaVal_C "Schalterwert, ob Zuheizer 1 und 2 aktiv sind (=1) oder inaktiv (=0)" VALUE 0x1C62C4 Kw_Wu8 1.000 OneToOne 0.00 1.000 FORMAT "%5.3" EXTENDED_LIMITS 0.00 255.0 /end CHARACTERISTIC
/begin CHARACTERISTIC AOHtCD_swtHeater12EnaType_C "Schaltertyp" VALUE 0x1C62C5 Kw_Wu8 2.000 OneToOne 0.00 2.000 FORMAT "%5.3" EXTENDED_LIMITS 0.00 255.0 /end CHARACTERISTIC
/begin CHARACTERISTIC AOHtCD_tiMax_C "Maximale Periodendauer in ms" VALUE 0x1C62C8 Kw_Ws32 1000.00000000 Time_ms 0.00 1000.00000000 FORMAT "%13.8" EXTENDED_LIMITS -21474836480.0 21474836470.0 /end CHARACTERISTIC
/begin CHARACTERISTIC AOHtCD_VolPerImp_C "Zuheizerkonstante (l/h)/Hz" VALUE 0x1C62CC Kw_Ws32 0.230000000000 dFlConsum 0.00 0.230000000000 FORMAT "%14.12" EXTENDED_LIMITS -21474836.4800 21474836.4700 /end CHARACTERISTIC
/begin CHARACTERISTIC AOHt_nEngHigh_C "obere Grenze der Drehzahl des Hysteresenelements" VALUE 0x1C611C Kw_Ws16 5000.000 EngN 0.00 5000.000 FORMAT "%8.3" EXTENDED_LIMITS -32768.00 32767.00 /end CHARACTERISTIC
/begin CHARACTERISTIC AOHt_nEngLow_C "untere Grenze der Drehzahl des Hysteresenelements" VALUE 0x1C611E Kw_Ws16 5000.000 EngN 0.00 5000.000 FORMAT "%8.3" EXTENDED_LIMITS -32768.00 32767.00 /end CHARACTERISTIC
/begin CHARACTERISTIC AOHt_nEngOffs_C "Drehzahloffset zur Übernahme der Solldrehzahlanforderung durch AOHt" VALUE 0x1C6120 Kw_Ws16 6000.000 EngN 0.00 6000.000 FORMAT "%8.3" EXTENDED_LIMITS -32768.00 32767.00 /end CHARACTERISTIC
/begin CHARACTERISTIC AOHt_nMin_C "Leerlaufanhebung bei Zuheizung" VALUE 0x1C6122 Kw_Ws16 2000.000 EngN 0.00 2000.000 FORMAT "%8.3" EXTENDED_LIMITS -32768.00 32767.00 /end CHARACTERISTIC
/begin CHARACTERISTIC AOHt_NumHeat_C "Anzahl angeschlossener Heizelemente" VALUE 0x1C6124 Kw_Wu8 3.000 OneToOne 0.00 3.000 FORMAT "%5.3" EXTENDED_LIMITS 0.00 255.0 /end CHARACTERISTIC
/begin CHARACTERISTIC AOHt_rAltLoadMax_C "Maximale Generatorlast für Motor-Aus von der Ecomatic" VALUE 0x1C6126 Kw_Ws16 100.0000 Prc 0.00 100.0000 FORMAT "%8.4" EXTENDED_LIMITS -327.6800 327.6700 /end CHARACTERISTIC
/begin CHARACTERISTIC AOHt_rOff_CUR "Kennlinie zur Berechnung der unteren Hystereseschwelle Generatorlast" CURVE 0x1C6128 Kl_Xs16_Ws16 100.0000 Prc 0.00 100.0000 FORMAT "%8.4" EXTENDED_LIMITS -327.6800 327.6700
 /begin AXIS_DESCR STD_AXIS Eng_nAvrg EngN 25 0.00 6000.000 FORMAT "%8.3" EXTENDED_LIMITS -32768.00 32767.00 DEPOSIT ABSOLUTE /end AXIS_DESCR
/end CHARACTERISTIC
/begin CHARACTERISTIC AOHt_rOn_CUR "Kennlinie zur Berechnung der oberen Hystereseschwelle Generatorlast" CURVE 0x1C618E Kl_Xs16_Ws16 100.0000 Prc 0.00 100.0000 FORMAT "%8.4" EXTENDED_LIMITS -327.6800 327.6700
 /begin AXIS_DESCR STD_AXIS Eng_nAvrg EngN 25 0.00 6000.000 FORMAT "%8.3" EXTENDED_LIMITS -32768.00 32767.00 DEPOSIT ABSOLUTE /end AXIS_DESCR
/end CHARACTERISTIC
/begin CHARACTERISTIC AOHt_rSE_C "Wert um der die Einschaltschwelle aus AOHt_rOn_CUR für die Zeit AOHt_tiSE_C abgesenkt wird" VALUE 0x1C61F4 Kw_Wu32 100.000000000 Prc 0.00 100.000000000 FORMAT "%13.9" EXTENDED_LIMITS 0.00 42949672.9500 /end CHARACTERISTIC
/begin CHARACTERISTIC AOHt_stCAN_C "Bit0=1: CAN Anforderung auf Heizelement 1 und 2, Bit1=1: CAN Anforderung auf Heizelement 3" VALUE 0x1C61F8 Kw_Wu8 3.000 OneToOne 0.00 3.000 FORMAT "%5.3" EXTENDED_LIMITS 0.00 255.0 /end CHARACTERISTIC
/begin CHARACTERISTIC AOHt_stSwt_C "Kein Motor-Aus-Funktion Konfiguration" VALUE 0x1C61F9 Kw_Wu8 255.0 OneToOne 0.00 255.0 FORMAT "%5.1" /end CHARACTERISTIC
/begin CHARACTERISTIC AOHt_swtSensAir_C "Auswahl der Lufttemperatur" VALUE 0x1C61FA Kw_Ws16 1.000000 OneToOne 0.00 1.000000 FORMAT "%8.6" EXTENDED_LIMITS -32768.00 32767.00 /end CHARACTERISTIC
/begin CHARACTERISTIC AOHt_swtSigCan_C "Schalter zur Aktivierung der Zusatzheizung über CAN" VALUE 0x1C61FC Kw_Wu8 1.000 OneToOne 0.00 1.000 FORMAT "%5.3" EXTENDED_LIMITS 0.00 255.0 /end CHARACTERISTIC
/begin CHARACTERISTIC AOHt_swtTempInput_C "Auswahl der Lufttemperatur" VALUE 0x1C61FD Kw_Wu8 255.0 OneToOne 0.00 255.0 FORMAT "%5.1" /end CHARACTERISTIC
/begin CHARACTERISTIC AOHt_swtTemp_C "Schalter der Temperaturwert des Arrays auswählt" VALUE 0x1C61FE Kw_Wu8 4.00000000000 EngTempFldSel 0.00 4.00000000000 FORMAT "%13.11" /end CHARACTERISTIC
/begin CHARACTERISTIC AOHt_tAirUpLi_CUR "Kennlinie fuer die Berechnung von AOHt_tCltOn_mp" CURVE 0x1C6200 Kl_Xs16_Ws16 600.0000 Temp_Cels -273.1400 326.8600 FORMAT "%8.4" EXTENDED_LIMITS -3549.940 3003.560
 /begin AXIS_DESCR STD_AXIS AOHt_tAir_mp Temp_Cels 25 -273.1400 326.8600 FORMAT "%8.4" EXTENDED_LIMITS -3549.940 3003.560 DEPOSIT ABSOLUTE /end AXIS_DESCR
/end CHARACTERISTIC
/begin CHARACTERISTIC AOHt_tClntEcoMin_C "Minimale Wassertemperatur für Motor-AUS Befehl" VALUE 0x1C6266 Kw_Ws16 200.0000 Temp_Cels -50.14000 149.8600 FORMAT "%8.4" EXTENDED_LIMITS -3549.940 3003.560 /end CHARACTERISTIC
/begin CHARACTERISTIC AOHt_tEnvHigh_C "obere Grenze der Umgebungstemperatur des Hysteresenelements" VALUE 0x1C6268 Kw_Ws16 3276.700 Temp_Cels -273.1400 3003.560 FORMAT "%8.3" EXTENDED_LIMITS -3549.940 3003.560 /end CHARACTERISTIC
/begin CHARACTERISTIC AOHt_tEnvLow_C "untere Grenze der Umgebungstemperatur des Hysteresenelements" VALUE 0x1C626A Kw_Ws16 3276.700 Temp_Cels -273.1400 3003.560 FORMAT "%8.3" EXTENDED_LIMITS -3549.940 3003.560 /end CHARACTERISTIC
/begin CHARACTERISTIC AOHt_tHysRng_C "Temperaturbereich fuer die Hysterese" VALUE 0x1C626C Kw_Ws16 400.0000 TempDiff_Kelv 0.00 400.0000 FORMAT "%8.4" EXTENDED_LIMITS -3276.800 3276.700 /end CHARACTERISTIC
/begin CHARACTERISTIC AOHt_tiEngOff_CUR "Lufttemperaturabhängige Ecomatic - Verzoegerungszeit" CURVE 0x1C626E Kl_Xs16_Ws16 327570.0 Time_ms 0.00 327570.0 FORMAT "%8.1" EXTENDED_LIMITS -327680.0 327670.0
 /begin AXIS_DESCR STD_AXIS AOHt_tAirEngOff_mp Temp_Cels 4 -50.14000 199.8600 FORMAT "%8.4" EXTENDED_LIMITS -3549.940 3003.560 DEPOSIT ABSOLUTE /end AXIS_DESCR
/end CHARACTERISTIC
/begin CHARACTERISTIC AOHt_tiSE_C "Zeitdauer in der die Absenkung AOHt_rSE_C aktiv ist" VALUE 0x1C6280 Kw_Wu32 3600000.00000 Time_ms 0.00 3600000.00000 FORMAT "%13.5" EXTENDED_LIMITS 0.00 42949672950.0 /end CHARACTERISTIC
/begin CHARACTERISTIC AOHt_tiStrt_C "Startverzoegerung fuer die Heizleistungssteigerung" VALUE 0x1C6284 Kw_Wu32 3600000.00000 Time_ms 0.00 3600000.00000 FORMAT "%13.5" EXTENDED_LIMITS 0.00 42949672950.0 /end CHARACTERISTIC
/begin CHARACTERISTIC AOHt_tiVER_C "Zuschaltverzögerung für das nächste Heizelement" VALUE 0x1C6288 Kw_Wu32 3600000.00000 Time_ms 0.00 3600000.00000 FORMAT "%13.5" EXTENDED_LIMITS 0.00 42949672950.0 /end CHARACTERISTIC
/begin CHARACTERISTIC AOHt_uBattHigh_C "obere Grenze der Batteriespannung des Hysteresenelements" VALUE 0x1C628C Kw_Ws16 100009.6 Volt_Batt 0.00 100009.6 FORMAT "%8.1" EXTENDED_LIMITS -665674.1 665653.8 /end CHARACTERISTIC
/begin CHARACTERISTIC AOHt_uBattLow_C "untere Grenze der Batteriespannung des Hysteresenelements" VALUE 0x1C628E Kw_Ws16 100009.6 Volt_Batt 0.00 100009.6 FORMAT "%8.1" EXTENDED_LIMITS -665674.1 665653.8 /end CHARACTERISTIC
/begin CHARACTERISTIC APPCD_uAPP1_SRCMin_C "Spannung SRC-low" VALUE 0x1C62D0 Kw_Ws16 5200.391 Volt 0.00 5200.391 FORMAT "%8.3" EXTENDED_LIMITS -160156.4 160151.5 /end CHARACTERISTIC
/begin CHARACTERISTIC APPCD_uAPP1_SRCMax_C "Spannung SRC-high" VALUE 0x1C62D2 Kw_Ws16 5200.391 Volt 0.00 5200.391 FORMAT "%8.3" EXTENDED_LIMITS -160156.4 160151.5 /end CHARACTERISTIC
/begin CHARACTERISTIC APPCD_rLinAPP1_CUR "Linerisierungs-Kennlinie APP1" CURVE 0x1C62D4 Kl_Xs16_Ws16 100.0000 Prc 0.00 100.0000 FORMAT "%8.4" EXTENDED_LIMITS -327.6800 327.6700
 /begin AXIS_DESCR STD_AXIS APPCD_uRawAPP1 Volt 10 0.00 5200.391 FORMAT "%8.3" EXTENDED_LIMITS -160156.4 160151.5 DEPOSIT ABSOLUTE /end AXIS_DESCR
/end CHARACTERISTIC
/begin CHARACTERISTIC APPCD_uAPP2_SRCMin_C "Spannung SRC-low" VALUE 0x1C62FE Kw_Ws16 5200.391 Volt 0.00 5200.391 FORMAT "%8.3" EXTENDED_LIMITS -160156.4 160151.5 /end CHARACTERISTIC
/begin CHARACTERISTIC APPCD_uAPP2_SRCMax_C "Spannung SRC-high" VALUE 0x1C6300 Kw_Ws16 5200.391 Volt 0.00 5200.391 FORMAT "%8.3" EXTENDED_LIMITS -160156.4 160151.5 /end CHARACTERISTIC
/begin CHARACTERISTIC APPCD_rLinAPP2_CUR "Linerisierungs-Kennlinie APP2" CURVE 0x1C6302 Kl_Xs16_Ws16 100.0000 Prc 0.00 100.0000 FORMAT "%8.4" EXTENDED_LIMITS -327.6800 327.6700
 /begin AXIS_DESCR STD_AXIS APPCD_uRawAPP2 Volt 10 0.00 5200.391 FORMAT "%8.3" EXTENDED_LIMITS -160156.4 160151.5 DEPOSIT ABSOLUTE /end AXIS_DESCR
/end CHARACTERISTIC
/begin CHARACTERISTIC APPCD_DebPlaDef_C "Defektzeit Plausibilitätsfehler" VALUE 0x1C632C Kw_Wu16 655350.0 Time_ms 0.00 655350.0 FORMAT "%8.1" /end CHARACTERISTIC
/begin CHARACTERISTIC APPCD_DebPlaOk_C "Heilungszeit Plausibilitätsfehler" VALUE 0x1C632E Kw_Wu16 655350.0 Time_ms 0.00 655350.0 FORMAT "%8.1" /end CHARACTERISTIC
/begin CHARACTERISTIC APPCD_DebSRCHighDef_C "Defektzeit SRC-high" VALUE 0x1C6330 Kw_Wu16 655350.0 Time_ms 0.00 655350.0 FORMAT "%8.1" /end CHARACTERISTIC
/begin CHARACTERISTIC APPCD_DebSRCHighOk_C "Heilungszeit SRC-high" VALUE 0x1C6332 Kw_Wu16 655350.0 Time_ms 0.00 655350.0 FORMAT "%8.1" /end CHARACTERISTIC
/begin CHARACTERISTIC APPCD_DebSRCLowDef_C "Defektzeit SRC-low" VALUE 0x1C6334 Kw_Wu16 655350.0 Time_ms 0.00 655350.0 FORMAT "%8.1" /end CHARACTERISTIC
/begin CHARACTERISTIC APPCD_DebSRCLowOk_C "Heilungszeit SRC-low" VALUE 0x1C6336 Kw_Wu16 655350.0 Time_ms 0.00 655350.0 FORMAT "%8.1" /end CHARACTERISTIC
/begin CHARACTERISTIC APPCD_DebSyncDef_C "Entprellzeit Gleichlauffehler APP1/APP2" VALUE 0x1C6338 Kw_Wu16 655350.0 Time_ms 0.00 655350.0 FORMAT "%8.1" /end CHARACTERISTIC
/begin CHARACTERISTIC APPCD_DebSyncOk_C "Heilzeit Gleichlauffehler APP1/APP2" VALUE 0x1C633A Kw_Wu16 655350.0 Time_ms 0.00 655350.0 FORMAT "%8.1" READ_ONLY /end CHARACTERISTIC
/begin CHARACTERISTIC APPCD_dFac_C "CAN Umrechnungsfaktor fuer Fahrpedalwert" VALUE 0x1C63FC Kw_Ws16 1.000000 Can1 0.00 1.000000 FORMAT "%8.6" EXTENDED_LIMITS -3.276800 3.276700 /end CHARACTERISTIC
/begin CHARACTERISTIC APPCD_dGradFac_C "Skalierungsfaktor für den Pedalwert-Gradienten über CAN" VALUE 0x1C63FE Kw_Ws16 1.000000 Can1 0.00 1.000000 FORMAT "%8.6" EXTENDED_LIMITS -3.276800 3.276700 /end CHARACTERISTIC
/begin CHARACTERISTIC APPCD_dGradOff_C "Offset für die Umrechnung des Pedalgradienten über CAN" VALUE 0x1C6400 Kw_Ws16 255.0000 OneToOne 0.00 255.0000 FORMAT "%8.4" EXTENDED_LIMITS -32768.00 32767.00 /end CHARACTERISTIC
/begin CHARACTERISTIC APPCD_dOff_C "Offset fuer CAN Umrechnungsfaktor" VALUE 0x1C6402 Kw_Ws16 255.0000 OneToOne 0.00 255.0000 FORMAT "%8.4" EXTENDED_LIMITS -32768.00 32767.00 /end CHARACTERISTIC
/begin CHARACTERISTIC APPCD_duAPPJit_C "Groesse des Jitters der APP-Rohspannung der unterdrueckt wird" VALUE 0x1C633C Kw_Ws16 5200.391 Volt 0.00 5200.391 FORMAT "%8.3" EXTENDED_LIMITS -160156.4 160151.5 /end CHARACTERISTIC
/begin CHARACTERISTIC APPCD_facrAPP1APP2_C "Faktor zwischen den Rohspannungen APP1/APP2" VALUE 0x1C1624 Kw_Ws16 7.999878 Fact -4.000000 3.999878 FORMAT "%8.6" /end CHARACTERISTIC
/begin CHARACTERISTIC APPCD_tiLowNegPT1_C "Filterzeit low position, neg. Steig" VALUE 0x1C6340 Kw_Wu32 4294.9673 TimeDelay_s 0.0000010000000 4294.9673 FORMAT "%9.4" /end CHARACTERISTIC
/begin CHARACTERISTIC APPCD_tiLowPosPT1_C "Filterzeit low position, pos. Steig." VALUE 0x1C6344 Kw_Wu32 4294.9673 TimeDelay_s 0.0000010000000 4294.9673 FORMAT "%9.4" /end CHARACTERISTIC
/begin CHARACTERISTIC APPCD_tiMidNegPT1_C "Filterzeit mid. position, neg. Steig." VALUE 0x1C6348 Kw_Wu32 4294.9673 TimeDelay_s 0.0000010000000 4294.9673 FORMAT "%9.4" /end CHARACTERISTIC
/begin CHARACTERISTIC APPCD_tiMidPosPT1_C "Filterzeit mid. position, pos. Steig." VALUE 0x1C634C Kw_Wu32 4294.9673 TimeDelay_s 0.0000010000000 4294.9673 FORMAT "%9.4" /end CHARACTERISTIC
/begin CHARACTERISTIC APPCD_tiUppNegPT1_C "Filterzeit upper position, neg. Steig." VALUE 0x1C6350 Kw_Wu32 4294.9673 TimeDelay_s 0.0000010000000 4294.9673 FORMAT "%9.4" /end CHARACTERISTIC
/begin CHARACTERISTIC APPCD_tiUppPosPT1_C "Filterzeit upper position, pos. Steig.:" VALUE 0x1C6354 Kw_Wu32 4294.9673 TimeDelay_s 0.0000010000000 4294.9673 FORMAT "%9.4" /end CHARACTERISTIC
/begin CHARACTERISTIC APPCD_swtNoFlt_C "Schalter für Filter AUS bei betätigter Kupplung (0 = Filter ein bei betätigter Kupplung, 1 = Filter aus bei betätigter Kupplung)" VALUE 0x1C6358 Kw_Wu8 1.000 OneToOne 0.00 1.000 FORMAT "%5.3" EXTENDED_LIMITS 0.00 255.0 /end CHARACTERISTIC
/begin CHARACTERISTIC APPCD_rThrFltLowPos_C "Schwelle Filterzeit low position, pos. Steig." VALUE 0x1C635A Kw_Ws16 100.0000 Prc 0.00 100.0000 FORMAT "%8.4" EXTENDED_LIMITS -327.6800 327.6700 /end CHARACTERISTIC
/begin CHARACTERISTIC APPCD_rThrFltMidPos_C "APPSchwelle Filterzeit mid. position, pos. Steig." VALUE 0x1C635C Kw_Ws16 100.0000 Prc 0.00 100.0000 FORMAT "%8.4" EXTENDED_LIMITS -327.6800 327.6700 /end CHARACTERISTIC
/begin CHARACTERISTIC APPCD_rThrFltLowNeg_C "Schwelle Filterzeit low position, neg. Steig." VALUE 0x1C635E Kw_Ws16 100.0000 Prc 0.00 100.0000 FORMAT "%8.4" EXTENDED_LIMITS -327.6800 327.6700 /end CHARACTERISTIC
/begin CHARACTERISTIC APPCD_rThrFltMidNeg_C "Schwelle Filterzeit mid position, neg. Steig." VALUE 0x1C6360 Kw_Ws16 100.0000 Prc 0.00 100.0000 FORMAT "%8.4" EXTENDED_LIMITS -327.6800 327.6700 /end CHARACTERISTIC
/begin CHARACTERISTIC APPCD_drHealRmpUp_C "Heilung pos. Rampe" VALUE 0x1C6364 Kw_Wu32 5000.00000000 RmpPrc 0.00 5000.00000000 FORMAT "%13.8" EXTENDED_LIMITS 0.00 655359.999847 /end CHARACTERISTIC
/begin CHARACTERISTIC APPCD_drHealRmpDwn_C "Heilung neg. Rampe" VALUE 0x1C6368 Kw_Wu32 5000.00000000 RmpPrc 0.00 5000.00000000 FORMAT "%13.8" EXTENDED_LIMITS 0.00 655359.999847 /end CHARACTERISTIC
/begin CHARACTERISTIC APPCD_uKickDownXLow_C "unterer Hys.-Kick-Down-Spg.-Schwelle" VALUE 0x1C636C Kw_Ws16 5200.391 Volt 0.00 5200.391 FORMAT "%8.3" EXTENDED_LIMITS -160156.4 160151.5 /end CHARACTERISTIC
/begin CHARACTERISTIC APPCD_uKickDownXHigh_C "obere Hys.-Kick-Down-Spg.-Schwelle" VALUE 0x1C636E Kw_Ws16 5200.391 Volt 0.00 5200.391 FORMAT "%8.3" EXTENDED_LIMITS -160156.4 160151.5 /end CHARACTERISTIC
/begin CHARACTERISTIC APPCD_stKickDownYLow_C "Hys.-Ausgang untere Spg.Schwelle" VALUE 0x1C6370 Kw_Ws16 0.00 OneToOne 0.00 0.00 FORMAT "%8.2" EXTENDED_LIMITS -32768.00 32767.00 /end CHARACTERISTIC
/begin CHARACTERISTIC APPCD_stKickDownYHigh_C "Hys.-Ausgang obere Spg.Schwelle" VALUE 0x1C6372 Kw_Ws16 0.00 OneToOne 1.000000 1.000000 FORMAT "%8.6" EXTENDED_LIMITS -32768.00 32767.00 /end CHARACTERISTIC
/begin CHARACTERISTIC APPCD_uLowIdlSwtSRCMin_C "Leergasschalter SRC-Umin" VALUE 0x1C6374 Kw_Ws16 5200.391 Volt 0.00 5200.391 FORMAT "%8.3" EXTENDED_LIMITS -160156.4 160151.5 /end CHARACTERISTIC
/begin CHARACTERISTIC APPCD_uLowIdlSwtSRCMax_C "Leergasschalter SRC-Umax" VALUE 0x1C6376 Kw_Ws16 5200.391 Volt 0.00 5200.391 FORMAT "%8.3" EXTENDED_LIMITS -160156.4 160151.5 /end CHARACTERISTIC
/begin CHARACTERISTIC APPCD_uLowIdlSwtLin_CUR "Leergasschalter Linearisierung" CURVE 0x1C6378 Kl_Xs16_Ws16 5200.391 Volt 0.00 5200.391 FORMAT "%8.3" EXTENDED_LIMITS -160156.4 160151.5
 /begin AXIS_DESCR STD_AXIS APPCD_uLowIdlSwtRawVal Volt 3 0.00 5200.391 FORMAT "%8.3" EXTENDED_LIMITS -160156.4 160151.5 DEPOSIT ABSOLUTE /end AXIS_DESCR
/end CHARACTERISTIC
/begin CHARACTERISTIC APPCD_numAdcAPP1_C "Applikationsparameter  fuer den Fahrpedal 1 position -Fuehler" VALUE 0x1C6386 Kw_Wu8 74.0000000000 NumPinAdc 0.00 74.0000000000 FORMAT "%13.10" /end CHARACTERISTIC
/begin CHARACTERISTIC APPCD_numAdcAPP2_C "Applikationsparameter  fuer den Fahrpedal 2 position -Fuehler" VALUE 0x1C6387 Kw_Wu8 74.0000000000 NumPinAdc 0.00 74.0000000000 FORMAT "%13.10" /end CHARACTERISTIC
/begin CHARACTERISTIC APPCD_rPlaWinLowIdleXLow_C "untere Hys.-Schwelle Plaus-Win. (Leerlauf):" VALUE 0x1C6388 Kw_Ws16 100.0000 Prc 0.00 100.0000 FORMAT "%8.4" EXTENDED_LIMITS -327.6800 327.6700 /end CHARACTERISTIC
/begin CHARACTERISTIC APPCD_rPlaWinLowIdleXHigh_C "obere Hys.-Schwelle Plaus-Win. (Leerlauf)" VALUE 0x1C638A Kw_Ws16 100.0000 Prc 0.00 100.0000 FORMAT "%8.4" EXTENDED_LIMITS -327.6800 327.6700 /end CHARACTERISTIC
/begin CHARACTERISTIC APPCD_stPlaWinLowIdleYLow_C "unterer Hys.-Ausgang (Leerlauf)" VALUE 0x1C638C Kw_Ws16 0.00 OneToOne 0.00 0.00 FORMAT "%8.2" EXTENDED_LIMITS -32768.00 32767.00 /end CHARACTERISTIC
/begin CHARACTERISTIC APPCD_stPlaWinLowIdleYHigh_C "oberer Hys.-Ausgang (Leerlauf)" VALUE 0x1C638E Kw_Ws16 0.00 OneToOne 1.000000 1.000000 FORMAT "%8.6" EXTENDED_LIMITS -32768.00 32767.00 /end CHARACTERISTIC
/begin CHARACTERISTIC APPCD_rPlaWinParLoadXLow_C "untere Hys.-Schwelle Plaus-Win. (Teillast)" VALUE 0x1C6390 Kw_Ws16 100.0000 Prc 0.00 100.0000 FORMAT "%8.4" EXTENDED_LIMITS -327.6800 327.6700 /end CHARACTERISTIC
/begin CHARACTERISTIC APPCD_rPlaWinParLoadXHigh_C "obere Hys.-Schwelle Plaus-Win. (Teillast)" VALUE 0x1C6392 Kw_Ws16 100.0000 Prc 0.00 100.0000 FORMAT "%8.4" EXTENDED_LIMITS -327.6800 327.6700 /end CHARACTERISTIC
/begin CHARACTERISTIC APPCD_stPlaWinParLoadYLow_C "unterer Hys.-Ausgang (Teillast)" VALUE 0x1C6394 Kw_Ws16 0.00 OneToOne 0.00 0.00 FORMAT "%8.2" EXTENDED_LIMITS -32768.00 32767.00 /end CHARACTERISTIC
/begin CHARACTERISTIC APPCD_stPlaWinParLoadYHigh_C "oberer Hys.-Ausgang (Teillast)" VALUE 0x1C6396 Kw_Ws16 0.00 OneToOne 1.000000 1.000000 FORMAT "%8.6" EXTENDED_LIMITS -32768.00 32767.00 /end CHARACTERISTIC
/begin CHARACTERISTIC APPCD_uPlaWinIdle_C "Plaus.-Window Leerlauf" VALUE 0x1C6398 Kw_Ws16 5200.391 Volt 0.00 5200.391 FORMAT "%8.3" EXTENDED_LIMITS -160156.4 160151.5 /end CHARACTERISTIC
/begin CHARACTERISTIC APPCD_uPlaWinPar_C "Plaus.-Window Teillast" VALUE 0x1C639A Kw_Ws16 5200.391 Volt 0.00 5200.391 FORMAT "%8.3" EXTENDED_LIMITS -160156.4 160151.5 /end CHARACTERISTIC
/begin CHARACTERISTIC APPCD_uPlaWinFull_C "Plaus.-Window Vollast" VALUE 0x1C639C Kw_Ws16 5200.391 Volt 0.00 5200.391 FORMAT "%8.3" EXTENDED_LIMITS -160156.4 160151.5 /end CHARACTERISTIC
/begin CHARACTERISTIC APPCD_duLimErrPos_C "Rampensteigung der Rohspannung PWG" VALUE 0x1C63A0 Kw_Wu32 320312805.400 RmpVoltSens 0.00 320312805.400 FORMAT "%13.3" /end CHARACTERISTIC
/begin CHARACTERISTIC APPCD_duLimErrNeg_C "Rampensteigung der Rohspannung PWG" VALUE 0x1C63A4 Kw_Wu32 320312805.400 RmpVoltSens 0.00 320312805.400 FORMAT "%13.3" READ_ONLY /end CHARACTERISTIC
/begin CHARACTERISTIC APPCD_rKickDownErrThres_C "Pedalwertschwelle für die Kick Down Fehlerdektion" VALUE 0x1C63A8 Kw_Ws16 100.0000 Prc 0.00 100.0000 FORMAT "%8.4" EXTENDED_LIMITS -327.6800 327.6700 /end CHARACTERISTIC
/begin CHARACTERISTIC APPCD_rKickDownlrnThres_C "schwellwert des zu startenden kickdown-lernens" VALUE 0x1C63AA Kw_Ws16 100.0000 Prc 0.00 100.0000 FORMAT "%8.4" EXTENDED_LIMITS -327.6800 327.6700 /end CHARACTERISTIC
/begin CHARACTERISTIC APPCD_rLinAPP_CUR "Linearisierungskennline für APP" CURVE 0x1C63AC Kl_Xs16_Ws16 100.0000 Prc 0.00 100.0000 FORMAT "%8.4" EXTENDED_LIMITS -327.6800 327.6700
 /begin AXIS_DESCR STD_AXIS APPCD_uRaw_mp Volt 2 0.00 5200.391 FORMAT "%8.3" EXTENDED_LIMITS -160156.4 160151.5 DEPOSIT ABSOLUTE /end AXIS_DESCR
/end CHARACTERISTIC
/begin CHARACTERISTIC APPCD_SSpMonAPP1_C "Auswahl der Sensor-Versorgungs-Spannung für APP1" VALUE 0x1C63B6 Kw_Wu8 2.000 OneToOne 1.000 3.000 FORMAT "%5.3" EXTENDED_LIMITS 0.00 255.0 /end CHARACTERISTIC
/begin CHARACTERISTIC APPCD_SSpMonAPP2_C "Auswahl der Sensor-Versorgungs-Spannung für APP2" VALUE 0x1C63B7 Kw_Wu8 2.000 OneToOne 1.000 3.000 FORMAT "%5.3" EXTENDED_LIMITS 0.00 255.0 /end CHARACTERISTIC
/begin CHARACTERISTIC APPCD_stActvPlausAPP_C "Aktivierung der Plausbilitaetspruefung" VALUE 0x1C63B8 Kw_Wu8 1.000 OneToOne 0.00 1.000 FORMAT "%5.3" EXTENDED_LIMITS 0.00 255.0 /end CHARACTERISTIC
/begin CHARACTERISTIC APPCD_stDigInInvKickDown_C "Invertierung des Eingangsignals" VALUE 0x1C63B9 Kw_Wu8 1.000 OneToOne 0.00 1.000 FORMAT "%5.3" EXTENDED_LIMITS 0.00 255.0 /end CHARACTERISTIC
/begin CHARACTERISTIC APPCD_stLowIdlSwtInvIn_C "Invertiertes Eingangssignal" VALUE 0x1C63BA Kw_Wu8 1.000 OneToOne 0.00 1.000 FORMAT "%5.3" EXTENDED_LIMITS 0.00 255.0 /end CHARACTERISTIC
/begin CHARACTERISTIC APPCD_swtDigInPresent_C "Schalter zur Deaktivierung des digitalen Eingangs von APPCD" VALUE 0x1C63BB Kw_Wu8 1.000 OneToOne 0.00 1.000 FORMAT "%5.3" EXTENDED_LIMITS 0.00 255.0 /end CHARACTERISTIC
/begin CHARACTERISTIC APPCD_swtEnaUnJit_C "Schalter zur Aktivierung der Entjitterung" VALUE 0x1C63BC Kw_Wu8 1.000 OneToOne 0.00 1.000 FORMAT "%5.3" EXTENDED_LIMITS 0.00 255.0 /end CHARACTERISTIC
/begin CHARACTERISTIC APPCD_swtKickDownHighAPP_C "Schalter zur Auswahl der Kick-Down-Spannungsschwelle" VALUE 0x1C63BD Kw_Wu8 1.000 OneToOne 0.00 1.000 FORMAT "%5.3" EXTENDED_LIMITS 0.00 255.0 /end CHARACTERISTIC
/begin CHARACTERISTIC APPCD_swtTypeVal_C "Auswahl zwischen Doppelanalog- und Poti/Schalter-PWG" VALUE 0x1C63BE Kw_Wu8 2.000 OneToOne 0.00 2.000 FORMAT "%5.3" EXTENDED_LIMITS 0.00 255.0 /end CHARACTERISTIC
/begin CHARACTERISTIC APPCD_swtTypeType_C "Auswahl zwischen Doppelanalog- und Poti/Schalter-PWG" VALUE 0x1C63BF Kw_Wu8 0.00 OneToOne 2.000 2.000 FORMAT "%5.3" EXTENDED_LIMITS 0.00 255.0 /end CHARACTERISTIC
/begin CHARACTERISTIC APPCD_tiDebKickDownDef_C "Fehlerentprellzeit für Dfp_APPCD_KickDown_mp" VALUE 0x1C63C0 Kw_Wu16 655350.0 Time_ms 0.00 655350.0 FORMAT "%8.1" /end CHARACTERISTIC
/begin CHARACTERISTIC APPCD_tiDebKickDownOk_C "Fehlerheilzeit für  Dfp_APPCD_KickDown_mp" VALUE 0x1C63C2 Kw_Wu16 655350.0 Time_ms 0.00 655350.0 FORMAT "%8.1" /end CHARACTERISTIC
/begin CHARACTERISTIC APPCD_tiKickDownlrnTimeout_C "Lernfunktionsdauer" VALUE 0x1C63C4 Kw_Wu16 655140.0 Time_ms 0.00 655140.0 FORMAT "%8.1" EXTENDED_LIMITS 0.00 655350.0 /end CHARACTERISTIC
/begin CHARACTERISTIC APPCD_tiKickDownSwtDebNeg_C "Entprellwert für neg. Steigung" VALUE 0x1C63C6 Kw_Wu16 655350.0 TimeDeb 0.00 655350.0 FORMAT "%8.1" /end CHARACTERISTIC
/begin CHARACTERISTIC APPCD_tiKickDownSwtDebPos_C "Entprellwert für pos. Steigung" VALUE 0x1C63C8 Kw_Wu16 655350.0 TimeDeb 0.00 655350.0 FORMAT "%8.1" /end CHARACTERISTIC
/begin CHARACTERISTIC APPCD_tiKickDownTolcLim_C "Toleranzzeitdauer für Kickdown-Lernwert gültig" VALUE 0x1C63CA Kw_Wu16 655140.0 Time_ms 0.00 655140.0 FORMAT "%8.1" EXTENDED_LIMITS 0.00 655350.0 /end CHARACTERISTIC
/begin CHARACTERISTIC APPCD_uAPPMin_C "Ersatzwert für APP-Rohspannung bei Defekt beider Geber" VALUE 0x1C63CC Kw_Ws16 5200.391 Volt 0.00 5200.391 FORMAT "%8.3" EXTENDED_LIMITS -160156.4 160151.5 /end CHARACTERISTIC
/begin CHARACTERISTIC APPCD_uHighLimLowIdle_C "Obere Grenze für plausible Leergasstellung" VALUE 0x1C63CE Kw_Ws16 5200.391 Volt 0.00 5200.391 FORMAT "%8.3" EXTENDED_LIMITS -160156.4 160151.5 /end CHARACTERISTIC
/begin CHARACTERISTIC APPCD_uKickDownCorrVal_C "Zu applizierender Korrekturwert für gelernten Kick-Down-Wert" VALUE 0x1C63D0 Kw_Ws16 1999.022 Volt 0.00 1999.022 FORMAT "%8.3" EXTENDED_LIMITS -160156.4 160151.5 /end CHARACTERISTIC
/begin CHARACTERISTIC APPCD_uKickDownHighAPP_C "obere Hys.-Kick-Down-Spg.-Schwelle für APP" VALUE 0x1C63D2 Kw_Ws16 5200.391 Volt 0.00 5200.391 FORMAT "%8.3" EXTENDED_LIMITS -160156.4 160151.5 /end CHARACTERISTIC
/begin CHARACTERISTIC APPCD_uKickDownLowAPP_C "untere Hys.-Kick-Down-Spg.-Schwelle für APP" VALUE 0x1C63D4 Kw_Ws16 5200.391 Volt 0.00 5200.391 FORMAT "%8.3" EXTENDED_LIMITS -160156.4 160151.5 /end CHARACTERISTIC
/begin CHARACTERISTIC APPCD_uKickDownThresDfl_C "Kickdown-Vorgabeschwellwert im Kickdown-Lernfehlerfall" VALUE 0x1C63D6 Kw_Ws16 5200.391 Volt 0.00 5200.391 FORMAT "%8.3" EXTENDED_LIMITS -160156.4 160151.5 /end CHARACTERISTIC
/begin CHARACTERISTIC APPCD_uKickDownTolcLim_C "Toleranzwert von APP1 während Kickdown-Lernens" VALUE 0x1C63D8 Kw_Ws16 5200.391 Volt 0.00 5200.391 FORMAT "%8.3" EXTENDED_LIMITS -160156.4 160151.5 /end CHARACTERISTIC
/begin CHARACTERISTIC APPCD_uLowIdlSwtA2DThres_C "Schwellwert für die Leergasschaltung ein/aus" VALUE 0x1C63DA Kw_Ws16 5200.391 Volt 0.00 5200.391 FORMAT "%8.3" EXTENDED_LIMITS -160156.4 160151.5 /end CHARACTERISTIC
/begin CHARACTERISTIC APPCD_uLowLimLowIdle_C "Untere Grenze für plausible Leergasstellung" VALUE 0x1C63DC Kw_Ws16 5200.391 Volt 0.00 5200.391 FORMAT "%8.3" EXTENDED_LIMITS -160156.4 160151.5 /end CHARACTERISTIC
/begin CHARACTERISTIC APPCD_uMinSync_C "Minimale Rohspannung zur Freigabe der Gleichlaufprüfung" VALUE 0x1C63DE Kw_Ws16 5200.391 Volt 0.00 5200.391 FORMAT "%8.3" EXTENDED_LIMITS -160156.4 160151.5 /end CHARACTERISTIC
/begin CHARACTERISTIC APPCD_uRawAPP2dOff_C "Offset für APP2-Rohspannung" VALUE 0x1C63E0 Kw_Ws16 498.5337 Volt 0.00 498.5337 FORMAT "%8.4" EXTENDED_LIMITS -160156.4 160151.5 /end CHARACTERISTIC
/begin CHARACTERISTIC APPCD_uSync_CUR "Kennlinie zur Bestimmung der maximal zulaessigen Abweichung APP1/APP2" CURVE 0x1C63E2 Kl_Xs16_Ws16 5200.391 Volt 0.00 5200.391 FORMAT "%8.3" EXTENDED_LIMITS -160156.4 160151.5
 /begin AXIS_DESCR STD_AXIS APPCD_uRawAPP1 Volt 5 0.00 5200.391 FORMAT "%8.3" EXTENDED_LIMITS -160156.4 160151.5 DEPOSIT ABSOLUTE /end AXIS_DESCR
/end CHARACTERISTIC
/begin CHARACTERISTIC APPCD_vDflMin_C "Minimum-Schwelle für die Geschwindigkeitserfassung" VALUE 0x1C63F8 Kw_Ws16 20.00000 Vel 0.00 20.00000 FORMAT "%8.5" EXTENDED_LIMITS -327.6800 327.6700 /end CHARACTERISTIC
/begin CHARACTERISTIC APSCD_uSRCMin_C "Atmosphaerendruckfuehler SRC-Min Fehlerschwelle" VALUE 0x1C6404 Kw_Ws16 5200.391 Volt 0.00 5200.391 FORMAT "%8.3" EXTENDED_LIMITS -160156.4 160151.5 /end CHARACTERISTIC
/begin CHARACTERISTIC APSCD_uSRCMax_C "Atmosphaerendruckfuehler SRC-Max Fehlerschwelle" VALUE 0x1C6406 Kw_Ws16 5200.391 Volt 0.00 5200.391 FORMAT "%8.3" EXTENDED_LIMITS -160156.4 160151.5 /end CHARACTERISTIC
/begin CHARACTERISTIC APSCD_pLin_CUR "Atmosphaerendruck Liniarisierungskennlinie" CURVE 0x1C6408 Kl_Xs16_Ws16 3500.000 Pres_hPa 0.00 3500.000 FORMAT "%8.3" EXTENDED_LIMITS -32768.00 32767.00
 /begin AXIS_DESCR STD_AXIS APSCD_uRaw Volt 25 0.00 5000.000 FORMAT "%8.3" EXTENDED_LIMITS -160156.4 160151.5 DEPOSIT ABSOLUTE /end AXIS_DESCR
/end CHARACTERISTIC
/begin CHARACTERISTIC APSCD_DebSigDef_C "Entprellzeit defekt für ungültiges CAN-Signal für Atmosphärendruck" VALUE 0x1C646E Kw_Wu16 655350.0 Time_ms 0.00 655350.0 FORMAT "%8.1" /end CHARACTERISTIC
/begin CHARACTERISTIC APSCD_DebSigOk_C "Heilungsentprellzeit für ungültiges CAN-Signal Atmosphärendruck" VALUE 0x1C6470 Kw_Wu16 655350.0 Time_ms 0.00 655350.0 FORMAT "%8.1" /end CHARACTERISTIC
/begin CHARACTERISTIC APSCD_DebSRCDef_C "Entprellzeit fuer SRC Defektzeit" VALUE 0x1C6472 Kw_Wu16 655350.0 Time_ms 0.00 655350.0 FORMAT "%8.1" /end CHARACTERISTIC
/begin CHARACTERISTIC APSCD_DebSRCOk_C "Entprellzeit fuer SRC-Heilzeit" VALUE 0x1C6474 Kw_Wu16 655350.0 Time_ms 0.00 655350.0 FORMAT "%8.1" /end CHARACTERISTIC
/begin CHARACTERISTIC APSCD_nLimHigh_C "obere Drehzahlgrenze zur Berechnung des Luftdrucks aus dem Ladedruck" VALUE 0x1C6476 Kw_Ws16 6000.000 EngN 0.00 6000.000 FORMAT "%8.3" EXTENDED_LIMITS -32768.00 32767.00 /end CHARACTERISTIC
/begin CHARACTERISTIC APSCD_pCor_MAP "Atmosphaerendruck Korrekturkennfeld (Drehzahlabhaengig)" MAP 0x1C6478 Kf_Xs16_Ys16_Ws16 7000.000 Pres_hPa -3500.000 3500.000 FORMAT "%8.3" EXTENDED_LIMITS -32768.00 32767.00
 /begin AXIS_DESCR STD_AXIS Eng_nAvrg EngN 10 0.00 6000.000 FORMAT "%8.3" EXTENDED_LIMITS -32768.00 32767.00 DEPOSIT ABSOLUTE /end AXIS_DESCR
 /begin AXIS_DESCR STD_AXIS Eng_dnAvrg dn_dZ20 10 -6000.000 6000.000 FORMAT "%8.3" EXTENDED_LIMITS -327680.0 327670.0 DEPOSIT ABSOLUTE /end AXIS_DESCR
/end CHARACTERISTIC
/begin CHARACTERISTIC APSCD_dpRmpSlpUp_C "positive Atmosphaerendruck - Rampensteigung" VALUE 0x1C656C Kw_Wu32 65535999.9847 RmpPres_hPa 0.00 65535999.9847 FORMAT "%13.4" /end CHARACTERISTIC
/begin CHARACTERISTIC APSCD_dpRmpSlpDwn_C "negative Atmosphaerendruck - Rampensteigung" VALUE 0x1C6570 Kw_Wu32 65535999.9847 RmpPres_hPa 0.00 65535999.9847 FORMAT "%13.4" /end CHARACTERISTIC
/begin CHARACTERISTIC APSCD_swtInst_C "Atmosphaerendruck Funktionsschalter (verbaut? -  ja/nein)" VALUE 0x1C6574 Kw_Wu8 1.000 OneToOne 0.00 1.000 FORMAT "%5.3" EXTENDED_LIMITS 0.00 255.0 /end CHARACTERISTIC
/begin CHARACTERISTIC APSCD_swtSigVal_C "Schalter zur Umschaltung der Signalquelle ADC/CAN" VALUE 0x1C6575 Kw_Wu8 1.000 OneToOne 0.00 1.000 FORMAT "%5.3" EXTENDED_LIMITS 0.00 255.0 /end CHARACTERISTIC
/begin CHARACTERISTIC APSCD_swtSrcpVal_C "Schalter ob APSCD_pVal aus Ladedruck berechnet wird (1) oder nicht (0)" VALUE 0x1C6576 Kw_Wu8 1.000 OneToOne 0.00 1.000 FORMAT "%5.3" EXTENDED_LIMITS 0.00 255.0 /end CHARACTERISTIC
/begin CHARACTERISTIC APSCD_tiDel_C "Atmosphaerendruck Verzögerungszeit bis Berechnung von Ladedruck beginnt" VALUE 0x1C6578 Kw_Wu16 655350.0 Time_ms 0.00 655350.0 FORMAT "%8.1" /end CHARACTERISTIC
/begin CHARACTERISTIC APSCD_stSensIDWord_C "Atmosphaerendruck Geberkennwort" VALUE 0x1C657A Kw_Wu16 65535.00 OneToOne 0.00 65535.00 FORMAT "%8.2" /end CHARACTERISTIC
/begin CHARACTERISTIC APSCD_pDfl_C "Atmosphaerendruck Vorgabewert" VALUE 0x1C657C Kw_Ws16 3500.000 Pres_hPa 0.00 3500.000 FORMAT "%8.3" EXTENDED_LIMITS -32768.00 32767.00 /end CHARACTERISTIC
/begin CHARACTERISTIC ARnMon_stInvIn_C "Eingangssignal der KL15 invertieren" VALUE 0x1C6580 Kw_Wu8 1.000 OneToOne 0.00 1.000 FORMAT "%5.3" EXTENDED_LIMITS 0.00 255.0 READ_ONLY /end CHARACTERISTIC
/begin CHARACTERISTIC ARnMon_stInvOut_C "Ausgangssignal für Selbsthaltung des HR invertieren" VALUE 0x1C6581 Kw_Wu8 1.000 OneToOne 0.00 1.000 FORMAT "%5.3" EXTENDED_LIMITS 0.00 255.0 READ_ONLY /end CHARACTERISTIC
/begin CHARACTERISTIC ARnMon_tiARnMax_C "Zeitdauer des erlaubten Nachlaufs" VALUE 0x1C6584 Kw_Wu32 42949672950.0 Time_ms 0.00 42949672950.0 FORMAT "%13.1" READ_ONLY /end CHARACTERISTIC
/begin CHARACTERISTIC ASDdc_T1Clu_C "ARD Störungsregler T1, ausgekuppelt" VALUE 0x1C6588 Kw_Wr32 1.50000000 ASD_GvrnDT1T1_float 0.00 1.50000000 FORMAT "%10.8" EXTENDED_LIMITS -1.00000000E+37 1.00000000E+37 /end CHARACTERISTIC
/begin CHARACTERISTIC ASDdc_KdClu_C "ARD Störungsregler Kd=sqrt(Td)/T1, ausgekuppelt" VALUE 0x1C658C Kw_Wr32 5.00000000 ASD_GvrnDT1Kd_float 0.00 5.00000000 FORMAT "%10.8" EXTENDED_LIMITS -1.00000000E+37 1.00000000E+37 /end CHARACTERISTIC
/begin CHARACTERISTIC ASDdc_dAccPedThres_C "Pedalwertgeber Schwelle" VALUE 0x1C6590 Kw_Ws16 100.0000 Prc 0.00 100.0000 FORMAT "%8.4" EXTENDED_LIMITS -327.6800 327.6700 /end CHARACTERISTIC
/begin CHARACTERISTIC ASDdc_dActGearFac_CUR "Kennlinie mit Faktoren für Turbinendrehzahlberechung" CURVE 0x1C6592 Kl_Xs16_Ws16 1.000000 VelToN 0.00 1.000000 FORMAT "%8.6" EXTENDED_LIMITS -0.3276800 0.3276700
 /begin AXIS_DESCR STD_AXIS ASDdc_stActGear_mp OneToOne 6 0.00 6.000 FORMAT "%5.3" EXTENDED_LIMITS -128.0 127.0 DEPOSIT ABSOLUTE /end AXIS_DESCR
/end CHARACTERISTIC
/begin CHARACTERISTIC ASDdc_dConvClthThres_C "Wandlerkupplungszustand Schwelle" VALUE 0x1C65AC Kw_Wu8 3.000 OneToOne 0.00 3.000 FORMAT "%5.3" EXTENDED_LIMITS 0.00 255.0 /end CHARACTERISTIC
/begin CHARACTERISTIC ASDdc_tiDT1TrqDyn_C "Zeitkonstante für DT1 Element" VALUE 0x1C65B0 Kw_Wu32 4294.9673 TimeDelay_s 0.0000010000000 4294.9673 FORMAT "%9.4" /end CHARACTERISTIC
/begin CHARACTERISTIC ASDdc_dDT1TrqDynfact_C "Verstärkung für DT1 Element" VALUE 0x1C65B4 Kw_Ws32 1.00000000000 Kd 0.00 1.00000000000 FORMAT "%13.11" EXTENDED_LIMITS -32768.0000000 32767.9999847 /end CHARACTERISTIC
/begin CHARACTERISTIC ASDdc_dFacNHiDwn_C "Rampenparameter für oberen Drehzahlbereich" VALUE 0x1C65B8 Kw_Wu32 1000.00000000 Rmp_Fact16 0.00 1000.00000000 FORMAT "%13.8" EXTENDED_LIMITS 0.00 1023999.99976 /end CHARACTERISTIC
/begin CHARACTERISTIC ASDdc_dFacNLoDwn_C "Rampenparameter für unteren Drehzahlbereich" VALUE 0x1C65BC Kw_Wu32 1000.00000000 Rmp_Fact16 0.00 1000.00000000 FORMAT "%13.8" EXTENDED_LIMITS 0.00 1023999.99976 /end CHARACTERISTIC
/begin CHARACTERISTIC ASDdc_dfacRmp_CUR "Steilheit der Factorrampe für Abschaltung des ASDdc im Schubfall" CURVE 0x1C65C0 Kl_Xs16_Ws16 7.479906 Rmp_Fact16 0.02002716 7.499933 FORMAT "%8.6" EXTENDED_LIMITS -7.812500 7.812262
 /begin AXIS_DESCR STD_AXIS DrvTrn_rTransDT TransR 6 0.00 100.0000 FORMAT "%8.4" EXTENDED_LIMITS -327.6800 327.6700 DEPOSIT ABSOLUTE /end AXIS_DESCR
/end CHARACTERISTIC
/begin CHARACTERISTIC ASDdc_dnAvrgLtdExitNeg_CUR "Abbruchbedingung negativer Lastschlag der abgeleiteten mittleren Motordrehzahl" CURVE 0x1C65DA Kl_Xs16_Ws16 12000.00 rev_acc -6000.000 6000.000 FORMAT "%8.3" EXTENDED_LIMITS -32768.00 32767.00
 /begin AXIS_DESCR STD_AXIS ASDdc_stActGear_mp OneToOne 6 0.00 6.000 FORMAT "%5.3" EXTENDED_LIMITS -128.0 127.0 DEPOSIT ABSOLUTE /end AXIS_DESCR
/end CHARACTERISTIC
/begin CHARACTERISTIC ASDdc_dnAvrgLtdExitPos_CUR "Limit fuer Drehzahlgardient fuer Abbruch positiver Lastfall" CURVE 0x1C65F4 Kl_Xs16_Ws16 12000.00 rev_acc -6000.000 6000.000 FORMAT "%8.3" EXTENDED_LIMITS -32768.00 32767.00
 /begin AXIS_DESCR STD_AXIS ASDdc_stActGear_mp OneToOne 6 0.00 6.000 FORMAT "%5.3" EXTENDED_LIMITS -128.0 127.0 DEPOSIT ABSOLUTE /end AXIS_DESCR
/end CHARACTERISTIC
/begin CHARACTERISTIC ASDdc_dnAvrgLtdNeg_CUR "Drehzahlgradientenschwelle für negativen Lastwechsel" CURVE 0x1C660E Kl_Xs16_Ws16 12000.00 rev_acc -6000.000 6000.000 FORMAT "%8.3" EXTENDED_LIMITS -32768.00 32767.00
 /begin AXIS_DESCR STD_AXIS ASDdc_stActGear_mp OneToOne 6 0.00 6.000 FORMAT "%5.3" EXTENDED_LIMITS -128.0 127.0 DEPOSIT ABSOLUTE /end AXIS_DESCR
/end CHARACTERISTIC
/begin CHARACTERISTIC ASDdc_dnAvrgLtdPos_CUR "Drehzahlgradientenschwelle für positiven Lastwechsel" CURVE 0x1C6628 Kl_Xs16_Ws16 12000.00 rev_acc -6000.000 6000.000 FORMAT "%8.3" EXTENDED_LIMITS -32768.00 32767.00
 /begin AXIS_DESCR STD_AXIS ASDdc_stActGear_mp OneToOne 6 0.00 6.000 FORMAT "%5.3" EXTENDED_LIMITS -128.0 127.0 DEPOSIT ABSOLUTE /end AXIS_DESCR
/end CHARACTERISTIC
/begin CHARACTERISTIC ASDdc_dnIntegLtdNeg_CUR "Limit fuer Drehzahlintegral fuer Abbruch im negativen Lastfall" CURVE 0x1C6642 Kl_Xs16_Ws16 2000.000 OneToOne -1000.000 1000.000 FORMAT "%8.3" EXTENDED_LIMITS -32768.00 32767.00
 /begin AXIS_DESCR STD_AXIS ASDdc_stActGear_mp OneToOne 6 0.00 6.000 FORMAT "%5.3" EXTENDED_LIMITS -128.0 127.0 DEPOSIT ABSOLUTE /end AXIS_DESCR
/end CHARACTERISTIC
/begin CHARACTERISTIC ASDdc_dnIntegLtdPos_MAP "Limit für Drehzahlintegral für Abbruch im positiven Lastschlag" MAP 0x1C665C Kf_Xs16_Ys16_Ws16 2000.000 OneToOne -1000.000 1000.000 FORMAT "%8.3" EXTENDED_LIMITS -32768.00 32767.00
 /begin AXIS_DESCR STD_AXIS ASDdc_stActGear_mp OneToOne 6 0.00 6.000 FORMAT "%5.3" EXTENDED_LIMITS -128.0 127.0 DEPOSIT ABSOLUTE /end AXIS_DESCR
 /begin AXIS_DESCR STD_AXIS ASDdc_nSPNOfs_mp EngN 4 -32768.00 32767.00 FORMAT "%8.2" DEPOSIT ABSOLUTE /end AXIS_DESCR
/end CHARACTERISTIC
/begin CHARACTERISTIC ASDdc_dNNegIKi_C "Integratorparameter Beendigung negativer Lastwechsel" VALUE 0x1C66A4 Kw_Wu32 999999.999767 Ki 0.00 999999.999767 FORMAT "%13.6" /end CHARACTERISTIC
/begin CHARACTERISTIC ASDdc_dNPosIKi_C "Integratorparameter für Beendigung postiver Lastwechsel" VALUE 0x1C66A8 Kw_Wu32 999999.999767 Ki 0.00 999999.999767 FORMAT "%13.6" /end CHARACTERISTIC
/begin CHARACTERISTIC ASDdc_dtrqNeg_C "Negative Hystereseschwelle" VALUE 0x1C66AC Kw_Ws16 8000.977 RmpTrqdHigh -4000.488 4000.488 FORMAT "%8.3" EXTENDED_LIMITS -48000.00 47998.54 /end CHARACTERISTIC
/begin CHARACTERISTIC ASDdc_dtrqPos_C "Positive Hystereseschwelle" VALUE 0x1C66AE Kw_Ws16 4000.488 RmpTrqdHigh 0.00 4000.488 FORMAT "%8.3" EXTENDED_LIMITS -48000.00 47998.54 /end CHARACTERISTIC
/begin CHARACTERISTIC ASDdc_T1ExtInt_C "ARD Störungsregler T1, externer Eingriff" VALUE 0x1C66B0 Kw_Wr32 1.50000000 ASD_GvrnDT1T1_float 0.00 1.50000000 FORMAT "%10.8" EXTENDED_LIMITS -1.00000000E+37 1.00000000E+37 /end CHARACTERISTIC
/begin CHARACTERISTIC ASDdc_KdExtInt_C "ARD Störungsregler Kd=sqrt(Td)/T1, externer Eingriff" VALUE 0x1C66B4 Kw_Wr32 5.00000000 ASD_GvrnDT1Kd_float 0.00 5.00000000 FORMAT "%10.8" EXTENDED_LIMITS -1.00000000E+37 1.00000000E+37 /end CHARACTERISTIC
/begin CHARACTERISTIC ASDdc_facKdGripPos_CUR "Kennlinie für Mulitplikatonsfaktor für die Verstärkung bei positiver Momententendenz" CURVE 0x1C66B8 Kl_Xs16_Ws16 1.000000 Fact1 0.00 1.000000 FORMAT "%8.6" EXTENDED_LIMITS -256.0000 255.9922
 /begin AXIS_DESCR STD_AXIS ASDrf_stDriver OneToOne 3 1.000 4.000 FORMAT "%5.3" EXTENDED_LIMITS 0.00 255.0 DEPOSIT ABSOLUTE /end AXIS_DESCR
/end CHARACTERISTIC
/begin CHARACTERISTIC ASDdc_KddNDT1_C "Verstärkungsfaktor für DT1 - Glied für Ableitung der mittleren Motordrehzahl" VALUE 0x1C66C8 Kw_Ws32 100.000000000 Kd -50.0000000000 50.0000000000 FORMAT "%13.10" EXTENDED_LIMITS -32768.0000000 32767.9999847 /end CHARACTERISTIC
/begin CHARACTERISTIC ASDdc_KdGrip_MAP "Zeitkonstante Kd des ARD-SR (ASDdc) für den Zustand Kraftschluss" MAP 0x1C66CC Kf_Xs16_Ys16_Ws16 1.500000 Kd16_sqr_rpm2Nm 0.00 1.500000 FORMAT "%8.6" EXTENDED_LIMITS -32.00000 31.99902
 /begin AXIS_DESCR STD_AXIS DrvTrn_rTransDT TransR 16 0.00 100.0000 FORMAT "%8.4" EXTENDED_LIMITS -327.6800 327.6700 DEPOSIT ABSOLUTE /end AXIS_DESCR
 /begin AXIS_DESCR STD_AXIS ASDdc_nAvrg_mp EngN 10 -32768.00 32767.00 FORMAT "%8.2" DEPOSIT ABSOLUTE /end AXIS_DESCR
/end CHARACTERISTIC
/begin CHARACTERISTIC ASDdc_KdPwrOnOff_MAP "Faktorkennfeld für Verstärkung des D2T2-Filters im Lastschlagfall" MAP 0x1C6844 Kf_Xs16_Ys16_Ws16 1.500000 Kd16_sqr_rpm2Nm 0.00 1.500000 FORMAT "%8.6" EXTENDED_LIMITS -32.00000 31.99902
 /begin AXIS_DESCR STD_AXIS ASDdc_stPosNeg_mp OneToOne 2 0.00 1.000 FORMAT "%5.3" EXTENDED_LIMITS 0.00 255.0 DEPOSIT ABSOLUTE /end AXIS_DESCR
 /begin AXIS_DESCR STD_AXIS ASDdc_nAvrg_mp EngN 10 -32768.00 32767.00 FORMAT "%8.2" DEPOSIT ABSOLUTE /end AXIS_DESCR
/end CHARACTERISTIC
/begin CHARACTERISTIC ASDdc_NGvnrDT1KdNeg_CUR "Differentialverstärkung des D-Reglers für negativen Lastschlag" CURVE 0x1C6888 Kl_Xs16_Ws16 1.000000 KD_RPM2NM_2 0.00 1.000000 FORMAT "%8.6" EXTENDED_LIMITS -0.8000000 0.7999756
 /begin AXIS_DESCR STD_AXIS ASDdc_stActGear_mp OneToOne 6 0.00 6.000 FORMAT "%5.3" EXTENDED_LIMITS -128.0 127.0 DEPOSIT ABSOLUTE /end AXIS_DESCR
/end CHARACTERISTIC
/begin CHARACTERISTIC ASDdc_NGvnrDT1KdPos_CUR "Differentialverstärkung des D-Reglers für positiven Lastschlag" CURVE 0x1C68A2 Kl_Xs16_Ws16 1.000000 KD_RPM2NM_2 0.00 1.000000 FORMAT "%8.6" EXTENDED_LIMITS -0.8000000 0.7999756
 /begin AXIS_DESCR STD_AXIS ASDdc_stActGear_mp OneToOne 6 0.00 6.000 FORMAT "%5.3" EXTENDED_LIMITS -128.0 127.0 DEPOSIT ABSOLUTE /end AXIS_DESCR
/end CHARACTERISTIC
/begin CHARACTERISTIC ASDdc_NGvnrIKiNeg_CUR "gangabhängige Parameter des I-Reglers für negativen Lastschlag" CURVE 0x1C68BC Kl_Xs16_Ws16 0.9998679 KI_RPM2NM_2 0.00 0.9998679 FORMAT "%8.6" EXTENDED_LIMITS -12.20703 12.20666
 /begin AXIS_DESCR STD_AXIS ASDdc_stActGear_mp OneToOne 6 0.00 6.000 FORMAT "%5.3" EXTENDED_LIMITS -128.0 127.0 DEPOSIT ABSOLUTE /end AXIS_DESCR
/end CHARACTERISTIC
/begin CHARACTERISTIC ASDdc_NGvnrIKiPos_CUR "gangabhängige Parameter des I-Reglers für positiven Lastschlag" CURVE 0x1C68D6 Kl_Xs16_Ws16 0.9998679 KI_RPM2NM_2 0.00 0.9998679 FORMAT "%8.6" EXTENDED_LIMITS -12.20703 12.20666
 /begin AXIS_DESCR STD_AXIS ASDdc_stActGear_mp OneToOne 6 0.00 6.000 FORMAT "%5.3" EXTENDED_LIMITS -128.0 127.0 DEPOSIT ABSOLUTE /end AXIS_DESCR
/end CHARACTERISTIC
/begin CHARACTERISTIC ASDdc_NGvnrPKpNeg_CUR "gangabhängige Parameter des P-Reglers für negativen Lastschlag" CURVE 0x1C68F0 Kl_Xs16_Ws16 1.000000 KP_RPM2NM_2 0.00 1.000000 FORMAT "%8.6" EXTENDED_LIMITS -1.600000 1.599951
 /begin AXIS_DESCR STD_AXIS ASDdc_stActGear_mp OneToOne 6 0.00 6.000 FORMAT "%5.3" EXTENDED_LIMITS -128.0 127.0 DEPOSIT ABSOLUTE /end AXIS_DESCR
/end CHARACTERISTIC
/begin CHARACTERISTIC ASDdc_NGvnrPKpPos_CUR "gangabhängige Parameter des P-Reglers für positiven Lastschlag" CURVE 0x1C690A Kl_Xs16_Ws16 1.000000 KP_RPM2NM_2 0.00 1.000000 FORMAT "%8.6" EXTENDED_LIMITS -1.600000 1.599951
 /begin AXIS_DESCR STD_AXIS ASDdc_stActGear_mp OneToOne 6 0.00 6.000 FORMAT "%5.3" EXTENDED_LIMITS -128.0 127.0 DEPOSIT ABSOLUTE /end AXIS_DESCR
/end CHARACTERISTIC
/begin CHARACTERISTIC ASDdc_NGvnrRstINeg_MAP "Initialisierungsmoment des I-Reglers neagtiver Lastschlag" MAP 0x1C6924 Kf_Xs16_Ys16_Ws16 1100.000 Trq -100.0000 1000.000 FORMAT "%8.3" EXTENDED_LIMITS -3276.800 3276.700
 /begin AXIS_DESCR STD_AXIS ASDdc_stActGear_mp OneToOne 6 0.00 6.000 FORMAT "%5.3" EXTENDED_LIMITS -128.0 127.0 DEPOSIT ABSOLUTE /end AXIS_DESCR
 /begin AXIS_DESCR STD_AXIS ASDdc_nSlipN_mp EngN 8 -32768.00 32767.00 FORMAT "%8.2" DEPOSIT ABSOLUTE /end AXIS_DESCR
/end CHARACTERISTIC
/begin CHARACTERISTIC ASDdc_NGvnrRstIPos0_MAP "Kennfeld 0 vom Kennraum für das Initialisierungsmoment des I-Reglers positver Lastschlag" MAP 0x1C69A4 Kf_Xs16_Ys16_Ws16 1100.000 Trq -100.0000 1000.000 FORMAT "%8.3" EXTENDED_LIMITS -3276.800 3276.700
 /begin AXIS_DESCR STD_AXIS ASDdc_nDeltaLead_mp EngN 6 -5000.000 5000.000 FORMAT "%8.3" EXTENDED_LIMITS -32768.00 32767.00 DEPOSIT ABSOLUTE /end AXIS_DESCR
 /begin AXIS_DESCR STD_AXIS Eng_nAvrg EngN 6 40.00000 6000.000 FORMAT "%8.3" EXTENDED_LIMITS -32768.00 32767.00 DEPOSIT ABSOLUTE /end AXIS_DESCR
/end CHARACTERISTIC
/begin CHARACTERISTIC ASDdc_NGvnrRstIPos1_MAP "Kennfeld 1 vom Kennraum für das Initialisierungsmoment des I-Reglers positver Lastschlag" MAP 0x1C6A08 Kf_Xs16_Ys16_Ws16 1100.000 Trq -100.0000 1000.000 FORMAT "%8.3" EXTENDED_LIMITS -3276.800 3276.700
 /begin AXIS_DESCR STD_AXIS ASDdc_nDeltaLead_mp EngN 6 -5000.000 5000.000 FORMAT "%8.3" EXTENDED_LIMITS -32768.00 32767.00 DEPOSIT ABSOLUTE /end AXIS_DESCR
 /begin AXIS_DESCR STD_AXIS Eng_nAvrg EngN 6 40.00000 6000.000 FORMAT "%8.3" EXTENDED_LIMITS -32768.00 32767.00 DEPOSIT ABSOLUTE /end AXIS_DESCR
/end CHARACTERISTIC
/begin CHARACTERISTIC ASDdc_NGvnrRstIPos2_MAP "Kennfeld 2 vom Kennraum für das Initialisierungsmoment des I-Reglers positver Lastschlag" MAP 0x1C6A6C Kf_Xs16_Ys16_Ws16 1100.000 Trq -100.0000 1000.000 FORMAT "%8.3" EXTENDED_LIMITS -3276.800 3276.700
 /begin AXIS_DESCR STD_AXIS ASDdc_nDeltaLead_mp EngN 6 -5000.000 5000.000 FORMAT "%8.3" EXTENDED_LIMITS -32768.00 32767.00 DEPOSIT ABSOLUTE /end AXIS_DESCR
 /begin AXIS_DESCR STD_AXIS Eng_nAvrg EngN 6 40.00000 6000.000 FORMAT "%8.3" EXTENDED_LIMITS -32768.00 32767.00 DEPOSIT ABSOLUTE /end AXIS_DESCR
/end CHARACTERISTIC
/begin CHARACTERISTIC ASDdc_NGvnrRstIPos3_MAP "Kennfeld 3 vom Kennraum für das Initialisierungsmoment des I-Reglers positver Lastschlag" MAP 0x1C6AD0 Kf_Xs16_Ys16_Ws16 1100.000 Trq -100.0000 1000.000 FORMAT "%8.3" EXTENDED_LIMITS -3276.800 3276.700
 /begin AXIS_DESCR STD_AXIS ASDdc_nDeltaLead_mp EngN 6 -5000.000 5000.000 FORMAT "%8.3" EXTENDED_LIMITS -32768.00 32767.00 DEPOSIT ABSOLUTE /end AXIS_DESCR
 /begin AXIS_DESCR STD_AXIS Eng_nAvrg EngN 6 40.00000 6000.000 FORMAT "%8.3" EXTENDED_LIMITS -32768.00 32767.00 DEPOSIT ABSOLUTE /end AXIS_DESCR
/end CHARACTERISTIC
/begin CHARACTERISTIC ASDdc_NGvnrRstIPos4_MAP "Kennfeld 4 vom Kennraum für das Initialisierungsmoment des I-Reglers positver Lastschlag" MAP 0x1C6B34 Kf_Xs16_Ys16_Ws16 1100.000 Trq -100.0000 1000.000 FORMAT "%8.3" EXTENDED_LIMITS -3276.800 3276.700
 /begin AXIS_DESCR STD_AXIS ASDdc_nDeltaLead_mp EngN 6 -5000.000 5000.000 FORMAT "%8.3" EXTENDED_LIMITS -32768.00 32767.00 DEPOSIT ABSOLUTE /end AXIS_DESCR
 /begin AXIS_DESCR STD_AXIS Eng_nAvrg EngN 6 40.00000 6000.000 FORMAT "%8.3" EXTENDED_LIMITS -32768.00 32767.00 DEPOSIT ABSOLUTE /end AXIS_DESCR
/end CHARACTERISTIC
/begin CHARACTERISTIC ASDdc_NGvnrRstIPos5_MAP "Kennfeld 5 vom Kennraum für das Initialisierungsmoment des I-Reglers positver Lastschlag" MAP 0x1C6B98 Kf_Xs16_Ys16_Ws16 1100.000 Trq -100.0000 1000.000 FORMAT "%8.3" EXTENDED_LIMITS -3276.800 3276.700
 /begin AXIS_DESCR STD_AXIS ASDdc_nDeltaLead_mp EngN 6 -5000.000 5000.000 FORMAT "%8.3" EXTENDED_LIMITS -32768.00 32767.00 DEPOSIT ABSOLUTE /end AXIS_DESCR
 /begin AXIS_DESCR STD_AXIS Eng_nAvrg EngN 6 40.00000 6000.000 FORMAT "%8.3" EXTENDED_LIMITS -32768.00 32767.00 DEPOSIT ABSOLUTE /end AXIS_DESCR
/end CHARACTERISTIC
/begin CHARACTERISTIC ASDdc_nLtdExitNeg_CUR "gangabhängige Schlupfdrehzahlschwelle Beendigung negativer Lastschlag" CURVE 0x1C6BFC Kl_Xs16_Ws16 12000.00 EngN -6000.000 6000.000 FORMAT "%8.3" EXTENDED_LIMITS -32768.00 32767.00
 /begin AXIS_DESCR STD_AXIS ASDdc_stActGear_mp OneToOne 6 0.00 6.000 FORMAT "%5.3" EXTENDED_LIMITS -128.0 127.0 DEPOSIT ABSOLUTE /end AXIS_DESCR
/end CHARACTERISTIC
/begin CHARACTERISTIC ASDdc_nLtdExitPos_CUR "gangabhängige Schlupfdrehzahlschwelle Beendigung positver Lastschlag" CURVE 0x1C6C16 Kl_Xs16_Ws16 12000.00 EngN -6000.000 6000.000 FORMAT "%8.3" EXTENDED_LIMITS -32768.00 32767.00
 /begin AXIS_DESCR STD_AXIS ASDdc_stActGear_mp OneToOne 6 0.00 6.000 FORMAT "%5.3" EXTENDED_LIMITS -128.0 127.0 DEPOSIT ABSOLUTE /end AXIS_DESCR
/end CHARACTERISTIC
/begin CHARACTERISTIC ASDdc_nLtdNegLdRevl_C "Motordrehzahlschwelle Beendigung negativer Lastschlag" VALUE 0x1C6C30 Kw_Ws16 5960.000 EngN 40.00000 6000.000 FORMAT "%8.3" EXTENDED_LIMITS -32768.00 32767.00 /end CHARACTERISTIC
/begin CHARACTERISTIC ASDdc_nMaxNLdRevlNeg_CUR "obere gangabhaengige Schlupfdrehzahlgrenzen negativer Lastwechsel" CURVE 0x1C6C32 Kl_Xs16_Ws16 12000.00 EngN -6000.000 6000.000 FORMAT "%8.3" EXTENDED_LIMITS -32768.00 32767.00
 /begin AXIS_DESCR STD_AXIS ASDdc_stActGear_mp OneToOne 6 0.00 6.000 FORMAT "%5.3" EXTENDED_LIMITS -128.0 127.0 DEPOSIT ABSOLUTE /end AXIS_DESCR
/end CHARACTERISTIC
/begin CHARACTERISTIC ASDdc_nMaxNLdRevlPos_CUR "obere gangabhaengige Schlupfdrehzahlgrenzen positiver Lastwechsel" CURVE 0x1C6C4C Kl_Xs16_Ws16 7000.000 EngN -1000.000 6000.000 FORMAT "%8.3" EXTENDED_LIMITS -32768.00 32767.00
 /begin AXIS_DESCR STD_AXIS ASDdc_stActGear_mp OneToOne 6 0.00 6.000 FORMAT "%5.3" EXTENDED_LIMITS -128.0 127.0 DEPOSIT ABSOLUTE /end AXIS_DESCR
/end CHARACTERISTIC
/begin CHARACTERISTIC ASDdc_nMinNLdRevlNeg_CUR "untere gangabhaengige Schlupfdrehzahlgrenzen negativer Lastwechsel" CURVE 0x1C6C66 Kl_Xs16_Ws16 12000.00 EngN -6000.000 6000.000 FORMAT "%8.3" EXTENDED_LIMITS -32768.00 32767.00
 /begin AXIS_DESCR STD_AXIS ASDdc_stActGear_mp OneToOne 6 0.00 6.000 FORMAT "%5.3" EXTENDED_LIMITS -128.0 127.0 DEPOSIT ABSOLUTE /end AXIS_DESCR
/end CHARACTERISTIC
/begin CHARACTERISTIC ASDdc_nMinNLdRevlPos_CUR "untere gangabhaengige Schlupfdrehzahlgrenzen positiver Lastwechsel" CURVE 0x1C6C80 Kl_Xs16_Ws16 7000.000 EngN -1000.000 6000.000 FORMAT "%8.3" EXTENDED_LIMITS -32768.00 32767.00
 /begin AXIS_DESCR STD_AXIS ASDdc_stActGear_mp OneToOne 6 0.00 6.000 FORMAT "%5.3" EXTENDED_LIMITS -128.0 127.0 DEPOSIT ABSOLUTE /end AXIS_DESCR
/end CHARACTERISTIC
/begin CHARACTERISTIC ASDdc_nPwrOnOffLim_C "Drehzahlschwelle, ab der Lastschlagerkennung aktiv werden kann" VALUE 0x1C6C9A Kw_Wu16 65535.00 EngN 0.00 65535.00 FORMAT "%8.2" /end CHARACTERISTIC
/begin CHARACTERISTIC ASDdc_nSPOfsNeg_CUR "gangabhängige Offsetdrehzahl für Sollwertbildung negativer Lastschlag" CURVE 0x1C6C9C Kl_Xs16_Ws16 12000.00 EngN -6000.000 6000.000 FORMAT "%8.3" EXTENDED_LIMITS -32768.00 32767.00
 /begin AXIS_DESCR STD_AXIS ASDdc_stActGear_mp OneToOne 6 0.00 6.000 FORMAT "%5.3" EXTENDED_LIMITS -128.0 127.0 DEPOSIT ABSOLUTE /end AXIS_DESCR
/end CHARACTERISTIC
/begin CHARACTERISTIC ASDdc_nSPOfsPos_MAP "gang- und motorausgangsdrehzahlabhängige Offsetdrehzahl für Sollwertbildung positiver Lastschlag" MAP 0x1C6CB6 Kf_Xs16_Ys16_Ws16 12000.00 EngN -6000.000 6000.000 FORMAT "%8.3" EXTENDED_LIMITS -32768.00 32767.00
 /begin AXIS_DESCR STD_AXIS ASDdc_stActGear_mp OneToOne 6 0.00 6.000 FORMAT "%5.3" EXTENDED_LIMITS -128.0 127.0 DEPOSIT ABSOLUTE /end AXIS_DESCR
 /begin AXIS_DESCR STD_AXIS ASDdc_trqEngOutLtd_mp Trq 4 -3276.800 3276.700 FORMAT "%8.3" DEPOSIT ABSOLUTE /end AXIS_DESCR
/end CHARACTERISTIC
/begin CHARACTERISTIC ASDdc_nThresHysNHi_C "Obere Hysteresedrehzahlschwelle für Parameter Umschaltung negativer Lastschlag" VALUE 0x1C6CFE Kw_Ws16 5960.000 EngN 40.00000 6000.000 FORMAT "%8.3" EXTENDED_LIMITS -32768.00 32767.00 /end CHARACTERISTIC
/begin CHARACTERISTIC ASDdc_nThresHysNLo_C "Untere Hysteresedrehzahlschwelle für Parameter Umschaltung negativer Lastschlag" VALUE 0x1C6D00 Kw_Ws16 5960.000 EngN 40.00000 6000.000 FORMAT "%8.3" EXTENDED_LIMITS -32768.00 32767.00 /end CHARACTERISTIC
/begin CHARACTERISTIC ASDdc_stActGear_CUR "Kennlinie zur Auswahl eines Kennfeldes vom Kennraum für das Initialisierungsmoment des I-Reglers bei positiven Lastschlag" CURVE 0x1C6D02 Kl_Xs16_Ws16 5.000000 Map_Select 0.00 5.000000 FORMAT "%8.6" EXTENDED_LIMITS -128.0000 127.9961
 /begin AXIS_DESCR STD_AXIS ASDdc_stActGear_mp OneToOne 6 1.000 6.000 FORMAT "%5.3" EXTENDED_LIMITS -128.0 127.0 DEPOSIT ABSOLUTE /end AXIS_DESCR
/end CHARACTERISTIC
/begin CHARACTERISTIC ASDdc_stCalcPT1FltNeg_C "Status PT1 Filterung negativer Lastschlag (1=aktiv)" VALUE 0x1C6D1C Kw_Wu8 1.000 OneToOne 0.00 1.000 FORMAT "%5.3" EXTENDED_LIMITS 0.00 255.0 /end CHARACTERISTIC
/begin CHARACTERISTIC ASDdc_stCalcPT1FltPos_C "Status PT1 Filterung negativer Lastschlag (1=aktiv)" VALUE 0x1C6D1D Kw_Wu8 1.000 OneToOne 0.00 1.000 FORMAT "%5.3" EXTENDED_LIMITS 0.00 255.0 /end CHARACTERISTIC
/begin CHARACTERISTIC ASDdc_stKickDown_C "Einfluss des Kick-Down Signals (1=aktiv)" VALUE 0x1C6D1E Kw_Wu8 1.000 OneToOne 0.00 1.000 FORMAT "%5.3" EXTENDED_LIMITS 0.00 255.0 /end CHARACTERISTIC
/begin CHARACTERISTIC ASDdc_swtCalcN_C "1: ASDdc_nAvrg_mp = Eng_nAvrg;   0: ASDdc_nAvrg_mp = Eng_nAvrg - LIGov_nSetpoint" VALUE 0x1C6D1F Kw_Wu8 255.0 OneToOne 0.00 255.0 FORMAT "%5.1" /end CHARACTERISTIC
/begin CHARACTERISTIC ASDdc_swtConvOff_C "Schalter zur Auswahl der Kupplungsbedingung für Parameterauswahl" VALUE 0x1C6D20 Kw_Wu8 1.000 OneToOne 0.00 1.000 FORMAT "%5.3" EXTENDED_LIMITS 0.00 255.0 /end CHARACTERISTIC
/begin CHARACTERISTIC ASDdc_swtGearbx_C "Schalter um verwendete Methode für Erkennung von externen Eingriff zu bestimmen (0 für Gearbx_stTSC.5, 1 für FrmMng_stTSC.8)" VALUE 0x1C6D21 Kw_Wu8 1.000 OneToOne 0.00 1.000 FORMAT "%5.3" EXTENDED_LIMITS 0.00 255.0 /end CHARACTERISTIC
/begin CHARACTERISTIC ASDdc_swtGearSel_C "Software - Schalter für Gangwahl (vor/nach Schaltung beendet)" VALUE 0x1C6D22 Kw_Wu8 1.000 OneToOne 0.00 1.000 FORMAT "%5.3" EXTENDED_LIMITS 0.00 255.0 /end CHARACTERISTIC
/begin CHARACTERISTIC ASDdc_swtInitPS_C "Schalter zur Aktivierung/Deaktivierung der kontinuierlichen Initialisierung aufgrund Parametersatzwechsels" VALUE 0x1C6D23 Kw_Wu8 255.0 OneToOne 0.00 255.0 FORMAT "%5.1" /end CHARACTERISTIC
/begin CHARACTERISTIC ASDdc_swtNGvnrMn_C "Hauptschalter Drehzahlregler (1=activ)" VALUE 0x1C6D24 Kw_Wu8 1.000 OneToOne 0.00 1.000 FORMAT "%5.3" EXTENDED_LIMITS 0.00 255.0 /end CHARACTERISTIC
/begin CHARACTERISTIC ASDdc_swtnNotFreeze_C "Deaktivierung der Einfrierung der Offsetdrehzahl für das PT1-Filter" VALUE 0x1C6D25 Kw_Wu8 1.000 OneToOne 0.00 1.000 FORMAT "%5.3" EXTENDED_LIMITS 0.00 255.0 /end CHARACTERISTIC
/begin CHARACTERISTIC ASDdc_swtvRaw_C "Funktionsschalter für ungefilterte (=0) /gefilterte Geschwindgkeit (=1)" VALUE 0x1C6D26 Kw_Wu8 1.000 OneToOne 0.00 1.000 FORMAT "%5.3" EXTENDED_LIMITS 0.00 255.0 /end CHARACTERISTIC
/begin CHARACTERISTIC ASDdc_T1Grip_MAP "Zeitkonstante T1 des ARD-SR (ASDdc) für den Zustand Kraftschluss" MAP 0x1C6D28 Kf_Xs16_Ys16_Ws16 1.498917 TimeDelay_s_Lin_16 0.001068148 1.499985 FORMAT "%8.6" EXTENDED_LIMITS -5.000153 5.000000
 /begin AXIS_DESCR STD_AXIS DrvTrn_rTransDT TransR 16 0.00 100.0000 FORMAT "%8.4" EXTENDED_LIMITS -327.6800 327.6700 DEPOSIT ABSOLUTE /end AXIS_DESCR
 /begin AXIS_DESCR STD_AXIS ASDdc_nAvrg_mp EngN 10 -32768.00 32767.00 FORMAT "%8.2" DEPOSIT ABSOLUTE /end AXIS_DESCR
/end CHARACTERISTIC
/begin CHARACTERISTIC ASDdc_T1PwrOnOff_MAP "Zeitkonstante des D2T2-filters im Lastschlagfall" MAP 0x1C6EA0 Kf_Xs16_Ys16_Ws16 1.498917 TimeDelay_s_Lin_16 0.001068148 1.499985 FORMAT "%8.6" EXTENDED_LIMITS -5.000153 5.000000
 /begin AXIS_DESCR STD_AXIS ASDdc_stPosNeg_mp OneToOne 2 0.00 1.000 FORMAT "%5.3" EXTENDED_LIMITS 0.00 255.0 DEPOSIT ABSOLUTE /end AXIS_DESCR
 /begin AXIS_DESCR STD_AXIS ASDdc_nAvrg_mp EngN 10 -32768.00 32767.00 FORMAT "%8.2" DEPOSIT ABSOLUTE /end AXIS_DESCR
/end CHARACTERISTIC
/begin CHARACTERISTIC ASDdc_tEngThres_C "Motortemperaturschwelle" VALUE 0x1C6EE4 Kw_Ws16 250.0000 Temp_Cels -50.14000 199.8600 FORMAT "%8.4" EXTENDED_LIMITS -3549.940 3003.560 /end CHARACTERISTIC
/begin CHARACTERISTIC ASDdc_tiActvRmpNHi_C "Wartezeit bis die Rampe gestartet wird bei hoher Motordrehzahl" VALUE 0x1C6EE6 Kw_Wu16 655350.0 Time_ms 0.00 655350.0 FORMAT "%8.1" /end CHARACTERISTIC
/begin CHARACTERISTIC ASDdc_tiActvRmpNLo_C "Wartezeit bis die Rampe gestartet wird bei niedriger Motordrehzahl" VALUE 0x1C6EE8 Kw_Wu16 655350.0 Time_ms 0.00 655350.0 FORMAT "%8.1" /end CHARACTERISTIC
/begin CHARACTERISTIC ASDdc_tiBlkTmr_C "Retrigger Sperrzeit und Begrenzungszeit" VALUE 0x1C6EEA Kw_Wu16 655350.0 Time_ms 0.00 655350.0 FORMAT "%8.1" /end CHARACTERISTIC
/begin CHARACTERISTIC ASDdc_tidNDT1_C "Zeitkonstante für DT1 Glied für Drehzahlgradient" VALUE 0x1C6EEC Kw_Wu32 1073.7408 TimeDelay_s 0.0010000001 1073.7418 FORMAT "%9.4" EXTENDED_LIMITS 0.0000010000000 4294.9673 /end CHARACTERISTIC
/begin CHARACTERISTIC ASDdc_tiMaxLdRevlPos_C "maximale Zeit des Zustandes postiver Lastschlag" VALUE 0x1C6EF0 Kw_Wu16 655350.0 Time_ms 0.00 655350.0 FORMAT "%8.1" /end CHARACTERISTIC
/begin CHARACTERISTIC ASDdc_tiMaxRmpNHi_C "maximale Zeit der Schubabschaltung bei hoher Motordrehzahl" VALUE 0x1C6EF2 Kw_Wu16 655350.0 Time_ms 0.00 655350.0 FORMAT "%8.1" /end CHARACTERISTIC
/begin CHARACTERISTIC ASDdc_tiMaxRmpNLo_C "maximale Zeit der Schubabschaltung bei niedriger Motordrehzahl" VALUE 0x1C6EF4 Kw_Wu16 655350.0 Time_ms 0.00 655350.0 FORMAT "%8.1" /end CHARACTERISTIC
/begin CHARACTERISTIC ASDdc_tiMinLdRevlNeg_C "minimale Aktivierungszeit fuer negativen Lastschlag" VALUE 0x1C6EF6 Kw_Wu16 655350.0 Time_ms 0.00 655350.0 FORMAT "%8.1" /end CHARACTERISTIC
/begin CHARACTERISTIC ASDdc_tiMinLdRevlPos_C "minimale Aktivierungszeit des positiven Lastschlages" VALUE 0x1C6EF8 Kw_Wu16 655350.0 Time_ms 0.00 655350.0 FORMAT "%8.1" /end CHARACTERISTIC
/begin CHARACTERISTIC ASDdc_tiMinTmrDnAvrg_C "minimale Aktivierungszeit bis die Abbruchbedingung abgeleitete Motordrehzahl aktiv wird" VALUE 0x1C6EFA Kw_Wu16 655350.0 Time_ms 0.00 655350.0 FORMAT "%8.1" /end CHARACTERISTIC
/begin CHARACTERISTIC ASDdc_tiNGvnrDT1Neg_C "Zeitkonstante des DT1 Gliedes für negativen Lastschlag" VALUE 0x1C6EFC Kw_Wu32 10.010579 TimeDelay_s 0.0010000001 10.011579 FORMAT "%9.6" EXTENDED_LIMITS 0.0000010000000 4294.9673 /end CHARACTERISTIC
/begin CHARACTERISTIC ASDdc_tiNGvnrDT1Pos_C "Zeitkonstante des D-Reglers für positiven Lastschlag" VALUE 0x1C6F00 Kw_Wu32 10.010579 TimeDelay_s 0.0010000001 10.011579 FORMAT "%9.6" EXTENDED_LIMITS 0.0000010000000 4294.9673 /end CHARACTERISTIC
/begin CHARACTERISTIC ASDdc_tiPT1Neg_CUR "Filterzeitkonstante PT1 für negativen Lastschlag" CURVE 0x1C6F04 Kl_Xs16_Ws16 5.5824070 TimeDelay_s_2 0.0099983409 5.5924053 FORMAT "%9.7" EXTENDED_LIMITS 0.00051201563 16.777216
 /begin AXIS_DESCR STD_AXIS ASDdc_stActGear_mp OneToOne 6 0.00 6.000 FORMAT "%5.3" EXTENDED_LIMITS -128.0 127.0 DEPOSIT ABSOLUTE /end AXIS_DESCR
/end CHARACTERISTIC
/begin CHARACTERISTIC ASDdc_tiPT1Pos_CUR "Filterzeitkonstante PT1 für positiven Lastschlag" CURVE 0x1C6F1E Kl_Xs16_Ws16 5.5824070 TimeDelay_s_2 0.0099983409 5.5924053 FORMAT "%9.7" EXTENDED_LIMITS 0.00051201563 16.777216
 /begin AXIS_DESCR STD_AXIS ASDdc_stActGear_mp OneToOne 6 0.00 6.000 FORMAT "%5.3" EXTENDED_LIMITS -128.0 127.0 DEPOSIT ABSOLUTE /end AXIS_DESCR
/end CHARACTERISTIC
/begin CHARACTERISTIC ASDdc_tiPT1Trq_C "Zeitkonstante für PT1 element" VALUE 0x1C6F38 Kw_Wu32 1.9004513 TimeDelay_s 0.099999239 2.0004505 FORMAT "%9.7" EXTENDED_LIMITS 0.0000010000000 4294.9673 /end CHARACTERISTIC
/begin CHARACTERISTIC ASDdc_tiPwrOnOff_C "Wirkzeit für Lastschlagparametersatz" VALUE 0x1C6F3C Kw_Wu16 655350.0 Time_ms 0.00 655350.0 FORMAT "%8.1" /end CHARACTERISTIC
/begin CHARACTERISTIC ASDdc_tiRmpStrt_CUR "Kennfeld für Wartezeit bis Faktorrampe startet" CURVE 0x1C6F3E Kl_Xs16_Ws16 327.6700 Time_s 0.00 327.6700 FORMAT "%8.4" EXTENDED_LIMITS -327.6800 327.6700
 /begin AXIS_DESCR STD_AXIS DrvTrn_rTransDT TransR 6 0.00 100.0000 FORMAT "%8.4" EXTENDED_LIMITS -327.6800 327.6700 DEPOSIT ABSOLUTE /end AXIS_DESCR
/end CHARACTERISTIC
/begin CHARACTERISTIC ASDdc_tiSwtOff_C "Zeit nach der ARDdc Ausgang im Schub hart auf 0 geschaltet wird" VALUE 0x1C6F58 Kw_Wu16 655350.0 Time_ms 0.00 655350.0 FORMAT "%8.1" /end CHARACTERISTIC
/begin CHARACTERISTIC ASDdc_tiTmrNCond_C "minimale Aktivierungszeit bis die Abbruchbedingung Motordrehzahl aktiv wird" VALUE 0x1C6F5A Kw_Wu16 655350.0 Time_ms 0.00 655350.0 FORMAT "%8.1" /end CHARACTERISTIC
/begin CHARACTERISTIC ASDdc_tiTmrTrqInrCond_C "minimale Aktivierungszeit bis die Abbruchbedingung inneres Moment aktiv wird" VALUE 0x1C6F5C Kw_Wu16 655350.0 Time_ms 0.00 655350.0 FORMAT "%8.1" /end CHARACTERISTIC
/begin CHARACTERISTIC ASDdc_T1TMFWRO_C "ARD Störungsregler T1, ausollen" VALUE 0x1C6F60 Kw_Wr32 1.50000000 ASD_GvrnDT1T1_float 0.00 1.50000000 FORMAT "%10.8" EXTENDED_LIMITS -1.00000000E+37 1.00000000E+37 /end CHARACTERISTIC
/begin CHARACTERISTIC ASDdc_KdTMFWRO_C "ARD Störungsregler Kd=sqrt(Td)/T1, ausrollen" VALUE 0x1C6F64 Kw_Wr32 5.00000000 ASD_GvrnDT1Kd_float 0.00 5.00000000 FORMAT "%10.8" EXTENDED_LIMITS -1.00000000E+37 1.00000000E+37 /end CHARACTERISTIC
/begin CHARACTERISTIC ASDdc_trqDpnOfsNegEnd_C "Offset für Verlustmoment für Deaktivierungsbedingung bei positiven Lastschlag" VALUE 0x1C6F68 Kw_Ws16 1500.000 Trq -500.0000 1000.000 FORMAT "%8.3" EXTENDED_LIMITS -3276.800 3276.700 /end CHARACTERISTIC
/begin CHARACTERISTIC ASDdc_trqDpnOfsNeg_C "Offset für Verlustmoment für Aktivierungsbedingung bei negativen Lastschlag" VALUE 0x1C6F6A Kw_Ws16 1500.000 Trq -500.0000 1000.000 FORMAT "%8.3" EXTENDED_LIMITS -3276.800 3276.700 /end CHARACTERISTIC
/begin CHARACTERISTIC ASDdc_trqDpnOfsPosEnd_C "Offset für Verlustmoment für Aktivierungsbedingung bei positiven Lastschlag" VALUE 0x1C6F6C Kw_Ws16 1500.000 Trq -500.0000 1000.000 FORMAT "%8.3" EXTENDED_LIMITS -3276.800 3276.700 /end CHARACTERISTIC
/begin CHARACTERISTIC ASDdc_trqDpnOfsPos_C "Offset für Verlustmoment für Aktivierungsbedingung bei positiven Lastschlag" VALUE 0x1C6F6E Kw_Ws16 1500.000 Trq -500.0000 1000.000 FORMAT "%8.3" EXTENDED_LIMITS -3276.800 3276.700 /end CHARACTERISTIC
/begin CHARACTERISTIC ASDdc_trqInrLtdThres_C "Schwelle inners Moment" VALUE 0x1C6F70 Kw_Ws16 1500.000 Trq -500.0000 1000.000 FORMAT "%8.3" EXTENDED_LIMITS -3276.800 3276.700 /end CHARACTERISTIC
/begin CHARACTERISTIC ASDdc_trqLimHiPwrOnOff_CUR "obere Begrenzung des Störreglerausgangs im Lastschlagfall" CURVE 0x1C6F72 Kl_Xs16_Ws16 1500.000 Trq -500.0000 1000.000 FORMAT "%8.3" EXTENDED_LIMITS -3276.800 3276.700
 /begin AXIS_DESCR STD_AXIS Eng_nAvrg EngN 5 0.00 6000.000 FORMAT "%8.3" EXTENDED_LIMITS -32768.00 32767.00 DEPOSIT ABSOLUTE /end AXIS_DESCR
/end CHARACTERISTIC
/begin CHARACTERISTIC ASDdc_trqLimHi_CUR "obere Begrenzung des Störreglerausgangs" CURVE 0x1C6F88 Kl_Xs16_Ws16 1500.000 Trq -500.0000 1000.000 FORMAT "%8.3" EXTENDED_LIMITS -3276.800 3276.700
 /begin AXIS_DESCR STD_AXIS Eng_nAvrg EngN 5 0.00 6000.000 FORMAT "%8.3" EXTENDED_LIMITS -32768.00 32767.00 DEPOSIT ABSOLUTE /end AXIS_DESCR
/end CHARACTERISTIC
/begin CHARACTERISTIC ASDdc_trqLimLoPwrOnOff_CUR "untere Begrenzung des Störreglerausgangs im Lastschlagfall" CURVE 0x1C6F9E Kl_Xs16_Ws16 1500.000 Trq -500.0000 1000.000 FORMAT "%8.3" EXTENDED_LIMITS -3276.800 3276.700
 /begin AXIS_DESCR STD_AXIS Eng_nAvrg EngN 5 0.00 6000.000 FORMAT "%8.3" EXTENDED_LIMITS -32768.00 32767.00 DEPOSIT ABSOLUTE /end AXIS_DESCR
/end CHARACTERISTIC
/begin CHARACTERISTIC ASDdc_trqLimLo_CUR "untere Begrenzung des Störreglerausgangs" CURVE 0x1C6FB4 Kl_Xs16_Ws16 1500.000 Trq -500.0000 1000.000 FORMAT "%8.3" EXTENDED_LIMITS -3276.800 3276.700
 /begin AXIS_DESCR STD_AXIS Eng_nAvrg EngN 5 0.00 6000.000 FORMAT "%8.3" EXTENDED_LIMITS -32768.00 32767.00 DEPOSIT ABSOLUTE /end AXIS_DESCR
/end CHARACTERISTIC
/begin CHARACTERISTIC ASDdc_trqMaxPosLdRevl_C "Vorgabewert für positives Moment im Falle neagtiven Lastschlages" VALUE 0x1C6FCA Kw_Ws16 1500.000 Trq -500.0000 1000.000 FORMAT "%8.3" EXTENDED_LIMITS -3276.800 3276.700 /end CHARACTERISTIC
/begin CHARACTERISTIC ASDdc_trqPwrOnOffLimNeg_MAP "Momentschwelle für Aktivierung des Lastschlagparametersatzes für neg. Mengentendenz" MAP 0x1C6FCC Kf_Xs16_Ys16_Ws16 1500.000 Trq -500.0000 1000.000 FORMAT "%8.3" EXTENDED_LIMITS -3276.800 3276.700
 /begin AXIS_DESCR STD_AXIS Eng_nAvrg EngN 8 0.00 6000.000 FORMAT "%8.3" EXTENDED_LIMITS -32768.00 32767.00 DEPOSIT ABSOLUTE /end AXIS_DESCR
 /begin AXIS_DESCR STD_AXIS DrvTrn_rTransDT TransR 12 -327.6800 327.6700 FORMAT "%8.4" DEPOSIT ABSOLUTE /end AXIS_DESCR
/end CHARACTERISTIC
/begin CHARACTERISTIC ASDdc_trqPwrOnOffLimPos_MAP "Momentschwelle für Aktivierung des Lastschlagparametersatzes für pos. Mengentendenz" MAP 0x1C70B8 Kf_Xs16_Ys16_Ws16 1500.000 Trq -500.0000 1000.000 FORMAT "%8.3" EXTENDED_LIMITS -3276.800 3276.700
 /begin AXIS_DESCR STD_AXIS Eng_nAvrg EngN 8 0.00 6000.000 FORMAT "%8.3" EXTENDED_LIMITS -32768.00 32767.00 DEPOSIT ABSOLUTE /end AXIS_DESCR
 /begin AXIS_DESCR STD_AXIS DrvTrn_rTransDT TransR 12 -327.6800 327.6700 FORMAT "%8.4" DEPOSIT ABSOLUTE /end AXIS_DESCR
/end CHARACTERISTIC
/begin CHARACTERISTIC ASDdc_trqPwrOnOffOffset_CUR "Kennlinie für Offset bei Triggerschwelle bei positiver Momententendenz" CURVE 0x1C71A4 Kl_Xs16_Ws16 1500.000 Trq -500.0000 1000.000 FORMAT "%8.3" EXTENDED_LIMITS -3276.800 3276.700
 /begin AXIS_DESCR STD_AXIS ASDrf_stDriver OneToOne 3 1.000 4.000 FORMAT "%5.3" EXTENDED_LIMITS 0.00 255.0 DEPOSIT ABSOLUTE /end AXIS_DESCR
/end CHARACTERISTIC
/begin CHARACTERISTIC ASDdc_trqThresNegOff_C "Momentenschwelle für Beendigung des negativen Lastschlages" VALUE 0x1C71B2 Kw_Ws16 1500.000 Trq -500.0000 1000.000 FORMAT "%8.3" EXTENDED_LIMITS -3276.800 3276.700 /end CHARACTERISTIC
/begin CHARACTERISTIC ASDdc_trq_Vector "Bypass Label, nicht ändern!" VALUE 0x1C0A3C Kw_Wu8 255.0 OneToOne 0.00 255.0 FORMAT "%5.1" /end CHARACTERISTIC
/begin CHARACTERISTIC ASDdc_trq_Channel "Bypass Label, nicht ändern!" VALUE 0x1C0A3D Kw_Wu8 255.0 OneToOne 0.00 255.0 FORMAT "%5.1" /end CHARACTERISTIC
/begin CHARACTERISTIC ASDdc_vLimIni_C "ARD Geschwindigkeitsschwelle f. Initialisierung Störregler" VALUE 0x1C71B4 Kw_Ws16 655.3500 Vel -327.6800 327.6700 FORMAT "%8.4" /end CHARACTERISTIC
/begin MEASUREMENT AirCtl_facGovRgnRmpEGR_mp "Rampenformung EGR für die Partikelfilter Regeneration" SWORD facRmpEGT16 1 100 -1.024000 1.023969 FORMAT "%8.6" ECU_ADDRESS 0x801F86 /end MEASUREMENT
/begin MEASUREMENT AirCtl_facGovRgnRmpTVA_mp "Rampenformung TVA für die Partikelfilter Regeneration" SWORD facRmpEGT16 1 100 -1.024000 1.023969 FORMAT "%8.6" ECU_ADDRESS 0x801F88 /end MEASUREMENT
/begin MEASUREMENT AirCtl_facGovRgnRmp_mp "Rampenformung für die Partikelfilter Regeneration" SWORD facRmpEGT16 1 100 -1.024000 1.023969 FORMAT "%8.6" ECU_ADDRESS 0x801F8A /end MEASUREMENT
/begin MEASUREMENT AirCtl_facP3Corr_mp "Korrekturfaktor bei unterschiedlichem Druck vor Turbine" SWORD Fact 1 100 -4.000000 3.999878 FORMAT "%8.6" ECU_ADDRESS 0x801FB4 /end MEASUREMENT
/begin MEASUREMENT AirCtl_mMaxDev_mp "Obergrenze für bleibende Regelabweichung" SWORD AirMassPerCyl 1 100 -3276.800 3276.700 FORMAT "%8.3" ECU_ADDRESS 0x801FC4 /end MEASUREMENT
/begin MEASUREMENT AirCtl_mMinDev_mp "Untergrenze für bleibende Regelabweichung" SWORD AirMassPerCyl 1 100 -3276.800 3276.700 FORMAT "%8.3" ECU_ADDRESS 0x801FC6 /end MEASUREMENT
/begin MEASUREMENT AirCtl_nOvrRunDel_mp "Schwelle zur Erkennung Schaltvorgang" SWORD EngN 1 100 -32768.00 32767.00 FORMAT "%8.2" ECU_ADDRESS 0x801FC8 /end MEASUREMENT
/begin MEASUREMENT AirCtl_nOvrRun_mp "Schwelle zur Erkennung Schubbetrieb" SWORD EngN 1 100 -32768.00 32767.00 FORMAT "%8.2" ECU_ADDRESS 0x801FCA /end MEASUREMENT
/begin MEASUREMENT AirCtl_pP3Corr2_mp "Differenz aus Druck vor Turbine rechts und Ladedruck" SWORD Pres_hPa 1 100 -32768.00 32767.00 FORMAT "%8.2" ECU_ADDRESS 0x801FB6 /end MEASUREMENT
/begin MEASUREMENT AirCtl_pP3Corr_mp "Differenz aus Druck vor Turbine links und Ladedruck" SWORD Pres_hPa 1 100 -32768.00 32767.00 FORMAT "%8.2" ECU_ADDRESS 0x801FB8 /end MEASUREMENT
/begin MEASUREMENT AirCtl_qGovOff_mp "untere Schwelle der Abschalthysterese" SWORD InjMass 1 100 -327.6800 327.6700 FORMAT "%8.4" ECU_ADDRESS 0x801F8C /end MEASUREMENT
/begin MEASUREMENT AirCtl_qGovOn_mp "obere Schwelle der Abschalthysterese" SWORD InjMass 1 100 -327.6800 327.6700 FORMAT "%8.4" ECU_ADDRESS 0x801F8E /end MEASUREMENT
/begin MEASUREMENT AirCtl_rBalGov "Abgleichwert des Lambdagleichreglers" SWORD Prc 1 100 -327.6800 327.6700 FORMAT "%8.4" ECU_ADDRESS 0x7F95F8 /end MEASUREMENT
/begin MEASUREMENT AirCtl_rBalGovOutI_mp "Integratorausgang des Gleichreglers" SWORD Prc 1 100 -327.6800 327.6700 FORMAT "%8.4" ECU_ADDRESS 0x801FBA /end MEASUREMENT
/begin MEASUREMENT AirCtl_rBalGovOutP_mp "Verstärkungsausgang des Lambdagleichreglers" SWORD Prc 1 100 -327.6800 327.6700 FORMAT "%8.4" ECU_ADDRESS 0x801FBC /end MEASUREMENT
/begin MEASUREMENT AirCtl_rBalGovUnCorr_mp "PI-Regler ausgang ohne Druckkorrektur des Gleichreglers" SWORD Prc 1 100 -327.6800 327.6700 FORMAT "%8.4" ECU_ADDRESS 0x801FBE /end MEASUREMENT
/begin MEASUREMENT AirCtl_rEGR "Stellgröße für das ARF-Ventil" SWORD Prc 1 100 -327.6800 327.6700 FORMAT "%8.4" ECU_ADDRESS 0x7F95FC /end MEASUREMENT
/begin MEASUREMENT AirCtl_rEGR2 "Stellwert 2 für Abgasregelung" SWORD Prc 1 100 -327.6800 327.6700 FORMAT "%8.4" ECU_ADDRESS 0x7F95FE /end MEASUREMENT
/begin MEASUREMENT AirCtl_rEGRByp2_mp "Meßpunkt für TV für 2. ARF Ventil vor Bypaß" SWORD Prc 1 100 -327.6800 327.6700 FORMAT "%8.4" ECU_ADDRESS 0x801FCC /end MEASUREMENT
/begin MEASUREMENT AirCtl_rEGRByp_mp "Bypass-Label, Kopie von AirCtl_rEGR" SWORD Prc 1 100 -327.6800 327.6700 FORMAT "%8.4" ECU_ADDRESS 0x801FCE /end MEASUREMENT
/begin MEASUREMENT AirCtl_rGovEGR_mp "Begrenzerausgang" SWORD Prc 1 100 -327.6800 327.6700 FORMAT "%8.4" ECU_ADDRESS 0x801F90 /end MEASUREMENT
/begin MEASUREMENT AirCtl_rGovHys1_mp "Ausgang 1. Teil von Dreifachhysterese" SWORD Prc 1 100 -327.6800 327.6700 FORMAT "%8.4" ECU_ADDRESS 0x801F92 /end MEASUREMENT
/begin MEASUREMENT AirCtl_rGovHys2_mp "Ausgang 2. Teil von Dreifachhysterese" SWORD Prc 1 100 -327.6800 327.6700 FORMAT "%8.4" ECU_ADDRESS 0x801F94 /end MEASUREMENT
/begin MEASUREMENT AirCtl_rGovHysSw_mp "Ausgang Dreifachhysterese nach Auswahlschalter" SWORD Prc 1 100 -327.6800 327.6700 FORMAT "%8.4" ECU_ADDRESS 0x801F96 /end MEASUREMENT
/begin MEASUREMENT AirCtl_rGovHys_mp "Ausgang Dreifachhysterese" SWORD Prc 1 100 -327.6800 327.6700 FORMAT "%8.4" ECU_ADDRESS 0x801F98 /end MEASUREMENT
/begin MEASUREMENT AirCtl_rGovMax_mp "Maximum für Luftmassenregler" SWORD Prc 1 100 -327.6800 327.6700 FORMAT "%8.4" ECU_ADDRESS 0x801F9A /end MEASUREMENT
/begin MEASUREMENT AirCtl_rGovMin_mp "Minimum für Luftmassenregelung" SWORD Prc 1 100 -327.6800 327.6700 FORMAT "%8.4" ECU_ADDRESS 0x801F9C /end MEASUREMENT
/begin MEASUREMENT AirCtl_rGovPCor_mp "Ausgang Luftdruckkorrekturkennfeld" SWORD Prc 1 100 -327.6800 327.6700 FORMAT "%8.4" ECU_ADDRESS 0x801F9E /end MEASUREMENT
/begin MEASUREMENT AirCtl_rGovQDes_mp "Ausgang Hauptkennfeld" SWORD Prc 1 100 -327.6800 327.6700 FORMAT "%8.4" ECU_ADDRESS 0x801FA0 /end MEASUREMENT
/begin MEASUREMENT AirCtl_rGovRgnEGR_mp "Begrenzerausgang für Partikelfilter Regeneration" SWORD Prc 1 100 -327.6800 327.6700 FORMAT "%8.4" ECU_ADDRESS 0x801FA2 /end MEASUREMENT
/begin MEASUREMENT AirCtl_rGovRgnMin_mp "Minimumwert der Luftmassenregelung während Regeneration" SWORD Prc 1 100 -327.6800 327.6700 FORMAT "%8.4" ECU_ADDRESS 0x801FA4 /end MEASUREMENT
/begin MEASUREMENT AirCtl_rGovRgnTVA_mp "Begrenzerausgang für Partikelfilter Regeneration" SWORD Prc 1 100 -327.6800 327.6700 FORMAT "%8.4" ECU_ADDRESS 0x801FA6 /end MEASUREMENT
/begin MEASUREMENT AirCtl_rGovStdEGR_mp "Standard Begrenzerausgang" SWORD Prc 1 100 -327.6800 327.6700 FORMAT "%8.4" ECU_ADDRESS 0x801FA8 /end MEASUREMENT
/begin MEASUREMENT AirCtl_rGovStdTVA_mp "Standard Begrenzerausgang" SWORD Prc 1 100 -327.6800 327.6700 FORMAT "%8.4" ECU_ADDRESS 0x801FAA /end MEASUREMENT
/begin MEASUREMENT AirCtl_rGovTEngCor_mp "Ausgang Temperaturkorrekturkennfeld" SWORD Prc 1 100 -327.6800 327.6700 FORMAT "%8.4" ECU_ADDRESS 0x801FAC /end MEASUREMENT
/begin MEASUREMENT AirCtl_rGovTVA1_mp "Begrenzerausgang Drosselklappe" SWORD Prc 1 100 -327.6800 327.6700 FORMAT "%8.4" ECU_ADDRESS 0x801FAE /end MEASUREMENT
/begin MEASUREMENT AirCtl_rGovTVA_mp "Begrenzerausgang" SWORD Prc 1 100 -327.6800 327.6700 FORMAT "%8.4" ECU_ADDRESS 0x801FB0 /end MEASUREMENT
/begin MEASUREMENT AirCtl_rLmbdDiff "Differenz der gefilterten Lambdawerte" SWORD lambda 1 100 -32.76800 32.76700 FORMAT "%8.5" ECU_ADDRESS 0x7F9608 /end MEASUREMENT
/begin MEASUREMENT AirCtl_rLmbdDiffThres_mp "Schwellwert der Lambdadifferenz in der Luftmassenregelung" SWORD lambda 1 100 -32.76800 32.76700 FORMAT "%8.5" ECU_ADDRESS 0x801FD0 /end MEASUREMENT
/begin MEASUREMENT AirCtl_rP3Diff_mp "Korrekturwert bei unterschiedlichem Druck vor Turbine" SWORD Prc 1 100 -327.6800 327.6700 FORMAT "%8.4" ECU_ADDRESS 0x801FC0 /end MEASUREMENT
/begin MEASUREMENT AirCtl_rTVA "Sollposition des Regelklappen-Stellers" SWORD Prc 1 100 -327.6800 327.6700 FORMAT "%8.4" ECU_ADDRESS 0x7F960A /end MEASUREMENT
/begin MEASUREMENT AirCtl_rTVAByp_mp "Bypass-Label, Kopie von AirCtl_rTVA" SWORD Prc 1 100 -327.6800 327.6700 FORMAT "%8.4" ECU_ADDRESS 0x801FD2 /end MEASUREMENT
/begin MEASUREMENT AirCtl_stAirCtlBits_mp "Anzeige der Abschaltursache in der ARF-Überwachung (bitorientiert)" ULONG OneToOne 1 100 0.00 4294967295.00 FORMAT "%13.2" ECU_ADDRESS 0x801FD4 /end MEASUREMENT
/begin MEASUREMENT AirCtl_stAirCtl_mp "Abschaltursache, die auf die  Abgas-Rückführ- und Drosselklappen-Regelung wirkt" UBYTE OneToOne 1 100 0.00 255.0 FORMAT "%5.1" ECU_ADDRESS 0x801FD8 /end MEASUREMENT
/begin MEASUREMENT AirCtl_stAirHiMsk_mp "Status der Übereinstimmung des EGT-Status mit entsprechender Maske" UBYTE OneToOne 1 100 0.00 255.0 FORMAT "%5.1" ECU_ADDRESS 0x801FD9 /end MEASUREMENT
/begin MEASUREMENT AirCtl_stAirLoMsk_mp "Status der Übereinstimmung des EGT-Status mit entsprechender Maske" UBYTE OneToOne 1 100 0.00 255.0 FORMAT "%5.1" ECU_ADDRESS 0x801FDA /end MEASUREMENT
/begin MEASUREMENT AirCtl_stBasAdj "Status der Grundeinstellung im Modul AirCtl; (höherpriore Abschaltanforderung)  (Diagnose)" UBYTE OneToOne 1 100 0.00 255.0 FORMAT "%5.1" ECU_ADDRESS 0x7F931D /end MEASUREMENT
/begin MEASUREMENT AirCtl_stDebDef "Flag für Fehler Entprellbedingung" UBYTE OneToOne 1 100 0.00 255.0 FORMAT "%5.1" ECU_ADDRESS 0x7F931E /end MEASUREMENT
/begin MEASUREMENT AirCtl_stGovHys "Status für Reglerabschaltung über Hysterese" UBYTE OneToOne 1 100 0.00 255.0 FORMAT "%5.1" ECU_ADDRESS 0x7F9320 /end MEASUREMENT
/begin MEASUREMENT AirCtl_stGovRgn2_mp "Regenerationsbetrieb 2 aktiv" UBYTE OneToOne 1 100 0.00 255.0 FORMAT "%5.1" ECU_ADDRESS 0x801FB2 /end MEASUREMENT
/begin MEASUREMENT AirCtl_stHealDef_mp "Status, ob Heilung von erkannter bleibender Regelabweichung zulässig" UBYTE OneToOne 1 100 0.00 255.0 FORMAT "%5.1" ECU_ADDRESS 0x801FDB /end MEASUREMENT
/begin MEASUREMENT AirCtl_stHighMsk_mp "Status der Übereinstimmung des EGT-Status mit entsprechender Maske" UBYTE OneToOne 1 100 0.00 255.0 FORMAT "%5.1" ECU_ADDRESS 0x801FDC /end MEASUREMENT
/begin MEASUREMENT AirCtl_stHigh_mp "gewähle Kennlinie in Abhängigkeit von EGT_st" SWORD InjMass 1 100 -327.6800 327.6700 FORMAT "%8.4" ECU_ADDRESS 0x801FDE /end MEASUREMENT
/begin MEASUREMENT AirCtl_stHyst_mp "Status der Mengenhysterese" UBYTE OneToOne 1 100 0.00 255.0 FORMAT "%5.1" ECU_ADDRESS 0x801FE0 /end MEASUREMENT
/begin MEASUREMENT AirCtl_stMiddleMsk_mp "Status der Übereinstimmung des EGT-Status mit entsprechender Maske" UBYTE OneToOne 1 100 0.00 255.0 FORMAT "%5.1" ECU_ADDRESS 0x801FE1 /end MEASUREMENT
/begin MEASUREMENT AirCtl_stMiddle_mp "gewähle Kennlinie in Abhängigkeit von EGT_st" SWORD InjMass 1 100 -327.6800 327.6700 FORMAT "%8.4" ECU_ADDRESS 0x801FE2 /end MEASUREMENT
/begin MEASUREMENT AirCtl_stMonitor "Status: Abschaltfall der Regelung" UBYTE OneToOne 1 100 0.00 255.0 FORMAT "%5.1" ECU_ADDRESS 0x7F9321 /end MEASUREMENT
/begin MEASUREMENT AirCtl_stMonOvr_mp "Status der Schubbetrieberkennung" UBYTE OneToOne 1 100 0.00 255.0 FORMAT "%5.1" ECU_ADDRESS 0x801FE4 /end MEASUREMENT
/begin MEASUREMENT AirCtl_stMonRsltBits_mp "Bitmaske der Abschaltursachen vor Eingriffe der Abgasnachbehandlung" ULONG OneToOne 1 100 0.00 4294967295.00 FORMAT "%13.2" ECU_ADDRESS 0x801FE8 /end MEASUREMENT
/begin MEASUREMENT AirCtl_stTimerOn_mp "Status für Timerstart" UBYTE OneToOne 1 100 0.00 255.0 FORMAT "%5.1" ECU_ADDRESS 0x801FEC /end MEASUREMENT
/begin MEASUREMENT AirCtl_tiDlyTimer_mp "Zeit für Verzögerungstimer" ULONG Time_ms 1 100 0.00 42949672950.0 FORMAT "%13.1" ECU_ADDRESS 0x801FF0 /end MEASUREMENT
/begin MEASUREMENT AirCtl_tiStrtDelay_mp "Zeit, in der die Regelung nach Startabwurf abgeschaltet bleibt" UWORD Time_ms 1 100 0.00 655350.0 FORMAT "%8.1" ECU_ADDRESS 0x801FF4 /end MEASUREMENT
/begin MEASUREMENT AirCtl_trqCrCtlHys_mp "Eingangswert der AirCtl_trqCrCtloff Hysterese" SLONG Trq 1 100 -214748364.800 214748364.700 FORMAT "%13.3" ECU_ADDRESS 0x801FF8 /end MEASUREMENT
/begin MEASUREMENT AirCtl_tStrtDelay_mp "Temperaturwert von dem Array Eng_tFld" SWORD Temp_Cels 1 100 -3549.940 3003.560 FORMAT "%8.3" ECU_ADDRESS 0x801FFC /end MEASUREMENT
/begin MEASUREMENT AirSys_stTstDem "Statusvariable für Stellertest bei Diagnoseeingriff" UWORD OneToOne 1 100 0.00 65535.00 FORMAT "%8.2" ECU_ADDRESS 0x7F960C /end MEASUREMENT
/begin MEASUREMENT AltCD_dcycAltLoad "gemessenes Tastverhältnis des Generatorlastsignals" SWORD DtyCyc 1 100 -327.6800 327.6700 FORMAT "%8.4" ECU_ADDRESS 0x7F960E /end MEASUREMENT
/begin MEASUREMENT AltCD_rAltLoad "Linearisiertes und fehlerentprelltes Generatorlastsignals" SWORD Prc 1 100 -327.6800 327.6700 FORMAT "%8.4" ECU_ADDRESS 0x7F9610 /end MEASUREMENT
/begin MEASUREMENT AltCD_stAltProvDef "Status ob Generator vorläufig defekt ist" UBYTE OneToOne 1 100 0.00 255.0 FORMAT "%5.1" ECU_ADDRESS 0x7F9327 /end MEASUREMENT
/begin MEASUREMENT AltCD_stErr_mp "Fehlerinformation der PWM-Erfassung" UBYTE OneToOne 1 100 0.00 255.0 FORMAT "%5.1" ECU_ADDRESS 0x802006 /end MEASUREMENT
/begin MEASUREMENT AltCD_stPwrStgExc_mp "Endstufenfehlerinformation der Generatorerregung" UWORD OneToOne 1 100 0.00 65535.00 FORMAT "%8.2" ECU_ADDRESS 0x802004 /end MEASUREMENT
/begin MEASUREMENT AltCD_tiActPer_mp "Aktuelle Periode PWM-in Generatorlastsignal" UWORD Period_ms 1 100 0.00 6553.500 FORMAT "%8.3" ECU_ADDRESS 0x802008 /end MEASUREMENT
/begin MEASUREMENT Alt_dcycAlt "Tastverhältnis für Generatorerregung" SWORD DtyCyc 1 100 -327.6800 327.6700 FORMAT "%8.4" ECU_ADDRESS 0x7F9612 /end MEASUREMENT
/begin MEASUREMENT Alt_pwrDemandEEP_mp "Limitierter EEPROM Abgleichwert von ALT_PWR_DEMAND" SWORD Pwr 1 100 -308831.1 308821.7 FORMAT "%8.1" ECU_ADDRESS 0x802002 /end MEASUREMENT
/begin MEASUREMENT Alt_pwrDes "mechanischer Leistungsbedarf des Generators" SWORD Pwr 1 100 -308831.1 308821.7 FORMAT "%8.1" ECU_ADDRESS 0x7F9614 /end MEASUREMENT
/begin MEASUREMENT Alt_pwrLead "Vorhaltleistung des Generators" SWORD Pwr 1 100 -308831.1 308821.7 FORMAT "%8.1" ECU_ADDRESS 0x7F9616 /end MEASUREMENT
/begin MEASUREMENT Alt_stAltExc_mp "Status der Statemachine" UBYTE OneToOne 1 100 0.00 255.0 FORMAT "%5.1" ECU_ADDRESS 0x801FFE /end MEASUREMENT
/begin MEASUREMENT Alt_stTrqInprec "Ersatzwert für Generatorleistung wird verwendet" UBYTE OneToOne 1 100 0.00 255.0 FORMAT "%5.1" ECU_ADDRESS 0x7F9328 /end MEASUREMENT
/begin MEASUREMENT Alt_swtPwrCan "Schalter für Generatorleistung über CAN" UBYTE OneToOne 1 100 0.00 255.0 FORMAT "%5.1" ECU_ADDRESS 0x7F9329 /end MEASUREMENT
/begin MEASUREMENT Alt_tiBEMLdResp "Lastreaktionszeit Generator" UWORD Time_s 1 100 0.00 655.3500 FORMAT "%8.4" ECU_ADDRESS 0x7F9618 /end MEASUREMENT
/begin MEASUREMENT Alt_tiExcdly_mp "Verzögerungszeit der Generatorerregung" SWORD Time_ms 1 100 -327680.0 327670.0 FORMAT "%8.1" ECU_ADDRESS 0x802000 /end MEASUREMENT
/begin MEASUREMENT AOHtCD_dvolFlConsum "Aktueller Zuheizerverbrauch in l/h" SWORD FlConsum_l_h 1 100 -327.6800 327.6700 FORMAT "%8.4" ECU_ADDRESS 0x7F9588 /end MEASUREMENT
/begin MEASUREMENT AOHtCD_swtHeater12Ena "Message, ob Schalterwert Zuheizer 1 und 2 aktiviert (=1) oder deaktiviert (=0) sind" UBYTE OneToOne 1 100 0.00 255.0 FORMAT "%5.1" ECU_ADDRESS 0x7F92F8 /end MEASUREMENT
/begin MEASUREMENT AOHtCD_tiPerAvrg_mp "Periodentime aus der HWK" SLONG Time_ms 1 100 -21474836480.0 21474836470.0 FORMAT "%13.1" ECU_ADDRESS 0x802020 /end MEASUREMENT
/begin MEASUREMENT AOHtCD_volFlConsum "Aktueller Zuheizerverbrauch in ul" SWORD FlConsum_ul_1 1 100 -32.76800 32.76700 FORMAT "%8.5" ECU_ADDRESS 0x7F958A /end MEASUREMENT
/begin MEASUREMENT AOHt_nMin "Minimum Leerlaufsolldrehzahlanforderung durch Zuheizer" SWORD EngN 1 100 -32768.00 32767.00 FORMAT "%8.2" ECU_ADDRESS 0x7F958C /end MEASUREMENT
/begin MEASUREMENT AOHt_nMin_mp "Minimale Leerlaudsolldrehzahlanforderung durch Zuheizer vor PT1" SWORD EngN 1 100 -32768.00 32767.00 FORMAT "%8.2" ECU_ADDRESS 0x80200A /end MEASUREMENT
/begin MEASUREMENT AOHt_NumRly_mp "Anzahl aktiver Heitzelemente" SWORD OneToOne 1 100 -32768.00 32767.00 FORMAT "%8.2" ECU_ADDRESS 0x80200C /end MEASUREMENT
/begin MEASUREMENT AOHt_rOff_mp "Meßpunkt der Generatorlast Abschaltschwelle" SWORD Prc 1 100 -327.6800 327.6700 FORMAT "%8.4" ECU_ADDRESS 0x80200E /end MEASUREMENT
/begin MEASUREMENT AOHt_rOn_mp "Meßpunkt der Generatorlast Zuschaltschwelle" SWORD Prc 1 100 -327.6800 327.6700 FORMAT "%8.4" ECU_ADDRESS 0x802010 /end MEASUREMENT
/begin MEASUREMENT AOHt_stEngOff "Kein Motor-Aus Befehl vom MSG an Getriebe SG" UBYTE OneToOne 1 100 0.00 255.0 FORMAT "%5.1" ECU_ADDRESS 0x7F92F9 /end MEASUREMENT
/begin MEASUREMENT AOHt_stHt1Out "Messages an Komponententreiber  Zuheizer 1 (Ein/Aus)" UBYTE OneToOne 1 100 0.00 255.0 FORMAT "%5.1" ECU_ADDRESS 0x7F92FA /end MEASUREMENT
/begin MEASUREMENT AOHt_stHt2Out "Messages an Komponententreiber  Zuheizer 2 (Ein/Aus)" UBYTE OneToOne 1 100 0.00 255.0 FORMAT "%5.1" ECU_ADDRESS 0x7F92FB /end MEASUREMENT
/begin MEASUREMENT AOHt_stHt3Out "Messages an Komponententreiber  Zuheizer 3 (Ein/Aus)" UBYTE OneToOne 1 100 0.00 255.0 FORMAT "%5.1" ECU_ADDRESS 0x7F92FC /end MEASUREMENT
/begin MEASUREMENT AOHt_stOK "Statusbereitschaft zum Einschalten der Zusatzheizung" UBYTE OneToOne 1 100 0.00 255.0 FORMAT "%5.1" ECU_ADDRESS 0x7F92FD /end MEASUREMENT
/begin MEASUREMENT AOHt_stShutOff_mp "Überblick auf alle Abschaltbedingungen" UWORD OneToOne 1 100 0.00 65535.00 FORMAT "%8.2" ECU_ADDRESS 0x802012 /end MEASUREMENT
/begin MEASUREMENT AOHt_swtACEngOff "Motor AUS trotz AC Anforderung" UBYTE OneToOne 1 100 0.00 255.0 FORMAT "%5.1" ECU_ADDRESS 0x7F92FE /end MEASUREMENT
/begin MEASUREMENT AOHt_swtHtEngOff "Motor AUS trotz Kühlwasserheizungsanfordern" UBYTE OneToOne 1 100 0.00 255.0 FORMAT "%5.1" ECU_ADDRESS 0x7F92FF /end MEASUREMENT
/begin MEASUREMENT AOHt_swtHtShOff "Kühlwasserheizung-Abschaltung mit Klimakompressor oder Kühlwasserheizungs Anforderung" UBYTE OneToOne 1 100 0.00 255.0 FORMAT "%5.1" ECU_ADDRESS 0x7F9300 /end MEASUREMENT
/begin MEASUREMENT AOHt_tAirEngOff_mp "Temperatureingang für Zeit-Kennlinie AOHt_tiEngOff_CUR" SWORD Temp_Cels 1 100 -3549.940 3003.560 FORMAT "%8.3" ECU_ADDRESS 0x802014 /end MEASUREMENT
/begin MEASUREMENT AOHt_tAir_mp "verwendete Lufttemperatur" SWORD Temp_Cels 1 100 -3549.940 3003.560 FORMAT "%8.3" ECU_ADDRESS 0x802016 /end MEASUREMENT
/begin MEASUREMENT AOHt_tCltOff_mp "Wassertemperatur Aus-Schwelle für das nächste Heizelement" SWORD Temp_Cels 1 100 -3549.940 3003.560 FORMAT "%8.3" ECU_ADDRESS 0x802018 /end MEASUREMENT
/begin MEASUREMENT AOHt_tCltOn_mp "Wassertemperatur Ein-Schwelle für das nächste Heizelement" SWORD Temp_Cels 1 100 -3549.940 3003.560 FORMAT "%8.3" ECU_ADDRESS 0x80201A /end MEASUREMENT
/begin MEASUREMENT AOHt_tEngHys_mp "Schalter der Temperaturwert des Arrays auswählt" SWORD Temp_Cels 1 100 -3549.940 3003.560 FORMAT "%8.3" ECU_ADDRESS 0x80201C /end MEASUREMENT
/begin MEASUREMENT APPCD_BegCo_mp "Veralteter Testmesspunkt, nicht beachten!" UWORD OneToOne 1 100 0.00 65535.00 FORMAT "%8.2" ECU_ADDRESS 0x802024 /end MEASUREMENT
/begin MEASUREMENT APPCD_drAPP1UnFlt "Differenz der Fahrpedal 1 Position ungefilterter Wert" SWORD Prc_D20ms 1 100 -16384.00 16383.50 FORMAT "%8.2" ECU_ADDRESS 0x7F958E /end MEASUREMENT
/begin MEASUREMENT APPCD_EndCo_mp "Veralteter Testmesspunkt, nicht beachten!" UWORD OneToOne 1 100 0.00 65535.00 FORMAT "%8.2" ECU_ADDRESS 0x802026 /end MEASUREMENT
/begin MEASUREMENT APPCD_rAPP1UnFlt "Fahrpedal 1 position ungefilterter Rohwert" SWORD Prc 1 100 -327.6800 327.6700 FORMAT "%8.4" ECU_ADDRESS 0x7F9590 /end MEASUREMENT
/begin MEASUREMENT APPCD_rFlt "gefiltertes Pedalwertgebersignal" SWORD Prc 1 100 -327.6800 327.6700 FORMAT "%8.4" ECU_ADDRESS 0x7F9592 /end MEASUREMENT
/begin MEASUREMENT APPCD_rLinAPP1_mp "linearisierter Spannungswert von APP1" SWORD Prc 1 100 -327.6800 327.6700 FORMAT "%8.4" ECU_ADDRESS 0x802028 /end MEASUREMENT
/begin MEASUREMENT APPCD_stAPP12def_mp "Messpunkt für unentprellten Gleichlauffehler APP1/APP2" UBYTE OneToOne 1 100 0.00 255.0 FORMAT "%5.1" ECU_ADDRESS 0x80202A /end MEASUREMENT
/begin MEASUREMENT APPCD_stErr1_mp "Fehlerzustand von APP1/2 Signal" UWORD OneToOne 1 100 0.00 65535.00 FORMAT "%8.2" ECU_ADDRESS 0x80202C /end MEASUREMENT
/begin MEASUREMENT APPCD_stErrSensSig_mp "Fehlerzustand von APP1/2 Signal" UWORD OneToOne 1 100 0.00 65535.00 FORMAT "%8.2" ECU_ADDRESS 0x80202E /end MEASUREMENT
/begin MEASUREMENT APPCD_stKickDown "Kick Down Zustand des Fahrpedals" UBYTE OneToOne 1 100 0.00 255.0 FORMAT "%5.1" ECU_ADDRESS 0x7F9301 /end MEASUREMENT
/begin MEASUREMENT APPCD_stLimp "Status Notfahrbetrieb APP" UBYTE OneToOne 1 100 0.00 255.0 FORMAT "%5.1" ECU_ADDRESS 0x7F9302 /end MEASUREMENT
/begin MEASUREMENT APPCD_stLowIdlSwtVal "Status Leergasschalter" UBYTE OneToOne 1 100 0.00 255.0 FORMAT "%5.1" ECU_ADDRESS 0x7F9303 /end MEASUREMENT
/begin MEASUREMENT APPCD_stRawKickDown "Kickdown Rohwert" UBYTE OneToOne 1 100 0.00 255.0 FORMAT "%5.1" ECU_ADDRESS 0x7F9304 /end MEASUREMENT
/begin MEASUREMENT APPCD_stSigSrc "Status der ausgewaehlten Signalquelle APP" UBYTE OneToOne 1 100 0.00 255.0 FORMAT "%5.1" ECU_ADDRESS 0x7F9305 /end MEASUREMENT
/begin MEASUREMENT APPCD_stSwitchSig "Status der Schalterstellungen 1 für Diagnose" UBYTE OneToOne 1 100 0.00 255.0 FORMAT "%5.1" ECU_ADDRESS 0x7F9306 /end MEASUREMENT
/begin MEASUREMENT APPCD_stTempErr_mp "Messpunkt für vorläufigen APP-Fehler" UBYTE OneToOne 1 100 0.00 255.0 FORMAT "%5.1" ECU_ADDRESS 0x802030 /end MEASUREMENT
/begin MEASUREMENT APPCD_swtType "Auswahl zwischen Doppelanalog- und Poti/Schalter-PWG" UBYTE OneToOne 1 100 0.00 255.0 FORMAT "%5.1" ECU_ADDRESS 0x7F9307 /end MEASUREMENT
/begin MEASUREMENT APPCD_uAPPunJit_mp "Messpunkt der  APP Rohspannung vor Entjitterung" SWORD Volt 1 100 -160156.4 160151.5 FORMAT "%8.1" ECU_ADDRESS 0x802032 /end MEASUREMENT
/begin MEASUREMENT APPCD_uDiffMax_mp "Maximal zulässige Differenz der Rohspannungen" SWORD Volt 1 100 -160156.4 160151.5 FORMAT "%8.1" ECU_ADDRESS 0x802034 /end MEASUREMENT
/begin MEASUREMENT APPCD_uHighLimLowIdle "Obere Grenze für plausible Leergasstellung" SWORD Volt 1 100 -160156.4 160151.5 FORMAT "%8.1" ECU_ADDRESS 0x7F9594 /end MEASUREMENT
/begin MEASUREMENT APPCD_uKickDownHighAPP_mp "Kick-Down Schwellwert hoch" SWORD Volt 1 100 -160156.4 160151.5 FORMAT "%8.1" ECU_ADDRESS 0x802036 /end MEASUREMENT
/begin MEASUREMENT APPCD_uKickDownThres_mp "Gelernter Kick-Down-Schwellwert" SWORD Volt 1 100 -160156.4 160151.5 FORMAT "%8.1" ECU_ADDRESS 0x802038 /end MEASUREMENT
/begin MEASUREMENT APPCD_uLowIdlSwtLinVal "Linearisierter Leergasschalterwert" SWORD Volt 1 100 -160156.4 160151.5 FORMAT "%8.1" ECU_ADDRESS 0x7F9596 /end MEASUREMENT
/begin MEASUREMENT APPCD_uLowIdlSwtRawVal "Leergasschalter Rohwert" SWORD Volt 1 100 -160156.4 160151.5 FORMAT "%8.1" ECU_ADDRESS 0x7F9598 /end MEASUREMENT
/begin MEASUREMENT APPCD_uLowLimLowIdle "Untere Grenze für plausible Leergasstellung" SWORD Volt 1 100 -160156.4 160151.5 FORMAT "%8.1" ECU_ADDRESS 0x7F959A /end MEASUREMENT
/begin MEASUREMENT APPCD_uRawAPP1 "Fahrpedal 1 Position Rohwert" SWORD Volt 1 100 -160156.4 160151.5 FORMAT "%8.1" ECU_ADDRESS 0x7F959C /end MEASUREMENT
/begin MEASUREMENT APPCD_uRawAPP1half_mp "Halbierte APP1 Rohspannung" SWORD Volt 1 100 -160156.4 160151.5 FORMAT "%8.1" ECU_ADDRESS 0x80203A /end MEASUREMENT
/begin MEASUREMENT APPCD_uRawAPP2 "Fahrpedal 2 Position Rohwert" SWORD Volt 1 100 -160156.4 160151.5 FORMAT "%8.1" ECU_ADDRESS 0x7F959E /end MEASUREMENT
/begin MEASUREMENT APPCD_uRawAPP2dbl_mp "Verdoppelte APP2 Rohspannung" SWORD Volt 1 100 -160156.4 160151.5 FORMAT "%8.1" ECU_ADDRESS 0x80203C /end MEASUREMENT
/begin MEASUREMENT APPCD_uRawDiff_mp "Betrag der Differenz der Rohspannungen von APP1 und APP2" SWORD Volt 1 100 -160156.4 160151.5 FORMAT "%8.1" ECU_ADDRESS 0x80203E /end MEASUREMENT
/begin MEASUREMENT APPCD_uRaw_mp "Messpunkt der ausgewaehlten APP Rohspannung" SWORD Volt 1 100 -160156.4 160151.5 FORMAT "%8.1" ECU_ADDRESS 0x802040 /end MEASUREMENT
/begin MEASUREMENT APSCD_BpsAllowed_mp "Wahlschalter - Atmosphaerendruck gemessen (wenn verbaut) od. gerechnet von Ladedrucksensor" UWORD OneToOne 1 100 0.00 65535.00 FORMAT "%8.2" ECU_ADDRESS 0x802042 /end MEASUREMENT
/begin MEASUREMENT APSCD_pCorVal_mp "Korrekturwert fuer Atmosphaerendruck von Ladedrucksensor" SWORD Pres_hPa 1 100 -32768.00 32767.00 FORMAT "%8.2" ECU_ADDRESS 0x802044 /end MEASUREMENT
/begin MEASUREMENT APSCD_pLinVal "Rohwert Atmosphärendruck über ADC" SWORD Pres_hPa 1 100 -32768.00 32767.00 FORMAT "%8.2" ECU_ADDRESS 0x7F95A0 /end MEASUREMENT
/begin MEASUREMENT APSCD_pSensorVal "Atmosphaerendruck Sensorwert" SWORD Pres_hPa 1 100 -32768.00 32767.00 FORMAT "%8.2" ECU_ADDRESS 0x7F95A2 /end MEASUREMENT
/begin MEASUREMENT APSCD_pVal "Atmosphärendruck" SWORD Pres_hPa 1 100 -32768.00 32767.00 FORMAT "%8.2" ECU_ADDRESS 0x7F95A4 /end MEASUREMENT
/begin MEASUREMENT APSCD_stSensorInst "Status, ob Atmosphärendrucksensor eingebaut ist (0 == nicht eingebaut)" UBYTE OneToOne 1 100 0.00 255.0 FORMAT "%5.1" ECU_ADDRESS 0x7F9308 /end MEASUREMENT
/begin MEASUREMENT APSCD_uRaw "Rohspannung ADC-Signal Atmosphärendruck" SWORD Volt 1 100 -160156.4 160151.5 FORMAT "%8.1" ECU_ADDRESS 0x7F95A6 /end MEASUREMENT
/begin MEASUREMENT ARnMon_stARnMon_mp "Zustand des After Run Monitors" UBYTE OneToOne 1 100 0.00 255.0 FORMAT "%5.1" ECU_ADDRESS 0x802046 /end MEASUREMENT
/begin MEASUREMENT ARnMon_stT15DebVal_mp "Zustand der Hardware-entprellten Klemme 15" UBYTE OneToOne 1 100 0.00 255.0 FORMAT "%5.1" ECU_ADDRESS 0x802047 /end MEASUREMENT
/begin MEASUREMENT ASDdc_dActGearFac_mp "Faktoren aus Kennlinie zur Berechnung der Turbinendrehzahl" SWORD VelToN 1 100 -0.3276800 0.3276700 FORMAT "%9.7" ECU_ADDRESS 0x802050 /end MEASUREMENT
/begin MEASUREMENT ASDdc_dfacRmp "negative Steigung der Abschaltrampe (positiven Gradienten gibt es nicht)" ULONG Rmp_Fact16 1 100 0.00 1023999.99976 FORMAT "%13.5" ECU_ADDRESS 0x7F9BC4 /end MEASUREMENT
/begin MEASUREMENT ASDdc_dnAvrg_mp "Drehzahlgradient DT1 Glied Ausgang" SWORD rev_acc 1 100 -32768.00 32767.00 FORMAT "%8.2" ECU_ADDRESS 0x802052 /end MEASUREMENT
/begin MEASUREMENT ASDdc_dnIntegOutNeg_mp "Ausgang des Integrators bei Beendigung des negativen Lastschlages" SWORD rev_acc 1 100 -32768.00 32767.00 FORMAT "%8.2" ECU_ADDRESS 0x802054 /end MEASUREMENT
/begin MEASUREMENT ASDdc_dnIntegOutPos_mp "Ausgang des Integrators bei Beendigung des positiven Lastschlages" SWORD rev_acc 1 100 -32768.00 32767.00 FORMAT "%8.2" ECU_ADDRESS 0x802056 /end MEASUREMENT
/begin MEASUREMENT ASDdc_dtrqInrDesSlow_mp "Wunschmomentänderung" SWORD RmpTrqdHigh 1 100 -48000.00 47998.54 FORMAT "%8.2" ECU_ADDRESS 0x802058 /end MEASUREMENT
/begin MEASUREMENT ASDdc_facRmpOvrRun "Abschaltfaktor bei Schub" SWORD Fact 1 100 -4.000000 3.999878 FORMAT "%8.6" ECU_ADDRESS 0x7F95A8 /end MEASUREMENT
/begin MEASUREMENT ASDdc_KdCurr_mp "Aktueller Parameter Kd des ARD-SR (ASDdc)" FLOAT32_IEEE ASD_GvrnDT1Kd_float 1 100 -1.00000000 100.000000 FORMAT "%10.6" ECU_ADDRESS 0x802048 /end MEASUREMENT
/begin MEASUREMENT ASDdc_nAvrg_mp "Motordrehzahl für die Parametersatzauswahl beim ASDdc" SWORD EngN 1 100 -32768.00 32767.00 FORMAT "%8.2" ECU_ADDRESS 0x80205A /end MEASUREMENT
/begin MEASUREMENT ASDdc_nDeltaLead_mp "ungefilterte Reglereingangsdrehzahl" SWORD EngN 1 100 -32768.00 32767.00 FORMAT "%8.2" ECU_ADDRESS 0x80205C /end MEASUREMENT
/begin MEASUREMENT ASDdc_nDeltaPT1_mp "gefilterte Reglereingangsdrehzahl" SWORD EngN 1 100 -32768.00 32767.00 FORMAT "%8.2" ECU_ADDRESS 0x80205E /end MEASUREMENT
/begin MEASUREMENT ASDdc_nSlipN_mp "Schlupfdrehzahl" SWORD EngN 1 100 -32768.00 32767.00 FORMAT "%8.2" ECU_ADDRESS 0x802060 /end MEASUREMENT
/begin MEASUREMENT ASDdc_nSPNOfs_mp "Offsetdrehzahl für Bildung des Sollwertes" SWORD EngN 1 100 -32768.00 32767.00 FORMAT "%8.2" ECU_ADDRESS 0x802062 /end MEASUREMENT
/begin MEASUREMENT ASDdc_nSPPT1_mp "Sollwert für Drehzahlregler Ausgang PT1 Filter" SWORD EngN 1 100 -32768.00 32767.00 FORMAT "%8.2" ECU_ADDRESS 0x802064 /end MEASUREMENT
/begin MEASUREMENT ASDdc_nTrbn_mp "Turbinendrehzahl" SWORD EngN 1 100 -32768.00 32767.00 FORMAT "%8.2" ECU_ADDRESS 0x802066 /end MEASUREMENT
/begin MEASUREMENT ASDdc_stActGear_mp "Ganginformation für Lastschlagdämpfung bei offener Wandlerkupplung" SBYTE OneToOne 1 100 -128.0 127.0 FORMAT "%5.1" ECU_ADDRESS 0x802068 /end MEASUREMENT
/begin MEASUREMENT ASDdc_stBitFrame_mp "Statusbitleiste für Parameterauswahl" ULONG OneToOne 1 100 0.00 4294967295.00 FORMAT "%13.2" ECU_ADDRESS 0x80206C /end MEASUREMENT
/begin MEASUREMENT ASDdc_stBlkTmr "Retriggung für Lastschlagerkennung gesperrt" UBYTE OneToOne 1 100 0.00 255.0 FORMAT "%5.1" ECU_ADDRESS 0x7F9309 /end MEASUREMENT
/begin MEASUREMENT ASDdc_stCluPS_mp "Kupplungs PS aktiv/nicht aktiv" UBYTE OneToOne 1 100 0.00 255.0 FORMAT "%5.1" ECU_ADDRESS 0x802070 /end MEASUREMENT
/begin MEASUREMENT ASDdc_stDisable "Zustand Schubabschaltung ASDdc" UBYTE OneToOne 1 100 0.00 255.0 FORMAT "%5.1" ECU_ADDRESS 0x7F930A /end MEASUREMENT
/begin MEASUREMENT ASDdc_stExitLdRevl_mp "Statuswort fuer Beendigung Lastschlagregelung" UWORD OneToOne 1 100 0.00 65535.00 FORMAT "%8.2" ECU_ADDRESS 0x802072 /end MEASUREMENT
/begin MEASUREMENT ASDdc_stExtInt "Status von ext. Eingriff" UBYTE OneToOne 1 100 0.00 255.0 FORMAT "%5.1" ECU_ADDRESS 0x7F930B /end MEASUREMENT
/begin MEASUREMENT ASDdc_stGenCondNGvnr_mp "Status der generellen Bedingungen des Drehzahlreglers" UBYTE OneToOne 1 100 0.00 255.0 FORMAT "%5.1" ECU_ADDRESS 0x802074 /end MEASUREMENT
/begin MEASUREMENT ASDdc_stGrip_mp "Kraftschluss und Nulldurchgang des Störungsreglers - Vergleich zwischen dem tatsächlichen und dem benötigten Zustand" UBYTE OneToOne 1 100 0.00 255.0 FORMAT "%5.1" ECU_ADDRESS 0x802075 /end MEASUREMENT
/begin MEASUREMENT ASDdc_stLdRevlDet_mp "Statuswort fuer Lastschlagerkennung" UWORD OneToOne 1 100 0.00 65535.00 FORMAT "%8.2" ECU_ADDRESS 0x802076 /end MEASUREMENT
/begin MEASUREMENT ASDdc_stNGvnr_mp "Status fuer Drehzahlregler (bitorientiert)" UBYTE OneToOne 1 100 0.00 255.0 FORMAT "%5.1" ECU_ADDRESS 0x802078 /end MEASUREMENT
/begin MEASUREMENT ASDdc_stPosNeg_mp "pos/neg Mengentendenz" UBYTE OneToOne 1 100 0.00 255.0 FORMAT "%5.1" ECU_ADDRESS 0x802079 /end MEASUREMENT
/begin MEASUREMENT ASDdc_stPwrOnOff_mp "Lastschlag erkannt" UBYTE OneToOne 1 100 0.00 255.0 FORMAT "%5.1" ECU_ADDRESS 0x80207A /end MEASUREMENT
/begin MEASUREMENT ASDdc_stShOffPT1Flt_mp "Schalter für Überbrückung der Sollwertfilterung des PT1 Gliedes" SWORD OneToOne 1 100 -32768.00 32767.00 FORMAT "%8.2" ECU_ADDRESS 0x80207C /end MEASUREMENT
/begin MEASUREMENT ASDdc_stStMNGvnr_mp "Status der Drehzahlregler Statemachine" UBYTE OneToOne 1 100 0.00 255.0 FORMAT "%5.1" ECU_ADDRESS 0x80207E /end MEASUREMENT
/begin MEASUREMENT ASDdc_stTrqRmp_mp "Schalterstellung Rampe zur ARDsr-Abschaltung im Schub" UBYTE OneToOne 1 100 0.00 255.0 FORMAT "%5.1" ECU_ADDRESS 0x80207F /end MEASUREMENT
/begin MEASUREMENT ASDdc_T1Curr_mp "Aktueller Parameter T1 des ARD-SR (ASDdc)" FLOAT32_IEEE ASD_GvrnDT1T1_float 1 100 -1.00000000 100.000000 FORMAT "%10.6" ECU_ADDRESS 0x80204C /end MEASUREMENT
/begin MEASUREMENT ASDdc_tiRmpStrt "aus Kennfeld berechnete Wartezeit bis Faktorrampe startet" UWORD Time_s 1 100 0.00 655.3500 FORMAT "%8.4" ECU_ADDRESS 0x7F95AA /end MEASUREMENT
/begin MEASUREMENT ASDdc_trq "Momentforderung Aktiver Ruckeldämpfer (Störungsregler)" SWORD Trq 1 100 -3276.800 3276.700 FORMAT "%8.3" ECU_ADDRESS 0x7F95AC /end MEASUREMENT
/begin MEASUREMENT ASDdc_trqBeforeRmp_mp "ASDdc Ausgang vor Schubabschaltung" SWORD Trq 1 100 -3276.800 3276.700 FORMAT "%8.3" ECU_ADDRESS 0x802080 /end MEASUREMENT
/begin MEASUREMENT ASDdc_trqDpn_mp "Verlustmoment" SWORD Trq 1 100 -3276.800 3276.700 FORMAT "%8.3" ECU_ADDRESS 0x802082 /end MEASUREMENT
/begin MEASUREMENT ASDdc_trqEngOutLtd_mp "limitiertes Motorausgangsmoment" SWORD Trq 1 100 -3276.800 3276.700 FORMAT "%8.3" ECU_ADDRESS 0x802084 /end MEASUREMENT
/begin MEASUREMENT ASDdc_trqInrDesSlowFlt_mp "Gefiltertes Wunschmoment" SWORD Trq 1 100 -3276.800 3276.700 FORMAT "%8.3" ECU_ADDRESS 0x802086 /end MEASUREMENT
/begin MEASUREMENT ASDdc_trqLimMax_mp "obere Begrenzung des Störreglerausgangs" SWORD Trq 1 100 -3276.800 3276.700 FORMAT "%8.3" ECU_ADDRESS 0x802088 /end MEASUREMENT
/begin MEASUREMENT ASDdc_trqLimMin_mp "untere Begrenzung des Störreglerausgangs" SWORD Trq 1 100 -3276.800 3276.700 FORMAT "%8.3" ECU_ADDRESS 0x80208A /end MEASUREMENT
/begin MEASUREMENT ASDdc_trqNGvnrDT1_mp "DT1 - Anteil des Drehzahlreglers" SWORD Trq 1 100 -3276.800 3276.700 FORMAT "%8.3" ECU_ADDRESS 0x80208C /end MEASUREMENT
/begin MEASUREMENT ASDdc_trqNGvnrI_mp "I-Anteil des Drehzahlreglers" SWORD Trq 1 100 -3276.800 3276.700 FORMAT "%8.3" ECU_ADDRESS 0x80208E /end MEASUREMENT
/begin MEASUREMENT ASDdc_trqNGvnrNeg "negatives Ausgangsmoment des Drehzahlreglers" SWORD Trq 1 100 -3276.800 3276.700 FORMAT "%8.3" ECU_ADDRESS 0x7F95AE /end MEASUREMENT
/begin MEASUREMENT ASDdc_trqNGvnrPID_mp "Summe der einzelnen Reglerausgänge" SWORD Trq 1 100 -3276.800 3276.700 FORMAT "%8.3" ECU_ADDRESS 0x802090 /end MEASUREMENT
/begin MEASUREMENT ASDdc_trqNGvnrPos "positves Ausgangsmoment des Drehzahlreglers" SWORD Trq 1 100 -3276.800 3276.700 FORMAT "%8.3" ECU_ADDRESS 0x7F95B0 /end MEASUREMENT
/begin MEASUREMENT ASDdc_trqNGvnrP_mp "P - Anteil des Drehzahlreglers" SWORD Trq 1 100 -3276.800 3276.700 FORMAT "%8.3" ECU_ADDRESS 0x802092 /end MEASUREMENT
/begin MEASUREMENT ASDdc_trqPwrOnOffLim_mp "Schwelle für Aktivierung der Lastschlagerkennung" SWORD Trq 1 100 -3276.800 3276.700 FORMAT "%8.3" ECU_ADDRESS 0x802094 /end MEASUREMENT
/begin MEASUREMENT ASDdc_trqRawNGvnrNeg_mp "negatives roh Ausgangsmoment des Drehzahlreglers" SWORD Trq 1 100 -3276.800 3276.700 FORMAT "%8.3" ECU_ADDRESS 0x802096 /end MEASUREMENT
/begin MEASUREMENT ASDdc_trqRstDpnOfs_mp "Initialisierungsmoment des I-Reglers aus Kennfeld" SWORD Trq 1 100 -3276.800 3276.700 FORMAT "%8.3" ECU_ADDRESS 0x802098 /end MEASUREMENT
/begin MEASUREMENT ASDdc_trqUnLtd "unbegrenzter Störreglerausgang" SWORD Trq 1 100 -3276.800 3276.700 FORMAT "%8.3" ECU_ADDRESS 0x7F95B2 /end MEASUREMENT
/begin FUNCTION airctl_governor_var ""
 /begin DEF_CHARACTERISTIC AirCtl_facGovRgnRmpEGR_CUR AirCtl_facGovRgnRmpTVA_CUR AirCtl_qGovOff_CUR AirCtl_qGovOn_CUR AirCtl_qGovRgn1Off_CUR AirCtl_qGovRgn1On_CUR AirCtl_qGovRgn2Off_CUR AirCtl_qGovRgn2On_CUR AirCtl_rThresPointLow_C AirCtl_rThresPointHigh_C AirCtl_YLow_C AirCtl_YHigh_C AirCtl_rEGR_MAP AirCtl_rGovEGRMax_C AirCtl_rGovEGRMin_C AirCtl_rGovThres1Low_C AirCtl_rGovThres1High_C AirCtl_rGovY1Low_C AirCtl_rGovY1High_C AirCtl_rGovThres2Low_C AirCtl_rGovThres2High_C AirCtl_rGovY2Low_C AirCtl_rGovY2High_C AirCtl_rGovPCor_MAP AirCtl_rGovQDes_MAP AirCtl_rGovRgnMax_C AirCtl_rGovRgnMin_MAP AirCtl_rGovTEngCor_MAP AirCtl_rGovTVA1Max_C AirCtl_rGovTVA1Min_C AirCtl_rGovTVAMax_C AirCtl_rGovTVAMin_C AirCtl_rIDflBPDem_C AirCtl_rIDflDiaLrnVal_C AirCtl_rIDflShOffCo_C AirCtl_rRgn1EGR_MAP AirCtl_rRgn1TVA_MAP AirCtl_rRgn2EGROpnLp_MAP AirCtl_rRgn2EGR_MAP AirCtl_rRgn2TVA_MAP AirCtl_rTVA_MAP AirCtl_stGovRgn1HysMsk_C AirCtl_stGovRgn1Msk_C AirCtl_stGovRgn2HysMsk_C AirCtl_stGovRgn2Msk_C AirCtl_stParRgnMsk_C AirCtl_swtCtlHys_C AirCtl_swtEGROpnLp_C AirCtl_swtGovCtl3Hys_C AirCtl_swtGovCtlPath_C AirCtl_tiGovRgnRmpNeg_C AirCtl_tiGovRgnRmpPos_C AirCtl_tiParRgnRmpNeg_C AirCtl_tiParRgnRmpPos_C /end DEF_CHARACTERISTIC
 /begin IN_MEASUREMENT AirCtl_facGovRgnRmp_mp AirCtl_pCor AirCtl_qCtl AirCtl_rGovOut_mp Eng_nAvrg Eng_tEng InjCtl_qCurr InjCtl_qDes /end IN_MEASUREMENT
/end FUNCTION
/begin FUNCTION airctl_governor_var_msg "" /begin OUT_MEASUREMENT AirCtl_stGovHys /end OUT_MEASUREMENT /end FUNCTION
/begin FUNCTION airctl_governor_var_uic ""
 /begin OUT_MEASUREMENT AirCtl_facGovRgnRmpEGR_mp AirCtl_facGovRgnRmpTVA_mp AirCtl_facGovRgnRmp_mp AirCtl_qGovOff_mp AirCtl_qGovOn_mp AirCtl_rGovEGR_mp AirCtl_rGovHys1_mp AirCtl_rGovHys2_mp AirCtl_rGovHysSw_mp AirCtl_rGovHys_mp AirCtl_rGovMax_mp AirCtl_rGovMin_mp AirCtl_rGovPCor_mp AirCtl_rGovQDes_mp AirCtl_rGovRgnEGR_mp AirCtl_rGovRgnMin_mp AirCtl_rGovRgnTVA_mp AirCtl_rGovStdEGR_mp AirCtl_rGovStdTVA_mp AirCtl_rGovTEngCor_mp AirCtl_rGovTVA1_mp AirCtl_rGovTVA_mp AirCtl_stGovRgn2_mp /end OUT_MEASUREMENT
/end FUNCTION
/begin FUNCTION airctl_lmbdbalgvnr "Lambda Gleichregelung"
 /begin DEF_CHARACTERISTIC AirCtl_facP3Corr_MAP AirCtl_LmbdBalGvnrIKiNeg_C AirCtl_LmbdBalGvnrIKiPos_C AirCtl_LmbdBalGvnrIKi_C AirCtl_LmbdBalGvnrIWinNeg_C AirCtl_LmbdBalGvnrIWinPos_C AirCtl_LmbdBalGvnrPKpNeg_C AirCtl_LmbdBalGvnrPKpPos_C AirCtl_LmbdBalGvnrPKp_C AirCtl_LmbdBalGvnrPWinNeg_C AirCtl_LmbdBalGvnrPWinPos_C AirCtl_rBalGvnrMAX_C AirCtl_rEGRThres_C AirCtl_tiFltNeg1_C AirCtl_tiFltNeg2_C AirCtl_tiFltNeg3_C AirCtl_tiFltNeg4_C AirCtl_tiFltNeg5_C AirCtl_tiFltPos1_C AirCtl_tiFltPos2_C AirCtl_tiFltPos3_C AirCtl_tiFltPos4_C AirCtl_tiFltPos5_C /end DEF_CHARACTERISTIC
 /begin IN_MEASUREMENT AirCtl_pP3Corr2_mp AirCtl_pP3Corr_mp /end IN_MEASUREMENT
/end FUNCTION
/begin FUNCTION airctl_lmbdbalgvnr_msg "" /begin OUT_MEASUREMENT AirCtl_rBalGov AirCtl_rLmbdDiff /end OUT_MEASUREMENT /end FUNCTION
/begin FUNCTION airctl_lmbdbalgvnr_uic ""
 /begin OUT_MEASUREMENT AirCtl_facP3Corr_mp AirCtl_pP3Corr2_mp AirCtl_pP3Corr_mp AirCtl_rBalGovOutI_mp AirCtl_rBalGovOutP_mp AirCtl_rBalGovUnCorr_mp AirCtl_rP3Diff_mp /end OUT_MEASUREMENT
/end FUNCTION
/begin FUNCTION airctl_monitor "Abgasrückführregelung - Überwachung und Abschaltung"
 /begin DEF_CHARACTERISTIC AirCtl_mMonOffDev_C AirCtl_nHealHi_C AirCtl_nHealLo_C AirCtl_nLI_C AirCtl_nOvrRunDel_CUR AirCtl_nOvrRun_CUR AirCtl_pAirHi_C AirCtl_pAirLo_C AirCtl_qHealHi_C AirCtl_qHealLo_C AirCtl_qHigh1_CUR AirCtl_qHigh_CUR AirCtl_qLow_CUR AirCtl_qMiddle1_CUR AirCtl_qMiddle_CUR AirCtl_qOvrRun_C AirCtl_rEGRDflGearShft_C AirCtl_rEGRDflLoAirTemp_C AirCtl_rEGRDflLogin_C AirCtl_rEGRDflOvrRun_C AirCtl_rEGRDflShOff_C AirCtl_rTVADflClsd_C AirCtl_rTVADflLogin_C AirCtl_stAirHiMsk_C AirCtl_stAirLoMsk_C AirCtl_stHighMsk_C AirCtl_stMiddleMsk_C AirCtl_stMonRgnMsk1_C AirCtl_stMonRgnMsk2_C AirCtl_stMonRgnMskOn_C AirCtl_swtTempStrtDelay_C AirCtl_tAirHi1_C AirCtl_tAirHi_C AirCtl_tAirLo1_C AirCtl_tAirLo_C AirCtl_tEngHHi_C AirCtl_tEngHLo_C AirCtl_tEngLHi_C AirCtl_tEngLLo_C AirCtl_tiClutch_C AirCtl_tiCoStrt_CUR AirCtl_tiDebHigh_C AirCtl_tiDebLow_C AirCtl_tiMaxDef_C AirCtl_tiMaxOk_C AirCtl_tiMinDef_C AirCtl_tiMinOk_C AirCtl_tiDly_CUR AirCtl_tiLowIdle_C AirCtl_tiMonRgn1_C AirCtl_tiMonRgn2_C AirCtl_tiOvrRunDel_C AirCtl_uBattThres_C /end DEF_CHARACTERISTIC
 /begin IN_MEASUREMENT AirCtl_tStrtDelay_mp Eng_nAvrg Eng_tEng /end IN_MEASUREMENT
/end FUNCTION
/begin FUNCTION airctl_monitor_msg ""
 /begin OUT_MEASUREMENT AirCtl_rEGR AirCtl_rEGR2 AirCtl_rTVA AirCtl_stDebDef AirCtl_stMonitor /end OUT_MEASUREMENT
/end FUNCTION
/begin FUNCTION airctl_monitor_uic ""
 /begin DEF_CHARACTERISTIC AirCtl_rEGRAdd_Vector AirCtl_rEGRAdd_Channel AirCtl_rEGR_Vector AirCtl_rEGR_Channel AirCtl_rTVAAdd_Vector AirCtl_rTVAAdd_Channel AirCtl_rTVA_Vector AirCtl_rTVA_Channel /end DEF_CHARACTERISTIC
 /begin OUT_MEASUREMENT AirCtl_mMaxDev_mp AirCtl_mMinDev_mp AirCtl_nOvrRunDel_mp AirCtl_nOvrRun_mp AirCtl_rEGRByp2_mp AirCtl_rEGRByp_mp AirCtl_rLmbdDiffThres_mp AirCtl_rTVAByp_mp AirCtl_stAirCtlBits_mp AirCtl_stAirCtl_mp AirCtl_stAirHiMsk_mp AirCtl_stAirLoMsk_mp AirCtl_stHealDef_mp AirCtl_stHighMsk_mp AirCtl_stHigh_mp AirCtl_stHyst_mp AirCtl_stMiddleMsk_mp AirCtl_stMiddle_mp AirCtl_stMonOvr_mp AirCtl_stMonRsltBits_mp AirCtl_stTimerOn_mp AirCtl_tiDlyTimer_mp AirCtl_tiStrtDelay_mp AirCtl_trqCrCtlHys_mp AirCtl_tStrtDelay_mp /end OUT_MEASUREMENT
/end FUNCTION
/begin FUNCTION airctl_monitor_var ""
 /begin DEF_CHARACTERISTIC AirCtl_facMaxDevCor_MAP AirCtl_facMinDevCor_MAP AirCtl_mMaxDev_MAP AirCtl_mMinDev_MAP AirCtl_rEGRDflBPDem_C AirCtl_rEGRDflBPLoDet_C AirCtl_rEGRDflClsd_C AirCtl_rEGRDflEngPrt_C AirCtl_rEGRDflRgnShOff_C AirCtl_rEGRDflShOffCo_C AirCtl_rLmbdDiffThres_MAP AirCtl_rTVADflBPDem_C AirCtl_rTVADflBPLoDet_C AirCtl_rTVADflEngPrt_C AirCtl_rTVADflGearShft_C AirCtl_rTVADflOvrRun_C AirCtl_rTVADflRgnShOff_C AirCtl_rTVADflShOffCo_C AirCtl_rTVADflShOff_C AirCtl_trqCrCtloff_C /end DEF_CHARACTERISTIC
 /begin IN_MEASUREMENT AirCtl_mDesVal AirCtl_qMon Eng_nAvrg InjCtl_qCurr /end IN_MEASUREMENT
/end FUNCTION
/begin FUNCTION airctl_monitor_var_msg "" /begin OUT_MEASUREMENT AirCtl_stBasAdj /end OUT_MEASUREMENT /end FUNCTION
/begin FUNCTION airctl_monitor_var_uic "" /end FUNCTION
/begin FUNCTION airsys_cotstdem_msg "" /begin OUT_MEASUREMENT AirSys_stTstDem /end OUT_MEASUREMENT /end FUNCTION
/begin FUNCTION alt "Generator"
 /begin DEF_CHARACTERISTIC Alt_tiDebPwrCanDef_C Alt_tiDebPwrCanOk_C Alt_pwrAdjValDef_C Alt_pwrAdjValMax_C Alt_pwrAdjValMin_C Alt_pwrAltLoad_MAP Alt_pwrCanDef_MAP Alt_pwrCanMax_C Alt_pwrCanMin_C Alt_swtPwrCan_C /end DEF_CHARACTERISTIC
 /begin IN_MEASUREMENT AltCD_rAltLoad CTSCD_tClnt Eng_nAvrg /end IN_MEASUREMENT
/end FUNCTION
/begin FUNCTION altcd_excitement "Generatorerregung Komponententreiber"
 /begin DEF_CHARACTERISTIC AltCD_rThresExc_C AltCD_stInvOutExc_C AltCD_stPwrStgDiaExc_C AltCD_tiDebExcTempDefExc_C AltCD_tiDebExcTempOkExc_C AltCD_tiDebNoLoadDefExc_C AltCD_tiDebNoLoadOkExc_C AltCD_tiDebShrtBatDefExc_C AltCD_tiDebShrtBatOkExc_C AltCD_tiDebShrtGndDefExc_C AltCD_tiDebShrtGndOkExc_C /end DEF_CHARACTERISTIC
/end FUNCTION
/begin FUNCTION altcd_excitement_msg "" /end FUNCTION
/begin FUNCTION altcd_excitement_uic "" /begin OUT_MEASUREMENT AltCD_stPwrStgExc_mp /end OUT_MEASUREMENT /end FUNCTION
/begin FUNCTION altcd_load "Generatorlasterfassung"
 /begin DEF_CHARACTERISTIC AltCD_tiDebAccessDef_C AltCD_tiDebAccessOk_C AltCD_ctMeanPer_C AltCD_tiDebDtyCycMaxDef_C AltCD_tiDebDtyCycMaxOk_C AltCD_tiDebDtyCycMinDef_C AltCD_tiDebDtyCycMinOk_C AltCD_tiDebPer2HiTransLo_C AltCD_tiDebPer2HiTransHi_C AltCD_tiDebPer2LoTransLo_C AltCD_tiDebPer2LoTransHi_C AltCD_rLoadStepUp_C AltCD_rLoadStepDown_C AltCD_stSensIDWord_C AltCD_rAltLoadDfl_C AltCD_stLoadPwmInInv_C AltCD_tiLoadPwmInMinPer_C AltCD_tiLoadPwmInMaxPer_C AltCD_dcycLoadPwmInMin_C AltCD_dcycLoadPwmInMax_C AltCD_rLoadLin_CUR AltCD_tiPT1InAcc_C AltCD_tiPT1_C /end DEF_CHARACTERISTIC
 /begin IN_MEASUREMENT AltCD_dcycAltLoad /end IN_MEASUREMENT
/end FUNCTION
/begin FUNCTION altcd_load_msg "" /begin OUT_MEASUREMENT AltCD_dcycAltLoad AltCD_rAltLoad AltCD_stAltProvDef /end OUT_MEASUREMENT /end FUNCTION
/begin FUNCTION altcd_load_uic "" /begin OUT_MEASUREMENT AltCD_stErr_mp AltCD_tiActPer_mp /end OUT_MEASUREMENT /end FUNCTION
/begin FUNCTION altcd_load_var "" /end FUNCTION
/begin FUNCTION alt_excitement "Generatorabschaltung"
 /begin DEF_CHARACTERISTIC Alt_nThresERR_C Alt_tiDelPT_MAP Alt_tiExcdur_C Alt_tiLdRespTi_CUR Alt_tiLdRespTi_ReqDur_C Alt_uBattThres_C /end DEF_CHARACTERISTIC
 /begin IN_MEASUREMENT APSCD_pVal Eng_tEng /end IN_MEASUREMENT
/end FUNCTION
/begin FUNCTION alt_excitement_msg "" /begin OUT_MEASUREMENT Alt_dcycAlt Alt_tiBEMLdResp /end OUT_MEASUREMENT /end FUNCTION
/begin FUNCTION alt_excitement_uic "" /begin OUT_MEASUREMENT Alt_stAltExc_mp Alt_tiExcdly_mp /end OUT_MEASUREMENT /end FUNCTION
/begin FUNCTION alt_msg "" /begin OUT_MEASUREMENT Alt_pwrDes Alt_pwrLead Alt_stTrqInprec Alt_swtPwrCan /end OUT_MEASUREMENT /end FUNCTION
/begin FUNCTION alt_uic "" /begin DEF_CHARACTERISTIC Alt_pwrDes_Vector Alt_pwrDes_Channel /end DEF_CHARACTERISTIC /begin OUT_MEASUREMENT Alt_pwrDemandEEP_mp /end OUT_MEASUREMENT /end FUNCTION
/begin FUNCTION aoht "Zuheizer"
 /begin DEF_CHARACTERISTIC AOHt_nEngHigh_C AOHt_nEngLow_C AOHt_nEngOffs_C AOHt_nMin_C AOHt_NumHeat_C AOHt_rAltLoadMax_C AOHt_rOff_CUR AOHt_rOn_CUR AOHt_rSE_C AOHt_stCAN_C AOHt_stSwt_C AOHt_swtSensAir_C AOHt_swtSigCan_C AOHt_swtTempInput_C AOHt_swtTemp_C AOHt_tAirUpLi_CUR AOHt_tClntEcoMin_C AOHt_tEnvHigh_C AOHt_tEnvLow_C AOHt_tHysRng_C AOHt_tiEngOff_CUR AOHt_tiSE_C AOHt_tiStrt_C AOHt_tiVER_C AOHt_uBattHigh_C AOHt_uBattLow_C /end DEF_CHARACTERISTIC
 /begin IN_MEASUREMENT AOHt_tAirEngOff_mp AOHt_tAir_mp Eng_nAvrg /end IN_MEASUREMENT
/end FUNCTION
/begin FUNCTION aohtcd "Zuheizer Komponententreiber"
 /begin DEF_CHARACTERISTIC AOHtCD_DebBattDefHt1_C AOHtCD_DebBattOkHt1_C AOHtCD_DebBattDefHt2_C AOHtCD_DebBattOkHt2_C AOHtCD_DebBattDefHt3_C AOHtCD_DebBattOkHt3_C AOHtCD_DebGndDefHt1_C AOHtCD_DebGndOkHt1_C AOHtCD_DebGndDefHt2_C AOHtCD_DebGndOkHt2_C AOHtCD_DebGndDefHt3_C AOHtCD_DebGndOkHt3_C AOHtCD_DebNoLoadDefHt1_C AOHtCD_DebNoLoadOkHt1_C AOHtCD_DebNoLoadDefHt2_C AOHtCD_DebNoLoadOkHt2_C AOHtCD_DebNoLoadDefHt3_C AOHtCD_DebNoLoadOkHt3_C AOHtCD_DebTempDefHt1_C AOHtCD_DebTempOkHt1_C AOHtCD_DebTempDefHt2_C AOHtCD_DebTempOkHt2_C AOHtCD_DebTempDefHt3_C AOHtCD_DebTempOkHt3_C AOHtCD_stPwmInInv_C AOHtCD_stDigInvHt1_C AOHtCD_stDigInvHt2_C AOHtCD_stDigInvHt3_C AOHtCD_swtHeater12EnaVal_C AOHtCD_swtHeater12EnaType_C AOHtCD_tiMax_C AOHtCD_VolPerImp_C /end DEF_CHARACTERISTIC
/end FUNCTION
/begin FUNCTION aohtcd_msg ""
 /begin OUT_MEASUREMENT AOHtCD_dvolFlConsum AOHtCD_swtHeater12Ena AOHtCD_volFlConsum /end OUT_MEASUREMENT
/end FUNCTION
/begin FUNCTION aohtcd_uic "" /begin OUT_MEASUREMENT AOHtCD_tiPerAvrg_mp /end OUT_MEASUREMENT /end FUNCTION
/begin FUNCTION aoht_msg ""
 /begin OUT_MEASUREMENT AOHt_nMin AOHt_stEngOff AOHt_stHt1Out AOHt_stHt2Out AOHt_stHt3Out AOHt_stOK AOHt_swtACEngOff AOHt_swtHtEngOff AOHt_swtHtShOff /end OUT_MEASUREMENT
/end FUNCTION
/begin FUNCTION aoht_uic ""
 /begin OUT_MEASUREMENT AOHt_nMin_mp AOHt_NumRly_mp AOHt_rOff_mp AOHt_rOn_mp AOHt_stShutOff_mp AOHt_tAirEngOff_mp AOHt_tAir_mp AOHt_tCltOff_mp AOHt_tCltOn_mp AOHt_tEngHys_mp /end OUT_MEASUREMENT
/end FUNCTION
/begin FUNCTION appcd "Fahrpedal Komponententreiber"
 /begin DEF_CHARACTERISTIC APPCD_uAPP1_SRCMin_C APPCD_uAPP1_SRCMax_C APPCD_rLinAPP1_CUR APPCD_uAPP2_SRCMin_C APPCD_uAPP2_SRCMax_C APPCD_rLinAPP2_CUR APPCD_DebPlaDef_C APPCD_DebPlaOk_C APPCD_DebSRCHighDef_C APPCD_DebSRCHighOk_C APPCD_DebSRCLowDef_C APPCD_DebSRCLowOk_C APPCD_DebSyncDef_C APPCD_DebSyncOk_C APPCD_duAPPJit_C APPCD_tiLowNegPT1_C APPCD_tiLowPosPT1_C APPCD_tiMidNegPT1_C APPCD_tiMidPosPT1_C APPCD_tiUppNegPT1_C APPCD_tiUppPosPT1_C APPCD_swtNoFlt_C APPCD_rThrFltLowPos_C APPCD_rThrFltMidPos_C APPCD_rThrFltLowNeg_C APPCD_rThrFltMidNeg_C APPCD_drHealRmpUp_C APPCD_drHealRmpDwn_C APPCD_uKickDownXLow_C APPCD_uKickDownXHigh_C APPCD_stKickDownYLow_C APPCD_stKickDownYHigh_C APPCD_uLowIdlSwtSRCMin_C APPCD_uLowIdlSwtSRCMax_C APPCD_uLowIdlSwtLin_CUR APPCD_numAdcAPP1_C APPCD_numAdcAPP2_C APPCD_rPlaWinLowIdleXLow_C APPCD_rPlaWinLowIdleXHigh_C APPCD_stPlaWinLowIdleYLow_C APPCD_stPlaWinLowIdleYHigh_C APPCD_rPlaWinParLoadXLow_C APPCD_rPlaWinParLoadXHigh_C APPCD_stPlaWinParLoadYLow_C APPCD_stPlaWinParLoadYHigh_C APPCD_uPlaWinIdle_C APPCD_uPlaWinPar_C APPCD_uPlaWinFull_C APPCD_duLimErrPos_C APPCD_duLimErrNeg_C APPCD_rKickDownErrThres_C APPCD_rKickDownlrnThres_C APPCD_rLinAPP_CUR APPCD_SSpMonAPP1_C APPCD_SSpMonAPP2_C APPCD_stActvPlausAPP_C APPCD_stDigInInvKickDown_C APPCD_stLowIdlSwtInvIn_C APPCD_swtDigInPresent_C APPCD_swtEnaUnJit_C APPCD_swtKickDownHighAPP_C APPCD_swtTypeVal_C APPCD_swtTypeType_C APPCD_tiDebKickDownDef_C APPCD_tiDebKickDownOk_C APPCD_tiKickDownlrnTimeout_C APPCD_tiKickDownSwtDebNeg_C APPCD_tiKickDownSwtDebPos_C APPCD_tiKickDownTolcLim_C APPCD_uAPPMin_C APPCD_uHighLimLowIdle_C APPCD_uKickDownCorrVal_C APPCD_uKickDownHighAPP_C APPCD_uKickDownLowAPP_C APPCD_uKickDownThresDfl_C APPCD_uKickDownTolcLim_C APPCD_uLowIdlSwtA2DThres_C APPCD_uLowLimLowIdle_C APPCD_uMinSync_C APPCD_uRawAPP2dOff_C APPCD_uSync_CUR APPCD_vDflMin_C /end DEF_CHARACTERISTIC
 /begin IN_MEASUREMENT APPCD_uLowIdlSwtRawVal APPCD_uRawAPP1 APPCD_uRawAPP2 APPCD_uRaw_mp /end IN_MEASUREMENT
/end FUNCTION
/begin FUNCTION appcd_chkd "" /begin DEF_CHARACTERISTIC APPCD_facrAPP1APP2_C /end DEF_CHARACTERISTIC /end FUNCTION
/begin FUNCTION appcd_msg ""
 /begin OUT_MEASUREMENT APPCD_drAPP1UnFlt APPCD_rAPP1UnFlt APPCD_rFlt APPCD_stKickDown APPCD_stLimp APPCD_stLowIdlSwtVal APPCD_stRawKickDown APPCD_stSigSrc APPCD_stSwitchSig APPCD_swtType APPCD_uHighLimLowIdle APPCD_uLowIdlSwtLinVal APPCD_uLowIdlSwtRawVal APPCD_uLowLimLowIdle APPCD_uRawAPP1 APPCD_uRawAPP2 /end OUT_MEASUREMENT
/end FUNCTION
/begin FUNCTION appcd_uic ""
 /begin OUT_MEASUREMENT APPCD_BegCo_mp APPCD_EndCo_mp APPCD_rLinAPP1_mp APPCD_stAPP12def_mp APPCD_stErr1_mp APPCD_stErrSensSig_mp APPCD_stTempErr_mp APPCD_uAPPunJit_mp APPCD_uDiffMax_mp APPCD_uKickDownHighAPP_mp APPCD_uKickDownThres_mp APPCD_uRawAPP1half_mp APPCD_uRawAPP2dbl_mp APPCD_uRawDiff_mp APPCD_uRaw_mp /end OUT_MEASUREMENT
/end FUNCTION
/begin FUNCTION appcd_var ""
 /begin DEF_CHARACTERISTIC APPCD_dFac_C APPCD_dGradFac_C APPCD_dGradOff_C APPCD_dOff_C /end DEF_CHARACTERISTIC
/end FUNCTION
/begin FUNCTION applib "" /end FUNCTION
/begin FUNCTION apscd "Atmosphärendruckfühler Komponententreiber"
 /begin DEF_CHARACTERISTIC APSCD_uSRCMin_C APSCD_uSRCMax_C APSCD_pLin_CUR APSCD_DebSigDef_C APSCD_DebSigOk_C APSCD_DebSRCDef_C APSCD_DebSRCOk_C APSCD_nLimHigh_C APSCD_pCor_MAP APSCD_dpRmpSlpUp_C APSCD_dpRmpSlpDwn_C APSCD_swtInst_C APSCD_swtSigVal_C APSCD_swtSrcpVal_C APSCD_tiDel_C APSCD_stSensIDWord_C APSCD_pDfl_C /end DEF_CHARACTERISTIC
 /begin IN_MEASUREMENT APSCD_uRaw Eng_dnAvrg Eng_nAvrg /end IN_MEASUREMENT
/end FUNCTION
/begin FUNCTION apscd_msg ""
 /begin OUT_MEASUREMENT APSCD_pLinVal APSCD_pSensorVal APSCD_pVal APSCD_stSensorInst APSCD_uRaw /end OUT_MEASUREMENT
/end FUNCTION
/begin FUNCTION apscd_uic "" /begin OUT_MEASUREMENT APSCD_BpsAllowed_mp APSCD_pCorVal_mp /end OUT_MEASUREMENT /end FUNCTION
/begin FUNCTION apscd_variant "" /end FUNCTION
/begin FUNCTION arnmon "Überwachung Nachlaufzeit" /begin DEF_CHARACTERISTIC ARnMon_stInvIn_C ARnMon_stInvOut_C ARnMon_tiARnMax_C /end DEF_CHARACTERISTIC /end FUNCTION
/begin FUNCTION arnmon_uic "" /begin OUT_MEASUREMENT ARnMon_stARnMon_mp ARnMon_stT15DebVal_mp /end OUT_MEASUREMENT /end FUNCTION
/begin FUNCTION asddc "Aktive Ruckeldämpfung Störgrößenregler (ARD)"
 /begin DEF_CHARACTERISTIC ASDdc_T1Clu_C ASDdc_KdClu_C ASDdc_dAccPedThres_C ASDdc_dActGearFac_CUR ASDdc_dConvClthThres_C ASDdc_tiDT1TrqDyn_C ASDdc_dDT1TrqDynfact_C ASDdc_dFacNHiDwn_C ASDdc_dFacNLoDwn_C ASDdc_dfacRmp_CUR ASDdc_dnAvrgLtdExitNeg_CUR ASDdc_dnAvrgLtdExitPos_CUR ASDdc_dnAvrgLtdNeg_CUR ASDdc_dnAvrgLtdPos_CUR ASDdc_dnIntegLtdNeg_CUR ASDdc_dnIntegLtdPos_MAP ASDdc_dNNegIKi_C ASDdc_dNPosIKi_C ASDdc_dtrqNeg_C ASDdc_dtrqPos_C ASDdc_T1ExtInt_C ASDdc_KdExtInt_C ASDdc_facKdGripPos_CUR ASDdc_KddNDT1_C ASDdc_KdGrip_MAP ASDdc_KdPwrOnOff_MAP ASDdc_NGvnrDT1KdNeg_CUR ASDdc_NGvnrDT1KdPos_CUR ASDdc_NGvnrIKiNeg_CUR ASDdc_NGvnrIKiPos_CUR ASDdc_NGvnrPKpNeg_CUR ASDdc_NGvnrPKpPos_CUR ASDdc_NGvnrRstINeg_MAP ASDdc_NGvnrRstIPos0_MAP ASDdc_NGvnrRstIPos1_MAP ASDdc_NGvnrRstIPos2_MAP ASDdc_NGvnrRstIPos3_MAP ASDdc_NGvnrRstIPos4_MAP ASDdc_NGvnrRstIPos5_MAP ASDdc_nLtdExitNeg_CUR ASDdc_nLtdExitPos_CUR ASDdc_nLtdNegLdRevl_C ASDdc_nMaxNLdRevlNeg_CUR ASDdc_nMaxNLdRevlPos_CUR ASDdc_nMinNLdRevlNeg_CUR ASDdc_nMinNLdRevlPos_CUR ASDdc_nPwrOnOffLim_C ASDdc_nSPOfsNeg_CUR ASDdc_nSPOfsPos_MAP ASDdc_nThresHysNHi_C ASDdc_nThresHysNLo_C ASDdc_stActGear_CUR ASDdc_stCalcPT1FltNeg_C ASDdc_stCalcPT1FltPos_C ASDdc_stKickDown_C ASDdc_swtCalcN_C ASDdc_swtConvOff_C ASDdc_swtGearbx_C ASDdc_swtGearSel_C ASDdc_swtInitPS_C ASDdc_swtNGvnrMn_C ASDdc_swtnNotFreeze_C ASDdc_swtvRaw_C ASDdc_T1Grip_MAP ASDdc_T1PwrOnOff_MAP ASDdc_tEngThres_C ASDdc_tiActvRmpNHi_C ASDdc_tiActvRmpNLo_C ASDdc_tiBlkTmr_C ASDdc_tidNDT1_C ASDdc_tiMaxLdRevlPos_C ASDdc_tiMaxRmpNHi_C ASDdc_tiMaxRmpNLo_C ASDdc_tiMinLdRevlNeg_C ASDdc_tiMinLdRevlPos_C ASDdc_tiMinTmrDnAvrg_C ASDdc_tiNGvnrDT1Neg_C ASDdc_tiNGvnrDT1Pos_C ASDdc_tiPT1Neg_CUR ASDdc_tiPT1Pos_CUR ASDdc_tiPT1Trq_C ASDdc_tiPwrOnOff_C ASDdc_tiRmpStrt_CUR ASDdc_tiSwtOff_C ASDdc_tiTmrNCond_C ASDdc_tiTmrTrqInrCond_C ASDdc_T1TMFWRO_C ASDdc_KdTMFWRO_C ASDdc_trqDpnOfsNegEnd_C ASDdc_trqDpnOfsNeg_C ASDdc_trqDpnOfsPosEnd_C ASDdc_trqDpnOfsPos_C ASDdc_trqInrLtdThres_C ASDdc_trqLimHiPwrOnOff_CUR ASDdc_trqLimHi_CUR ASDdc_trqLimLoPwrOnOff_CUR ASDdc_trqLimLo_CUR ASDdc_trqMaxPosLdRevl_C ASDdc_trqPwrOnOffLimNeg_MAP ASDdc_trqPwrOnOffLimPos_MAP ASDdc_trqPwrOnOffOffset_CUR ASDdc_trqThresNegOff_C ASDdc_vLimIni_C /end DEF_CHARACTERISTIC
 /begin IN_MEASUREMENT ASDdc_nAvrg_mp ASDdc_nDeltaLead_mp ASDdc_nSlipN_mp ASDdc_nSPNOfs_mp ASDdc_stActGear_mp ASDdc_stPosNeg_mp ASDdc_trqEngOutLtd_mp ASDrf_stDriver DrvTrn_rTransDT Eng_nAvrg /end IN_MEASUREMENT
 /begin OUT_MEASUREMENT ASDdc_KdCurr_mp ASDdc_T1Curr_mp /end OUT_MEASUREMENT
/end FUNCTION
/begin FUNCTION asddc_msg ""
 /begin OUT_MEASUREMENT ASDdc_dfacRmp ASDdc_facRmpOvrRun ASDdc_stBlkTmr ASDdc_stDisable ASDdc_stExtInt ASDdc_tiRmpStrt ASDdc_trq ASDdc_trqNGvnrNeg ASDdc_trqNGvnrPos ASDdc_trqUnLtd /end OUT_MEASUREMENT
/end FUNCTION
/begin FUNCTION asddc_uic "" /begin DEF_CHARACTERISTIC ASDdc_trq_Vector ASDdc_trq_Channel /end DEF_CHARACTERISTIC
 /begin OUT_MEASUREMENT ASDdc_dActGearFac_mp ASDdc_dnAvrg_mp ASDdc_dnIntegOutNeg_mp ASDdc_dnIntegOutPos_mp ASDdc_dtrqInrDesSlow_mp ASDdc_nAvrg_mp ASDdc_nDeltaLead_mp ASDdc_nDeltaPT1_mp ASDdc_nSlipN_mp ASDdc_nSPNOfs_mp ASDdc_nSPPT1_mp ASDdc_nTrbn_mp ASDdc_stActGear_mp ASDdc_stBitFrame_mp ASDdc_stCluPS_mp ASDdc_stExitLdRevl_mp ASDdc_stGenCondNGvnr_mp ASDdc_stGrip_mp ASDdc_stLdRevlDet_mp ASDdc_stNGvnr_mp ASDdc_stPosNeg_mp ASDdc_stPwrOnOff_mp ASDdc_stShOffPT1Flt_mp ASDdc_stStMNGvnr_mp ASDdc_stTrqRmp_mp ASDdc_trqBeforeRmp_mp ASDdc_trqDpn_mp ASDdc_trqEngOutLtd_mp ASDdc_trqInrDesSlowFlt_mp ASDdc_trqLimMax_mp ASDdc_trqLimMin_mp ASDdc_trqNGvnrDT1_mp ASDdc_trqNGvnrI_mp ASDdc_trqNGvnrPID_mp ASDdc_trqNGvnrP_mp ASDdc_trqPwrOnOffLim_mp ASDdc_trqRawNGvnrNeg_mp ASDdc_trqRstDpnOfs_mp /end OUT_MEASUREMENT
/end FUNCTION
/begin FUNCTION asddc_var "" /end FUNCTION
/begin FUNCTION asddc_var_uic "" /end FUNCTION
/begin COMPU_METHOD AirMassPerCyl "Luftmasse pro Zylinder" RAT_FUNC "%6.3" "[mg/Hub Luft]" COEFFS 0 10 0 0 0 1 /end COMPU_METHOD
/begin COMPU_METHOD ASD_GvrnDT1Kd_float "Differentialverstärkung Kd (Motordrehzahl EngN zu Motormoment Trq)" RAT_FUNC "%6.2" "(Nm/rpm)^0.5" COEFFS 0 1 0 0 0 1 /end COMPU_METHOD
/begin COMPU_METHOD ASD_GvrnDT1T1_float "Zeitkonstante T1 (in s) für PT1, DT1 beim ARD" RAT_FUNC "%6.2" "s" COEFFS 0 1 0 0 0 1 /end COMPU_METHOD
/begin COMPU_METHOD Can "Umrechnungsfaktor für CAN-bezogene Größen" RAT_FUNC "%6.5" "[-]" COEFFS 0 1000 0 0 0 1 /end COMPU_METHOD
/begin COMPU_METHOD Can1 "Umsetzungsfaktor fuer CAN verwandte Groeßen" RAT_FUNC "%7.6" "[-]" COEFFS 0 10000 0 0 0 1 /end COMPU_METHOD
/begin COMPU_METHOD dFlConsum "Ableitung des Kraftstoffverbrauchs" RAT_FUNC "%6.4" "[l/h/s]" COEFFS 0 100 0 0 0 1 /end COMPU_METHOD
/begin COMPU_METHOD dn_dZ20 "Motorbeschleunigung pro Zeit (dn/dt) (im 20 ms Raster)" RAT_FUNC "%6.1" "[rpm/s]" COEFFS 0 0.1 0 0 0 1 /end COMPU_METHOD
/begin COMPU_METHOD DtyCyc "Tastverhaeltnis" RAT_FUNC "%6.4" "[%]" COEFFS 0 100 0 0 0 1 /end COMPU_METHOD
/begin COMPU_METHOD EngN "Motordrehzahl" RAT_FUNC "%6.2" "[rpm]" COEFFS 0 1 0 0 0 1 /end COMPU_METHOD
/begin COMPU_METHOD EngTempFldSel "Verbale Umrechnung für Auswahl aus dem Motortemperatur-Feld Eng_tFld" TAB_VERB "%6.3" "" COMPU_TAB_REF EngTempFldSel /end COMPU_METHOD
/begin COMPU_VTAB EngTempFldSel "Verbale Umrechnung für Auswahl aus dem Motortemperatur-Feld Eng_tFld" TAB_VERB 5 0 "Coolant_Temperature" 1 "Oil_Temperature" 2 "Engine_Temperature" 3 "Fuel_Temperature" 4 "Coolant_Temperature_CAN" /end COMPU_VTAB
/begin COMPU_METHOD facRmpEGT16 "Faktor für EGT Rampe  (16bit Normiert)" RAT_FUNC "%7.6" "[-]" COEFFS 0 32000 0 0 0 1 /end COMPU_METHOD
/begin COMPU_METHOD Fact "Faktor mit Auflösung 1 / 8192, hauptsächlich für einen Faktorenbereich 0...1 verwendet" RAT_FUNC "%6.5" "[-]" COEFFS 0 8192 0 0 0 1 /end COMPU_METHOD
/begin COMPU_METHOD Fact1 "Faktor mit Auflösung 0,01 (100 mal höherer Bereich als Fact)" RAT_FUNC "%6.4" "[-]" COEFFS 0 128 0 0 0 1 /end COMPU_METHOD
/begin COMPU_METHOD FlConsum_l_h "Kraftstoffverbrauch" RAT_FUNC "%6.4" "[l/h]" COEFFS 0 100 0 0 0 1 /end COMPU_METHOD
/begin COMPU_METHOD FlConsum_ul_1 "Verbrauchsintegral (in Mikroliter pro 20ms) mit genauerer Auflösung" RAT_FUNC "%6.5" "[ul]" COEFFS 0 1000 0 0 0 1 /end COMPU_METHOD
/begin COMPU_METHOD InjMass "Einspritzmenge" RAT_FUNC "%6.4" "[mg/hub]" COEFFS 0 100 0 0 0 1 /end COMPU_METHOD
/begin COMPU_METHOD Kd "Differentialverstärkung Kd (gleiche Einheit/Umrechnungsformel an Ein- und Ausgang)" RAT_FUNC "%7.6" "[1/1]" COEFFS 0 65536 0 0 0 1 /end COMPU_METHOD
/begin COMPU_METHOD Kd16_sqr_rpm2Nm "Wurzeldifferentialverstärkung Kd^0,5 für D2T2 (zweifach DT1), Motordrehzahl EngN zu Motormoment Trq" RAT_FUNC "%6.5" "(Nm/rpm)^0.5" COEFFS 0 1024 0 0 0 1 /end COMPU_METHOD
/begin COMPU_METHOD KD_RPM2NM_2 "Verstärkungsfaktor zur Anpassung von 16 Bit an 32 Bit Werte (mit KD_RPM2NM_2_NRM schieben)" RAT_FUNC "%7.6" "[Nm/rpm]" COEFFS 0 40960 0 0 0 1 /end COMPU_METHOD
/begin COMPU_METHOD Ki "Integrale Verstärkung Ki (gleiche Einheit/Umrechnungsregel an Ein- und Ausgang)" RAT_FUNC "%6.5" "[1/s]" COEFFS 0 4294.967296 0 0 0 1 /end COMPU_METHOD
/begin COMPU_METHOD KI_LMBD2PRC "Verstärkungkonstante des Integrators (Lambdawert zu Prozent)" RAT_FUNC "%6.4" "[%/s]" COEFFS 0 26.8435456 0 0 0 1 /end COMPU_METHOD
/begin COMPU_METHOD KI_RPM2NM_2 "Verstärkungsfaktor zur Anpassung von 16 Bit an 32 Bit Werte (mit KI_RPM2NM_2_NRM schieben)" RAT_FUNC "%6.5" "[Nm/rpm]" COEFFS 0 2684.35456 0 0 0 1 /end COMPU_METHOD
/begin COMPU_METHOD KP_LMBD2PRC "Proportionalverstärkung (Lambdawert zu Prozent)" RAT_FUNC "%6.4" "[%/1]" COEFFS 0 51.2 0 0 0 1 /end COMPU_METHOD
/begin COMPU_METHOD KP_RPM2NM_2 "Verstärkungsfaktor zur Anpassung von 16 Bit an 32 Bit Werte (mit KP_RPM2NM_2_NRM schieben)" RAT_FUNC "%7.6" "[Nm/rpm]" COEFFS 0 20480 0 0 0 1 /end COMPU_METHOD
/begin COMPU_METHOD lambda "Lambda" RAT_FUNC "%6.5" "[-]" COEFFS 0 1000 0 0 0 1 /end COMPU_METHOD
/begin COMPU_METHOD Map_Select "Umsetzungsfaktor von Kennfeldern fuer vierdimensionale Raeume" RAT_FUNC "%6.4" "[-]" COEFFS 0 256 0 0 0 1 /end COMPU_METHOD
/begin COMPU_METHOD NumPinAdc "verbale Umrechnung für ADC Signale" TAB_VERB "%6.3" "" COMPU_TAB_REF NumPinAdc /end COMPU_METHOD
/begin COMPU_VTAB NumPinAdc "verbale Umrechnung für ADC Signale" TAB_VERB 75 0 "Dummy_0" 1 "Dummy_1" 2 "Kick_Down_Switch" 3 "EGR_Actuator_Sensor" 4 "Intake_Air_Temperature_Sensor" 5 "Variable_Swirl_Position_1" 6 "Dummy_2" 7 "Terminal_50_Signal" 8 "Atmospheric_Pressure_Sensor" 9 "Starter_Sensor_1" 10 "Terminal_15_Signal" 11 "Dummy_3" 12 "Engine_Oil_Temperature_Sensor" 13 "Internal_Temperature_ECU" 14 "Variable_Swirl_Position_2" 15 "Dummy_4" 16 "Brake_Pedal_Switch" 17 "Empty_Tank_Switch" 18 "Dummy_5" 19 "Rhaps_Methyl_Sensor" 20 "Fuel_Level_Additive_Pump" 21 "Dummy_6" 22 "Interlock_Switch" 23 "Fuel_Temperature_Sensor" 24 "Fuel_Low_Pressure_Sensor" 25 "Dummy_7" 26 "Throttle_Valve_Position" 27 "Terminal_50_redundant_Signal" 28 "Water_Temperature_Sensor_2" 29 "Starter_Sensor_2" 30 "Boost_Pressure_Sensor" 31 "Rail_Pressure_Sensor_Peak" 32 "Rail_Pressure_Sensor_Actual" 33 "Lambda_Sensor_NLamda" 34 "Lambda_Sensor_RLamda" 35 "Exhaust_Gas_contra_Pressure_Sensor_1" 36 "Exhaust_Gas_contra_Pressure_Sensor_2" 37 "Engine_Temperature_Sensor" 38 "Air_Mass_Sensor_HFM5" 39 "1st_APP_Sensor" 40 "2nd_APP_Sensor" 41 "Exhaust_Gas_Temperature_Sensor_1_1" 42 "Exhaust_Gas_Temperature_Sensor_2_1" 43 "Exhaust_Gas_Temperature_Sensor_3_1" 44 "Exhaust_Gas_Temperature_Sensor_1_2" 45 "Exhaust_Gas_Temperature_Sensor_2_2" 46 "Reference_Voltage" 47 "Current_MeUn_Sensor" 48 "Current_PCV_Sensor" 49 "Battery_Voltage" 50 "Charge_Actuator_Event_1" 51 "Voltage_Piezo_Actuator_Bank_1_Event_1" 52 "Voltage_Piezo_Actuator_Bank_2_Event_1" 53 "Charge_Actuator_Event_2" 54 "Voltage_Piezo_Actuator_Bank_1_Event_2" 55 "Voltage_Piezo_Actuator_Bank_2_Event_2" 56 "Charge_Actuator_Event_3" 57 "Voltage_Piezo_Actuator_Bank_1_Event_3" 58 "Voltage_Piezo_Actuator_Bank_2_Event_3" 59 "Voltage_Buffer_Entry_1" 60 "Voltage_Buffer_Entry_2" 61 "Voltage_Buffer_Entry_3" 62 "Voltage_Buffer_Entry_4" 63 "Voltage_Buffer_Entry_5" 64 "Voltage_Buffer_Entry_6" 65 "Voltage_Buffer_Entry_7" 66 "Voltage_Buffer_Entry_8" 67 "Voltage_Buffer_Entry_9" 68 "Voltage_Buffer_Entry_10" 69 "Voltage_Buffer_Entry_11" 70 "Voltage_Buffer_Entry_12" 71 "Voltage_Buffer_Entry_13" 72 "Voltage_Buffer_Entry_14" 73 "Voltage_Buffer_Entry_15" 74 "Booster_Voltage_Piezo" /end COMPU_VTAB
/begin COMPU_METHOD OneToOne "eins zu eins (physikalischer Wert ist gleich dem internen Wert)" RAT_FUNC "%6.2" "[-]" COEFFS 0 1 0 0 0 1 /end COMPU_METHOD
/begin COMPU_METHOD Period "Periodendauer" RAT_FUNC "%6.3" "[ms]" COEFFS 0 10 0 0 0 1 /end COMPU_METHOD
/begin COMPU_METHOD Period_ms "Periodendauer in ms" RAT_FUNC "%6.3" "[ms]" COEFFS 0 10 0 0 0 1 /end COMPU_METHOD
/begin COMPU_METHOD Prc "Prozent, gleiche interne Auflösung wie Fact, aber Darstellung in Prozent (0...100%)" RAT_FUNC "%6.4" "[%]" COEFFS 0 100 0 0 0 1 /end COMPU_METHOD
/begin COMPU_METHOD Prc_D20ms "Prozent (0...100%/s) fuer 20ms - Task" RAT_FUNC "%6.3" "[%/s]" COEFFS 0 2 0 0 0 1 /end COMPU_METHOD
/begin COMPU_METHOD Pres_hPa "Druck (angezeigt in [hPa])" RAT_FUNC "%6.2" "[hPa]" COEFFS 0 1 0 0 0 1 /end COMPU_METHOD
/begin COMPU_METHOD Pwr "Leistung" RAT_FUNC "%6.2" "[W]" COEFFS 0 0.10610329539459 0 0 0 1 /end COMPU_METHOD
/begin COMPU_METHOD rev_acc "Drehzahlbeschleunigung" RAT_FUNC "%6.2" "[rmp/s]" COEFFS 0 1 0 0 0 1 /end COMPU_METHOD
/begin COMPU_METHOD Rmp "einheitenloser Rampengradient (für Library Ramp, etc.)" RAT_FUNC "%6.4" "[1/s]" COEFFS 0 65.536 0 0 0 1 /end COMPU_METHOD
/begin COMPU_METHOD RmpPrc "Prozent Rampengradient" RAT_FUNC "%6.5" "[%/s]" COEFFS 0 6553.6 0 0 0 1 /end COMPU_METHOD
/begin COMPU_METHOD RmpPres_hPa "Rampengradient für Druck angezeigt in [hPa/s]" RAT_FUNC "%6.4" "[hPa/s]" COEFFS 0 65.536 0 0 0 1 /end COMPU_METHOD
/begin COMPU_METHOD RmpTrqdHigh "Rampengradient für Momente mit großen Steigungen" RAT_FUNC "%6.2" "[Nm/s]" COEFFS 0 0.682666666666667 0 0 0 1 /end COMPU_METHOD
/begin COMPU_METHOD RmpVoltSens "Rampengradient für Geschwindigkeit" RAT_FUNC "%6.4" "mV/s" COEFFS 0 13.4086656 0 0 0 1 /end COMPU_METHOD
/begin COMPU_METHOD Rmp_Fact16 "Rampenfaktorgradient" RAT_FUNC "%6.5" "[1/s]" COEFFS 0 4194.304 0 0 0 1 /end COMPU_METHOD
/begin COMPU_METHOD TempDiff_Kelv "Offsettemperatur dargestellt in [K]" RAT_FUNC "%6.3" "[ deg C ]" COEFFS 0 10 0 0 0 1 /end COMPU_METHOD
/begin COMPU_METHOD Temp_Cels "Temperatur dargestellt in °C (gleiche interne Darstellung wie Temp_Kelv)" RAT_FUNC "%6.1" "[deg C]" COEFFS 0 10 2731.4 0 0 1 /end COMPU_METHOD
/begin COMPU_METHOD TimeDeb "Entprellzeit in Millisekunden für Libraryfunktion Debounce" RAT_FUNC "%6.1" "[ms]" COEFFS 0 0.1 0 0 0 1 /end COMPU_METHOD
/begin COMPU_METHOD TimeDelay_ms "Zeitkonstante T1 fuer die Bibliotheksfunktionen PT1, DT1, etc.,  in ms angegeben" RAT_FUNC "%9.0" "[ms]" COEFFS 0 0 1 0 2.3283064365387e-07 0 /end COMPU_METHOD
/begin COMPU_METHOD TimeDelay_s "Zeitkonstante T1 (in s) für PT1, DT1, etc." RAT_FUNC "%9.3" "[s]" COEFFS 0 0 1 0 0.00023283064365387 0 /end COMPU_METHOD
/begin COMPU_METHOD TimeDelay_s_2 "Zeitkonstante T1 (in s) für PT1, DT1, etc. normiert auf 16 bit" RAT_FUNC "%9.4" "[s]" COEFFS 0 0 1 0 0.0596046447753906 0 /end COMPU_METHOD
/begin COMPU_METHOD TimeDelay_s_Lin_16 "Zeitkonstante T1 (in s) für PT1, DT1, etc. für SINT16, kein Kehrwert" RAT_FUNC "%6.5" "s" COEFFS 0 6553.4 0 0 0 1 /end COMPU_METHOD
/begin COMPU_METHOD Time_ms "Zeit in ms für Fehlerentprellung (DSM) und SW-Timer" RAT_FUNC "%6.1" "[ms]" COEFFS 0 0.1 0 0 0 1 /end COMPU_METHOD
/begin COMPU_METHOD Time_s "Zeit in s für Fehlerentprellung (DSM) und SW-Timer" RAT_FUNC "%6.4" "[s]" COEFFS 0 100 0 0 0 1 /end COMPU_METHOD
/begin COMPU_METHOD TransR "Übersetzungsverhältnis (Getriebe etc.)" RAT_FUNC "%6.4" "[-]" COEFFS 0 100 0 0 0 1 /end COMPU_METHOD
/begin COMPU_METHOD Trq "Motormoment" RAT_FUNC "%6.3" "[Nm]" COEFFS 0 10 0 0 0 1 /end COMPU_METHOD
/begin COMPU_METHOD Vel "Fahrzeuggeschwindigkeit, gleiche interne Auflösung wie Vel_SI" RAT_FUNC "%6.4" "[km/h]" COEFFS 0 100 0 0 0 1 /end COMPU_METHOD
/begin COMPU_METHOD VelToN "Verhältnis Fahrzeuggeschwindigkeit zu Motordrehzahl v/n" RAT_FUNC "%8.7" "[(km/h)/rpm]" COEFFS 0 100000 0 0 0 1 /end COMPU_METHOD
/begin COMPU_METHOD Volt "Spannung in V (von ADC)" RAT_FUNC "%6.2" "[mV]" COEFFS 0 0.2046 0 0 0 1 /end COMPU_METHOD
/begin COMPU_METHOD Volt_Batt "Batteriespannung" RAT_FUNC "%6.1" "[mV]" COEFFS 0 0.0492252911173131 0 0 0 1 /end COMPU_METHOD
/begin RECORD_LAYOUT Kf_Xs16_Ys16_Ws16 NO_AXIS_PTS_X 1 SWORD NO_AXIS_PTS_Y 2 SWORD AXIS_PTS_X 3 SWORD INDEX_INCR DIRECT AXIS_PTS_Y 4 SWORD INDEX_INCR DIRECT FNC_VALUES 5 SWORD COLUMN_DIR DIRECT /end RECORD_LAYOUT
/begin RECORD_LAYOUT Kl_Xs16_Ws16 NO_AXIS_PTS_X 1 SWORD AXIS_PTS_X 2 SWORD INDEX_INCR DIRECT FNC_VALUES 3 SWORD COLUMN_DIR DIRECT /end RECORD_LAYOUT
/begin RECORD_LAYOUT Kw_Wr32 FNC_VALUES 1 FLOAT32_IEEE COLUMN_DIR DIRECT /end RECORD_LAYOUT
/begin RECORD_LAYOUT Kw_Ws16 FNC_VALUES 1 SWORD COLUMN_DIR DIRECT /end RECORD_LAYOUT
/begin RECORD_LAYOUT Kw_Ws32 FNC_VALUES 1 SLONG COLUMN_DIR DIRECT /end RECORD_LAYOUT
/begin RECORD_LAYOUT Kw_Wu16 FNC_VALUES 1 UWORD COLUMN_DIR DIRECT /end RECORD_LAYOUT
/begin RECORD_LAYOUT Kw_Wu32 FNC_VALUES 1 ULONG COLUMN_DIR DIRECT /end RECORD_LAYOUT
/begin RECORD_LAYOUT Kw_Wu8 FNC_VALUES 1 UBYTE COLUMN_DIR DIRECT /end RECORD_LAYOUT
/end MODULE
/end PROJECT
