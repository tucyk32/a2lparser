ASAP2_VERSION 1 3
/begin PROJECT C177 "EDC16CP"
/begin HEADER "" VERSION "VCP7A3" PROJECT_NO C177 /end HEADER
/begin MODULE DIM ""
/begin MOD_COMMON "" BYTE_ORDER MSB_FIRST ALIGNMENT_BYTE 1 ALIGNMENT_WORD 2 ALIGNMENT_LONG 4 ALIGNMENT_FLOAT32_IEEE 4 /end MOD_COMMON
/begin CHARACTERISTIC EGSys_AlpFreeCnvtTube_C "Wärmeübertragungskoeffizient am Abgasrohr aufgrund freier Konvektion" VAL_BLK 0x1CE874 Kwb_Ws16 999.9000 ThermalCoEff 0.1000000 1000.000 FORMAT "%8.3" EXTENDED_LIMITS -3276.800 3276.700 NUMBER 2 /end CHARACTERISTIC
/begin CHARACTERISTIC EGSys_cpTube_C "Wärmekapazität Abgasrohr" VAL_BLK 0x1CE878 Kwb_Ws16 2999.900 HeatCapacity 0.1000000 3000.000 FORMAT "%8.3" EXTENDED_LIMITS -3276.800 3276.700 NUMBER 2 /end CHARACTERISTIC
/begin CHARACTERISTIC EGSys_lDiamTube_C "Durchmesser Abgasrohr" VAL_BLK 0x1CE87C Kwb_Ws16 99.99219 Length1 0.007812500 100.0000 FORMAT "%8.4" EXTENDED_LIMITS -256.0000 255.9922 NUMBER 2 /end CHARACTERISTIC
/begin CHARACTERISTIC EGSys_lLngthTube_C "Länge Abgasrohr" VAL_BLK 0x1CE880 Kwb_Ws16 99.99219 Length1 0.007812500 100.0000 FORMAT "%8.4" EXTENDED_LIMITS -256.0000 255.9922 NUMBER 2 /end CHARACTERISTIC
/begin CHARACTERISTIC EGSys_NuTubeEnv_CUR "Nusselt-Zahl Abgasrohr-Aussenumströmung (nicht applizierbar)" CURVE 0x1CE884 Kl_Xs16_Ws16 5309.000 OneToOne 0.00 5309.000 FORMAT "%8.3" EXTENDED_LIMITS -32768.00 32767.00 READ_ONLY
 /begin AXIS_DESCR STD_AXIS EGSys_ReTubeEnvInpCrv_mp OneToOne 8 0.00 3750.000 FORMAT "%8.3" EXTENDED_LIMITS -32768.00 32767.00 DEPOSIT ABSOLUTE /end AXIS_DESCR
/end CHARACTERISTIC
/begin CHARACTERISTIC EGSys_NuTube_CUR "Nusselt-Zahl für Abgasrohrdurchströmung (nicht applizierbar)" CURVE 0x1CE8A6 Kl_Xs16_Ws16 1130.000 OneToOne 0.00 1130.000 FORMAT "%8.3" EXTENDED_LIMITS -32768.00 32767.00 READ_ONLY
 /begin AXIS_DESCR STD_AXIS EGSys_ReTubeInpCrv_mp ReynoldsNum 8 0.00 800000.0 FORMAT "%8.1" EXTENDED_LIMITS -3276800. 3276700. DEPOSIT ABSOLUTE /end AXIS_DESCR
/end CHARACTERISTIC
/begin CHARACTERISTIC EGSys_rSqTube_C "Anteil der vom Fahrtwind beaufschlagten Oberfläche Abgasrohr" VAL_BLK 0x1CE8C8 Kwb_Ws16 3.800049 Fact 0.09997559 3.900024 FORMAT "%8.6" EXTENDED_LIMITS -4.000000 3.999878 NUMBER 2 /end CHARACTERISTIC
/begin CHARACTERISTIC EGSys_tEGTubeDfl_C "Ersatzwert Abgastemperatur im Abgasrohr" VAL_BLK 0x1CE8CC Kwb_Ws16 1095.000 Temp_Cels -45.04000 1049.960 FORMAT "%8.3" EXTENDED_LIMITS -3549.940 3003.560 NUMBER 2 /end CHARACTERISTIC
/begin CHARACTERISTIC EGSys_tTubeDfl_C "Ersatzwert Abgasrohr-Temperatur" VAL_BLK 0x1CE8D0 Kwb_Ws16 1095.000 Temp_Cels -45.04000 1049.960 FORMAT "%8.3" EXTENDED_LIMITS -3549.940 3003.560 NUMBER 2 /end CHARACTERISTIC
/begin CHARACTERISTIC EGSys_tTubeIKi_C "I-Verstärkung Integrator zur Abgasrohr-Temperaturmodellierung" VALUE 0x1CE8D4 Kw_Wu32 4.00003045797 Ki_Kelv_Sec 0.00 4.00003045797 FORMAT "%13.11" EXTENDED_LIMITS 0.00 9999999.99767 /end CHARACTERISTIC
/begin CHARACTERISTIC EGSys_tTubeIKiPos_C "I-Verstärkung Integrator Abgasrohr-Temperaturmodellierung für pos. Großsignalbereich" VALUE 0x1CE8D8 Kw_Wu32 4.00003045797 Ki_Kelv_Sec 0.00 4.00003045797 FORMAT "%13.11" EXTENDED_LIMITS 0.00 9999999.99767 /end CHARACTERISTIC
/begin CHARACTERISTIC EGSys_tTubeIKiNeg_C "I-Verstärkung Integrator Abgasrohr-Temperaturmodellierung für neg. Großsignalbereich" VALUE 0x1CE8DC Kw_Wu32 4.00003045797 Ki_Kelv_Sec 0.00 4.00003045797 FORMAT "%13.11" EXTENDED_LIMITS 0.00 9999999.99767 /end CHARACTERISTIC
/begin CHARACTERISTIC EGSys_tTubeIWinPos_C "Obere Kleinstwertgrenze Integrator zur Abgasrohr-Temperaturmodellierung" VALUE 0x1CE8E0 Kw_Ws16 65535.00 OneToOne -32768.00 32767.00 FORMAT "%8.2" READ_ONLY /end CHARACTERISTIC
/begin CHARACTERISTIC EGSys_tTubeIWinNeg_C "Untere Kleinstwertgrenze Integrator zur Abgasrohr-Temperaturmodellierung" VALUE 0x1CE8E2 Kw_Ws16 65535.00 OneToOne -32768.00 32767.00 FORMAT "%8.2" READ_ONLY /end CHARACTERISTIC
/begin CHARACTERISTIC EGT_stTSync_Vector "Konfigurationslabel für Bypass" VALUE 0x1C0A68 Kw_Wu8 255.0 OneToOne 0.00 255.0 FORMAT "%5.1" /end CHARACTERISTIC
/begin CHARACTERISTIC EGT_stTSync_Channel "Konfigurationslabels für Bypass" VALUE 0x1C0A69 Kw_Wu8 255.0 OneToOne 0.00 255.0 FORMAT "%5.1" /end CHARACTERISTIC
/begin CHARACTERISTIC EGT_st_Vector "Bypass-Label, nicht editieren !" VALUE 0x1C0A66 Kw_Wu8 255.0 OneToOne 0.00 255.0 FORMAT "%5.1" /end CHARACTERISTIC
/begin CHARACTERISTIC EGT_st_Channel "Bypass-Label, nicht editieren !" VALUE 0x1C0A67 Kw_Wu8 255.0 OneToOne 0.00 255.0 FORMAT "%5.1" /end CHARACTERISTIC
/begin CHARACTERISTIC EGT_swtEGTActv_C "Schalter- Wert, um die EGT- Funktionen ein- oder auszuschalten" VALUE 0x1CE8E4 Kw_Wu8 1.000 OneToOne 0.00 1.000 FORMAT "%5.3" EXTENDED_LIMITS 0.00 255.0 /end CHARACTERISTIC
/begin CHARACTERISTIC EGT_tiRmpSlpMax_C "Maximale Rampenlaufzeit für EGT-Mehrfachschalter" VALUE 0x1CE8E8 Kw_Wu32 15.0000000000 Time_s 0.00 15.0000000000 FORMAT "%13.10" EXTENDED_LIMITS 0.00 42949672.9500 /end CHARACTERISTIC
/begin CHARACTERISTIC EMCCD_DebExcTempDef_C "Zeit bis defekt für EXC_TEMP Fehler" VALUE 0x1CE8EC Kw_Wu16 655350.0 Time_ms 0.00 655350.0 FORMAT "%8.1" /end CHARACTERISTIC
/begin CHARACTERISTIC EMCCD_DebExcTempOk_C "Heilungszeit für EXC_TEMP Fehler" VALUE 0x1CE8EE Kw_Wu16 655350.0 Time_ms 0.00 655350.0 FORMAT "%8.1" /end CHARACTERISTIC
/begin CHARACTERISTIC EMCCD_DebNoLoadDef_C "Zeit bis defekt für NO_LOAD Fehler" VALUE 0x1CE8F0 Kw_Wu16 655350.0 Time_ms 0.00 655350.0 FORMAT "%8.1" /end CHARACTERISTIC
/begin CHARACTERISTIC EMCCD_DebNoLoadOk_C "Heilungszeit für NO_LOAD Fehler" VALUE 0x1CE8F2 Kw_Wu16 655350.0 Time_ms 0.00 655350.0 FORMAT "%8.1" /end CHARACTERISTIC
/begin CHARACTERISTIC EMCCD_DebShortCircBatDef_C "Zeit bis defekt für SHORTCIRC_BAT Fehler" VALUE 0x1CE8F4 Kw_Wu16 655350.0 Time_ms 0.00 655350.0 FORMAT "%8.1" /end CHARACTERISTIC
/begin CHARACTERISTIC EMCCD_DebShortCircBatOk_C "Heilungszeit für SHORTCIRC_BAT Fehler" VALUE 0x1CE8F6 Kw_Wu16 655350.0 Time_ms 0.00 655350.0 FORMAT "%8.1" /end CHARACTERISTIC
/begin CHARACTERISTIC EMCCD_DebShortCircGndDef_C "Zeit bis defekt für SHORTCIRC_GND Fehler" VALUE 0x1CE8F8 Kw_Wu16 655350.0 Time_ms 0.00 655350.0 FORMAT "%8.1" /end CHARACTERISTIC
/begin CHARACTERISTIC EMCCD_DebShortCircGndOk_C "Heilungszeit für SHORTCIRC_GND Fehler" VALUE 0x1CE8FA Kw_Wu16 655350.0 Time_ms 0.00 655350.0 FORMAT "%8.1" /end CHARACTERISTIC
/begin CHARACTERISTIC EMCCD_stEngMntCtl_Init_C "Initialisierungswert für den Status der Motorlagersteuerung Ausgang 1" VALUE 0x1CE8FC Kw_Wu8 15.00 OneToOne 0.00 15.00 FORMAT "%5.2" EXTENDED_LIMITS 0.00 255.0 /end CHARACTERISTIC
/begin CHARACTERISTIC EMCCD_swtEnOut_C "Aggregatelager Endstufen deaktivieren" VALUE 0x1CE8FD Kw_Wu8 15.00 OneToOne 0.00 15.00 FORMAT "%5.2" EXTENDED_LIMITS 0.00 255.0 /end CHARACTERISTIC
/begin CHARACTERISTIC EMCCD_swtInvOut_C "Invertierter Ausgang der Aggregatelagersteuerung" VALUE 0x1CE8FE Kw_Wu8 15.00 OneToOne 0.00 15.00 FORMAT "%5.2" EXTENDED_LIMITS 0.00 255.0 /end CHARACTERISTIC
/begin CHARACTERISTIC EMCCD_tiG2checkDfpTmr_C "GTL2 Einschaltzeit vor erneuter Fehlerpruefung" VALUE 0x1CE900 Kw_Wu16 655350.0 Time_ms 0.00 655350.0 FORMAT "%8.1" /end CHARACTERISTIC
/begin CHARACTERISTIC EMCCD_tiG2OFFTmr_C "Abschaltzeit fuer GTL2 Endstufe" VALUE 0x1CE902 Kw_Wu16 655350.0 Time_ms 0.00 655350.0 FORMAT "%8.1" /end CHARACTERISTIC
/begin CHARACTERISTIC EMCCD_tiM1checkDfpTmr_C "MLS1 Einschaltzeit vor erneuter Fehlerpruefung" VALUE 0x1CE904 Kw_Wu16 655350.0 Time_ms 0.00 655350.0 FORMAT "%8.1" /end CHARACTERISTIC
/begin CHARACTERISTIC EMCCD_tiM1OFFTmr_C "Abschaltzeit fuer MLS1 Endstufe" VALUE 0x1CE906 Kw_Wu16 655350.0 Time_ms 0.00 655350.0 FORMAT "%8.1" /end CHARACTERISTIC
/begin CHARACTERISTIC EngMon_DebIrrCmbStepUp_C "Aufwärtsschrittweite für Entprellung des Fehlers irreguläre Verbrennung" VALUE 0x1CEBCC Kw_Wu8 3.000 OneToOne 0.00 3.000 FORMAT "%5.3" EXTENDED_LIMITS 0.00 255.0 /end CHARACTERISTIC
/begin CHARACTERISTIC EngMon_DebIrrCmbStepDown_C "Abwärtsschrittweite für Entprellung des Fehlers irreguläre Verbrennung" VALUE 0x1CEBCD Kw_Wu8 3.000 OneToOne 0.00 3.000 FORMAT "%5.3" EXTENDED_LIMITS 0.00 255.0 /end CHARACTERISTIC
/begin CHARACTERISTIC EngMon_DebIrrCmbDef_C "Grenze Fehlerentprellung für Fehler irreguläre Verbrennung" VALUE 0x1CEBCE Kw_Wu16 65535.00 OneToOne 0.00 65535.00 FORMAT "%8.2" /end CHARACTERISTIC
/begin CHARACTERISTIC EngMon_DebIrrCmbOk_C "Grenze Heilungsentprellung für Fehler irreguläre Verbrennung" VALUE 0x1CEBD0 Kw_Wu16 65535.00 OneToOne 0.00 65535.00 FORMAT "%8.2" /end CHARACTERISTIC
/begin CHARACTERISTIC EngMon_nMonActv_C "Mindestdrehzahl für Aktivierung der Überwachung auf irreguläre Verbrennung" VALUE 0x1CEBD2 Kw_Wu16 65535.00 EngN 0.00 65535.00 FORMAT "%8.2" /end CHARACTERISTIC
/begin CHARACTERISTIC EngMon_rO2MaxVal_C "Sauerstoffendwert der Schwellwertberechnung" VALUE 0x1CEBD4 Kw_Ws16 0.6553500 O2 -0.3276800 0.3276700 FORMAT "%9.7" /end CHARACTERISTIC
/begin CHARACTERISTIC EngMon_stActv_C "Schalter der Funktion Verbrennungserkennung (1=aktiv, 0= nicht aktiv)" VALUE 0x1CEBD6 Kw_Wu8 1.000 OneToOne 0.00 1.000 FORMAT "%5.3" EXTENDED_LIMITS 0.00 255.0 /end CHARACTERISTIC
/begin CHARACTERISTIC EngMon_tiFltPT1_C "Filterzeitkonstante für Schwellwertberechnung" VALUE 0x1CEBD8 Kw_Wu32 4294.9673 TimeDelay_s 0.0000010000000 4294.9673 FORMAT "%9.4" /end CHARACTERISTIC
/begin CHARACTERISTIC EngMon_tiDel_C "Totzeit nach Schubbeginn für Aktivierung des Schwellwertfilters" VALUE 0x1CEBDC Kw_Wu16 655.3500 Time_s 0.00 655.3500 FORMAT "%8.4" /end CHARACTERISTIC
/begin CHARACTERISTIC EngMon_tiMonActv_C "Totzeit nach Schubbeginn für Aktivierung der Überwachung auf irreguläre Verbrennung" VALUE 0x1CEBDE Kw_Wu16 655.3500 Time_s 0.00 655.3500 FORMAT "%8.4" /end CHARACTERISTIC
/begin CHARACTERISTIC EngM_ctOfsCaSCrS_C "Anzahl von Interrupts mit CaS/CrS Verdrehung (> EngM_phiDelta_C) im WAIT_PHASE State bis Verdreherkennung" VALUE 0x1C162C Kw_Wu8 255.0 default 0.00 255.0 FORMAT "%5.1" /end CHARACTERISTIC
/begin CHARACTERISTIC EngM_ctPhWhlRev_C "Anzahl von Phasenradumdrehungen bis zum Abbruch der Plausibilitätsprüfung" VALUE 0x1C162D Kw_Wu8 255.0 default 0.00 255.0 FORMAT "%5.1" /end CHARACTERISTIC
/begin CHARACTERISTIC EngM_ctPostSync_C "Anzahl statischer Interrupts bis zum Verlassen des Zustands POST" VALUE 0x1C162E Kw_Wu8 255.0 default 0.00 255.0 FORMAT "%5.1" /end CHARACTERISTIC
/begin CHARACTERISTIC EngM_ctReSync_C "Max. Anzahl von Versuchen das System umzusynchronisieren" VALUE 0x1C162F Kw_Wu8 255.0 default 0.00 255.0 FORMAT "%5.1" /end CHARACTERISTIC
/begin CHARACTERISTIC EngM_ctSpdtoZero_C "Anzahl Timeoutinterrupts bis Motordrehzahl  = Null" VALUE 0x1CE9DC Kw_Wu16 65535.00 OneToOne 0.00 65535.00 FORMAT "%8.2" /end CHARACTERISTIC
/begin CHARACTERISTIC EngM_ctVerSync_C "Anzahl der MAIN, PILOT, UPDATE, SEGMENT  Interrupts zur Plausibilisierung der Nockenwelle mit der Kurbelwelle" VALUE 0x1C1630 Kw_Wu8 255.0 default 0.00 255.0 FORMAT "%5.1" /end CHARACTERISTIC
/begin CHARACTERISTIC EngM_DebIncCaSErrSigDef_C "Inkrementdefektentprellung  für Nockenwellen-Signalstörung" VALUE 0x1CE9DE Kw_Wu16 65535.00 OneToOne 0.00 65535.00 FORMAT "%8.2" /end CHARACTERISTIC
/begin CHARACTERISTIC EngM_DebIncCaSErrSigOK_C "Inkrementheilungsentprellung bis NW-Position gueltig" VALUE 0x1CE9E0 Kw_Wu16 65535.00 OneToOne 0.00 65535.00 FORMAT "%8.2" /end CHARACTERISTIC
/begin CHARACTERISTIC EngM_DebIncCaSNoSigDef_C "Inkrementdefektentprellung für Nockenwellen-Signalausfall" VALUE 0x1CE9E2 Kw_Wu16 65535.00 OneToOne 0.00 65535.00 FORMAT "%8.2" /end CHARACTERISTIC
/begin CHARACTERISTIC EngM_DebIncCrSErrSigDef_C "Inkrementdefektentprellung für gestörtes Kurbelwellen-Signal" VALUE 0x1CE9E4 Kw_Wu16 65535.00 OneToOne 0.00 65535.00 FORMAT "%8.2" /end CHARACTERISTIC
/begin CHARACTERISTIC EngM_DebIncCrSErrSigOK_C "Inkrementheilungsprellung für gestörtes Kurbelwellen-Signal" VALUE 0x1CE9E6 Kw_Wu16 65535.00 OneToOne 0.00 65535.00 FORMAT "%8.2" /end CHARACTERISTIC
/begin CHARACTERISTIC EngM_DebIncOfsSigCaSCrSDef_C "Inkremententprellung zur Unterdrückung doppelter Fehlereinträge von Signal Störung / Verdrehung" VALUE 0x1CE9E8 Kw_Wu16 65535.00 OneToOne 0.00 65535.00 FORMAT "%8.2" /end CHARACTERISTIC
/begin CHARACTERISTIC EngM_DebPhCrSErrSigDef_C "Entprellung des Kurbelwellensignalausfalls über die Anzahl von Nockenwellenzaehnen" VALUE 0x1CE9EA Kw_Wu16 65535.00 OneToOne 0.00 65535.00 FORMAT "%8.2" /end CHARACTERISTIC
/begin CHARACTERISTIC EngM_dLimitCond_ASD_CA "Abschrankbedingung fuer die ASD-Task" VAL_BLK 0x1CE9B8 Kwb_Wu8 255.0 OneToOne 0.00 255.0 FORMAT "%5.1" NUMBER 3 /end CHARACTERISTIC
/begin CHARACTERISTIC EngM_dLimitCond_Common_CA "Abschrankbedingung fuer die Common-Task" VAL_BLK 0x1CE9BB Kwb_Wu8 255.0 OneToOne 0.00 255.0 FORMAT "%5.1" NUMBER 3 /end CHARACTERISTIC
/begin CHARACTERISTIC EngM_dLimitCond_FBC_CA "Abschrankbedingung fuer die FBC-Task" VAL_BLK 0x1CE9BE Kwb_Wu8 255.0 OneToOne 0.00 255.0 FORMAT "%5.1" NUMBER 3 /end CHARACTERISTIC
/begin CHARACTERISTIC EngM_dLimitCond_Joint_CA "Abschrankbedingung fuer die Joint-Task" VAL_BLK 0x1CE9C1 Kwb_Wu8 255.0 OneToOne 0.00 255.0 FORMAT "%5.1" NUMBER 3 /end CHARACTERISTIC
/begin CHARACTERISTIC EngM_dLimitCond_LiGov_CA "Abschrankbedingung fuer die LiGov-Task" VAL_BLK 0x1CE9C4 Kwb_Wu8 255.0 OneToOne 0.00 255.0 FORMAT "%5.1" NUMBER 3 /end CHARACTERISTIC
/begin CHARACTERISTIC EngM_dLimitCond_Pilot_CA "Abschrankbedingung fuer die Pilot-Task" VAL_BLK 0x1CE9C7 Kwb_Wu8 255.0 OneToOne 0.00 255.0 FORMAT "%5.1" NUMBER 3 /end CHARACTERISTIC
/begin CHARACTERISTIC EngM_nLimitInj_C "Drehzahlschwelle zur Abschrankung der Mengen- und Ansteuerbeginnberechnung" VALUE 0x1CE9CA Kw_Wu16 6000.000 EngN 0.00 6000.000 FORMAT "%8.3" EXTENDED_LIMITS 0.00 65535.00 /end CHARACTERISTIC
/begin CHARACTERISTIC EngM_nLimitThreshHyst_CA "Hysteresebreite der Abschrankdrehzahl" VAL_BLK 0x1CE9CC Kwb_Wu16 600.0000 EngN 0.00 600.0000 FORMAT "%8.4" EXTENDED_LIMITS 0.00 65535.00 NUMBER 3 /end CHARACTERISTIC
/begin CHARACTERISTIC EngM_nLimitThresh_CA "Drehzahlschwellen zur Taskabschrankung" VAL_BLK 0x1CE9D2 Kwb_Wu16 6000.000 EngN 0.00 6000.000 FORMAT "%8.3" EXTENDED_LIMITS 0.00 65535.00 NUMBER 3 /end CHARACTERISTIC
/begin CHARACTERISTIC EngM_nMaxStrtBackUp_C "Max. Drehzahl für Start nur mit Nockenwellensignal" VALUE 0x1CE9EC Kw_Ws16 300.0000 EngN 900.0000 1200.000 FORMAT "%8.3" EXTENDED_LIMITS -32768.00 32767.00 /end CHARACTERISTIC
/begin CHARACTERISTIC EngM_nMaxStrt_C "Motordrehzahl unterhalb dieser Schwelle; Einspritzung für redundanten Start mit Kurbelwelle ist erlaubt" VALUE 0x1C1632 Kw_Ws16 65535.00 EngN -32768.00 32767.00 FORMAT "%8.2" /end CHARACTERISTIC
/begin CHARACTERISTIC EngM_nMinDiag_C "Nockenwellendiagnose ab minimale Motordrehzahl" VALUE 0x1C0D00 Kw_Ws16 480.0000 EngN 20.00000 500.0000 FORMAT "%8.4" EXTENDED_LIMITS -32768.00 32767.00 /end CHARACTERISTIC
/begin CHARACTERISTIC EngM_nSwtCoMa_C "Schwellendrehzahl für die Umschaltung der Aufrufreihenfolge von Common- und MainInj-Task" VALUE 0x1CE9D8 Kw_Wu16 6000.000 EngN 0.00 6000.000 FORMAT "%8.3" EXTENDED_LIMITS 0.00 65535.00 /end CHARACTERISTIC
/begin CHARACTERISTIC EngM_numLimitInj_C "Berechnungshäufigkeit bei aktiver Abschrankung der Mengen- und Ansteuerbeginnberechnung" VALUE 0x1CE9DA Kw_Wu8 9.000 OneToOne 1.000 10.00 FORMAT "%5.2" EXTENDED_LIMITS 0.00 255.0 /end CHARACTERISTIC
/begin CHARACTERISTIC EngM_numPin_C "Zuordnungstabelle phyikalischer Zylinder zu SG-Endstufe (SG-Pin)" VAL_BLK 0x1C0CE4 Kwb_Wu8 255.0 OneToOne 0.00 255.0 FORMAT "%5.1" NUMBER 6 /end CHARACTERISTIC
/begin CHARACTERISTIC EngM_nWaitIncSig_C "Inkrementdrehzahl ab der das Signal im Start ausgeblendet wird" VALUE 0x1C1634 Kw_Ws16 6000.000 EngN 0.00 6000.000 FORMAT "%8.3" EXTENDED_LIMITS -32768.00 32767.00 /end CHARACTERISTIC
/begin CHARACTERISTIC EngM_phiDelayPhNoSig_C "Winkelverzoegerung für die Erkennung kein Nockenwellensignal" VALUE 0x1C1636 Kw_Ws16 720.0000 AngleCrS 0.00 720.0000 FORMAT "%8.4" EXTENDED_LIMITS -768.0000 767.9766 /end CHARACTERISTIC
/begin CHARACTERISTIC EngM_phiDeltaExtSync_C "Toleranz zwischen Kurbelwelle und Nockenwelle bei freigeschalteten CAN-Synchronisation" VALUE 0x1C1638 Kw_Ws16 720.0000 AngleCrS 0.00 720.0000 FORMAT "%8.4" EXTENDED_LIMITS -768.0000 767.9766 /end CHARACTERISTIC
/begin CHARACTERISTIC EngM_phiDelta_C "Toleranz zwischen Kurbelwelle und Nockenwelle" VALUE 0x1C163A Kw_Ws16 720.0000 AngleCrS 0.00 720.0000 FORMAT "%8.4" EXTENDED_LIMITS -768.0000 767.9766 /end CHARACTERISTIC
/begin CHARACTERISTIC EngM_phiFrstInjInt_C "Position des ersten Interrupts vor OT zur Berechnung der ersten Einspritzung" VALUE 0x1C163C Kw_Ws16 0.00 AngleCrS 739.9922 739.9922 FORMAT "%8.4" EXTENDED_LIMITS -768.0000 767.9766 /end CHARACTERISTIC
/begin CHARACTERISTIC EngM_phiInt_C "Positionen der stat. Interrupts vor jedem OT" VAL_BLK 0x1C163E Kwb_Ws16 720.0000 AngleCrS 0.00 720.0000 FORMAT "%8.4" EXTENDED_LIMITS -768.0000 767.9766 NUMBER 5 /end CHARACTERISTIC
/begin CHARACTERISTIC EngM_phiMax_C "Max. physikalischer Winkel im System" VALUE 0x1C0CEC Kw_Ws32 360.000000000 AngleCrS 360.000000000 720.000000000 FORMAT "%13.9" EXTENDED_LIMITS -50331648.0000 50331647.9766 /end CHARACTERISTIC
/begin CHARACTERISTIC EngM_phiTDC_C "Vektor der OT-Winkel aller Zylinder" VAL_BLK 0x1C0CF0 Kwb_Ws16 720.0000 AngleCrS 0.00 720.0000 FORMAT "%8.4" EXTENDED_LIMITS -768.0000 767.9766 NUMBER 6 /end CHARACTERISTIC
/begin CHARACTERISTIC EngM_rNOnOffGL_CUR "Drehzahlabhängige Lagersteuerung (Getriebelager)" CURVE 0x1CE9F0 Kl_Xs16_Ws16 1.000000 Fact 0.00 1.000000 FORMAT "%8.6" EXTENDED_LIMITS -4.000000 3.999878
 /begin AXIS_DESCR STD_AXIS Eng_nAvrg EngN 12 40.00000 6000.000 FORMAT "%8.3" EXTENDED_LIMITS -32768.00 32767.00 DEPOSIT ABSOLUTE /end AXIS_DESCR
/end CHARACTERISTIC
/begin CHARACTERISTIC EngM_rNOnOffML_CUR "Drehzahlabhängige Lagersteuerung (Motorlager)" CURVE 0x1CEA22 Kl_Xs16_Ws16 1.000000 Fact 0.00 1.000000 FORMAT "%8.6" EXTENDED_LIMITS -4.000000 3.999878
 /begin AXIS_DESCR STD_AXIS Eng_nAvrg EngN 12 40.00000 6000.000 FORMAT "%8.3" EXTENDED_LIMITS -32768.00 32767.00 DEPOSIT ABSOLUTE /end AXIS_DESCR
/end CHARACTERISTIC
/begin CHARACTERISTIC EngM_stBackUpVar_C "Variante: 0->Wechsel in BU-mode erfolgt bei einen Timeout von CrSCD  1->Wechsel erfolgt sobald Fehlerpf. CrS1 gesetzt ist" VALUE 0x1CE9EE Kw_Wu8 1.000 OneToOne 0.00 1.000 FORMAT "%5.3" EXTENDED_LIMITS 0.00 255.0 /end CHARACTERISTIC
/begin CHARACTERISTIC EngM_stEnaBackUp_C "Schalter zur Aktivierung des Betriebsmodus nur mit Nockenwellensignal" VALUE 0x1CE9EF Kw_Wu8 1.000 OneToOne 0.00 1.000 FORMAT "%5.3" EXTENDED_LIMITS 0.00 255.0 /end CHARACTERISTIC
/begin CHARACTERISTIC EngM_stSyncBefGap_C "Synchronisation ohne  Luecke" VALUE 0x1C1648 Kw_Wu8 1.000 OneToOne 0.00 1.000 FORMAT "%5.3" EXTENDED_LIMITS 0.00 255.0 /end CHARACTERISTIC
/begin CHARACTERISTIC EngM_swtEngMntCtlVal_C "Softwareschalter für Motorlagersteuerung" VALUE 0x1CEA54 Kw_Wu8 1.000 OneToOne 0.00 1.000 FORMAT "%5.3" EXTENDED_LIMITS 0.00 255.0 /end CHARACTERISTIC
/begin CHARACTERISTIC EngM_swtEngMntCtlType_C "Auswahl Wert aus Datensatz oder EEPROM für Softwareschalter Motorlagersteuerung" VALUE 0x1CEA55 Kw_Wu8 0.00 OneToOne 2.000 2.000 FORMAT "%5.3" EXTENDED_LIMITS 0.00 255.0 /end CHARACTERISTIC
/begin CHARACTERISTIC EngM_swtExitOfs_C "Aussprungbedingung aus dem SYNC_OFFSET State" VALUE 0x1C1649 Kw_Wu8 255.0 default 0.00 255.0 FORMAT "%5.1" /end CHARACTERISTIC
/begin CHARACTERISTIC EngM_swtFirSeqFBC_C "Schalter zur Auswahl der FBC Zählweise" VALUE 0x1C164A Kw_Wu8 1.000 default 0.00 1.000 FORMAT "%5.3" EXTENDED_LIMITS 0.00 255.0 /end CHARACTERISTIC
/begin CHARACTERISTIC EngM_swtModeGL_C "Betriebsart für Leerlauf  und Klimamoment (Getriebelager)" VALUE 0x1CEA56 Kw_Wu8 3.000 OneToOne 0.00 3.000 FORMAT "%5.3" EXTENDED_LIMITS 0.00 255.0 /end CHARACTERISTIC
/begin CHARACTERISTIC EngM_swtModeML_C "Betriebsart für Leerlauf  und Klimamoment (Motorlager)" VALUE 0x1CEA57 Kw_Wu8 3.000 OneToOne 0.00 3.000 FORMAT "%5.3" EXTENDED_LIMITS 0.00 255.0 /end CHARACTERISTIC
/begin CHARACTERISTIC EngM_swtNumCylVal_C "Zylinderanzahl, bei Applikation nicht verändern" VALUE 0x1C162A Kw_Wu8 0.00 OneToOne 6.000 6.000 FORMAT "%5.3" EXTENDED_LIMITS 0.00 255.0 READ_ONLY /end CHARACTERISTIC
/begin CHARACTERISTIC EngM_swtNumCylType_C "Sw-Schaltertyp für Zylinderanzahl" VALUE 0x1C162B Kw_Wu8 0.00 OneToOne 0.00 0.00 FORMAT "%5.2" EXTENDED_LIMITS 0.00 255.0 READ_ONLY /end CHARACTERISTIC
/begin CHARACTERISTIC EngM_swtSyncViaCAN_C "Ein-, Ausschalten 1/0 der Master-Slave Synchronisation via CAN" VALUE 0x1C164B Kw_Wu8 1.000 OneToOne 0.00 1.000 FORMAT "%5.3" EXTENDED_LIMITS 0.00 255.0 /end CHARACTERISTIC
/begin CHARACTERISTIC EngM_swtTempTrqFrc_C "Schalter der Temperaturwert des Arrays auswählt" VALUE 0x1CEA70 Kw_Wu8 4.00000000000 EngTempFldSel 0.00 4.00000000000 FORMAT "%13.11" /end CHARACTERISTIC
/begin CHARACTERISTIC EngM_tiCpuTimeOut_C "CPU timeout Periode" VALUE 0x1C0CFC Kw_Wu32 100000.000000 TimeDT 0.00 100000.000000 FORMAT "%13.6" EXTENDED_LIMITS 0.00 4294967295.00 /end CHARACTERISTIC
/begin CHARACTERISTIC EngM_tiDiffInt_C "Minimaler Abstand swischen zwei stat. Interrupts" VALUE 0x1C164C Kw_Wu32 1228361874.73 TimeSys_us 0.00 1228361874.73 FORMAT "%13.2" /end CHARACTERISTIC
/begin CHARACTERISTIC EngM_tiWaitIncSig_C "Zeit zum Ausblenden des Inkrementsignals im Start" VALUE 0x1C1650 Kw_Wu16 20000.00 Time_ms 0.00 20000.00 FORMAT "%8.2" EXTENDED_LIMITS 0.00 655350.0 /end CHARACTERISTIC
/begin CHARACTERISTIC EngM_trqFrcMin_CUR "Kennlinie für die Berechnung des minimum Reibmoments" CURVE 0x1CEA72 Kl_Xs16_Ws16 500.0000 Trq -500.0000 0.00 FORMAT "%8.4" EXTENDED_LIMITS -3276.800 3276.700
 /begin AXIS_DESCR STD_AXIS Eng_nAvrg EngN 25 0.00 6000.000 FORMAT "%8.3" EXTENDED_LIMITS -32768.00 32767.00 DEPOSIT ABSOLUTE /end AXIS_DESCR
/end CHARACTERISTIC
/begin CHARACTERISTIC EngM_trqFrc_MAP "Schleppkennfeld, Reibkennfeld" MAP 0x1CEAD8 Kf_Xs16_Ys16_Ws16 6553.500 Trq -3276.800 3276.700 FORMAT "%8.3"
 /begin AXIS_DESCR STD_AXIS Eng_nAvrg EngN 10 0.00 32767.00 FORMAT "%8.2" EXTENDED_LIMITS -32768.00 32767.00 DEPOSIT ABSOLUTE /end AXIS_DESCR
 /begin AXIS_DESCR STD_AXIS EngM_tTrqFrc_mp Temp_Cels 10 -273.1400 3003.560 FORMAT "%8.3" EXTENDED_LIMITS -3549.940 3003.560 DEPOSIT ABSOLUTE /end AXIS_DESCR
/end CHARACTERISTIC
/begin CHARACTERISTIC EngM_trqHysGL_C "Hysterese für Schwelle Klimamoment (Getriebelager)" VALUE 0x1CEA58 Kw_Ws16 630.0000 Trq 0.00 630.0000 FORMAT "%8.4" EXTENDED_LIMITS -3276.800 3276.700 /end CHARACTERISTIC
/begin CHARACTERISTIC EngM_trqHysML_C "Hysterese für Schwelle Klimamoment (Motorlager)" VALUE 0x1CEA5A Kw_Ws16 630.0000 Trq 0.00 630.0000 FORMAT "%8.4" EXTENDED_LIMITS -3276.800 3276.700 /end CHARACTERISTIC
/begin CHARACTERISTIC EngM_trqValGL_C "Schwelle Klimamoment (Getriebelager)" VALUE 0x1CEA5C Kw_Ws16 630.0000 Trq 0.00 630.0000 FORMAT "%8.4" EXTENDED_LIMITS -3276.800 3276.700 /end CHARACTERISTIC
/begin CHARACTERISTIC EngM_trqValML_C "Schwelle Klimamoment (Motorlager)" VALUE 0x1CEA5E Kw_Ws16 630.0000 Trq 0.00 630.0000 FORMAT "%8.4" EXTENDED_LIMITS -3276.800 3276.700 /end CHARACTERISTIC
/begin CHARACTERISTIC EngM_vHiHysGL_C "Hysterese für obere Schwelle Geschwindigkeit (Getriebelager)" VALUE 0x1CEA60 Kw_Ws16 655.3500 Vel -327.6800 327.6700 FORMAT "%8.4" /end CHARACTERISTIC
/begin CHARACTERISTIC EngM_vHiHysML_C "Hysterese für Schwelle Klimamoment (Motorlager)" VALUE 0x1CEA62 Kw_Ws16 655.3500 Vel -327.6800 327.6700 FORMAT "%8.4" /end CHARACTERISTIC
/begin CHARACTERISTIC EngM_vHiValGL_C "obere Schwelle Geschwindigkeit (Getriebelager)" VALUE 0x1CEA64 Kw_Ws16 655.3500 Vel -327.6800 327.6700 FORMAT "%8.4" /end CHARACTERISTIC
/begin CHARACTERISTIC EngM_vHiValML_C "obere Schwelle Geschwindigkeit (Motorlager)" VALUE 0x1CEA66 Kw_Ws16 655.3500 Vel -327.6800 327.6700 FORMAT "%8.4" /end CHARACTERISTIC
/begin CHARACTERISTIC EngM_vLoHysGL_C "Hysterese für untere Schwelle Geschwindigkeit (Getriebelager)" VALUE 0x1CEA68 Kw_Ws16 655.3500 Vel -327.6800 327.6700 FORMAT "%8.4" /end CHARACTERISTIC
/begin CHARACTERISTIC EngM_vLoHysML_C "Hysterese für untere Schwelle Geschwindigkeit (Motorlager)" VALUE 0x1CEA6A Kw_Ws16 655.3500 Vel -327.6800 327.6700 FORMAT "%8.4" /end CHARACTERISTIC
/begin CHARACTERISTIC EngM_vLoValGL_C "untere Schwelle Geschwindigkeit (Getriebelager)" VALUE 0x1CEA6C Kw_Ws16 655.3500 Vel -327.6800 327.6700 FORMAT "%8.4" /end CHARACTERISTIC
/begin CHARACTERISTIC EngM_vLoValML_C "untere Schwelle Geschwindigkeit (Motorlager)" VALUE 0x1CEA6E Kw_Ws16 655.3500 Vel -327.6800 327.6700 FORMAT "%8.4" /end CHARACTERISTIC
/begin CHARACTERISTIC EngPrt_DebSigDef_C "Fehlerentprellzeit fuer Ueberdrehzahlerkennung" VALUE 0x1CEBE0 Kw_Wu16 655350.0 Time_ms 0.00 655350.0 FORMAT "%8.1" /end CHARACTERISTIC
/begin CHARACTERISTIC EngPrt_DebSigOk_C "Heilungsentprellzeit fuer Ueberdrehzahlerkennung" VALUE 0x1CEBE2 Kw_Wu16 655350.0 Time_ms 0.00 655350.0 FORMAT "%8.1" /end CHARACTERISTIC
/begin CHARACTERISTIC EngPrt_dfacCTOvhtUp_C "Rampensteigung bei Kochschutz aktiv" VALUE 0x1CEFEC Kw_Wu32 7999.99399856 Rmp_Fact 0.00599958002567 7999.99999814 FORMAT "%13.8" EXTENDED_LIMITS 0.00 7999.99999814 /end CHARACTERISTIC
/begin CHARACTERISTIC EngPrt_dfacCTOvhtDwn_C "Rampensteigung bei Kochschutz aktiv" VALUE 0x1CEFF0 Kw_Wu32 7999.99399856 Rmp_Fact 0.00599958002567 7999.99999814 FORMAT "%13.8" EXTENDED_LIMITS 0.00 7999.99999814 /end CHARACTERISTIC
/begin CHARACTERISTIC EngPrt_facFlClgDSPHysXLow_C "Untere Grenze Hysterese" VALUE 0x1CEFF4 Kw_Ws16 1.000000 Fact 0.00 1.000000 FORMAT "%8.6" EXTENDED_LIMITS -4.000000 3.999878 /end CHARACTERISTIC
/begin CHARACTERISTIC EngPrt_facFlClgDSPHysXHigh_C "Obere Grenze Hysterese" VALUE 0x1CEFF6 Kw_Ws16 1.000000 Fact 0.00 1.000000 FORMAT "%8.6" EXTENDED_LIMITS -4.000000 3.999878 /end CHARACTERISTIC
/begin CHARACTERISTIC EngPrt_stFlClgDSPHysYLow_C "Unterer Ausgangswert Hysterese" VALUE 0x1CEFF8 Kw_Ws16 1.000000 OneToOne 0.00 1.000000 FORMAT "%8.6" EXTENDED_LIMITS -32768.00 32767.00 /end CHARACTERISTIC
/begin CHARACTERISTIC EngPrt_stFlClgDSPHysYHigh_C "Oberer Ausgangswert Hysterese" VALUE 0x1CEFFA Kw_Ws16 1.000000 OneToOne 0.00 1.000000 FORMAT "%8.6" EXTENDED_LIMITS -32768.00 32767.00 /end CHARACTERISTIC
/begin CHARACTERISTIC EngPrt_facAirOvhtPrv_MAP "Überhitzungsschutz Ladeluft-Kennfeld" MAP 0x1CEFFC Kf_Xs16_Ys16_Ws16 3.999878 Fact 0.00 3.999878 FORMAT "%8.6" EXTENDED_LIMITS -4.000000 3.999878
 /begin AXIS_DESCR STD_AXIS IATSCD_tAir Temp_Cels 10 -50.14000 199.8600 FORMAT "%8.4" EXTENDED_LIMITS -3549.940 3003.560 DEPOSIT ABSOLUTE /end AXIS_DESCR
 /begin AXIS_DESCR STD_AXIS Eng_nAvrg EngN 10 0.00 6000.000 FORMAT "%8.3" EXTENDED_LIMITS -32768.00 32767.00 DEPOSIT ABSOLUTE /end AXIS_DESCR
/end CHARACTERISTIC
/begin CHARACTERISTIC EngPrt_facAPCorr_MAP "Höhenabhängiges Drehzahl-Kennfeld" MAP 0x1CF0F0 Kf_Xs16_Ys16_Ws16 3.999878 Fact 0.00 3.999878 FORMAT "%8.6" EXTENDED_LIMITS -4.000000 3.999878
 /begin AXIS_DESCR STD_AXIS APSCD_pVal Pres_hPa 10 -32768.00 32767.00 FORMAT "%8.2" DEPOSIT ABSOLUTE /end AXIS_DESCR
 /begin AXIS_DESCR STD_AXIS Eng_nAvrg EngN 10 0.00 6000.000 FORMAT "%8.3" EXTENDED_LIMITS -32768.00 32767.00 DEPOSIT ABSOLUTE /end AXIS_DESCR
/end CHARACTERISTIC
/begin CHARACTERISTIC EngPrt_facBPAPIncLoadCorr_MAP "Kennfeld zur Korrektur der Volllasterhöhung" MAP 0x1CF1E4 Kf_Xs16_Ys16_Ws16 3.999878 Fact 0.00 3.999878 FORMAT "%8.6" EXTENDED_LIMITS -4.000000 3.999878
 /begin AXIS_DESCR STD_AXIS Eng_tEng Temp_Cels 4 -50.14000 199.8600 FORMAT "%8.4" EXTENDED_LIMITS -3549.940 3003.560 DEPOSIT ABSOLUTE /end AXIS_DESCR
 /begin AXIS_DESCR STD_AXIS EngPrt_pVal_mp Pres_hPa 5 0.00 3500.000 FORMAT "%8.3" EXTENDED_LIMITS -32768.00 32767.00 DEPOSIT ABSOLUTE /end AXIS_DESCR
/end CHARACTERISTIC
/begin CHARACTERISTIC EngPrt_facCTOvhtPrv_MAP "Kennfeld Überhitzungsschutz aus Motortemperatur und Fahrgeschwindigkeit" MAP 0x1CF222 Kf_Xs16_Ys16_Ws16 3.999878 Fact 0.00 3.999878 FORMAT "%8.6" EXTENDED_LIMITS -4.000000 3.999878
 /begin AXIS_DESCR STD_AXIS CTSCD_tClntCan Temp_Cels 6 -50.14000 149.8600 FORMAT "%8.4" EXTENDED_LIMITS -3549.940 3003.560 DEPOSIT ABSOLUTE /end AXIS_DESCR
 /begin AXIS_DESCR STD_AXIS VSSCD_v Vel 10 0.00 300.0000 FORMAT "%8.4" EXTENDED_LIMITS -327.6800 327.6700 DEPOSIT ABSOLUTE /end AXIS_DESCR
/end CHARACTERISTIC
/begin CHARACTERISTIC EngPrt_facFlTempLim_MAP "Überhitzungsschutz Kraftstoff-Kennfeld" MAP 0x1CF2BE Kf_Xs16_Ys16_Ws16 3.999878 Fact 0.00 3.999878 FORMAT "%8.6" EXTENDED_LIMITS -4.000000 3.999878
 /begin AXIS_DESCR STD_AXIS EngPrt_tFuel_mp Temp_Cels 10 -50.14000 149.8600 FORMAT "%8.4" EXTENDED_LIMITS -3549.940 3003.560 DEPOSIT ABSOLUTE /end AXIS_DESCR
 /begin AXIS_DESCR STD_AXIS Eng_nAvrg EngN 10 0.00 6000.000 FORMAT "%8.3" EXTENDED_LIMITS -32768.00 32767.00 DEPOSIT ABSOLUTE /end AXIS_DESCR
/end CHARACTERISTIC
/begin CHARACTERISTIC EngPrt_facOilOvhtPrv_MAP "Kennfeld Überhitzungsschutz Oil" MAP 0x1CF3B2 Kf_Xs16_Ys16_Ws16 3.999878 Fact 0.00 3.999878 FORMAT "%8.6" EXTENDED_LIMITS -4.000000 3.999878
 /begin AXIS_DESCR STD_AXIS OTSCD_tEngOil Temp_Cels 10 -3549.940 3003.560 FORMAT "%8.3" DEPOSIT ABSOLUTE /end AXIS_DESCR
 /begin AXIS_DESCR STD_AXIS Eng_nAvrg EngN 10 0.00 6000.000 FORMAT "%8.3" EXTENDED_LIMITS -32768.00 32767.00 DEPOSIT ABSOLUTE /end AXIS_DESCR
/end CHARACTERISTIC
/begin CHARACTERISTIC EngPrt_facTempPreTrbn_MAP "Kennfeld zur Ermittlung des Momenten-Begrenzungsfaktors zur Limitierung der Temperatur vor der Abgasturbine" MAP 0x1CF4A6 Kf_Xs16_Ys16_Ws16 3.999878 Fact 0.00 3.999878 FORMAT "%8.6" EXTENDED_LIMITS -4.000000 3.999878
 /begin AXIS_DESCR STD_AXIS EngPrt_tPreTrbn_mp Temp_Cels 8 -45.04000 1049.960 FORMAT "%8.3" EXTENDED_LIMITS -3549.940 3003.560 DEPOSIT ABSOLUTE /end AXIS_DESCR
 /begin AXIS_DESCR STD_AXIS Eng_nAvrg EngN 8 0.00 6000.000 FORMAT "%8.3" EXTENDED_LIMITS -32768.00 32767.00 DEPOSIT ABSOLUTE /end AXIS_DESCR
/end CHARACTERISTIC
/begin CHARACTERISTIC EngPrt_facTnkTempLim_MAP "Überhitzungsschutz Tankeintrittstemperatur-Kennfeld" MAP 0x1CF54A Kf_Xs16_Ys16_Ws16 3.999878 Fact 0.00 3.999878 FORMAT "%8.6" EXTENDED_LIMITS -4.000000 3.999878
 /begin AXIS_DESCR STD_AXIS TTSCD_tTnk Temp_Cels 2 -3549.940 3003.560 FORMAT "%8.3" DEPOSIT ABSOLUTE /end AXIS_DESCR
 /begin AXIS_DESCR STD_AXIS Eng_nAvrg EngN 2 0.00 6000.000 FORMAT "%8.3" EXTENDED_LIMITS -32768.00 32767.00 DEPOSIT ABSOLUTE /end AXIS_DESCR
/end CHARACTERISTIC
/begin CHARACTERISTIC EngPrt_nIncLoadHigh_C "Obere Drehzahlgrenze der motortemperaturabhängigen Volllasterhöhung" VALUE 0x1CF55E Kw_Ws16 6000.000 EngN 0.00 6000.000 FORMAT "%8.3" EXTENDED_LIMITS -32768.00 32767.00 /end CHARACTERISTIC
/begin CHARACTERISTIC EngPrt_nIncLoadLow_C "Untere Drehzahlgrenze der motortemperaturabhängigen Volllasterhöhung" VALUE 0x1CF560 Kw_Ws16 6000.000 EngN 0.00 6000.000 FORMAT "%8.3" EXTENDED_LIMITS -32768.00 32767.00 /end CHARACTERISTIC
/begin CHARACTERISTIC EngPrt_nOvhtThresHigh_C "Obere Drehzahlschwelle für Wassertemperaturüberhitzungsschutz" VALUE 0x1CF562 Kw_Ws16 6000.000 EngN 0.00 6000.000 FORMAT "%8.3" EXTENDED_LIMITS -32768.00 32767.00 /end CHARACTERISTIC
/begin CHARACTERISTIC EngPrt_nOvhtThresLow_C "Untere Drehzahlschwelle für Wassertemperaturüberhitzungsschutz" VALUE 0x1CF564 Kw_Ws16 6000.000 EngN 0.00 6000.000 FORMAT "%8.3" EXTENDED_LIMITS -32768.00 32767.00 /end CHARACTERISTIC
/begin CHARACTERISTIC EngPrt_nOvrSpd_C "Schwelle für Überdrehzahlerkennung" VALUE 0x1CEBE4 Kw_Ws16 6000.000 EngN 0.00 6000.000 FORMAT "%8.3" EXTENDED_LIMITS -32768.00 32767.00 /end CHARACTERISTIC
/begin CHARACTERISTIC EngPrt_nThrClo_C "Drehzahlschwelle für Schließen der Drosselklappe" VALUE 0x1CEBE6 Kw_Ws16 6000.000 EngN 0.00 6000.000 FORMAT "%8.3" EXTENDED_LIMITS -32768.00 32767.00 /end CHARACTERISTIC
/begin CHARACTERISTIC EngPrt_nThrOpen_C "Drehzahlschwelle für Öffnen der Drosselklappe" VALUE 0x1CEBE8 Kw_Ws16 6000.000 EngN 0.00 6000.000 FORMAT "%8.3" EXTENDED_LIMITS -32768.00 32767.00 /end CHARACTERISTIC
/begin CHARACTERISTIC EngPrt_tiPreTrbnPT1_C "Zeitkonstante des PT1-Filters zur Filterung des Begrenzungsfaktors der Abgastemperatur vor der Turbine" VALUE 0x1CF568 Kw_Wu32 4294.9673 TimeDelay_s 0.0000010000000 4294.9673 FORMAT "%9.4" /end CHARACTERISTIC
/begin CHARACTERISTIC EngPrt_qLimP_MAP "Motorschutz Mengenbegrenzung durch Atmosphärendruck" MAP 0x1CEBEA Kf_Xs16_Ys16_Ws16 327.6700 InjMass 0.00 327.6700 FORMAT "%8.4" EXTENDED_LIMITS -327.6800 327.6700
 /begin AXIS_DESCR STD_AXIS APSCD_pVal Pres_hPa 4 0.00 3500.000 FORMAT "%8.3" EXTENDED_LIMITS -32768.00 32767.00 DEPOSIT ABSOLUTE /end AXIS_DESCR
 /begin AXIS_DESCR STD_AXIS Eng_nAvrg EngN 25 40.00000 6000.000 FORMAT "%8.3" EXTENDED_LIMITS -32768.00 32767.00 DEPOSIT ABSOLUTE /end AXIS_DESCR
/end CHARACTERISTIC
/begin CHARACTERISTIC EngPrt_dtrqUpNLim_C "Rampenanstieg von Ersatzkennlinie auf Normalkennlinie der Motordrehzahlbegrenzung" VALUE 0x1CECF0 Kw_Wu32 6553594.99817 RmpTrq 5.00030517578 6553599.99847 FORMAT "%13.5" EXTENDED_LIMITS 0.00 6553599.99847 /end CHARACTERISTIC
/begin CHARACTERISTIC EngPrt_dtrqDwnNLim_C "Rampenanstieg von Normalkennlinie zur Ersatzkennlinie der Motordrehzahlbegrenzung" VALUE 0x1CECF4 Kw_Wu32 6553594.99817 RmpTrq 5.00030517578 6553599.99847 FORMAT "%13.5" EXTENDED_LIMITS 0.00 6553599.99847 /end CHARACTERISTIC
/begin CHARACTERISTIC EngPrt_rThrCloAct_C "PWG-Schwelle für Schließen der Drosselklappe bei Überdrehzahl" VALUE 0x1CECF8 Kw_Ws16 100.0000 Prc 0.00 100.0000 FORMAT "%8.4" EXTENDED_LIMITS -327.6800 327.6700 /end CHARACTERISTIC
/begin CHARACTERISTIC EngPrt_rThrClo_C "PWG-Schwelle für Überdrehzahl-Überwachung ( Funktion: Schließen der Drosselklappe bei Überdrehzahl )" VALUE 0x1CECFA Kw_Ws16 100.0000 Prc 0.00 100.0000 FORMAT "%8.4" EXTENDED_LIMITS -327.6800 327.6700 /end CHARACTERISTIC
/begin CHARACTERISTIC EngPrt_swtAPBP_C "Schalter zur Wahl des Drucks für Volllasterhöhung (0: BPACD_pOutVal, 1: APSCD_pVal)" VALUE 0x1CF56C Kw_Wu8 1.000 OneToOne 0.00 1.000 FORMAT "%5.3" EXTENDED_LIMITS 0.00 255.0 /end CHARACTERISTIC
/begin CHARACTERISTIC EngPrt_swtEGSys2_C "Schalter für Auswahr ein- oder zweiflutiges Abgassystem" VALUE 0x1CF56D Kw_Wu8 1.000 OneToOne 0.00 1.000 FORMAT "%5.3" EXTENDED_LIMITS 0.00 255.0 /end CHARACTERISTIC
/begin CHARACTERISTIC EngPrt_swtFlTempVirtEna_C "Schalter zur Aktivierung der virtuellen Kraftstofftemperatur" VALUE 0x1CF56E Kw_Wu8 1.000 OneToOne 0.00 1.000 FORMAT "%5.3" EXTENDED_LIMITS 0.00 255.0 /end CHARACTERISTIC
/begin CHARACTERISTIC EngPrt_swtLimPMap_C "Motorschutz Begrenzungs Schalter für Atmosphärendruckkennfelder" VALUE 0x1CECFC Kw_Wu8 1.000 OneToOne 0.00 1.000 FORMAT "%5.3" EXTENDED_LIMITS 0.00 255.0 /end CHARACTERISTIC
/begin CHARACTERISTIC EngPrt_swtOilOvhtPrevVal_C "Softwareschalter Öltemperaturüberhitzungsschutz" VALUE 0x1CF56F Kw_Wu8 1.000 OneToOne 0.00 1.000 FORMAT "%5.3" EXTENDED_LIMITS 0.00 255.0 /end CHARACTERISTIC
/begin CHARACTERISTIC EngPrt_swtOilOvhtPrevType_C "Auswahl Wert aus Datensatz oder EEPROM für Softwareschalter Öltemperaturüberhitzungsschutz" VALUE 0x1CF570 Kw_Wu8 0.00 OneToOne 2.000 2.000 FORMAT "%5.3" EXTENDED_LIMITS 0.00 255.0 /end CHARACTERISTIC
/begin CHARACTERISTIC EngPrt_swtTempPreTrbnVal_C "Schalterwerte zum Auswählen der Temperatur entweder aus Modellrechnung (1) oder vom Sensor (0)" VALUE 0x1CF571 Kw_Wu8 1.000 OneToOne 0.00 1.000 FORMAT "%5.3" EXTENDED_LIMITS 0.00 255.0 /end CHARACTERISTIC
/begin CHARACTERISTIC EngPrt_swtTempPreTrbnType_C "Schaltertyp zum Auswählen der Temperatur entweder aus Modellrechnung (1) oder vom Sensor (0)" VALUE 0x1CF572 Kw_Wu8 0.00 OneToOne 2.000 2.000 FORMAT "%5.3" EXTENDED_LIMITS 0.00 255.0 /end CHARACTERISTIC
/begin CHARACTERISTIC EngPrt_swtTrqLimEco_C "Schalter für AST Momentenbegrenzung" VALUE 0x1CECFD Kw_Wu8 1.000 OneToOne 0.00 1.000 FORMAT "%5.3" EXTENDED_LIMITS 0.00 255.0 /end CHARACTERISTIC
/begin CHARACTERISTIC EngPrt_tAirHysShiftHigh_C "obere Hystereseschwelle - Ansauglufttemperatrur" VALUE 0x1CF574 Kw_Ws16 250.0000 Temp_Cels -50.14000 199.8600 FORMAT "%8.4" EXTENDED_LIMITS -3549.940 3003.560 /end CHARACTERISTIC
/begin CHARACTERISTIC EngPrt_tAirHysShiftLow_C "Untere Hystereseschwelle - Ansauglufttemperatrur" VALUE 0x1CF576 Kw_Ws16 250.0000 Temp_Cels -50.14000 199.8600 FORMAT "%8.4" EXTENDED_LIMITS -3549.940 3003.560 /end CHARACTERISTIC
/begin CHARACTERISTIC EngPrt_tClntHysShiftHigh_C "obere Hystereseschwelle - Wassertemperatrur" VALUE 0x1CF578 Kw_Ws16 200.0000 Temp_Cels -50.14000 149.8600 FORMAT "%8.4" EXTENDED_LIMITS -3549.940 3003.560 /end CHARACTERISTIC
/begin CHARACTERISTIC EngPrt_tClntHysShiftLow_C "Untere Hystereseschwelle - Wassertemperatrur" VALUE 0x1CF57A Kw_Ws16 200.0000 Temp_Cels -50.14000 149.8600 FORMAT "%8.4" EXTENDED_LIMITS -3549.940 3003.560 /end CHARACTERISTIC
/begin CHARACTERISTIC EngPrt_tEngOilHysShiftHigh_C "Obere Hystereseschwelle - Motoröltemperatur" VALUE 0x1CF57C Kw_Ws16 330.0000 Temp_Cels -53.14000 276.8600 FORMAT "%8.4" EXTENDED_LIMITS -3549.940 3003.560 /end CHARACTERISTIC
/begin CHARACTERISTIC EngPrt_tEngOilHysShiftLow_C "Untere Hystereseschwelle - Motoröltemperatur" VALUE 0x1CF57E Kw_Ws16 330.0000 Temp_Cels -53.14000 276.8600 FORMAT "%8.4" EXTENDED_LIMITS -3549.940 3003.560 /end CHARACTERISTIC
/begin CHARACTERISTIC EngPrt_tFuelVirt_MAP "Map zur Berechnung der virtuellen Kraftstofftemperatur" MAP 0x1CF580 Kf_Xs16_Ys16_Ws16 3699.800 Temp_Cels -3549.940 149.8600 FORMAT "%8.3" EXTENDED_LIMITS -3549.940 3003.560
 /begin AXIS_DESCR STD_AXIS EngM_ctRevSta OneToOne 3 0.00 32767.00 FORMAT "%8.2" EXTENDED_LIMITS -32768.00 32767.00 DEPOSIT ABSOLUTE /end AXIS_DESCR
 /begin AXIS_DESCR STD_AXIS FTSCD_tFuel Temp_Cels 5 -50.14000 149.8600 FORMAT "%8.4" EXTENDED_LIMITS -3549.940 3003.560 DEPOSIT ABSOLUTE /end AXIS_DESCR
/end CHARACTERISTIC
/begin CHARACTERISTIC EngPrt_tiDelOvrSpd_C "Ausblendzeit fuer Ueberdrehzahlerkennung" VALUE 0x1CECFE Kw_Wu16 10000000. Time_us 0.00 10000000. EXTENDED_LIMITS 0.00 655350000. /end CHARACTERISTIC
/begin CHARACTERISTIC EngPrt_tiThrClo_C "Entprellzeit für Schließen der Drosselklappe" VALUE 0x1CED00 Kw_Wu16 650000.0 Time_us 0.00 650000.0 FORMAT "%8.1" EXTENDED_LIMITS 0.00 655350000. /end CHARACTERISTIC
/begin CHARACTERISTIC EngPrt_trqIncLoad_MAP "Motortemperaturabhängiges Volllasterhöhungskennfeld" MAP 0x1CF5B2 Kf_Xs16_Ys16_Ws16 1000.000 Trq 0.00 1000.000 FORMAT "%8.3" EXTENDED_LIMITS -3276.800 3276.700
 /begin AXIS_DESCR STD_AXIS Eng_nAvrg EngN 11 0.00 6000.000 FORMAT "%8.3" EXTENDED_LIMITS -32768.00 32767.00 DEPOSIT ABSOLUTE /end AXIS_DESCR
 /begin AXIS_DESCR STD_AXIS Eng_tEng Temp_Cels 10 -50.14000 199.8600 FORMAT "%8.4" EXTENDED_LIMITS -3549.940 3003.560 DEPOSIT ABSOLUTE /end AXIS_DESCR
/end CHARACTERISTIC
/begin CHARACTERISTIC EngPrt_trqLimP_MAP "Kennfeld zur Begrenzung aufgrund des Atmosphärendrucks und der Drehzahl" MAP 0x1CED02 Kf_Xs16_Ys16_Ws16 1000.000 Trq 0.00 1000.000 FORMAT "%8.3" EXTENDED_LIMITS -3276.800 3276.700
 /begin AXIS_DESCR STD_AXIS APSCD_pVal Pres_hPa 4 0.00 3500.000 FORMAT "%8.3" EXTENDED_LIMITS -32768.00 32767.00 DEPOSIT ABSOLUTE /end AXIS_DESCR
 /begin AXIS_DESCR STD_AXIS Eng_nAvrg EngN 25 40.00000 6000.000 FORMAT "%8.3" EXTENDED_LIMITS -32768.00 32767.00 DEPOSIT ABSOLUTE /end AXIS_DESCR
/end CHARACTERISTIC
/begin CHARACTERISTIC EngPrt_trqLimrVnNoPI_MAP "Kennfeld zur Begrenzung bei Voreinspritzung inaktiv" MAP 0x1CEE08 Kf_Xs16_Ys16_Ws16 1000.000 Trq 0.00 1000.000 FORMAT "%8.3" EXTENDED_LIMITS -3276.800 3276.700
 /begin AXIS_DESCR STD_AXIS VehDa_rVn VelToN 3 -0.3276800 0.3276700 FORMAT "%9.7" DEPOSIT ABSOLUTE /end AXIS_DESCR
 /begin AXIS_DESCR STD_AXIS Eng_nAvrg EngN 21 40.00000 6000.000 FORMAT "%8.3" EXTENDED_LIMITS -32768.00 32767.00 DEPOSIT ABSOLUTE /end AXIS_DESCR
/end CHARACTERISTIC
/begin CHARACTERISTIC EngPrt_trqNEcoLim_CUR "Kennlinie für AST Eingriffs Momentenbegrenzung" CURVE 0x1CEEBA Kl_Xs16_Ws16 3276.700 Trq 0.00 3276.700 FORMAT "%8.3" EXTENDED_LIMITS -3276.800 3276.700
 /begin AXIS_DESCR STD_AXIS Eng_nAvrg EngN 25 0.00 32767.00 FORMAT "%8.2" EXTENDED_LIMITS -32768.00 32767.00 DEPOSIT ABSOLUTE /end AXIS_DESCR
/end CHARACTERISTIC
/begin CHARACTERISTIC EngPrt_trqNLimSpr_CUR "Kennlinie für Motordrehzahlbegrenzung bei Systemfehler (als Begrenzungsmoment)" CURVE 0x1CEF20 Kl_Xs16_Ws16 3276.700 Trq 0.00 3276.700 FORMAT "%8.3" EXTENDED_LIMITS -3276.800 3276.700
 /begin AXIS_DESCR STD_AXIS Eng_nAvrg EngN 25 0.00 32767.00 FORMAT "%8.2" EXTENDED_LIMITS -32768.00 32767.00 DEPOSIT ABSOLUTE /end AXIS_DESCR
/end CHARACTERISTIC
/begin CHARACTERISTIC EngPrt_trqNLim_CUR "Kennlinie für Drehzahlbegrenzung im Normalbetrieb (inneres Motormoment)" CURVE 0x1CEF86 Kl_Xs16_Ws16 3276.700 Trq 0.00 3276.700 FORMAT "%8.3" EXTENDED_LIMITS -3276.800 3276.700
 /begin AXIS_DESCR STD_AXIS Eng_nAvrg EngN 25 0.00 32767.00 FORMAT "%8.2" EXTENDED_LIMITS -32768.00 32767.00 DEPOSIT ABSOLUTE /end AXIS_DESCR
/end CHARACTERISTIC
/begin CHARACTERISTIC Eng_ctEngSpdDiffCalc_C "Anzahl der Drehzahlwerte zur Mittelung" VALUE 0x1CE908 Kw_Wu8 4.000 OneToOne 1.000 5.000 FORMAT "%5.3" EXTENDED_LIMITS 0.00 255.0 /end CHARACTERISTIC
/begin CHARACTERISTIC Eng_dtEng_MAP "Temperaturkennfeld zur Korrektur der Motortemperatur" MAP 0x1CE970 Kf_Xs16_Ys16_Ws16 300.0000 TempDiff_Kelv -150.0000 150.0000 FORMAT "%8.4" EXTENDED_LIMITS -3276.800 3276.700
 /begin AXIS_DESCR STD_AXIS EngM_ctRevSta OneToOne 4 0.00 32767.00 FORMAT "%8.2" EXTENDED_LIMITS -32768.00 32767.00 DEPOSIT ABSOLUTE /end AXIS_DESCR
 /begin AXIS_DESCR STD_AXIS Eng_dtEngSub_mp TempDiff_Kelv 6 -150.0000 150.0000 FORMAT "%8.4" EXTENDED_LIMITS -3276.800 3276.700 DEPOSIT ABSOLUTE /end AXIS_DESCR
/end CHARACTERISTIC
/begin CHARACTERISTIC Eng_trqSpd_CUR "Drehmomentkennlinie" CURVE 0x1CE90A Kl_Xs16_Ws16 3276.700 Trq 0.00 3276.700 FORMAT "%8.3" EXTENDED_LIMITS -3276.800 3276.700
 /begin AXIS_DESCR STD_AXIS Eng_nAvrg EngN 25 0.00 6000.000 FORMAT "%8.3" EXTENDED_LIMITS -32768.00 32767.00 DEPOSIT ABSOLUTE /end AXIS_DESCR
/end CHARACTERISTIC
/begin CHARACTERISTIC ErLpCD_tiDebMILReqOnDef_C "Debounce Dauer" VALUE 0x1CF6C0 Kw_Wu16 655350.0 Time_ms 0.00 655350.0 FORMAT "%8.1" /end CHARACTERISTIC
/begin CHARACTERISTIC ErLpCD_tiDebMILReqOnOk_C "Fehlerheilungserkennungszeit" VALUE 0x1CF6C2 Kw_Wu16 655350.0 Time_ms 0.00 655350.0 FORMAT "%8.1" /end CHARACTERISTIC
/begin CHARACTERISTIC ErLpCD_stMilInvOut_C "Invertierung des Ausgangssignals" VALUE 0x1CF6C4 Kw_Wu8 1.000 OneToOne 0.00 1.000 FORMAT "%5.3" EXTENDED_LIMITS 0.00 255.0 /end CHARACTERISTIC
/begin CHARACTERISTIC ErLpCD_stPwrStgLampActv_C "Spezifikation des Abschaltverhaltens der Lamp-Endstufe" VALUE 0x1CF6C5 Kw_Wu8 255.0 OneToOne 0.00 255.0 FORMAT "%5.1" /end CHARACTERISTIC
/begin CHARACTERISTIC ErLpCD_stPwrStgLampDia_C "Spezifikation des Diagnoseabschaltverhaltens der Lamp-Endstufe" VALUE 0x1CF6C6 Kw_Wu8 255.0 OneToOne 0.00 255.0 FORMAT "%5.1" /end CHARACTERISTIC
/begin CHARACTERISTIC ErLpCD_stPwrStgMilActv_C "Spezifikation des Abschaltverhaltens der MIL-Endstufe" VALUE 0x1CF6C7 Kw_Wu8 255.0 OneToOne 0.00 255.0 FORMAT "%5.1" /end CHARACTERISTIC
/begin CHARACTERISTIC ErLpCD_stPwrStgMilDia_C "Spezifikation des Diagnoseabschaltverhaltens der MIL-Endstufe" VALUE 0x1CF6C8 Kw_Wu8 255.0 OneToOne 0.00 255.0 FORMAT "%5.1" /end CHARACTERISTIC
/begin CHARACTERISTIC ErLpCD_stSysLampInvOut_C "Invertierung des Ausgangssignals" VALUE 0x1CF6C9 Kw_Wu8 1.000 OneToOne 0.00 1.000 FORMAT "%5.3" EXTENDED_LIMITS 0.00 255.0 /end CHARACTERISTIC
/begin CHARACTERISTIC ErLpCD_swtMILVal_C "Datensatzwert für den Schalter ErLpCD_swtMIL" VALUE 0x1CF6CA Kw_Wu8 1.000 OneToOne 0.00 1.000 FORMAT "%5.3" EXTENDED_LIMITS 0.00 255.0 /end CHARACTERISTIC
/begin CHARACTERISTIC ErLpCD_swtMILType_C "Parameter zur Auswahl des Schaltertyps (soll Wert aus Datensatz oder aus EEPROM kommen)" VALUE 0x1CF6CB Kw_Wu8 0.00 OneToOne 2.000 2.000 FORMAT "%5.3" EXTENDED_LIMITS 0.00 255.0 /end CHARACTERISTIC
/begin CHARACTERISTIC ErLpCD_swtSYSVal_C "Datensatzwert für den Schalter ErLpCD_swtSYS" VALUE 0x1CF6CC Kw_Wu8 1.000 OneToOne 0.00 1.000 FORMAT "%5.3" EXTENDED_LIMITS 0.00 255.0 /end CHARACTERISTIC
/begin CHARACTERISTIC ErLpCD_swtSYSType_C "Parameter zur Auswahl des Schaltertyps (soll Wert aus Datensatz oder aus EEPROM kommen)" VALUE 0x1CF6CD Kw_Wu8 0.00 OneToOne 2.000 2.000 FORMAT "%5.3" EXTENDED_LIMITS 0.00 255.0 /end CHARACTERISTIC
/begin CHARACTERISTIC ErLpCD_tiSysLampBlkDia_C "Blinkfrequenz bei externer Diagnoseanforderung" VALUE 0x1CF6CE Kw_Wu16 655350.0 Time_ms 0.00 655350.0 FORMAT "%8.1" /end CHARACTERISTIC
/begin CHARACTERISTIC ErLp_tiMilDefectTime_C "Zeit für MIL Defekterkennung (Endstufenüberwachung)" VALUE 0x1CF6D0 Kw_Wu16 655350.0 Time_ms 0.00 655350.0 FORMAT "%8.1" /end CHARACTERISTIC
/begin CHARACTERISTIC ErLp_tiMilOkTime_C "Zeit für MIL in Ordnung Erkennung (Endstufenüberwachung)" VALUE 0x1CF6D2 Kw_Wu16 655350.0 Time_ms 0.00 655350.0 FORMAT "%8.1" /end CHARACTERISTIC
/begin CHARACTERISTIC ErLp_MilEngN_C "Drehzahlgrenze für MIL-Test" VALUE 0x1CF6D4 Kw_Ws16 65535.00 EngN -32768.00 32767.00 FORMAT "%8.2" /end CHARACTERISTIC
/begin CHARACTERISTIC ErLp_tiMilMax_C "Zeitgrenze für MIL-Test" VALUE 0x1CF6D6 Kw_Wu16 655350.0 Time_ms 0.00 655350.0 FORMAT "%8.1" /end CHARACTERISTIC
/begin CHARACTERISTIC ErLp_tiMilTst_C "zusätzliche MIL Test Zeit nach Überschreiten Drehzahlschwelle" VALUE 0x1CF6D8 Kw_Wu16 655350.0 Time_ms 0.00 655350.0 FORMAT "%8.1" /end CHARACTERISTIC
/begin CHARACTERISTIC ErLp_tiMilDel_C "Verzögerung der MIL Anzeige nach Lampentest" VALUE 0x1CF6DA Kw_Wu16 655350.0 Time_ms 0.00 655350.0 FORMAT "%8.1" /end CHARACTERISTIC
/begin CHARACTERISTIC ErLp_tiMilBlk_C "halbe Periodendauer  der MIL-Blinkphase" VALUE 0x1CF6DC Kw_Wu16 655350.0 Time_ms 0.00 655350.0 FORMAT "%8.1" /end CHARACTERISTIC
/begin CHARACTERISTIC ErLp_swtMilEn_C "MIL Freigabe Schalter" VALUE 0x1CF6DE Kw_Wu8 1.000 OneToOne 0.00 1.000 FORMAT "%5.3" EXTENDED_LIMITS 0.00 255.0 /end CHARACTERISTIC
/begin CHARACTERISTIC ErLp_swtSysEqGlwLamp_C "SysLamp entspricht Glühlampe (Signalumleitung)" VALUE 0x1CF6E0 Kw_Wu8 1.000 OneToOne 0.00 1.000 FORMAT "%5.3" EXTENDED_LIMITS 0.00 255.0 /end CHARACTERISTIC
/begin CHARACTERISTIC ErLp_tiSysLampDefectTime_C "Zeit für SysLamp Defekterkennung (Endstufenüberwachung)" VALUE 0x1CF6E2 Kw_Wu16 655350.0 Time_ms 0.00 655350.0 FORMAT "%8.1" /end CHARACTERISTIC
/begin CHARACTERISTIC ErLp_tiSysLampOkTime_C "Zeit für SysLamp in Ordnung Erkennung (Endstufenüberwachung)" VALUE 0x1CF6E4 Kw_Wu16 655350.0 Time_ms 0.00 655350.0 FORMAT "%8.1" /end CHARACTERISTIC
/begin CHARACTERISTIC ErLp_SysLampEngN_C "Drehzahlgrenze für SysLamp-Test" VALUE 0x1CF6E6 Kw_Ws16 65535.00 EngN -32768.00 32767.00 FORMAT "%8.2" /end CHARACTERISTIC
/begin CHARACTERISTIC ErLp_tiSysLampMax_C "Zeitgrenze für SysLamp-Test" VALUE 0x1CF6E8 Kw_Wu16 655350.0 Time_ms 0.00 655350.0 FORMAT "%8.1" /end CHARACTERISTIC
/begin CHARACTERISTIC ErLp_tiSysLampTst_C "zusätzliche SysLamp Test Zeit nach Überschreiten Drehzahlschwelle" VALUE 0x1CF6EA Kw_Wu16 655350.0 Time_ms 0.00 655350.0 FORMAT "%8.1" /end CHARACTERISTIC
/begin CHARACTERISTIC ErLp_tiSysLampDel_C "Verzögerung der SysLamp Anzeige nach Lampentest" VALUE 0x1CF6EC Kw_Wu16 655350.0 Time_ms 0.00 655350.0 FORMAT "%8.1" /end CHARACTERISTIC
/begin CHARACTERISTIC ErLp_tiSysLampBlk_C "halbe Periodendauer der Systemlampen-Blinkphase" VALUE 0x1CF6EE Kw_Wu16 655350.0 Time_ms 0.00 655350.0 FORMAT "%8.1" /end CHARACTERISTIC
/begin CHARACTERISTIC ErLp_swtSysLampEn_C "SysLamp Freigabe Schalter" VALUE 0x1CF6F0 Kw_Wu8 1.000 OneToOne 0.00 1.000 FORMAT "%5.3" EXTENDED_LIMITS 0.00 255.0 /end CHARACTERISTIC
/begin CHARACTERISTIC Ertm_swMaxReset_u8 "Resetschalter für Ertm_timax_u32" VALUE 0x1CF6BC Kw_Wu8 1.000 OneToOne 0.00 1.000 FORMAT "%5.3" EXTENDED_LIMITS 0.00 255.0 /end CHARACTERISTIC
/begin CHARACTERISTIC Ertm_tiMeasTime_u16 "Integrationszeit für die Laufzeitmessung 10 * 100ms" VALUE 0x1CF6BE Kw_Wu16 65535.00 OneToOne 0.00 65535.00 FORMAT "%8.2" /end CHARACTERISTIC
/begin CHARACTERISTIC ESS_nBattIncrMin_C "Anforderungwert zur Erhöhung der Leerlaufsolldrehzahl bei schwacher Batterie" VALUE 0x1CF6F2 Kw_Ws16 6000.000 EngN 0.00 6000.000 FORMAT "%8.3" EXTENDED_LIMITS -32768.00 32767.00 /end CHARACTERISTIC
/begin CHARACTERISTIC ESS_nBattMinThres_C "Threshold to avoid a sudden increase of torque" VALUE 0x1CF6F4 Kw_Ws16 6000.000 EngN 0.00 6000.000 FORMAT "%8.3" EXTENDED_LIMITS -32768.00 32767.00 /end CHARACTERISTIC
/begin CHARACTERISTIC ESS_nBattMin_C "Wert der geforderten Drehzahl nach Freigabe" VALUE 0x1CF6F6 Kw_Ws16 6000.000 EngN 0.00 6000.000 FORMAT "%8.3" EXTENDED_LIMITS -32768.00 32767.00 /end CHARACTERISTIC
/begin CHARACTERISTIC ESS_nLIBattThres_C "Schwelle Drehzahl zur Aktivierung der Drehzahlforderung" VALUE 0x1CF6F8 Kw_Ws16 6000.000 EngN 0.00 6000.000 FORMAT "%8.3" EXTENDED_LIMITS -32768.00 32767.00 /end CHARACTERISTIC
/begin CHARACTERISTIC ESS_tiDelayStrtDoneFFSet_C "Zeit bis Freigabe des Startabwurfs" VALUE 0x1CF6FE Kw_Ws16 327.6700 Time_s 0.00 327.6700 FORMAT "%8.4" EXTENDED_LIMITS -327.6800 327.6700 /end CHARACTERISTIC
/begin CHARACTERISTIC ESS_tiDelayUBattFFRes_C "Zeit bis Rücknahme der Drehzahlforderung nach Deaktivierung" VALUE 0x1CF700 Kw_Ws16 327.6700 Time_s 0.00 327.6700 FORMAT "%8.4" EXTENDED_LIMITS -327.6800 327.6700 /end CHARACTERISTIC
/begin CHARACTERISTIC ESS_tiDelayUBattFFSet_C "Zeit bis Freigabe der Drehzahlforderung nach Aktivierung" VALUE 0x1CF6FA Kw_Ws16 327.6700 Time_s 0.00 327.6700 FORMAT "%8.4" EXTENDED_LIMITS -327.6800 327.6700 /end CHARACTERISTIC
/begin CHARACTERISTIC ESS_uLIBattThresFFRes_C "Schwelle Batteriespannung zur Deaktivierung der Drehzahlforderung" VALUE 0x1CF702 Kw_Ws16 665653.8 Volt_Batt 0.00 665653.8 FORMAT "%8.1" EXTENDED_LIMITS -665674.1 665653.8 /end CHARACTERISTIC
/begin CHARACTERISTIC ESS_uLIBattThresFFSet_C "Schwelle Batteriespannung zur Aktivierung der Drehzahlforderung" VALUE 0x1CF6FC Kw_Ws16 665653.8 Volt_Batt 0.00 665653.8 FORMAT "%8.1" EXTENDED_LIMITS -665674.1 665653.8 /end CHARACTERISTIC
/begin CHARACTERISTIC ETClb_ctDflLrn_CA "Defaultwerte für die applikative Änderung der Lernzykluszähler der Ansteuerdauerkalibrierung für die ZFC" VAL_BLK 0x1CF760 Kwb_Wu16 65535.00 OneToOne 0.00 65535.00 FORMAT "%8.2" NUMBER 3 /end CHARACTERISTIC
/begin CHARACTERISTIC ETClb_ctLrnThresQck_C "Anzahl der Lernzyklen für die Freigabe der Ansteuerdauerkorrektur durch die Ansteurdauerkalibrierung bei Schnellkalibrierung" VALUE 0x1CF704 Kw_Wu16 65535.00 OneToOne 0.00 65535.00 FORMAT "%8.2" /end CHARACTERISTIC
/begin CHARACTERISTIC ETClb_ctLrnThres_C "Anzahl der Lernzyklen für die Freigabe der Ansteuerdauerkorrektur durch die Ansteurdauerkalibrierung" VALUE 0x1CF706 Kw_Wu16 65535.00 OneToOne 0.00 65535.00 FORMAT "%8.2" /end CHARACTERISTIC
/begin CHARACTERISTIC ETClb_DebETMaxDefect_C "Entprellzeit der Defekterkennung der Überschreitung der maximalen Ansteuerdauer von der Ansteuerdauerkalibrierung" VALUE 0x1CF744 Kw_Wu16 65535.00 OneToOne 0.00 65535.00 FORMAT "%8.2" /end CHARACTERISTIC
/begin CHARACTERISTIC ETClb_DebETMaxOk_C "Entprellzeit der Intakterkennung der Überschreitung der maximalen Ansteuerdauer von der Ansteuerdauerkalibrierung" VALUE 0x1CF746 Kw_Wu16 65535.00 OneToOne 0.00 65535.00 FORMAT "%8.2" /end CHARACTERISTIC
/begin CHARACTERISTIC ETClb_DebETMinDefect_C "Entprellzeit der Defekterkennung der Unterschreitung der minimalen Ansteuerdauer von der Ansteuerdauerkalibrierung" VALUE 0x1CF748 Kw_Wu16 65535.00 OneToOne 0.00 65535.00 FORMAT "%8.2" /end CHARACTERISTIC
/begin CHARACTERISTIC ETClb_DebETMinOk_C "Entprellzeit der Intakterkennung der Unterschreitung der minimalen Ansteuerdauer von der Ansteuerdauerkalibrierung" VALUE 0x1CF74A Kw_Wu16 65535.00 OneToOne 0.00 65535.00 FORMAT "%8.2" /end CHARACTERISTIC
/begin CHARACTERISTIC ETClb_dpRailLim_CA "Raildruck-Kalibrierpunkt abhängige max. Abweichung des Raildrucks für die Nullmengenkalibrierung" VAL_BLK 0x1CF708 Kwb_Ws16 1800000. Pres_Rail 0.00 1800000. FORMAT "%8.0" EXTENDED_LIMITS -3276800. 3276700. NUMBER 3 /end CHARACTERISTIC
/begin CHARACTERISTIC ETClb_dtiDflETFlt0_CA "Defaultwerte für die gefilterte Ansteuerdauerdifferenz der Ansteuerdauerkalibrierung für den Raildruck-Kalibrierpunkt 0" VAL_BLK 0x1CF766 Kwb_Ws16 1000.000 InjTime_us 0.00 1000.000 FORMAT "%8.3" EXTENDED_LIMITS -32768.00 32767.00 NUMBER 6 /end CHARACTERISTIC
/begin CHARACTERISTIC ETClb_dtiDflETFlt1_CA "Defaultwerte für die gefilterte Ansteuerdauerdifferenz der Ansteuerdauerkalibrierung für den Raildruck-Kalibrierpunkt 1" VAL_BLK 0x1CF772 Kwb_Ws16 1000.000 InjTime_us 0.00 1000.000 FORMAT "%8.3" EXTENDED_LIMITS -32768.00 32767.00 NUMBER 6 /end CHARACTERISTIC
/begin CHARACTERISTIC ETClb_dtiDflETFlt2_CA "Defaultwerte für die gefilterte Ansteuerdauerdifferenz der Ansteuerdauerkalibrierung für den Raildruck-Kalibrierpunkt 2" VAL_BLK 0x1CF77E Kwb_Ws16 1000.000 InjTime_us 0.00 1000.000 FORMAT "%8.3" EXTENDED_LIMITS -32768.00 32767.00 NUMBER 6 /end CHARACTERISTIC
/begin CHARACTERISTIC ETClb_facFltQck_C "Filterkonstante für die Ansteuerdauerdifferenz der Ansteuerdauerkalibrierung bei Schnellkalibrierung" VALUE 0x1CF70E Kw_Wu16 1.000000 Fact 0.00 1.000000 FORMAT "%8.6" EXTENDED_LIMITS 0.00 7.999878 /end CHARACTERISTIC
/begin CHARACTERISTIC ETClb_facFlt_C "Filterkonstante für die Ansteuerdauerdifferenz der Ansteuerdauerkalibrierung" VALUE 0x1CF710 Kw_Wu16 1.000000 Fact 0.00 1.000000 FORMAT "%8.6" EXTENDED_LIMITS 0.00 7.999878 /end CHARACTERISTIC
/begin CHARACTERISTIC ETClb_numCyclMeas_C "Anzahl der Einspritzzyklen für die Messung der Ansteuerdauerkalibrierung" VALUE 0x1CF712 Kw_Wu16 65535.00 OneToOne 0.00 65535.00 FORMAT "%8.2" /end CHARACTERISTIC
/begin CHARACTERISTIC ETClb_numCyclNoDyn_C "Anzahl der Einspritzzyklen bis die Ansteuerdauekalibrierung den maximalen Drehzahlanstieg prüft" VALUE 0x1CF714 Kw_Wu16 65535.00 OneToOne 0.00 65535.00 FORMAT "%8.2" /end CHARACTERISTIC
/begin CHARACTERISTIC ETClb_numCyclStartEnergize_C "Anzahl der Einspritzzyklen bis die Ansteuerdauerkalibrierung für die Messung eingeschwungen ist" VALUE 0x1CF716 Kw_Wu16 65535.00 OneToOne 0.00 65535.00 FORMAT "%8.2" /end CHARACTERISTIC
/begin CHARACTERISTIC ETClb_numDflCylCur_CA "Testwerte für die aktuellen Zylinder der Ansteuerdauerkalibrierung für jeden Raildruck-Kalibrierpunkt" VAL_BLK 0x1CF78A Kwb_Wu8 5.000 OneToOne 1.000 6.000 FORMAT "%5.3" EXTENDED_LIMITS 0.00 255.0 NUMBER 3 /end CHARACTERISTIC
/begin CHARACTERISTIC ETClb_pRailSet_CA "Raildruck-Kalibrierpunkte für die Ansteuerdauerkalibrierung" VAL_BLK 0x1CF718 Kwb_Ws16 1800000. Pres_Rail 0.00 1800000. FORMAT "%8.0" EXTENDED_LIMITS -3276800. 3276700. NUMBER 3 /end CHARACTERISTIC
/begin CHARACTERISTIC ETClb_SigThres_CA "Raildurck-Kalibrierpunkt abhänge Signalschwelle der Nullmengenkalibrierung" VAL_BLK 0x1CF71E Kwb_Ws16 200.0000 OneToOne 0.00 200.0000 FORMAT "%8.4" EXTENDED_LIMITS -32768.00 32767.00 NUMBER 3 /end CHARACTERISTIC
/begin CHARACTERISTIC ETClb_swtCorActvVal_C "Applikativer Wert des SW-Schalters für die Ansteuerdauerkorrektur" VALUE 0x1CF724 Kw_Wu8 1.000 OneToOne 0.00 1.000 FORMAT "%5.3" EXTENDED_LIMITS 0.00 255.0 /end CHARACTERISTIC
/begin CHARACTERISTIC ETClb_swtCorActvType_C "Typ des SW-Schalters für die Ansteuerdauerkorrektur der Nullmengenkalibrierung" VALUE 0x1CF725 Kw_Wu8 2.000 OneToOne 0.00 2.000 FORMAT "%5.3" EXTENDED_LIMITS 0.00 255.0 /end CHARACTERISTIC
/begin CHARACTERISTIC ETClb_swtDflQckClb_C "Testwert zum Umschalten auf Schnellkalibrierung der Ansteuerdauerkalibrierung" VALUE 0x1CF78D Kw_Wu8 1.000 OneToOne 0.00 1.000 FORMAT "%5.3" EXTENDED_LIMITS 0.00 255.0 /end CHARACTERISTIC
/begin CHARACTERISTIC ETClb_swtWrDflVal_C "Aktivierung zum schreiben der Testwerte für die Ansteuerdauerkalibrierung bei Wechsel von 0 nach 1" VALUE 0x1CF726 Kw_Wu8 1.000 OneToOne 0.00 1.000 FORMAT "%5.3" EXTENDED_LIMITS 0.00 255.0 /end CHARACTERISTIC
/begin CHARACTERISTIC ETClb_tiDflETCur_CA "Testwert der aktuellen Ansteuerdauer für die Ansteuerdauerkalibrierung bei jedem Raildruck-Kalibrierpunkt" VAL_BLK 0x1CF78E Kwb_Ws16 1000.000 InjTime_us 0.00 1000.000 FORMAT "%8.3" EXTENDED_LIMITS -32768.00 32767.00 NUMBER 3 /end CHARACTERISTIC
/begin CHARACTERISTIC ETClb_tiDflInjInit_C "Defaultwert für die applikative Änderung des Ininitialisierungswerts des Injektor-Betriebsstundenzählers" VALUE 0x1CF794 Kw_Wu32 4294967295.00 OneToOne 0.00 4294967295.00 FORMAT "%13.2" /end CHARACTERISTIC
/begin CHARACTERISTIC ETClb_tiETStep_CA "Schrittweite der Ansteuerdauer für die Anhebung oder Senkung der Ansteuerdauer von der Ansteuerdauer-Kalibrierung" VAL_BLK 0x1CF74C Kwb_Ws16 1000.000 InjTime_us 0.00 1000.000 FORMAT "%8.3" EXTENDED_LIMITS -32768.00 32767.00 NUMBER 3 /end CHARACTERISTIC
/begin CHARACTERISTIC ETClb_tiET_MAX_CA "Maximale Ansteuerdauer der Einspritzungen für die Ansteuerdauerkalibrierung für jeden Raildruck-Kalibirierpunkt" VAL_BLK 0x1CF752 Kwb_Ws16 32767.00 InjTime_us 0.00 32767.00 FORMAT "%8.2" EXTENDED_LIMITS -32768.00 32767.00 NUMBER 3 /end CHARACTERISTIC
/begin CHARACTERISTIC ETClb_tiET_MIN_CA "Minimale Ansteuerdauer der Einspritzungen für die Ansteuerdauerkalibrierung für jeden Raildruck-Kalibirierpunkt" VAL_BLK 0x1CF758 Kwb_Ws16 32767.00 InjTime_us 0.00 32767.00 FORMAT "%8.2" EXTENDED_LIMITS -32768.00 32767.00 NUMBER 3 /end CHARACTERISTIC
/begin CHARACTERISTIC ETClb_tiInjThresQck_C "Injektorbetriebsstunden bis zur Freigabe der Ansteuerdauerkorrektur durch die Ansteuerdauer-Kalibrierung bei Schnellkalibrierung" VALUE 0x1CF728 Kw_Wu32 65535.0000000 TimeEngOn 0.00 65535.0000000 FORMAT "%13.7" EXTENDED_LIMITS 0.00 4294967295.00 /end CHARACTERISTIC
/begin CHARACTERISTIC ETClb_tiInjThres_C "Injektorbetriebsstunden bis zur Freigabe der Ansteuerdauerkorrektur durch die Ansteuerdauer-Kalibrierung" VALUE 0x1CF72C Kw_Wu32 1000000.00000 TimeEngOn 0.00 1000000.00000 FORMAT "%13.5" EXTENDED_LIMITS 0.00 4294967295.00 /end CHARACTERISTIC
/begin CHARACTERISTIC ETClb_volEffectiveMin_CA "Menge der Wirkgrenze für die Ansteuerdauerkalibrierung" VAL_BLK 0x1CF730 Kwb_Ws16 100.0000 InjQntInj 0.00 100.0000 FORMAT "%8.4" EXTENDED_LIMITS -327.6800 327.6700 NUMBER 3 /end CHARACTERISTIC
/begin CHARACTERISTIC ETClb_vStartClb_CA "Minimale Fahrzeuggeschwindigkeit zum Starten der Ansteuerdauerkalibrierung bei jedem Raildruck-Kalibrierpunkt" VAL_BLK 0x1CF736 Kwb_Ws16 200.0000 Vel 0.00 200.0000 FORMAT "%8.4" EXTENDED_LIMITS -327.6800 327.6700 NUMBER 3 /end CHARACTERISTIC
/begin CHARACTERISTIC ETClb_vStopClb_CA "Minimale Fahrzeuggeschwindigkeit der Ansteuerdauerkalibrierung bei jedem Raildruck-Kalibrierpunkt" VAL_BLK 0x1CF73C Kwb_Ws16 200.0000 Vel 0.00 200.0000 FORMAT "%8.4" EXTENDED_LIMITS -327.6800 327.6700 NUMBER 3 /end CHARACTERISTIC
/begin CHARACTERISTIC FanCD_ctShutOffPeriods_C "Anzahl der Perioden für die Lüfterabschaltsequenz" VALUE 0x1CF798 Kw_Wu8 125.0 OneToOne 0.00 125.0 FORMAT "%5.1" EXTENDED_LIMITS 0.00 255.0 /end CHARACTERISTIC
/begin CHARACTERISTIC FanCD_tiDebFan1Ctlr1Def_C "Fehlerentprellzeiten für Lüftersteuergerät 1 Lüfter 1" VALUE 0x1CF79A Kw_Wu16 655350.0 Time_ms 0.00 655350.0 FORMAT "%8.1" /end CHARACTERISTIC
/begin CHARACTERISTIC FanCD_tiDebFan1Ctlr1Ok_C "Fehlerentprellzeiten für Lüftersteuergerät 1 Lüfter 1" VALUE 0x1CF79C Kw_Wu16 655350.0 Time_ms 0.00 655350.0 FORMAT "%8.1" /end CHARACTERISTIC
/begin CHARACTERISTIC FanCD_tiDebFan1Ctlr2Def_C "Fehlerentprellzeiten für Lüftersteuergerät 2 Lüfter 1" VALUE 0x1CF79E Kw_Wu16 655350.0 Time_ms 0.00 655350.0 FORMAT "%8.1" /end CHARACTERISTIC
/begin CHARACTERISTIC FanCD_tiDebFan1Ctlr2Ok_C "Fehlerentprellzeiten für Lüftersteuergerät 2 Lüfter 1" VALUE 0x1CF7A0 Kw_Wu16 655350.0 Time_ms 0.00 655350.0 FORMAT "%8.1" /end CHARACTERISTIC
/begin CHARACTERISTIC FanCD_tiDebFan2Ctlr1Def_C "Fehlerentprellzeiten für Lüftersteuergerät 1 Lüfter 2" VALUE 0x1CF7A2 Kw_Wu16 655350.0 Time_ms 0.00 655350.0 FORMAT "%8.1" /end CHARACTERISTIC
/begin CHARACTERISTIC FanCD_tiDebFan2Ctlr1Ok_C "Fehlerentprellzeiten für Lüftersteuergerät 1 Lüfter 2" VALUE 0x1CF7A4 Kw_Wu16 655350.0 Time_ms 0.00 655350.0 FORMAT "%8.1" /end CHARACTERISTIC
/begin CHARACTERISTIC FanCD_tiDebFan2Ctlr2Def_C "Fehlerentprellzeiten für Lüftersteuergerät 2 Lüfter 2" VALUE 0x1CF7A6 Kw_Wu16 655350.0 Time_ms 0.00 655350.0 FORMAT "%8.1" /end CHARACTERISTIC
/begin CHARACTERISTIC FanCD_tiDebFan2Ctlr2Ok_C " Fehlerentprellzeiten für Lüftersteuergerät 2 Lüfter 2" VALUE 0x1CF7A8 Kw_Wu16 655350.0 Time_ms 0.00 655350.0 FORMAT "%8.1" /end CHARACTERISTIC
/begin CHARACTERISTIC FanCD_tiDebFanCtlr1Def_C "Defektentprellzeit des Lüftersteuergerätes 1" VALUE 0x1CF7AA Kw_Wu16 655350.0 Time_ms 0.00 655350.0 FORMAT "%8.1" /end CHARACTERISTIC
/begin CHARACTERISTIC FanCD_tiDebFanCtlr1Ok_C "Heilungsentprellzeit des Lüftersteuergerätes 1" VALUE 0x1CF7AC Kw_Wu16 655350.0 Time_ms 0.00 655350.0 FORMAT "%8.1" /end CHARACTERISTIC
/begin CHARACTERISTIC FanCD_tiDebFanCtlr2Def_C "Defektentprellzeit des Lüftersteuergerätes 2" VALUE 0x1CF7AE Kw_Wu16 655350.0 Time_ms 0.00 655350.0 FORMAT "%8.1" /end CHARACTERISTIC
/begin CHARACTERISTIC FanCD_tiDebFanCtlr2Ok_C "Heilungsentprellzeit des Lüftersteuergerätes 2" VALUE 0x1CF7B0 Kw_Wu16 655350.0 Time_ms 0.00 655350.0 FORMAT "%8.1" /end CHARACTERISTIC
/begin CHARACTERISTIC FanCD_Fan1DebExcTempDef_C "Fehlerentprellzeit für Übertemperaturfehler Fan1" VALUE 0x1CF7B2 Kw_Wu16 655350.0 Time_ms 0.00 655350.0 FORMAT "%8.1" /end CHARACTERISTIC
/begin CHARACTERISTIC FanCD_Fan1DebExcTempOk_C "Heilungsentrpellzeit für Übertemperaturfehler von Fan1" VALUE 0x1CF7B4 Kw_Wu16 655350.0 Time_ms 0.00 655350.0 FORMAT "%8.1" /end CHARACTERISTIC
/begin CHARACTERISTIC FanCD_Fan1DebNoLoadDef_C "Fehlerentprellzeit für Leerlauf Fan1" VALUE 0x1CF7B6 Kw_Wu16 655350.0 Time_ms 0.00 655350.0 FORMAT "%8.1" /end CHARACTERISTIC
/begin CHARACTERISTIC FanCD_Fan1DebNoLoadOk_C "Heilungsentprellzeit für Leerlauf Fan1" VALUE 0x1CF7B8 Kw_Wu16 655350.0 Time_ms 0.00 655350.0 FORMAT "%8.1" /end CHARACTERISTIC
/begin CHARACTERISTIC FanCD_Fan1DebShortCircBatDef_C "Fehlerentprellzeit für Kurzschluß nach UBatt Fan1" VALUE 0x1CF7BA Kw_Wu16 655350.0 Time_ms 0.00 655350.0 FORMAT "%8.1" /end CHARACTERISTIC
/begin CHARACTERISTIC FanCD_Fan1DebShortCircBatOk_C "Heilungsentprellzeit für Kurzschluß nach UBatt Fan1" VALUE 0x1CF7BC Kw_Wu16 655350.0 Time_ms 0.00 655350.0 FORMAT "%8.1" /end CHARACTERISTIC
/begin CHARACTERISTIC FanCD_Fan1DebShortCircGndDef_C "Fehlerentprellzeit für Kurzschluß nach Masse Fan1" VALUE 0x1CF7BE Kw_Wu16 655350.0 Time_ms 0.00 655350.0 FORMAT "%8.1" /end CHARACTERISTIC
/begin CHARACTERISTIC FanCD_Fan1DebShortCircGndOk_C "Heilungsentprellzeit für Kurzschluß nach Masse Fan1" VALUE 0x1CF7C0 Kw_Wu16 655350.0 Time_ms 0.00 655350.0 FORMAT "%8.1" /end CHARACTERISTIC
/begin CHARACTERISTIC FanCD_Fan2DebExcTempDef_C "Fehlerentprellzeit für Übertemperatur Fan2" VALUE 0x1CF7C2 Kw_Wu16 655350.0 Time_ms 0.00 655350.0 FORMAT "%8.1" /end CHARACTERISTIC
/begin CHARACTERISTIC FanCD_Fan2DebExcTempOk_C "Heilungsentprellzeit für Übertemperatur Fan2" VALUE 0x1CF7C4 Kw_Wu16 655350.0 Time_ms 0.00 655350.0 FORMAT "%8.1" /end CHARACTERISTIC
/begin CHARACTERISTIC FanCD_Fan2DebNoLoadDef_C "Fehlerentprellzeit Leerlauf Fan2" VALUE 0x1CF7C6 Kw_Wu16 655350.0 Time_ms 0.00 655350.0 FORMAT "%8.1" /end CHARACTERISTIC
/begin CHARACTERISTIC FanCD_Fan2DebNoLoadOk_C "Heilungsentprellzeit Leerlauf Fan2" VALUE 0x1CF7C8 Kw_Wu16 655350.0 Time_ms 0.00 655350.0 FORMAT "%8.1" /end CHARACTERISTIC
/begin CHARACTERISTIC FanCD_Fan2DebShortCircBatDef_C "Fehlerentprellzeit für Kurzschluß nach UBatt Fan2" VALUE 0x1CF7CA Kw_Wu16 655350.0 Time_ms 0.00 655350.0 FORMAT "%8.1" /end CHARACTERISTIC
/begin CHARACTERISTIC FanCD_Fan2DebShortCircBatOk_C "Heilungsentprellzeit für Kurzschluß nach UBatt Fan2" VALUE 0x1CF7CC Kw_Wu16 655350.0 Time_ms 0.00 655350.0 FORMAT "%8.1" /end CHARACTERISTIC
/begin CHARACTERISTIC FanCD_Fan2DebShortCircGndDef_C "Fehlerentprellzeit für Kurzschluß nach Masse Fan2" VALUE 0x1CF7CE Kw_Wu16 655350.0 Time_ms 0.00 655350.0 FORMAT "%8.1" /end CHARACTERISTIC
/begin CHARACTERISTIC FanCD_Fan2DebShortCircGndOk_C "Heilungsentprellzeit für Kurzschluß nach Masse Fan2" VALUE 0x1CF7D0 Kw_Wu16 655350.0 Time_ms 0.00 655350.0 FORMAT "%8.1" /end CHARACTERISTIC
/begin CHARACTERISTIC FanCD_tiFanCtlr1Min_C "Minimum des ersten Signalfensters für Fehlersignale des Lüfter-SG" VALUE 0x1CF7D2 Kw_Wu16 655350.0 Time_ms 0.00 655350.0 FORMAT "%8.1" /end CHARACTERISTIC
/begin CHARACTERISTIC FanCD_tiFanCtlr1Max_C "Maximum des ersten Signalfensters für Fehlersignale des Lüfter-SG" VALUE 0x1CF7D4 Kw_Wu16 655350.0 Time_ms 0.00 655350.0 FORMAT "%8.1" /end CHARACTERISTIC
/begin CHARACTERISTIC FanCD_tiFanCtlr2Min_C "Minimum des zweiten Signalfensters für Fehlersignale des Lüfter-SG" VALUE 0x1CF7D6 Kw_Wu16 655350.0 Time_ms 0.00 655350.0 FORMAT "%8.1" /end CHARACTERISTIC
/begin CHARACTERISTIC FanCD_tiFanCtlr2Max_C "Maximum des zweiten Signalfensters für Fehlersignale des Lüfter-SG" VALUE 0x1CF7D8 Kw_Wu16 655350.0 Time_ms 0.00 655350.0 FORMAT "%8.1" /end CHARACTERISTIC
/begin CHARACTERISTIC FanCD_tiFanCtlr3Min_C "Minimum des dritten Signalfensters für Fehlersignale des Lüfter-SG" VALUE 0x1CF7DA Kw_Wu16 655350.0 Time_ms 0.00 655350.0 FORMAT "%8.1" /end CHARACTERISTIC
/begin CHARACTERISTIC FanCD_tiFanCtlr3Max_C "Maximum des dritten Signalfensters für Fehlersignale des Lüfter-SG" VALUE 0x1CF7DC Kw_Wu16 655350.0 Time_ms 0.00 655350.0 FORMAT "%8.1" /end CHARACTERISTIC
/begin CHARACTERISTIC FanCD_tiFanCtlr4Min_C "Signalfenstergröße für Fehlerart 4 eines Lüfter-SG" VALUE 0x1CF7DE Kw_Wu16 655350.0 Time_ms 0.00 655350.0 FORMAT "%8.1" /end CHARACTERISTIC
/begin CHARACTERISTIC FanCD_tiFanCtlr4Max_C "Signalfenstergröße für Fehlerart 4 eines Lüfter-SG" VALUE 0x1CF7E0 Kw_Wu16 655350.0 Time_ms 0.00 655350.0 FORMAT "%8.1" /end CHARACTERISTIC
/begin CHARACTERISTIC FanCD_tiFanCtlr5Min_C "Signalfenstergröße für Fehlerart 5 eines Lüfter-SG" VALUE 0x1CF7E2 Kw_Wu16 655350.0 Time_ms 0.00 655350.0 FORMAT "%8.1" /end CHARACTERISTIC
/begin CHARACTERISTIC FanCD_tiFanCtlr5Max_C "Signalfenstergröße für Fehlerart 5 eines Lüfter-SG" VALUE 0x1CF7E4 Kw_Wu16 655350.0 Time_ms 0.00 655350.0 FORMAT "%8.1" /end CHARACTERISTIC
/begin CHARACTERISTIC FanCD_tiFanCtlr6Min_C "Signalfenstergröße für Fehlerart 6 eines Lüfter-SG" VALUE 0x1CF7E6 Kw_Wu16 655350.0 Time_ms 0.00 655350.0 FORMAT "%8.1" /end CHARACTERISTIC
/begin CHARACTERISTIC FanCD_tiFanCtlr6Max_C "Signalfenstergröße für Fehlerart 6 eines Lüfter-SG" VALUE 0x1CF7E8 Kw_Wu16 655350.0 Time_ms 0.00 655350.0 FORMAT "%8.1" /end CHARACTERISTIC
/begin CHARACTERISTIC FanCD_tiFanCtlrErrIdlMin_C "Debounce Zeit für fan Controller Fan1" VALUE 0x1CF7EA Kw_Wu16 655350.0 Time_ms 0.00 655350.0 FORMAT "%8.1" /end CHARACTERISTIC
/begin CHARACTERISTIC FanCD_tiFanCtlrErrIdlMax_C "Debounce Zeit für Fan Controller Fan1" VALUE 0x1CF7EC Kw_Wu16 655350.0 Time_ms 0.00 655350.0 FORMAT "%8.1" /end CHARACTERISTIC
/begin CHARACTERISTIC FanCD_numErrThres_C "Die Anzahl, wie oft ein Fehler über LOW Pegel  mindestens gesendet werden muß, bevor ein entsprechender Fehler eingetragen wird." VALUE 0x1CF7EE Kw_Wu16 10.00000 OneToOne 0.00 10.00000 FORMAT "%8.5" EXTENDED_LIMITS 0.00 65535.00 /end CHARACTERISTIC
/begin CHARACTERISTIC FanCD_rFan1Tst_C "Testimpuls-TV bei Endstufenfehler Lüfter SG 1" VALUE 0x1CF7F0 Kw_Ws16 100.0000 DtyCyc 0.00 100.0000 FORMAT "%8.4" EXTENDED_LIMITS -327.6800 327.6700 /end CHARACTERISTIC
/begin CHARACTERISTIC FanCD_rFan2Tst_C "Testimpuls-TV bei Endstufenfehler Lüfter SG 2" VALUE 0x1CF7F2 Kw_Ws16 100.0000 DtyCyc 0.00 100.0000 FORMAT "%8.4" EXTENDED_LIMITS -327.6800 327.6700 /end CHARACTERISTIC
/begin CHARACTERISTIC FanCD_rShutOff_CA "Tastverhältnisse für Lüfterabschaltsequenz (high/low Phasen für die Abschaltsequenz)" VAL_BLK 0x1CF7F4 Kwb_Ws16 100.0000 DtyCyc 0.00 100.0000 FORMAT "%8.4" EXTENDED_LIMITS -327.6800 327.6700 NUMBER 2 /end CHARACTERISTIC
/begin CHARACTERISTIC FanCD_stStage1InvOut_C "Invertierung des Ausgangssignals" VALUE 0x1CF7F8 Kw_Wu8 1.000 OneToOne 0.00 1.000 FORMAT "%5.3" EXTENDED_LIMITS 0.00 255.0 /end CHARACTERISTIC
/begin CHARACTERISTIC FanCD_tiStage1Per_C "Periodenzeit der Ausgangsstufe 1" VALUE 0x1CF7FA Kw_Ws16 120.0000 Period 30.00000 150.0000 FORMAT "%8.4" EXTENDED_LIMITS -3276.800 3276.700 /end CHARACTERISTIC
/begin CHARACTERISTIC FanCD_stStage2InvOut_C "Invertierung des Ausgangssignals" VALUE 0x1CF7FC Kw_Wu8 1.000 OneToOne 0.00 1.000 FORMAT "%5.3" EXTENDED_LIMITS 0.00 255.0 /end CHARACTERISTIC
/begin CHARACTERISTIC FanCD_tiStage2Per_C "Periodenzeit der Ausgangsstufe 2" VALUE 0x1CF7FE Kw_Ws16 120.0000 Period 30.00000 150.0000 FORMAT "%8.4" EXTENDED_LIMITS -3276.800 3276.700 /end CHARACTERISTIC
/begin CHARACTERISTIC FanCD_swtFanShutOffVal_C "Schalterwerte zur Deaktivierung der Lüfterabschaltung bei Nicht- Öffnen  des Hauptrelais." VALUE 0x1CF800 Kw_Wu8 1.000 OneToOne 0.00 1.000 FORMAT "%5.3" EXTENDED_LIMITS 0.00 255.0 /end CHARACTERISTIC
/begin CHARACTERISTIC FanCD_swtFanShutOffType_C "Schaltertyp zur Deaktivierung der Lüfterabschaltung bei Nicht- Öffnen des Hauptrelais." VALUE 0x1CF801 Kw_Wu8 0.00 OneToOne 2.000 2.000 FORMAT "%5.3" EXTENDED_LIMITS 0.00 255.0 /end CHARACTERISTIC
/begin CHARACTERISTIC FanCD_tiFan1BtwTst_C "Zeit zwischen Endstufentests bei erkanntem Fehler" VALUE 0x1CF802 Kw_Wu16 29980.00 Time_ms 20.00000 30000.00 FORMAT "%8.2" EXTENDED_LIMITS 0.00 655350.0 /end CHARACTERISTIC
/begin CHARACTERISTIC FanCD_tiFan2BtwTst_C "Zeit zwischen Endstufentests bei erkanntem Fehler" VALUE 0x1CF804 Kw_Wu16 29980.00 Time_ms 20.00000 30000.00 FORMAT "%8.2" EXTENDED_LIMITS 0.00 655350.0 /end CHARACTERISTIC
/begin CHARACTERISTIC FanCD_tiFANcheckDfpTmr_C "Ansteuerdauer der Endstufe bei Abschaltung im Fehlerfall" VALUE 0x1CF806 Kw_Wu16 655350.0 Time_ms 0.00 655350.0 FORMAT "%8.1" /end CHARACTERISTIC
/begin CHARACTERISTIC FanCD_tiFanOFFTmr_C "Abschaltzeit der Endstufe im Fehlerfall" VALUE 0x1CF808 Kw_Wu16 655350.0 Time_ms 0.00 655350.0 FORMAT "%8.1" /end CHARACTERISTIC
/begin CHARACTERISTIC FanCD_tiShutOffBreak_C "Timeout für Lüfterabschaltsequenz - Normalbetrieb wird nach Ablauf dieser Zeit nach Beendigung der Abschaltsequenz aufgenommen" VALUE 0x1CF80A Kw_Wu16 900.0000 Time_ms 100.0000 1000.000 FORMAT "%8.3" EXTENDED_LIMITS 0.00 655350.0 /end CHARACTERISTIC
/begin CHARACTERISTIC FanCD_tiShutOffPeriod_C "Periodendauer der Lüfterabschaltsequenz" VALUE 0x1CF80C Kw_Wu16 200.0000 Time_ms 700.0000 900.0000 FORMAT "%8.4" EXTENDED_LIMITS 0.00 655350.0 /end CHARACTERISTIC
/begin CHARACTERISTIC FanCtl_dcycBSGmax_C "Ansteuerwertt bei BSG-Lüfteranforderung" VALUE 0x1CF810 Kw_Ws16 100.0000 DtyCyc 0.00 100.0000 FORMAT "%8.4" EXTENDED_LIMITS -327.6800 327.6700 /end CHARACTERISTIC
/begin CHARACTERISTIC FanCtl_dcycCtTThres1_C "Schwellwert 1 des Thermostat-TV" VALUE 0x1CF812 Kw_Ws16 100.0000 DtyCyc 0.00 100.0000 FORMAT "%8.4" EXTENDED_LIMITS -327.6800 327.6700 /end CHARACTERISTIC
/begin CHARACTERISTIC FanCtl_dcycCtTThres2_C "Schwellwert 2 des Thermostat-TV" VALUE 0x1CF814 Kw_Ws16 100.0000 DtyCyc 0.00 100.0000 FORMAT "%8.4" EXTENDED_LIMITS -327.6800 327.6700 /end CHARACTERISTIC
/begin CHARACTERISTIC FanCtl_dcycFan1HiLim_C "maximaler Ansteuerwert des Lüfters 1" VALUE 0x1CF816 Kw_Ws16 100.0000 DtyCyc 0.00 100.0000 FORMAT "%8.4" EXTENDED_LIMITS -327.6800 327.6700 /end CHARACTERISTIC
/begin CHARACTERISTIC FanCtl_dcycFan1LoLim_C "minimaler Ansteuerwert des Lüfters 1" VALUE 0x1CF818 Kw_Ws16 100.0000 DtyCyc 0.00 100.0000 FORMAT "%8.4" EXTENDED_LIMITS -327.6800 327.6700 /end CHARACTERISTIC
/begin CHARACTERISTIC FanCtl_dcycFan1Preset1_C "Vorgabewert von Dutycyle für Fan1 wenn Motor sich in Start Zustand befindet." VALUE 0x1CF81A Kw_Ws16 100.0000 DtyCyc 0.00 100.0000 FORMAT "%8.4" EXTENDED_LIMITS -327.6800 327.6700 /end CHARACTERISTIC
/begin CHARACTERISTIC FanCtl_dcycFan1Preset2_C "Vorgabewert von Dutycycle für Fan1 wenn Kühltemperatur den maximalen Wert übersteigt." VALUE 0x1CF81C Kw_Ws16 100.0000 DtyCyc 0.00 100.0000 FORMAT "%8.4" EXTENDED_LIMITS -327.6800 327.6700 /end CHARACTERISTIC
/begin CHARACTERISTIC FanCtl_dcycFan1Preset3_MAP "Berechnete dutycycle für fan1 wenn Fan Control sich im AFTERRUN Zustand befindet" MAP 0x1CF81E Kf_Xs16_Ys16_Ws16 100.0000 DtyCyc 0.00 100.0000 FORMAT "%8.4" EXTENDED_LIMITS -327.6800 327.6700
 /begin AXIS_DESCR STD_AXIS EATSCD_tAir Temp_Cels 5 -53.14000 176.8600 FORMAT "%8.4" EXTENDED_LIMITS -3549.940 3003.560 DEPOSIT ABSOLUTE /end AXIS_DESCR
 /begin AXIS_DESCR STD_AXIS CTSCD_tClnt Temp_Cels 5 -53.14000 176.8600 FORMAT "%8.4" EXTENDED_LIMITS -3549.940 3003.560 DEPOSIT ABSOLUTE /end AXIS_DESCR
/end CHARACTERISTIC
/begin CHARACTERISTIC FanCtl_dcycFan1ShutOff_C "Ansteuererersatzwert der Lüfteransteuerung 1 nach dem Lüfternachlauf" VALUE 0x1CF868 Kw_Ws16 100.0000 DtyCyc 0.00 100.0000 FORMAT "%8.4" EXTENDED_LIMITS -327.6800 327.6700 /end CHARACTERISTIC
/begin CHARACTERISTIC FanCtl_dcycFan1_CUR "Kennlinie: Ermittlung des Ansteuerwertes für Lüfter 1" CURVE 0x1CF86A Kl_Xs16_Ws16 100.0000 DtyCyc 0.00 100.0000 FORMAT "%8.4" EXTENDED_LIMITS -327.6800 327.6700
 /begin AXIS_DESCR STD_AXIS FanCtl_nFan1 EngN 8 0.00 32700.00 FORMAT "%8.2" EXTENDED_LIMITS -32768.00 32767.00 DEPOSIT ABSOLUTE /end AXIS_DESCR
/end CHARACTERISTIC
/begin CHARACTERISTIC FanCtl_dcycFan2HiLim_C "maximaler Ansteuerwert des Lüfters 2" VALUE 0x1CF88C Kw_Ws16 100.0000 DtyCyc 0.00 100.0000 FORMAT "%8.4" EXTENDED_LIMITS -327.6800 327.6700 /end CHARACTERISTIC
/begin CHARACTERISTIC FanCtl_dcycFan2LoLim_C "minimaler Ansteuerwert des Lüfters 2" VALUE 0x1CF88E Kw_Ws16 100.0000 DtyCyc 0.00 100.0000 FORMAT "%8.4" EXTENDED_LIMITS -327.6800 327.6700 /end CHARACTERISTIC
/begin CHARACTERISTIC FanCtl_dcycFan2Preset1_C "Vorgabewert Dutycycle von Fan2 wenn Motor sich in ""start"" Zustand befindet" VALUE 0x1CF890 Kw_Ws16 100.0000 DtyCyc 0.00 100.0000 FORMAT "%8.4" EXTENDED_LIMITS -327.6800 327.6700 /end CHARACTERISTIC
/begin CHARACTERISTIC FanCtl_dcycFan2Preset2_C "Vorgabewert von Dutycycle für fan 2 wenn Kühltemperatur den maximalen Wert überschreitet" VALUE 0x1CF892 Kw_Ws16 100.0000 DtyCyc 0.00 100.0000 FORMAT "%8.4" EXTENDED_LIMITS -327.6800 327.6700 /end CHARACTERISTIC
/begin CHARACTERISTIC FanCtl_dcycFan2Preset3_MAP "Tastverhältnis für Ansteuerung des Lüfter 2 im Zustand AFTERRUN" MAP 0x1CF894 Kf_Xs16_Ys16_Ws16 100.0000 DtyCyc 0.00 100.0000 FORMAT "%8.4" EXTENDED_LIMITS -327.6800 327.6700
 /begin AXIS_DESCR STD_AXIS EATSCD_tAir Temp_Cels 5 -53.14000 176.8600 FORMAT "%8.4" EXTENDED_LIMITS -3549.940 3003.560 DEPOSIT ABSOLUTE /end AXIS_DESCR
 /begin AXIS_DESCR STD_AXIS CTSCD_tClnt Temp_Cels 5 -53.14000 176.8600 FORMAT "%8.4" EXTENDED_LIMITS -3549.940 3003.560 DEPOSIT ABSOLUTE /end AXIS_DESCR
/end CHARACTERISTIC
/begin CHARACTERISTIC FanCtl_dcycFan2ShutOff_C "Vorgabewert für die Lüfteransteuerung 2 nach Lüfternachlauf" VALUE 0x1CF8DE Kw_Ws16 100.0000 DtyCyc 0.00 100.0000 FORMAT "%8.4" EXTENDED_LIMITS -327.6800 327.6700 /end CHARACTERISTIC
/begin CHARACTERISTIC FanCtl_dcycFan2_CUR "Kennlinie zur Berechnung des Tastverhältnisses für Lüfter 2" CURVE 0x1CF8E0 Kl_Xs16_Ws16 100.0000 DtyCyc 0.00 100.0000 FORMAT "%8.4" EXTENDED_LIMITS -327.6800 327.6700
 /begin AXIS_DESCR STD_AXIS FanCtl_nFan2 EngN 8 0.00 32700.00 FORMAT "%8.2" EXTENDED_LIMITS -32768.00 32767.00 DEPOSIT ABSOLUTE /end AXIS_DESCR
/end CHARACTERISTIC
/begin CHARACTERISTIC FanCtl_dcycRampBSGUp_C "Raufschaltrampe (BSG Anforderung)" VALUE 0x1CF904 Kw_Wu32 100.000000000 RmpDtyCyc 0.00 100.000000000 FORMAT "%13.9" EXTENDED_LIMITS 0.00 655359.999847 /end CHARACTERISTIC
/begin CHARACTERISTIC FanCtl_dcycRampBSGDown_C "Runterschaltrampe (BSG Anforderung)" VALUE 0x1CF908 Kw_Wu32 100.000000000 RmpDtyCyc 0.00 100.000000000 FORMAT "%13.9" EXTENDED_LIMITS 0.00 655359.999847 /end CHARACTERISTIC
/begin CHARACTERISTIC FanCtl_dtClntDesCorrDfl_C "Temperaturoffset-Wert" VALUE 0x1CF90C Kw_Ws16 400.0000 TempDiff_Kelv -200.0000 200.0000 FORMAT "%8.4" EXTENDED_LIMITS -3276.800 3276.700 /end CHARACTERISTIC
/begin CHARACTERISTIC FanCtl_dtClntDesCorr_MAP "Kennfeld: Korrekturwert der Solltemperatur" MAP 0x1CF90E Kf_Xs16_Ys16_Ws16 100.0000 Prc 0.00 100.0000 FORMAT "%8.4" EXTENDED_LIMITS -327.6800 327.6700
 /begin AXIS_DESCR STD_AXIS CtTCtl_dtClntDiff TempDiff_Kelv 5 -200.0000 200.0000 FORMAT "%8.4" EXTENDED_LIMITS -3276.800 3276.700 DEPOSIT ABSOLUTE /end AXIS_DESCR
 /begin AXIS_DESCR STD_AXIS FanCtl_dtClntDes_mp TempDiff_Kelv 5 -200.0000 200.0000 FORMAT "%8.4" EXTENDED_LIMITS -3276.800 3276.700 DEPOSIT ABSOLUTE /end AXIS_DESCR
/end CHARACTERISTIC
/begin CHARACTERISTIC FanCtl_dtClntDesDiff_MAP "Soll-Temperaturdifferenz des Kühlers" MAP 0x1CF958 Kf_Xs16_Ys16_Ws16 100.0000 Prc 0.00 100.0000 FORMAT "%8.4" EXTENDED_LIMITS -327.6800 327.6700
 /begin AXIS_DESCR STD_AXIS EATSCD_tAir Temp_Cels 8 -53.14000 176.8600 FORMAT "%8.4" EXTENDED_LIMITS -3549.940 3003.560 DEPOSIT ABSOLUTE /end AXIS_DESCR
 /begin AXIS_DESCR STD_AXIS CTSCD_tClntCan Temp_Cels 8 -53.14000 176.8600 FORMAT "%8.4" EXTENDED_LIMITS -3549.940 3003.560 DEPOSIT ABSOLUTE /end AXIS_DESCR
/end CHARACTERISTIC
/begin CHARACTERISTIC FanCtl_dtCtTClntDiffThres1_C "Schwellwert 1 der Temperaturabweichung zwischen Kühlmitteltemperatur am Zylinderkopfaustritt und aktueller" VALUE 0x1CF9FC Kw_Ws16 400.0000 TempDiff_Kelv -200.0000 200.0000 FORMAT "%8.4" EXTENDED_LIMITS -3276.800 3276.700 /end CHARACTERISTIC
/begin CHARACTERISTIC FanCtl_dtCtTClntDiffThres2_C "Schwellwert 2 der Temperaturabweichung zwischen Soll-Kühlmitteltemperatur am Zylinderkopfaustritt und aktueller" VALUE 0x1CF9FE Kw_Ws16 400.0000 TempDiff_Kelv -200.0000 200.0000 FORMAT "%8.4" EXTENDED_LIMITS -3276.800 3276.700 /end CHARACTERISTIC
/begin CHARACTERISTIC FanCtl_factACReqCorr_CUR "Kennlinie: Geschwindigkeitskorrektur der Klimalast" CURVE 0x1CFA00 Kl_Xs16_Ws16 1.000000 Fact 0.00 1.000000 FORMAT "%8.6" EXTENDED_LIMITS -4.000000 3.999878
 /begin AXIS_DESCR STD_AXIS VSSCD_v Vel 6 0.00 300.0000 FORMAT "%8.4" EXTENDED_LIMITS -327.6800 327.6700 DEPOSIT ABSOLUTE /end AXIS_DESCR
/end CHARACTERISTIC
/begin CHARACTERISTIC FanCtl_factApReqCorr_CUR "Korrekturkennlinie der Atmosphärendruckleistungsanforderung" CURVE 0x1CFA1A Kl_Xs16_Ws16 1.000000 Fact 0.00 1.000000 FORMAT "%8.6" EXTENDED_LIMITS -4.000000 3.999878
 /begin AXIS_DESCR STD_AXIS FanCtl_vCurr2_mp Vel 6 0.00 300.0000 FORMAT "%8.4" EXTENDED_LIMITS -327.6800 327.6700 DEPOSIT ABSOLUTE /end AXIS_DESCR
/end CHARACTERISTIC
/begin CHARACTERISTIC FanCtl_factApReq_MAP "Kühlleistung durch Anfahren in der Höhe" MAP 0x1CFA34 Kf_Xs16_Ys16_Ws16 1.000000 Fact 0.00 1.000000 FORMAT "%8.6" EXTENDED_LIMITS -4.000000 3.999878
 /begin AXIS_DESCR STD_AXIS IATSCD_tAir Temp_Cels 6 -53.14000 226.8600 FORMAT "%8.4" EXTENDED_LIMITS -3549.940 3003.560 DEPOSIT ABSOLUTE /end AXIS_DESCR
 /begin AXIS_DESCR STD_AXIS APSCD_pVal Pres_hPa 6 0.00 2000.000 FORMAT "%8.3" EXTENDED_LIMITS -32768.00 32767.00 DEPOSIT ABSOLUTE /end AXIS_DESCR
/end CHARACTERISTIC
/begin CHARACTERISTIC FanCtl_factARBaseCor_CUR "Korrekturkurve der Nachlaufzeit" CURVE 0x1CFA98 Kl_Xs16_Ws16 1.000000 Fact 0.00 1.000000 FORMAT "%8.6" EXTENDED_LIMITS -4.000000 3.999878
 /begin AXIS_DESCR STD_AXIS EATSCD_tAir Temp_Cels 4 -53.14000 99.86000 FORMAT "%8.5" EXTENDED_LIMITS -3549.940 3003.560 DEPOSIT ABSOLUTE /end AXIS_DESCR
/end CHARACTERISTIC
/begin CHARACTERISTIC FanCtl_factBattCorr1_CUR "Kennlinie für Batteriekorrektur Lüfter 1" CURVE 0x1CFAAA Kl_Xs16_Ws16 1.600098 Fact 0.1999512 1.800049 FORMAT "%8.6" EXTENDED_LIMITS -4.000000 3.999878
 /begin AXIS_DESCR STD_AXIS BattCD_u Volt_Batt 4 0.00 20010.04 FORMAT "%8.2" EXTENDED_LIMITS -665674.1 665653.8 DEPOSIT ABSOLUTE /end AXIS_DESCR
/end CHARACTERISTIC
/begin CHARACTERISTIC FanCtl_factBattCorr2_CUR "Kennlinie für Batteriekorrektur Lüfter 2" CURVE 0x1CFABC Kl_Xs16_Ws16 1.600098 Fact 0.1999512 1.800049 FORMAT "%8.6" EXTENDED_LIMITS -4.000000 3.999878
 /begin AXIS_DESCR STD_AXIS BattCD_u Volt_Batt 4 0.00 20010.04 FORMAT "%8.2" EXTENDED_LIMITS -665674.1 665653.8 DEPOSIT ABSOLUTE /end AXIS_DESCR
/end CHARACTERISTIC
/begin CHARACTERISTIC FanCtl_factCorr_CUR "Korrekturfaktor des Temperaturdifferenzsollwertes des Kühlers" CURVE 0x1CFACE Kl_Xs16_Ws16 3.250000 Fact 0.00 3.250000 FORMAT "%8.6" EXTENDED_LIMITS -4.000000 3.999878
 /begin AXIS_DESCR STD_AXIS Eng_nAvrg EngN 8 0.00 6500.000 FORMAT "%8.3" EXTENDED_LIMITS -32768.00 32767.00 DEPOSIT ABSOLUTE /end AXIS_DESCR
/end CHARACTERISTIC
/begin CHARACTERISTIC FanCtl_nFan1Base_MAP "Kennfeld: Ermittlung der Basisdrehzahl des Lüfters 1" MAP 0x1CFAF0 Kf_Xs16_Ys16_Ws16 32700.00 EngN 0.00 32700.00 FORMAT "%8.2" EXTENDED_LIMITS -32768.00 32767.00
 /begin AXIS_DESCR STD_AXIS Eng_nAvrg EngN 8 0.00 6500.000 FORMAT "%8.3" EXTENDED_LIMITS -32768.00 32767.00 DEPOSIT ABSOLUTE /end AXIS_DESCR
 /begin AXIS_DESCR STD_AXIS FanCtl_prcRampFan1_mp Prc 8 0.00 100.0000 FORMAT "%8.4" EXTENDED_LIMITS -327.6800 327.6700 DEPOSIT ABSOLUTE /end AXIS_DESCR
/end CHARACTERISTIC
/begin CHARACTERISTIC FanCtl_nFan1MinThres1_C "Untere Schwelle des 1. ausgeblendeten Drehzahlbereichs für Lüfter 1" VALUE 0x1CFB94 Kw_Ws16 32000.00 EngN 0.00 32000.00 FORMAT "%8.2" EXTENDED_LIMITS -32768.00 32767.00 /end CHARACTERISTIC
/begin CHARACTERISTIC FanCtl_nFan1MaxThres1_C "Obere Schwelle des 1. ausgeblendeten Drehzahlbereichs für Lüfter 1" VALUE 0x1CFB96 Kw_Ws16 32000.00 EngN 0.00 32000.00 FORMAT "%8.2" EXTENDED_LIMITS -32768.00 32767.00 /end CHARACTERISTIC
/begin CHARACTERISTIC FanCtl_nFan1MinThres2_C "Untere Schwelle des 2. ausgeblendeten Drehzahlbereichs für Lüfter 1" VALUE 0x1CFB98 Kw_Ws16 32000.00 EngN 0.00 32000.00 FORMAT "%8.2" EXTENDED_LIMITS -32768.00 32767.00 /end CHARACTERISTIC
/begin CHARACTERISTIC FanCtl_nFan1MaxThres2_C "Obere Schwelle des 2. ausgeblendeten Drehzahlbereichs für Lüfter 1" VALUE 0x1CFB9A Kw_Ws16 32000.00 EngN 0.00 32000.00 FORMAT "%8.2" EXTENDED_LIMITS -32768.00 32767.00 /end CHARACTERISTIC
/begin CHARACTERISTIC FanCtl_nFan1MinThres3_C "Untere Schwelle des 3. ausgeblendeten Drehzahlbereichs für Lüfter 1" VALUE 0x1CFB9C Kw_Ws16 32000.00 EngN 0.00 32000.00 FORMAT "%8.2" EXTENDED_LIMITS -32768.00 32767.00 /end CHARACTERISTIC
/begin CHARACTERISTIC FanCtl_nFan1MaxThres3_C "Obere Schwelle des 3. ausgeblendeten Drehzahlbereichs für Lüfter 1" VALUE 0x1CFB9E Kw_Ws16 32000.00 EngN 0.00 32000.00 FORMAT "%8.2" EXTENDED_LIMITS -32768.00 32767.00 /end CHARACTERISTIC
/begin CHARACTERISTIC FanCtl_nFan1MinThres4_C "Untere Schwelle des 4. ausgeblendeten Drehzahlbereichs für Lüfter 1" VALUE 0x1CFBA0 Kw_Ws16 32000.00 EngN 0.00 32000.00 FORMAT "%8.2" EXTENDED_LIMITS -32768.00 32767.00 /end CHARACTERISTIC
/begin CHARACTERISTIC FanCtl_nFan1MaxThres4_C "Obere Schwelle des 4. ausgeblendeten Drehzahlbereichs für Lüfter 1" VALUE 0x1CFBA2 Kw_Ws16 32000.00 EngN 0.00 32000.00 FORMAT "%8.2" EXTENDED_LIMITS -32768.00 32767.00 /end CHARACTERISTIC
/begin CHARACTERISTIC FanCtl_nFan1MinThres5_C "Untere Schwelle des 5. ausgeblendeten Drehzahlbereichs für Lüfter 1" VALUE 0x1CFBA4 Kw_Ws16 32000.00 EngN 0.00 32000.00 FORMAT "%8.2" EXTENDED_LIMITS -32768.00 32767.00 /end CHARACTERISTIC
/begin CHARACTERISTIC FanCtl_nFan1MaxThres5_C "Obere Schwelle des 5. ausgeblendeten Drehzahlbereichs für Lüfter 1" VALUE 0x1CFBA6 Kw_Ws16 32000.00 EngN 0.00 32000.00 FORMAT "%8.2" EXTENDED_LIMITS -32768.00 32767.00 /end CHARACTERISTIC
/begin CHARACTERISTIC FanCtl_nFan1XLow_C "unterer Hysteresenwert für die Ausblendbedingungen des Lüfters 1" VALUE 0x1CFBA8 Kw_Ws16 6000.000 EngN 0.00 6000.000 FORMAT "%8.3" EXTENDED_LIMITS -32768.00 32767.00 /end CHARACTERISTIC
/begin CHARACTERISTIC FanCtl_nFan1XHigh_C "oberer Hysteresenwert für die Ausblendbedingungen des Lüfters 1" VALUE 0x1CFBAA Kw_Ws16 6000.000 EngN 0.00 6000.000 FORMAT "%8.3" EXTENDED_LIMITS -32768.00 32767.00 /end CHARACTERISTIC
/begin CHARACTERISTIC FanCtl_stFan1YLow_C "Hysteresewert wenn der Hystereseingang für Lüfter 1 unter der unteren Schwelle ist" VALUE 0x1CFBAC Kw_Ws16 0.00 OneToOne 0.00 0.00 FORMAT "%8.2" EXTENDED_LIMITS -32768.00 32767.00 READ_ONLY /end CHARACTERISTIC
/begin CHARACTERISTIC FanCtl_stFan1YHigh_C "Hysteresewert wenn der Hystereseingang für Lüfter 1 über der oberen Schwelle ist" VALUE 0x1CFBAE Kw_Ws16 0.00 OneToOne 1.000000 1.000000 FORMAT "%8.6" EXTENDED_LIMITS -32768.00 32767.00 READ_ONLY /end CHARACTERISTIC
/begin CHARACTERISTIC FanCtl_nFan1Min_C "Minimaldrehzahlvorgabewert für die Ausblendbedingungen des Lüfters 1" VALUE 0x1CFBB0 Kw_Ws16 6000.000 EngN 0.00 6000.000 FORMAT "%8.3" EXTENDED_LIMITS -32768.00 32767.00 /end CHARACTERISTIC
/begin CHARACTERISTIC FanCtl_nFan2Base_MAP "Kennfeld: Ermittlung der Basisdrehzahl des Lüfters 2" MAP 0x1CFBB2 Kf_Xs16_Ys16_Ws16 32700.00 EngN 0.00 32700.00 FORMAT "%8.2" EXTENDED_LIMITS -32768.00 32767.00
 /begin AXIS_DESCR STD_AXIS Eng_nAvrg EngN 8 0.00 6500.000 FORMAT "%8.3" EXTENDED_LIMITS -32768.00 32767.00 DEPOSIT ABSOLUTE /end AXIS_DESCR
 /begin AXIS_DESCR STD_AXIS FanCtl_prcRampFan2_mp Prc 8 0.00 100.0000 FORMAT "%8.4" EXTENDED_LIMITS -327.6800 327.6700 DEPOSIT ABSOLUTE /end AXIS_DESCR
/end CHARACTERISTIC
/begin CHARACTERISTIC FanCtl_nFan2MinThres1_C "Untere Schwelle des 1. ausgeblendeten Drehzahlbereichs für Lüfter 2" VALUE 0x1CFC56 Kw_Ws16 32000.00 EngN 0.00 32000.00 FORMAT "%8.2" EXTENDED_LIMITS -32768.00 32767.00 /end CHARACTERISTIC
/begin CHARACTERISTIC FanCtl_nFan2MaxThres1_C "Obere Schwelle des 1. ausgeblendeten Drehzahlbereichs für Lüfter 2" VALUE 0x1CFC58 Kw_Ws16 32000.00 EngN 0.00 32000.00 FORMAT "%8.2" EXTENDED_LIMITS -32768.00 32767.00 /end CHARACTERISTIC
/begin CHARACTERISTIC FanCtl_nFan2MinThres2_C "Untere Schwelle des 2. ausgeblendeten Drehzahlbereichs für Lüfter 2" VALUE 0x1CFC5A Kw_Ws16 32000.00 EngN 0.00 32000.00 FORMAT "%8.2" EXTENDED_LIMITS -32768.00 32767.00 /end CHARACTERISTIC
/begin CHARACTERISTIC FanCtl_nFan2MaxThres2_C "Obere Schwelle des 2. ausgeblendeten Drehzahlbereichs für Lüfter 2" VALUE 0x1CFC5C Kw_Ws16 32000.00 EngN 0.00 32000.00 FORMAT "%8.2" EXTENDED_LIMITS -32768.00 32767.00 /end CHARACTERISTIC
/begin CHARACTERISTIC FanCtl_nFan2MinThres3_C "Untere Schwelle des 3. ausgeblendeten Drehzahlbereichs für Lüfter 2" VALUE 0x1CFC5E Kw_Ws16 32000.00 EngN 0.00 32000.00 FORMAT "%8.2" EXTENDED_LIMITS -32768.00 32767.00 /end CHARACTERISTIC
/begin CHARACTERISTIC FanCtl_nFan2MaxThres3_C "Obere Schwelle des 3. ausgeblendeten Drehzahlbereichs für Lüfter 2" VALUE 0x1CFC60 Kw_Ws16 32000.00 EngN 0.00 32000.00 FORMAT "%8.2" EXTENDED_LIMITS -32768.00 32767.00 /end CHARACTERISTIC
/begin CHARACTERISTIC FanCtl_nFan2MinThres4_C "Untere Schwelle des 4. ausgeblendeten Drehzahlbereichs für Lüfter 2" VALUE 0x1CFC62 Kw_Ws16 32000.00 EngN 0.00 32000.00 FORMAT "%8.2" EXTENDED_LIMITS -32768.00 32767.00 /end CHARACTERISTIC
/begin CHARACTERISTIC FanCtl_nFan2MaxThres4_C "Obere Schwelle des 4. ausgeblendeten Drehzahlbereichs für Lüfter 2" VALUE 0x1CFC64 Kw_Ws16 32000.00 EngN 0.00 32000.00 FORMAT "%8.2" EXTENDED_LIMITS -32768.00 32767.00 /end CHARACTERISTIC
/begin CHARACTERISTIC FanCtl_nFan2MinThres5_C "Untere Schwelle des 5. ausgeblendeten Drehzahlbereichs für Lüfter 2" VALUE 0x1CFC66 Kw_Ws16 32000.00 EngN 0.00 32000.00 FORMAT "%8.2" EXTENDED_LIMITS -32768.00 32767.00 /end CHARACTERISTIC
/begin CHARACTERISTIC FanCtl_nFan2MaxThres5_C "Obere Schwelle des 5. ausgeblendeten Drehzahlbereichs für Lüfter 2" VALUE 0x1CFC68 Kw_Ws16 32000.00 EngN 0.00 32000.00 FORMAT "%8.2" EXTENDED_LIMITS -32768.00 32767.00 /end CHARACTERISTIC
/begin CHARACTERISTIC FanCtl_nFan2XLow_C "unterer Hysteresenwert für die Ausblendbedingungen des Lüfters 2" VALUE 0x1CFC6A Kw_Ws16 6000.000 EngN 0.00 6000.000 FORMAT "%8.3" EXTENDED_LIMITS -32768.00 32767.00 /end CHARACTERISTIC
/begin CHARACTERISTIC FanCtl_nFan2XHigh_C "oberer Hysteresenwert für die Ausblendbedingungen des Lüfters 2" VALUE 0x1CFC6C Kw_Ws16 6000.000 EngN 0.00 6000.000 FORMAT "%8.3" EXTENDED_LIMITS -32768.00 32767.00 /end CHARACTERISTIC
/begin CHARACTERISTIC FanCtl_stFan2YLow_C "Hysteresewert wenn der Hystereseingang Lüfter 1unter der unteren Schwelle ist" VALUE 0x1CFC6E Kw_Ws16 0.00 OneToOne 0.00 0.00 FORMAT "%8.2" EXTENDED_LIMITS -32768.00 32767.00 READ_ONLY /end CHARACTERISTIC
/begin CHARACTERISTIC FanCtl_stFan2YHigh_C "Hysteresewert wenn der Hystereseingang für Lüfter 2 über der oberen Schwelle ist" VALUE 0x1CFC70 Kw_Ws16 0.00 OneToOne 1.000000 1.000000 FORMAT "%8.6" EXTENDED_LIMITS -32768.00 32767.00 READ_ONLY /end CHARACTERISTIC
/begin CHARACTERISTIC FanCtl_nFan2Min_C "Minimaldrehzahlvorgabewert für die Ausblendbedingungen des Lüfters 2" VALUE 0x1CFC72 Kw_Ws16 6000.000 EngN 0.00 6000.000 FORMAT "%8.3" EXTENDED_LIMITS -32768.00 32767.00 /end CHARACTERISTIC
/begin CHARACTERISTIC FanCtl_pACCDDfl_C "Vorgabewert Klimakompressordruck bei defektem Sensor" VALUE 0x1CFC74 Kw_Ws16 60000.00 PresAC_hPa 0.00 60000.00 FORMAT "%8.2" EXTENDED_LIMITS -65536.00 65534.00 /end CHARACTERISTIC
/begin CHARACTERISTIC FanCtl_pAcHigh_C "oberer Schwellwert des Klimadruckes" VALUE 0x1CFC76 Kw_Ws16 60000.00 PresAC_hPa 0.00 60000.00 FORMAT "%8.2" EXTENDED_LIMITS -65536.00 65534.00 /end CHARACTERISTIC
/begin CHARACTERISTIC FanCtl_pAcLow_C "unterer Schwellwert des Klimadruckes" VALUE 0x1CFC78 Kw_Ws16 60000.00 PresAC_hPa 0.00 60000.00 FORMAT "%8.2" EXTENDED_LIMITS -65536.00 65534.00 /end CHARACTERISTIC
/begin CHARACTERISTIC FanCtl_RglIKi_C "Ki für Eingangssignale innerhalb des Fensters" VALUE 0x1CFC7C Kw_Wu32 1.99999194592 Ki_Temp2Prc 0.00 1.99999194592 FORMAT "%13.11" EXTENDED_LIMITS 0.00 99999.9999767 /end CHARACTERISTIC
/begin CHARACTERISTIC FanCtl_RglIKiPos_C "Ki für Eingangssignaländerungen über die positive Fenstergrenze" VALUE 0x1CFC80 Kw_Wu32 1.99999194592 Ki_Temp2Prc 0.00 1.99999194592 FORMAT "%13.11" EXTENDED_LIMITS 0.00 99999.9999767 /end CHARACTERISTIC
/begin CHARACTERISTIC FanCtl_RglIKiNeg_C "Ki für Eingangssignaländerungen über die negative Fenstergrenze" VALUE 0x1CFC84 Kw_Wu32 1.99999194592 Ki_Temp2Prc 0.00 1.99999194592 FORMAT "%13.11" EXTENDED_LIMITS 0.00 99999.9999767 /end CHARACTERISTIC
/begin CHARACTERISTIC FanCtl_RglIWinPos_C "Positive Fenstergrenze des I-Gliedes" VALUE 0x1CFC88 Kw_Ws16 400.0000 TempDiff_Kelv -200.0000 200.0000 FORMAT "%8.4" EXTENDED_LIMITS -3276.800 3276.700 /end CHARACTERISTIC
/begin CHARACTERISTIC FanCtl_RglIWinNeg_C "Negative Fenstergrenze des I-Gliedes" VALUE 0x1CFC8A Kw_Ws16 400.0000 TempDiff_Kelv -200.0000 200.0000 FORMAT "%8.4" EXTENDED_LIMITS -3276.800 3276.700 /end CHARACTERISTIC
/begin CHARACTERISTIC FanCtl_tiPT1Neg_C "Zeitkonstante für negative Eingangswertänderung" VALUE 0x1CFC8C Kw_Wu32 4294.9673 TimeDelay_s 0.0000010000000 4294.9673 FORMAT "%9.4" /end CHARACTERISTIC
/begin CHARACTERISTIC FanCtl_tiPT1Pos_C "Zeitkonstante für positive Eingangswertänderung" VALUE 0x1CFC90 Kw_Wu32 4294.9673 TimeDelay_s 0.0000010000000 4294.9673 FORMAT "%9.4" /end CHARACTERISTIC
/begin CHARACTERISTIC FanCtl_dprcRampFan1Up_C "positive Rampensteigung der Kühlleistung des Lüfters 1" VALUE 0x1CFC94 Kw_Wu32 5000.00000000 RmpPrc 0.00 5000.00000000 FORMAT "%13.8" EXTENDED_LIMITS 0.00 655359.999847 /end CHARACTERISTIC
/begin CHARACTERISTIC FanCtl_dprcRampFan1Down_C "negative Rampensteigung der Kühlleistung des Lüfters 1" VALUE 0x1CFC98 Kw_Wu32 5000.00000000 RmpPrc 0.00 5000.00000000 FORMAT "%13.8" EXTENDED_LIMITS 0.00 655359.999847 /end CHARACTERISTIC
/begin CHARACTERISTIC FanCtl_dprcRampFan2Up_C "positive Rampensteigung der Kühlleistung des Lüfters 2" VALUE 0x1CFC9C Kw_Wu32 5000.00000000 RmpPrc 0.00 5000.00000000 FORMAT "%13.8" EXTENDED_LIMITS 0.00 655359.999847 /end CHARACTERISTIC
/begin CHARACTERISTIC FanCtl_dprcRampFan2Down_C "negative Rampensteigung der Kühlleistung des Lüfters 2" VALUE 0x1CFCA0 Kw_Wu32 5000.00000000 RmpPrc 0.00 5000.00000000 FORMAT "%13.8" EXTENDED_LIMITS 0.00 655359.999847 /end CHARACTERISTIC
/begin CHARACTERISTIC FanCtl_prcARTime_C "Zeitpunkt der 2. Nachlaufzeitberechnung in Prozent der 1. Nachlaufzeit" VALUE 0x1CFCA4 Kw_Ws16 100.0000 Prc 0.00 100.0000 FORMAT "%8.4" EXTENDED_LIMITS -327.6800 327.6700 /end CHARACTERISTIC
/begin CHARACTERISTIC FanCtl_prcCanReq_CUR "Kennlinie zur Ermittlung des Ansteursignals aus der CAN-Anforderung" CURVE 0x1CFCA6 Kl_Xs16_Ws16 100.0000 Prc 0.00 100.0000 FORMAT "%8.4" EXTENDED_LIMITS -327.6800 327.6700
 /begin AXIS_DESCR STD_AXIS FanCtl_prcFan_mp Prc 5 0.00 100.0000 FORMAT "%8.4" EXTENDED_LIMITS -327.6800 327.6700 DEPOSIT ABSOLUTE /end AXIS_DESCR
/end CHARACTERISTIC
/begin CHARACTERISTIC FanCtl_prcClntInc_CUR "Zusatzkühlung für Angeforderte Motortemperatur von CAN" CURVE 0x1CFCBC Kl_Xs16_Ws16 100.0000 Prc 0.00 100.0000 FORMAT "%8.4" EXTENDED_LIMITS -327.6800 327.6700
 /begin AXIS_DESCR STD_AXIS FrmMng_stClgGearbx OneToOne 4 0.00 3.000 FORMAT "%5.3" EXTENDED_LIMITS 0.00 255.0 DEPOSIT ABSOLUTE /end AXIS_DESCR
/end CHARACTERISTIC
/begin CHARACTERISTIC FanCtl_prcCnv_MAP "Umwandlung in Prozent relative Kühlleistung für das Lüfter-SG" MAP 0x1CFCCE Kf_Xs16_Ys16_Ws16 100.0000 Prc 0.00 100.0000 FORMAT "%8.4" EXTENDED_LIMITS -327.6800 327.6700
 /begin AXIS_DESCR STD_AXIS FanCtl_dcycFan2 DtyCyc 6 0.00 100.0000 FORMAT "%8.4" EXTENDED_LIMITS -327.6800 327.6700 DEPOSIT ABSOLUTE /end AXIS_DESCR
 /begin AXIS_DESCR STD_AXIS FanCtl_dcycFan1 DtyCyc 6 0.00 100.0000 FORMAT "%8.4" EXTENDED_LIMITS -327.6800 327.6700 DEPOSIT ABSOLUTE /end AXIS_DESCR
/end CHARACTERISTIC
/begin CHARACTERISTIC FanCtl_prcCtl_MAP "Kennfeld: Ermittlung des Steuerwertes des zusätzlichen Kühlbedarfs" MAP 0x1CFD32 Kf_Xs16_Ys16_Ws16 100.0000 Prc 0.00 100.0000 FORMAT "%8.4" EXTENDED_LIMITS -327.6800 327.6700
 /begin AXIS_DESCR STD_AXIS FanCtl_vCurr_mp Vel 8 0.00 300.0000 FORMAT "%8.4" EXTENDED_LIMITS -327.6800 327.6700 DEPOSIT ABSOLUTE /end AXIS_DESCR
 /begin AXIS_DESCR STD_AXIS FanCtl_prcRelClntDes2_mp Prc 8 0.00 100.0000 FORMAT "%8.4" EXTENDED_LIMITS -327.6800 327.6700 DEPOSIT ABSOLUTE /end AXIS_DESCR
/end CHARACTERISTIC
/begin CHARACTERISTIC FanCtl_prcFanDfl_C "Ersatzwert fuer FrmMng_prcFan" VALUE 0x1CFDD6 Kw_Ws16 100.0000 Prc 0.00 100.0000 FORMAT "%8.4" EXTENDED_LIMITS -327.6800 327.6700 /end CHARACTERISTIC
/begin CHARACTERISTIC FanCtl_prcHiLimI_C "Maximumbegrenzung des I-Reglers für die Ermittlung des zusätzlichen Kühlbedarfs" VALUE 0x1CFDD8 Kw_Ws16 20000.00 Prc -10000.00 10000.00 FORMAT "%8.2" EXTENDED_LIMITS -327.6800 327.6700 /end CHARACTERISTIC
/begin CHARACTERISTIC FanCtl_prcLoLimI_C "Minimumbegrenzung des I-Reglers für die Ermittlung des zusätzlichen Kühlbedarfs" VALUE 0x1CFDDA Kw_Ws16 20000.00 Prc -10000.00 10000.00 FORMAT "%8.2" EXTENDED_LIMITS -327.6800 327.6700 /end CHARACTERISTIC
/begin CHARACTERISTIC FanCtl_prcHiLim_C "Obere Begrenzung des zusätzlichen Kühlbedarfs" VALUE 0x1CFDDC Kw_Ws16 100.0000 Prc 0.00 100.0000 FORMAT "%8.4" EXTENDED_LIMITS -327.6800 327.6700 /end CHARACTERISTIC
/begin CHARACTERISTIC FanCtl_prcLoLim_C "Untere Begrenzung des zusätzlichen Kühlbedarfs" VALUE 0x1CFDDE Kw_Ws16 100.0000 Prc 0.00 100.0000 FORMAT "%8.4" EXTENDED_LIMITS -327.6800 327.6700 /end CHARACTERISTIC
/begin CHARACTERISTIC FanCtl_prcQKakt_MAP "Kennfeld: Ermittlung der Klimalast bei aktivem Kompressor" MAP 0x1CFDE0 Kf_Xs16_Ys16_Ws16 100.0000 Prc 0.00 100.0000 FORMAT "%8.4" EXTENDED_LIMITS -327.6800 327.6700
 /begin AXIS_DESCR STD_AXIS FanCtl_pAc_mp PresAC_hPa 5 0.00 60000.00 FORMAT "%8.2" EXTENDED_LIMITS -65536.00 65534.00 DEPOSIT ABSOLUTE /end AXIS_DESCR
 /begin AXIS_DESCR STD_AXIS EATSCD_tAir Temp_Cels 4 -53.14000 176.8600 FORMAT "%8.4" EXTENDED_LIMITS -3549.940 3003.560 DEPOSIT ABSOLUTE /end AXIS_DESCR
/end CHARACTERISTIC
/begin CHARACTERISTIC FanCtl_prcQKdeakt_CUR "Kennlinie: Ermittlung der Klimalast bei inaktivem Kompressor" CURVE 0x1CFE1E Kl_Xs16_Ws16 100.0000 Prc 0.00 100.0000 FORMAT "%8.4" EXTENDED_LIMITS -327.6800 327.6700
 /begin AXIS_DESCR STD_AXIS FanCtl_pAc_mp PresAC_hPa 6 0.00 60000.00 FORMAT "%8.2" EXTENDED_LIMITS -65536.00 65534.00 DEPOSIT ABSOLUTE /end AXIS_DESCR
/end CHARACTERISTIC
/begin CHARACTERISTIC FanCtl_prcRelClntDesPreset_C "Vorgabewert für den relativen dynamischen Kühlbedarf" VALUE 0x1CFE38 Kw_Ws16 100.0000 Prc 0.00 100.0000 FORMAT "%8.4" EXTENDED_LIMITS -327.6800 327.6700 /end CHARACTERISTIC
/begin CHARACTERISTIC FanCtl_stFanVar_C "bitcodierter Schalter für Lüftervariante" VALUE 0x1CFE3A Kw_Wu8 7.000 OneToOne 0.00 7.000 FORMAT "%5.3" EXTENDED_LIMITS 0.00 255.0 /end CHARACTERISTIC
/begin CHARACTERISTIC FanCtl_swtClgModVarVal_C "Schalterzustand des Kühlleistungsvariantenschalters" VALUE 0x1CFE3B Kw_Wu8 1.000 OneToOne 0.00 1.000 FORMAT "%5.3" EXTENDED_LIMITS 0.00 255.0 READ_ONLY /end CHARACTERISTIC
/begin CHARACTERISTIC FanCtl_swtClgModVarType_C "Schaltertype des Kühlleistungsvariantenschalters" VALUE 0x1CFE3C Kw_Wu8 0.00 OneToOne 0.00 0.00 FORMAT "%5.2" EXTENDED_LIMITS 0.00 255.0 READ_ONLY /end CHARACTERISTIC
/begin CHARACTERISTIC FanCtl_tARThres_CUR "Abschalttemperaturschwelle während der 2. Nachlaufphase" CURVE 0x1CFE3E Kl_Xs16_Ws16 200.0000 Temp_Cels -50.14000 149.8600 FORMAT "%8.4" EXTENDED_LIMITS -3549.940 3003.560
 /begin AXIS_DESCR STD_AXIS CTSCD_tClnt Temp_Cels 4 -50.14000 149.8600 FORMAT "%8.4" EXTENDED_LIMITS -3549.940 3003.560 DEPOSIT ABSOLUTE /end AXIS_DESCR
/end CHARACTERISTIC
/begin CHARACTERISTIC FanCtl_tClntCrit_MAP "Berechnung der kitischen Kühlmitteltemperatur" MAP 0x1CFE50 Kf_Xs16_Ys16_Ws16 280.0000 Temp_Cels -53.14000 226.8600 FORMAT "%8.4" EXTENDED_LIMITS -3549.940 3003.560
 /begin AXIS_DESCR STD_AXIS CTSCD_tClntCan Temp_Cels 5 -53.14000 176.8600 FORMAT "%8.4" EXTENDED_LIMITS -3549.940 3003.560 DEPOSIT ABSOLUTE /end AXIS_DESCR
 /begin AXIS_DESCR STD_AXIS CoEng_dvolFlConsumFlt FlConsum_l_h 5 0.00 150.0000 FORMAT "%8.4" EXTENDED_LIMITS -327.6800 327.6700 DEPOSIT ABSOLUTE /end AXIS_DESCR
/end CHARACTERISTIC
/begin CHARACTERISTIC FanCtl_tClntDesPreset_C "Ersatzwert für Kühlmitteltemperatur" VALUE 0x1CFE9A Kw_Ws16 280.0000 Temp_Cels -53.14000 226.8600 FORMAT "%8.4" EXTENDED_LIMITS -3549.940 3003.560 /end CHARACTERISTIC
/begin CHARACTERISTIC FanCtl_tClntDesRaw_MAP "Drehzahl- und Einspritzmengeabhängen/Moment Berechnung des Kühlmitteltemperaturrohwertes" MAP 0x1CFE9C Kf_Xs16_Ys16_Ws16 280.0000 Temp_Cels -53.14000 226.8600 FORMAT "%8.4" EXTENDED_LIMITS -3549.940 3003.560
 /begin AXIS_DESCR STD_AXIS Eng_nAvrg EngN 8 0.00 6000.000 FORMAT "%8.3" EXTENDED_LIMITS -32768.00 32767.00 DEPOSIT ABSOLUTE /end AXIS_DESCR
 /begin AXIS_DESCR STD_AXIS CoEng_trqInrSet Trq 8 0.00 600.0000 FORMAT "%8.4" EXTENDED_LIMITS -3276.800 3276.700 DEPOSIT ABSOLUTE /end AXIS_DESCR
/end CHARACTERISTIC
/begin CHARACTERISTIC FanCtl_tClntDes_MAP "Temperatursollwert am Kühleraustritt" MAP 0x1CFF40 Kf_Xs16_Ys16_Ws16 280.0000 Temp_Cels -53.14000 226.8600 FORMAT "%8.4" EXTENDED_LIMITS -3549.940 3003.560
 /begin AXIS_DESCR STD_AXIS FanCtl_tClntDesFlt_mp Temp_Cels 8 -53.14000 226.8600 FORMAT "%8.4" EXTENDED_LIMITS -3549.940 3003.560 DEPOSIT ABSOLUTE /end AXIS_DESCR
 /begin AXIS_DESCR STD_AXIS FanCtl_tCTSCurr_mp Temp_Cels 8 -53.14000 226.8600 FORMAT "%8.4" EXTENDED_LIMITS -3549.940 3003.560 DEPOSIT ABSOLUTE /end AXIS_DESCR
/end CHARACTERISTIC
/begin CHARACTERISTIC FanCtl_dtCOTSCritXLow_C "untere Temperaturdifferenzschwelle der Hysterese" VALUE 0x1CFFE4 Kw_Ws16 400.0000 TempDiff_Kelv -200.0000 200.0000 FORMAT "%8.4" EXTENDED_LIMITS -3276.800 3276.700 /end CHARACTERISTIC
/begin CHARACTERISTIC FanCtl_dtCOTSCritXHi_C "Obere Temperaturdifferenzschwelle der Hysterese" VALUE 0x1CFFE6 Kw_Ws16 400.0000 TempDiff_Kelv -200.0000 200.0000 FORMAT "%8.4" EXTENDED_LIMITS -3276.800 3276.700 /end CHARACTERISTIC
/begin CHARACTERISTIC FanCtl_stCOTSCritYLow_C "untere Schwelle der kritischen Temperatur" VALUE 0x1CFFE8 Kw_Ws16 0.00 OneToOne 0.00 0.00 FORMAT "%8.2" EXTENDED_LIMITS -32768.00 32767.00 READ_ONLY /end CHARACTERISTIC
/begin CHARACTERISTIC FanCtl_stCOTSCritYHi_C "obere Schwelle der kritischen Temperatur" VALUE 0x1CFFEA Kw_Ws16 0.00 OneToOne 1.000000 1.000000 FORMAT "%8.6" EXTENDED_LIMITS -32768.00 32767.00 READ_ONLY /end CHARACTERISTIC
/begin CHARACTERISTIC FanCtl_tCOTSCrit_C "Offsetwert der kritischen Temperatur am Kühleraustritt" VALUE 0x1CFFEC Kw_Ws16 280.0000 Temp_Cels -53.14000 226.8600 FORMAT "%8.4" EXTENDED_LIMITS -3549.940 3003.560 /end CHARACTERISTIC
/begin CHARACTERISTIC FanCtl_tCOTSPreset_C "Vorgabewert der Kühlmitteltemperatur am Kühleraustritt bei Sensorfehlern" VALUE 0x1CFFEE Kw_Ws16 280.0000 Temp_Cels -53.14000 226.8600 FORMAT "%8.4" EXTENDED_LIMITS -3549.940 3003.560 /end CHARACTERISTIC
/begin CHARACTERISTIC FanCtl_tCTSCritXLow_C "untere Hystereseschwelle der kritischen Kühlmitteltemperatur" VALUE 0x1CFFF0 Kw_Ws16 230.0000 Temp_Cels -53.14000 176.8600 FORMAT "%8.4" EXTENDED_LIMITS -3549.940 3003.560 /end CHARACTERISTIC
/begin CHARACTERISTIC FanCtl_tCTSCritXHi_C "obere Hystereseschwelle der kritischen Kühlmitteltemperatur" VALUE 0x1CFFF2 Kw_Ws16 230.0000 Temp_Cels -53.14000 176.8600 FORMAT "%8.4" EXTENDED_LIMITS -3549.940 3003.560 /end CHARACTERISTIC
/begin CHARACTERISTIC FanCtl_stCTSCritYLow_C "unterer Ausgang der temperaturkritischen Hysterese" VALUE 0x1CFFF4 Kw_Ws16 0.00 OneToOne 0.00 0.00 FORMAT "%8.2" EXTENDED_LIMITS -32768.00 32767.00 READ_ONLY /end CHARACTERISTIC
/begin CHARACTERISTIC FanCtl_stCTSCritYHi_C "oberer Ausgang der temperaturkritischen Hysterese" VALUE 0x1CFFF6 Kw_Ws16 0.00 OneToOne 1.000000 1.000000 FORMAT "%8.6" EXTENDED_LIMITS -32768.00 32767.00 READ_ONLY /end CHARACTERISTIC
/begin CHARACTERISTIC FanCtl_tiAfterrunFan1_C "Abschaltrampendauer des Lüfters 1" VALUE 0x1CFFF8 Kw_Wu32 1000000.00000 Time_ms 0.00 1000000.00000 FORMAT "%13.5" EXTENDED_LIMITS 0.00 42949672950.0 /end CHARACTERISTIC
/begin CHARACTERISTIC FanCtl_tiAfterrunFan2_C "Abschaltrampendauer des Lüfters 2" VALUE 0x1CFFFC Kw_Wu32 1000000.00000 Time_ms 0.00 1000000.00000 FORMAT "%13.5" EXTENDED_LIMITS 0.00 42949672950.0 /end CHARACTERISTIC
/begin CHARACTERISTIC FanCtl_tiARBase_MAP "Lüfternachlaufdauer-Grundkennfeld" MAP 0x1D0000 Kf_Xs16_Ys16_Ws16 3200.000 TimeRed 0.00 3200.000 FORMAT "%8.3" EXTENDED_LIMITS -5242.880 5242.720
 /begin AXIS_DESCR STD_AXIS CTSCD_tClnt Temp_Cels 14 -53.14000 176.8600 FORMAT "%8.4" EXTENDED_LIMITS -3549.940 3003.560 DEPOSIT ABSOLUTE /end AXIS_DESCR
 /begin AXIS_DESCR STD_AXIS FanCtl_dvolFlConsumFltHold_mp FlConsum_l_h 8 0.00 150.0000 FORMAT "%8.4" EXTENDED_LIMITS -327.6800 327.6700 DEPOSIT ABSOLUTE /end AXIS_DESCR
/end CHARACTERISTIC
/begin CHARACTERISTIC FanCtl_tiARCor1_MAP "2. Lüfternachlaufdauerkennfeld für die 1. Phase" MAP 0x1D0110 Kf_Xs16_Ys16_Ws16 3200.000 TimeRed 0.00 3200.000 FORMAT "%8.3" EXTENDED_LIMITS -5242.880 5242.720
 /begin AXIS_DESCR STD_AXIS CTSCD_tClnt Temp_Cels 8 -53.14000 176.8600 FORMAT "%8.4" EXTENDED_LIMITS -3549.940 3003.560 DEPOSIT ABSOLUTE /end AXIS_DESCR
 /begin AXIS_DESCR STD_AXIS EATSCD_tAir Temp_Cels 8 -53.14000 99.86000 FORMAT "%8.5" EXTENDED_LIMITS -3549.940 3003.560 DEPOSIT ABSOLUTE /end AXIS_DESCR
/end CHARACTERISTIC
/begin CHARACTERISTIC FanCtl_tiARCor2_MAP "Lüfternachlaufdauer-Kennfeld für 2. Phase" MAP 0x1D01B4 Kf_Xs16_Ys16_Ws16 3200.000 TimeRed 0.00 3200.000 FORMAT "%8.3" EXTENDED_LIMITS -5242.880 5242.720
 /begin AXIS_DESCR STD_AXIS CTSCD_tClnt Temp_Cels 8 -53.14000 226.8600 FORMAT "%8.4" EXTENDED_LIMITS -3549.940 3003.560 DEPOSIT ABSOLUTE /end AXIS_DESCR
 /begin AXIS_DESCR STD_AXIS EATSCD_tAir Temp_Cels 8 -53.14000 99.86000 FORMAT "%8.5" EXTENDED_LIMITS -3549.940 3003.560 DEPOSIT ABSOLUTE /end AXIS_DESCR
/end CHARACTERISTIC
/begin CHARACTERISTIC FanCtl_tiARmax_C "maximale Lüfternachlaufdauer" VALUE 0x1D0258 Kw_Wu32 1000000.00000 Time_ms 0.00 1000000.00000 FORMAT "%13.5" EXTENDED_LIMITS 0.00 42949672950.0 /end CHARACTERISTIC
/begin CHARACTERISTIC FanCtl_tiARmin_C "minimale Lüfternachlaufdauer" VALUE 0x1D025C Kw_Wu32 1000000.00000 Time_ms 0.00 1000000.00000 FORMAT "%13.5" EXTENDED_LIMITS 0.00 42949672950.0 /end CHARACTERISTIC
/begin CHARACTERISTIC FanCtl_tiAROilCorDfl_C "Ersatzwert wenn keine Serviceintervallberechnung aktiviert ist" VALUE 0x1D0260 Kw_Ws16 3200.000 TimeRed 0.00 3200.000 FORMAT "%8.3" EXTENDED_LIMITS -5242.880 5242.720 /end CHARACTERISTIC
/begin CHARACTERISTIC FanCtl_tiAROilCor_CUR "3. Lüfternachlaufzeit der 1. Phase" CURVE 0x1D0262 Kl_Xs16_Ws16 3200.000 TimeRed 0.00 3200.000 FORMAT "%8.3" EXTENDED_LIMITS -5242.880 5242.720
 /begin AXIS_DESCR STD_AXIS OTSCD_tEngOil Temp_Cels 8 -53.14000 226.8600 FORMAT "%8.4" EXTENDED_LIMITS -3549.940 3003.560 DEPOSIT ABSOLUTE /end AXIS_DESCR
/end CHARACTERISTIC
/begin CHARACTERISTIC FanCtl_tiARShutOffFan1_C "Abschaltrampendauer des Lüfters 1" VALUE 0x1D0284 Kw_Wu32 1000000.00000 Time_ms 0.00 1000000.00000 FORMAT "%13.5" EXTENDED_LIMITS 0.00 42949672950.0 /end CHARACTERISTIC
/begin CHARACTERISTIC FanCtl_tiARShutOffFan2_C "Abschaltrampendauer des Lüfters 2" VALUE 0x1D0288 Kw_Wu32 1000000.00000 Time_ms 0.00 1000000.00000 FORMAT "%13.5" EXTENDED_LIMITS 0.00 42949672950.0 /end CHARACTERISTIC
/begin CHARACTERISTIC FanCtl_tiClntDesCorrDly1_C "Verzögerung für zusätzliche Korrektur der Kühlmittelsolltemperatur" VALUE 0x1D028C Kw_Wu16 655140.0 Time_ms 0.00 655140.0 FORMAT "%8.1" EXTENDED_LIMITS 0.00 655350.0 /end CHARACTERISTIC
/begin CHARACTERISTIC FanCtl_tiClntDesCorrDly2_C "Verzögerung der Korrekturrücknahme der Kühlmittelsolltemperatur" VALUE 0x1D028E Kw_Wu16 655140.0 Time_ms 0.00 655140.0 FORMAT "%8.1" EXTENDED_LIMITS 0.00 655350.0 /end CHARACTERISTIC
/begin CHARACTERISTIC FanCtl_tiStartDly_C "Dauer der Lüfterabschaltung während des Startvorganges" VALUE 0x1D0290 Kw_Wu32 1000000.00000 Time_ms 0.00 1000000.00000 FORMAT "%13.5" EXTENDED_LIMITS 0.00 42949672950.0 /end CHARACTERISTIC
/begin CHARACTERISTIC FanCtl_vPreset2_C "zweiter Ersatzwert im Fehlerfall von VSS" VALUE 0x1D0294 Kw_Ws16 300.0000 Vel 0.00 300.0000 FORMAT "%8.4" EXTENDED_LIMITS -327.6800 327.6700 /end CHARACTERISTIC
/begin CHARACTERISTIC FanCtl_vPreset_C "Ersatzwert im Fehlerfall von VSS" VALUE 0x1D0296 Kw_Ws16 300.0000 Vel 0.00 300.0000 FORMAT "%8.4" EXTENDED_LIMITS -327.6800 327.6700 /end CHARACTERISTIC
/begin MEASUREMENT EGSys_AlpEGTube_mp "Wärmeübertragungskoeffizient zwischen Abgas und Abgasrohr" SWORD ThermalCoEff 1 100 -3276.800 3276.700 FORMAT "%8.3" ARRAY_SIZE 2 ECU_ADDRESS 0x802AAC /end MEASUREMENT
/begin MEASUREMENT EGSys_AlpTubeEnv_mp "Wärmeübertragungskoeffizient zwischen Abgasrohr und Umgebung" SWORD ThermalCoEff 1 100 -3276.800 3276.700 FORMAT "%8.3" ARRAY_SIZE 2 ECU_ADDRESS 0x802AB0 /end MEASUREMENT
/begin MEASUREMENT EGSys_cndHtEGi_mp "Wärmeleitfähigkeit Abgas im Rohr" SWORD Fact 1 100 -4.000000 3.999878 FORMAT "%8.6" ARRAY_SIZE 2 ECU_ADDRESS 0x802AB4 /end MEASUREMENT
/begin MEASUREMENT EGSys_cndHtEGo_mp "Wärmeleitfähigkeit Luft ausserhalb des Rohres" SWORD Fact 1 100 -4.000000 3.999878 FORMAT "%8.6" ARRAY_SIZE 2 ECU_ADDRESS 0x802AB8 /end MEASUREMENT
/begin MEASUREMENT EGSys_cpEGTrbn_mp "Spezifische Wärmekapazität Abgas in Turbine" SWORD SpecificHeat 1 100 -3.276800 3.276700 FORMAT "%8.6" ECU_ADDRESS 0x802AA0 /end MEASUREMENT
/begin MEASUREMENT EGSys_cpEGTube_mp "Spezifsche Wärmekapazität Abgas im Abgasrohr" SWORD SpecificHeat 1 100 -3.276800 3.276700 FORMAT "%8.6" ARRAY_SIZE 2 ECU_ADDRESS 0x802ABC /end MEASUREMENT
/begin MEASUREMENT EGSys_dtTube_mp "Temperaturänderung Abgasrohr" SWORD Temp_Kelv_Sec 1 100 -327.6800 327.6700 FORMAT "%8.4" ARRAY_SIZE 2 ECU_ADDRESS 0x802AC0 /end MEASUREMENT
/begin MEASUREMENT EGSys_dwTubeIn_mp "Eintretender Wärmestrom Abgasrohr" SLONG Pwr1 1 100 -214748364.800 214748364.700 FORMAT "%13.3" ARRAY_SIZE 2 ECU_ADDRESS 0x802AC4 /end MEASUREMENT
/begin MEASUREMENT EGSys_dwTubeOut_mp "Austretender Wärmestrom Abgasrohr" SLONG Pwr1 1 100 -214748364.800 214748364.700 FORMAT "%13.3" ARRAY_SIZE 2 ECU_ADDRESS 0x802ACC /end MEASUREMENT
/begin MEASUREMENT EGSys_dwTube_mp "Wärmeänderung Abgasrohr" SLONG Pwr1 1 100 -214748364.800 214748364.700 FORMAT "%13.3" ARRAY_SIZE 2 ECU_ADDRESS 0x802AD4 /end MEASUREMENT
/begin MEASUREMENT EGSys_etaChrg_mp "Gesamtwirkungsgrad Turbolader" SWORD Fact 1 100 -4.000000 3.999878 FORMAT "%8.6" ECU_ADDRESS 0x802AA2 /end MEASUREMENT
/begin MEASUREMENT EGSys_facPT1Chrg_mp "Variabler Faktor für thermische Zeitkonstante Lader" SWORD Fact_PT1 1 100 -256.0000 255.9922 FORMAT "%8.4" ECU_ADDRESS 0x802AA4 /end MEASUREMENT
/begin MEASUREMENT EGSys_NuTubeEnv_mp "Nusselt-Zahl Aussenumströmung Abgasrohr" SWORD OneToOne 1 100 -32768.00 32767.00 FORMAT "%8.2" ARRAY_SIZE 2 ECU_ADDRESS 0x802ADC /end MEASUREMENT
/begin MEASUREMENT EGSys_NuTube_mp "Nusselt-Zahl im Abgasrohr" SWORD OneToOne 1 100 -32768.00 32767.00 FORMAT "%8.2" ARRAY_SIZE 2 ECU_ADDRESS 0x802AE0 /end MEASUREMENT
/begin MEASUREMENT EGSys_pwrCmpr_mp "Verdichterleistung" SWORD Pwr 1 100 -308831.1 308821.7 FORMAT "%8.1" ECU_ADDRESS 0x802AA6 /end MEASUREMENT
/begin MEASUREMENT EGSys_ReTubeEnvInpCrv_mp "Messpunkt Eingangswert Kurve EGSys_NuTubeEnv_CUR" SWORD OneToOne 1 100 -32768.00 32767.00 FORMAT "%8.2" ECU_ADDRESS 0x802AE4 /end MEASUREMENT
/begin MEASUREMENT EGSys_ReTubeEnv_mp "Reynolds-Zahl Aussenumströmung Abgasrohr" SWORD OneToOne 1 100 -32768.00 32767.00 FORMAT "%8.2" ARRAY_SIZE 2 ECU_ADDRESS 0x802AE6 /end MEASUREMENT
/begin MEASUREMENT EGSys_ReTubeInpCrv_mp "Messpunkt Eingang Kurve EGSys_NuTube_CUR" SWORD ReynoldsNum 1 100 -3276800. 3276700. FORMAT "%8.0" ECU_ADDRESS 0x802AEA /end MEASUREMENT
/begin MEASUREMENT EGSys_ReTube_mp "Reynolds-Zahl im Abgasrohr" SWORD ReynoldsNum 1 100 -3276800. 3276700. FORMAT "%8.0" ARRAY_SIZE 2 ECU_ADDRESS 0x802AEC /end MEASUREMENT
/begin MEASUREMENT EGSys_rPresCmpr_mp "Verdichterdruckverhältnis" SWORD Fact 1 100 -4.000000 3.999878 FORMAT "%8.6" ECU_ADDRESS 0x802AA8 /end MEASUREMENT
/begin MEASUREMENT EGSys_sqTube_mp "Oberfläche Abgasrohr" SWORD Area 1 100 -4.000000 3.999878 FORMAT "%8.6" ARRAY_SIZE 2 ECU_ADDRESS 0x802AF0 /end MEASUREMENT
/begin MEASUREMENT EGSys_tAvrgEGTrbn_mp "Mittlere Abgastemperatur in Turbine" SWORD Temp_Cels 1 100 -3549.940 3003.560 FORMAT "%8.3" ECU_ADDRESS 0x802AAA /end MEASUREMENT
/begin MEASUREMENT EGSys_tAvrgEGTube_mp "Mittlere Abgastemperatur im Abgasrohr" SWORD Temp_Cels 1 100 -3549.940 3003.560 FORMAT "%8.3" ARRAY_SIZE 2 ECU_ADDRESS 0x802AF4 /end MEASUREMENT
/begin MEASUREMENT EGSys_tDiffEGTube_mp "Temperaturdifferenz Abgas / Abgasrohr" SWORD TempDiff_Kelv 1 100 -3276.800 3276.700 FORMAT "%8.3" ARRAY_SIZE 2 ECU_ADDRESS 0x802AF8 /end MEASUREMENT
/begin MEASUREMENT EGSys_tDiffTubeEnv_mp "Temperaturdifferenz Abgasrohr / Umgebung" SWORD TempDiff_Kelv 1 100 -3276.800 3276.700 FORMAT "%8.3" ARRAY_SIZE 2 ECU_ADDRESS 0x802AFC /end MEASUREMENT
/begin MEASUREMENT EGSys_tEGPstTube "Abgastemperatur am Abgasrohr-Auslass" SWORD Temp_Cels 1 100 -3549.940 3003.560 FORMAT "%8.3" ARRAY_SIZE 2 ECU_ADDRESS 0x7F9C88 /end MEASUREMENT
/begin MEASUREMENT EGSys_tMidEGTube_mp "Mittlere Temperatur zwischen Abgas und Abgasrohrwand" SWORD Temp_Cels 1 100 -3549.940 3003.560 FORMAT "%8.3" ARRAY_SIZE 2 ECU_ADDRESS 0x802B00 /end MEASUREMENT
/begin MEASUREMENT EGSys_tMidTubeEnv_mp "Mittlere Temperatur zwischen Abgasrohr und Umgebung" SWORD Temp_Cels 1 100 -3549.940 3003.560 FORMAT "%8.3" ARRAY_SIZE 2 ECU_ADDRESS 0x802B04 /end MEASUREMENT
/begin MEASUREMENT EGSys_tTube "Wandtemperatur Abgasrohr" SWORD Temp_Cels 1 100 -3549.940 3003.560 FORMAT "%8.3" ARRAY_SIZE 2 ECU_ADDRESS 0x7F9C8C /end MEASUREMENT
/begin MEASUREMENT EGT_st "Regenerationsanforderung für Abgasnachbehandlung (drehzahlsynchron)" ULONG OneToOne 1 100 0.00 4294967295.00 FORMAT "%13.2" ECU_ADDRESS 0x7F9C94 /end MEASUREMENT
/begin MEASUREMENT EGT_stByp_mp "Meßpunkt für Bypass" ULONG OneToOne 1 100 0.00 4294967295.00 FORMAT "%13.2" ECU_ADDRESS 0x802B08 /end MEASUREMENT
/begin MEASUREMENT EGT_stCoRgn "Innerer Zustand des Regenerationskoordinator (drehzahlsynchron)" UBYTE OneToOne 1 100 0.00 255.0 FORMAT "%5.1" ECU_ADDRESS 0x7F93A8 /end MEASUREMENT
/begin MEASUREMENT EGT_stIntOld_mp "Letzte interne Regenerationsanforderung nach Priorisierung" ULONG OneToOne 1 100 0.00 4294967295.00 FORMAT "%13.2" ECU_ADDRESS 0x802B0C /end MEASUREMENT
/begin MEASUREMENT EGT_stInt_mp "Interne Regenerationsanforderung nach Priorisierung" ULONG OneToOne 1 100 0.00 4294967295.00 FORMAT "%13.2" ECU_ADDRESS 0x802B10 /end MEASUREMENT
/begin MEASUREMENT EGT_stSubCoRgn_mp "Interner Zustand des Zustandsautomaten" UBYTE OneToOne 1 100 0.00 255.0 FORMAT "%5.1" ECU_ADDRESS 0x802B14 /end MEASUREMENT
/begin MEASUREMENT EGT_stTmp_mp "Temporäre Regenerationsanforderung nach Einfügung des Zustands ""adsorbe""" ULONG OneToOne 1 100 0.00 4294967295.00 FORMAT "%13.2" ECU_ADDRESS 0x802B18 /end MEASUREMENT
/begin MEASUREMENT EGT_stTSync "Regenerationsanforderung für Abgasnachbehandlung (zeitsynchron)" ULONG OneToOne 1 100 0.00 4294967295.00 FORMAT "%13.2" ECU_ADDRESS 0x7F9C9C /end MEASUREMENT
/begin MEASUREMENT EGT_stTSyncByp_mp "Meßpunkt für Bypass Freischnitt" ULONG OneToOne 1 100 0.00 4294967295.00 FORMAT "%13.2" ECU_ADDRESS 0x802B1C /end MEASUREMENT
/begin MEASUREMENT EGT_swtEGTActv "Message zur Deaktivierung der gesamten Funktionalität der Abgasnachbehandlung" UBYTE OneToOne 1 100 0.00 255.0 FORMAT "%5.1" ECU_ADDRESS 0x7F93A9 /end MEASUREMENT
/begin MEASUREMENT EGT_tiRgn "Zeit seit letzter Änderung von EGT_st (drehzahlsynchron)" ULONG Time_s 1 100 0.00 42949672.9500 FORMAT "%13.4" ECU_ADDRESS 0x7F9CA0 /end MEASUREMENT
/begin MEASUREMENT EGT_tiRgnTSync "Zeit seit letzter Änderung von EGT_st (zeitsynchron)" ULONG Time_s 1 100 0.00 42949672.9500 FORMAT "%13.4" ECU_ADDRESS 0x7F9CA4 /end MEASUREMENT
/begin MEASUREMENT EMCCD_stEngMntCtl1_mp "Status Motorlagersteuerung Ausgang 1" UBYTE OneToOne 1 100 0.00 255.0 FORMAT "%5.1" ECU_ADDRESS 0x802B20 /end MEASUREMENT
/begin MEASUREMENT EMCCD_stOutHWEG2_mp "Hardwareansteuerung Getriebelagersteuerung2" UBYTE OneToOne 1 100 0.00 255.0 FORMAT "%5.1" ECU_ADDRESS 0x802B21 /end MEASUREMENT
/begin MEASUREMENT EMCCD_stOutHWEM1_mp "Hardwareansteuerung Motorlagersteuerung1" UBYTE OneToOne 1 100 0.00 255.0 FORMAT "%5.1" ECU_ADDRESS 0x802B22 /end MEASUREMENT
/begin MEASUREMENT EngMon_rO2Thres_mp "Ausgangsgröße des Schwellwertfilters der Funktion Verbrennungserkennung" SWORD O2 1 100 -0.3276800 0.3276700 FORMAT "%9.7" ECU_ADDRESS 0x802B5E /end MEASUREMENT
/begin MEASUREMENT EngMon_stMon_mp "Zustand der Überwachung auf irreguläre Verbrennung (1=aktiv, 0=nicht aktiv)" UBYTE OneToOne 1 100 0.00 255.0 FORMAT "%5.1" ECU_ADDRESS 0x802B60 /end MEASUREMENT
/begin MEASUREMENT EngMon_stShOffIrrCmb "Abschaltbotschaft an Abschaltkoordinator auf Grund irregulärer Verbrennung" UBYTE OneToOne 1 100 0.00 255.0 FORMAT "%5.1" ECU_ADDRESS 0x7F93C2 /end MEASUREMENT
/begin MEASUREMENT EngMon_stTstRslt_mp "Testergebnis der Überwachung auf irreguläre Verbrennung" UBYTE OneToOne 1 100 0.00 255.0 FORMAT "%5.1" ECU_ADDRESS 0x802B61 /end MEASUREMENT
/begin MEASUREMENT EngM_ctIncErrSigDiagCaSDef_mp "Inkrementezaehlerstand zur Erkennung gestörtes Nockenwellensignal" UWORD OneToOne 1 100 0.00 65535.00 FORMAT "%8.2" ECU_ADDRESS 0x802B3C /end MEASUREMENT
/begin MEASUREMENT EngM_ctIncErrSigDiagCaSOk_mp "Inkrementezaehlerstand zur Erkennung gestörtes Nockenwellensignal geheilt" UWORD OneToOne 1 100 0.00 65535.00 FORMAT "%8.2" ECU_ADDRESS 0x802B3E /end MEASUREMENT
/begin MEASUREMENT EngM_ctIncErrSigDiagCrSDef_mp "Inkrementezaehlerstand zur Erkennung eines gestörten Kurbelwellensignal" UWORD OneToOne 1 100 0.00 65535.00 FORMAT "%8.2" ECU_ADDRESS 0x802B40 /end MEASUREMENT
/begin MEASUREMENT EngM_ctIncErrSigDiagCrSOK_mp "Inkrementezaehlerstand zur Erkennung Kurbelwellensignal ohne Störungen" UWORD OneToOne 1 100 0.00 65535.00 FORMAT "%8.2" ECU_ADDRESS 0x802B42 /end MEASUREMENT
/begin MEASUREMENT EngM_ctIncErrSigDiagmaxCaSDef_mp "maximaler Inkrementezaehlerstand bei Erkennung gestörtes Nockenwellensignal" UWORD OneToOne 1 100 0.00 65535.00 FORMAT "%8.2" ECU_ADDRESS 0x802B44 /end MEASUREMENT
/begin MEASUREMENT EngM_ctIncErrSigDiagmaxCaSOk_mp "maximaler Inkrementezaehlerstand bei Erkennung gestörtes Nockenwellensignal geheilt" UWORD OneToOne 1 100 0.00 65535.00 FORMAT "%8.2" ECU_ADDRESS 0x802B46 /end MEASUREMENT
/begin MEASUREMENT EngM_ctIncErrSigDiagmaxCrSDef_mp "maximeler Inkrementezaehlerstand bei Erkennung gestörtes Kurbelwellensignal" UWORD OneToOne 1 100 0.00 65535.00 FORMAT "%8.2" ECU_ADDRESS 0x802B48 /end MEASUREMENT
/begin MEASUREMENT EngM_ctIncNoSigDiagCaS_mp "Inkrementezaehlerstand zur Erkennung ausgefallenes Nockenwellensignal" UWORD OneToOne 1 100 0.00 65535.00 FORMAT "%8.2" ECU_ADDRESS 0x802B4A /end MEASUREMENT
/begin MEASUREMENT EngM_ctIncNoSigDiagmaxCaS_mp "maximaler Inkrementezaehlerstand bei Erkennung ausgefallenes Nockenwellensignal" UWORD OneToOne 1 100 0.00 65535.00 FORMAT "%8.2" ECU_ADDRESS 0x802B4C /end MEASUREMENT
/begin MEASUREMENT EngM_ctIntOvrLoad_mp "Anzahl der statischen Interrupts, bei denen der zeitliche Abstand zu kurz ist" UBYTE OneToOne 1 100 0.00 255.0 FORMAT "%5.1" ECU_ADDRESS 0x802B28 /end MEASUREMENT
/begin MEASUREMENT EngM_ctPhErrSigDiagCrSDef_mp "Anzahl Nockenwellenzaehne zur Erkennung eines gestörten Kurbelwellensignal" UWORD OneToOne 1 100 0.00 65535.00 FORMAT "%8.2" ECU_ADDRESS 0x802B4E /end MEASUREMENT
/begin MEASUREMENT EngM_ctPhErrSigDiagmaxCrSDef_mp "maximale Anzahl Nockenwellenzaehne bei Erkennung ausgefallenes Kurbelwellensignal" UWORD OneToOne 1 100 0.00 65535.00 FORMAT "%8.2" ECU_ADDRESS 0x802B50 /end MEASUREMENT
/begin MEASUREMENT EngM_ctPostSync_mp "Interruptzähler im State EngM_stSync = 64 (Post-Synchron)" UBYTE OneToOne 1 100 0.00 255.0 FORMAT "%5.1" ECU_ADDRESS 0x802B29 /end MEASUREMENT
/begin MEASUREMENT EngM_ctReSync_mp "Resynchronisationszähler, wird bei jeder Resynchronisation inkrementiert" UBYTE OneToOne 1 100 0.00 255.0 FORMAT "%5.1" ECU_ADDRESS 0x802B2A /end MEASUREMENT
/begin MEASUREMENT EngM_ctRevIni "Umdrehzungszaehler seit Initialisierung" SWORD OneToOne 1 100 -32768.00 32767.00 FORMAT "%8.2" ECU_ADDRESS 0x7F97E2 /end MEASUREMENT
/begin MEASUREMENT EngM_ctRevSta "Umdrehungszaehler seit Startabwurf" SWORD OneToOne 1 100 -32768.00 32767.00 FORMAT "%8.2" ECU_ADDRESS 0x7F97E4 /end MEASUREMENT
/begin MEASUREMENT EngM_ctSpdtoZero_mp "Zähler Timeoutinterrupts bis Motordrehzahl  = Null" ULONG OneToOne 1 100 0.00 4294967295.00 FORMAT "%13.2" ECU_ADDRESS 0x802B54 /end MEASUREMENT
/begin MEASUREMENT EngM_ctVerSync_mp "Verif.zähler der Sync; Anzahl der MAIN, PILOT, UPDATE, SEGMENT Interrupts zur Plaus. der NW mit der KW" UBYTE OneToOne 1 100 0.00 255.0 FORMAT "%5.1" ECU_ADDRESS 0x802B2B /end MEASUREMENT
/begin MEASUREMENT EngM_nDyn "dynamische Drehzahl" SWORD EngN 1 100 -32768.00 32767.00 FORMAT "%8.2" ECU_ADDRESS 0x7F97EA /end MEASUREMENT
/begin MEASUREMENT EngM_numCyl "Zylinderanzahl" UBYTE OneToOne 1 100 0.00 255.0 FORMAT "%5.1" ECU_ADDRESS 0x7F93AF /end MEASUREMENT
/begin MEASUREMENT EngM_numInt "Interreupt-Klasse" UBYTE OneToOne 1 100 0.00 255.0 FORMAT "%5.1" ECU_ADDRESS 0x7F93B1 /end MEASUREMENT
/begin MEASUREMENT EngM_numLastTDC "Vorhergehender Zünd-OT" UBYTE OneToOne 1 100 0.00 255.0 FORMAT "%5.1" ECU_ADDRESS 0x7F93B2 /end MEASUREMENT
/begin MEASUREMENT EngM_numRevCnt_mp "Zähler der Kurbelwellenumdrehungen" UWORD OneToOne 1 100 0.00 65535.00 FORMAT "%8.2" ECU_ADDRESS 0x802B2C /end MEASUREMENT
/begin MEASUREMENT EngM_numSyncTDC "Zylindernummer an dem die Synchronisation erkannt wurde" UBYTE OneToOne 1 100 0.00 255.0 FORMAT "%5.1" ECU_ADDRESS 0x7F93B3 /end MEASUREMENT
/begin MEASUREMENT EngM_numTDC "Aktueller Zünd-OT" UBYTE OneToOne 1 100 0.00 255.0 FORMAT "%5.1" ECU_ADDRESS 0x7F93B4 /end MEASUREMENT
/begin MEASUREMENT EngM_phiDiffTDC "Winkel zwischen TDC1 und dem in der Zündreihenfolge nächsten TDC auf diesem Steuergerät" SWORD AngleCrS 1 100 -768.0000 767.9766 FORMAT "%8.4" ECU_ADDRESS 0x7F97EC /end MEASUREMENT
/begin MEASUREMENT EngM_phiInt "aktuelle Interrupt-Position" SWORD AngleCrS 1 100 -768.0000 767.9766 FORMAT "%8.4" ECU_ADDRESS 0x7F97EE /end MEASUREMENT
/begin MEASUREMENT EngM_phiIntExt "aktuelle Interrupt-Position, extern vom Master zum Slave über CAN" SWORD AngleCrS 1 100 -768.0000 767.9766 FORMAT "%8.4" ECU_ADDRESS 0x7F97F0 /end MEASUREMENT
/begin MEASUREMENT EngM_phiIntExtCorr_mp "aktuelle Winkelposition an der Masterseite nach der Korrektur im Slave-Steuergerät" SWORD AngleCrS 1 100 -768.0000 767.9766 FORMAT "%8.4" ECU_ADDRESS 0x802B2E /end MEASUREMENT
/begin MEASUREMENT EngM_phiTDC "OT-Position der aktuellen Zumessung" SWORD AngleCrS 1 100 -768.0000 767.9766 FORMAT "%8.4" ECU_ADDRESS 0x7F97F4 /end MEASUREMENT
/begin MEASUREMENT EngM_SchedDelta_mp "Sprungweite in der Schedule-Tabelle" UBYTE OneToOne 1 100 0.00 255.0 FORMAT "%5.1" ECU_ADDRESS 0x802B30 /end MEASUREMENT
/begin MEASUREMENT EngM_SchedIndex_mp "Anzahl der abgearbeiteten Anweisungen der Schedule-Sequenz" UBYTE OneToOne 1 100 0.00 255.0 FORMAT "%5.1" ECU_ADDRESS 0x802B31 /end MEASUREMENT
/begin MEASUREMENT EngM_SchedLimitInt_mp "Nummer des Abschrankintervalls" UBYTE OneToOne 1 100 0.00 255.0 FORMAT "%5.1" ECU_ADDRESS 0x802B32 /end MEASUREMENT
/begin MEASUREMENT EngM_SchedSegID_mp "Nummer des Segments vor dem Interrupt" UBYTE OneToOne 1 100 0.00 255.0 FORMAT "%5.1" ECU_ADDRESS 0x802B33 /end MEASUREMENT
/begin MEASUREMENT EngM_stCaSExt "Statusinformation CaSCD_stPhaseSig_mp vom Mastersteuergeraet über CAN" UWORD OneToOne 1 100 0.00 65535.00 FORMAT "%8.2" ECU_ADDRESS 0x7F97F6 /end MEASUREMENT
/begin MEASUREMENT EngM_stCaSVerifyDiag "Statusinformation der Diagnose aus den VERIFY Zustand" UBYTE OneToOne 1 100 0.00 255.0 FORMAT "%5.1" ECU_ADDRESS 0x7F93B5 /end MEASUREMENT
/begin MEASUREMENT EngM_stEngMntCtl "Motorlagersteuerung-Zustandssignal" SWORD default 1 100 -32768.00 32767.00 FORMAT "%8.2" ECU_ADDRESS 0x7F97F8 /end MEASUREMENT
/begin MEASUREMENT EngM_stEngMntCtl_GTL1 "Status von Motorlagersteuerung" UBYTE OneToOne 1 100 0.00 255.0 FORMAT "%5.1" ECU_ADDRESS 0x7F93B6 /end MEASUREMENT
/begin MEASUREMENT EngM_stEngMntCtl_GTL2 "Status von Motorlagersteuerung" UBYTE OneToOne 1 100 0.00 255.0 FORMAT "%5.1" ECU_ADDRESS 0x7F93B7 /end MEASUREMENT
/begin MEASUREMENT EngM_stEngMntCtl_MLS1 "Status von Motorlagersteuerung" UBYTE OneToOne 1 100 0.00 255.0 FORMAT "%5.1" ECU_ADDRESS 0x7F93B8 /end MEASUREMENT
/begin MEASUREMENT EngM_stEngMntCtl_MLS2 "Status von Motorlagersteuerung" UBYTE OneToOne 1 100 0.00 255.0 FORMAT "%5.1" ECU_ADDRESS 0x7F93B9 /end MEASUREMENT
/begin MEASUREMENT EngM_stErrCanExt "CAN-Errorstatus der Botschaft MS_PHI_SNYC extern vom Master mit: EngM_phiIntExt, EngM_stNextExt" UBYTE OneToOne 1 100 0.00 255.0 FORMAT "%5.1" ECU_ADDRESS 0x7F93BA /end MEASUREMENT
/begin MEASUREMENT EngM_stEvent "Interruptereignis" UBYTE OneToOne 1 100 0.00 255.0 FORMAT "%5.1" ECU_ADDRESS 0x7F93BB /end MEASUREMENT
/begin MEASUREMENT EngM_stEventEnable_mp "n-synchrone Interrupts freigegeben" UWORD OneToOne 1 100 0.00 65535.00 FORMAT "%8.2" ECU_ADDRESS 0x802B34 /end MEASUREMENT
/begin MEASUREMENT EngM_stEventServed_mp "Aktuell bediente Interrupts" UWORD OneToOne 1 100 0.00 65535.00 FORMAT "%8.2" ECU_ADDRESS 0x802B36 /end MEASUREMENT
/begin MEASUREMENT EngM_stInjCharSetVal "Zeigt den Zustand der erlaubten Einspritzungen" UBYTE OneToOne 1 100 0.00 255.0 FORMAT "%5.1" ECU_ADDRESS 0x7F93BC /end MEASUREMENT
/begin MEASUREMENT EngM_stNext "Meta-Status der KW- und NW-Ereignisverwaltung (Motorpositions-Management), ohne Interim-Zustände" UBYTE OneToOne 1 100 0.00 255.0 FORMAT "%5.1" ECU_ADDRESS 0x7F93BD /end MEASUREMENT
/begin MEASUREMENT EngM_stNextExt "Meta-Status der KW- und NW-Ereignisverwaltung, ohne Interim-Zustände, extern vom Master zum Slave über CAN" UBYTE OneToOne 1 100 0.00 255.0 FORMAT "%5.1" ECU_ADDRESS 0x7F93BE /end MEASUREMENT
/begin MEASUREMENT EngM_stSpd "Status der Motordrehzahl" UBYTE OneToOne 1 100 0.00 255.0 FORMAT "%5.1" ECU_ADDRESS 0x7F93BF /end MEASUREMENT
/begin MEASUREMENT EngM_stStatGL_mp "Status der Getriebelagerung" UWORD OneToOne 1 100 0.00 65535.00 FORMAT "%8.2" ECU_ADDRESS 0x802B58 /end MEASUREMENT
/begin MEASUREMENT EngM_stStatML_mp "Status der Motorlagerung" UWORD OneToOne 1 100 0.00 65535.00 FORMAT "%8.2" ECU_ADDRESS 0x802B5A /end MEASUREMENT
/begin MEASUREMENT EngM_stSync "Meta-Status der KW- und NW-Ereignisverwaltung (Motorpositions-Management)" UBYTE OneToOne 1 100 0.00 255.0 FORMAT "%5.1" ECU_ADDRESS 0x7F93C0 /end MEASUREMENT
/begin MEASUREMENT EngM_swtEngMntCtl "Softwareschalter Motorlagersteuerung" SWORD default 1 100 -32768.00 32767.00 FORMAT "%8.2" ECU_ADDRESS 0x7F97FA /end MEASUREMENT
/begin MEASUREMENT EngM_swtTempTrqFrc "Schalter der Temperaturwert des Arrays auswählt" UBYTE EngTempFldSel 1 100 0.00 4.00000000000 FORMAT "%13.11" ECU_ADDRESS 0x7F93C1 /end MEASUREMENT
/begin MEASUREMENT EngM_tiDiffInt_mp "Differenz zwischen zwei statische interrupts" ULONG TimeSys_us 1 100 0.00 1228361874.73 FORMAT "%13.2" ECU_ADDRESS 0x802B38 /end MEASUREMENT
/begin MEASUREMENT EngM_tiSeg "Segmentzeit" UWORD TimeDT 1 100 0.00 65535.00 FORMAT "%8.2" ECU_ADDRESS 0x7F97FC /end MEASUREMENT
/begin MEASUREMENT EngM_tiSegLimAvrg "gemittelte beschränkte Segmentzeit" UWORD TimeDT 1 100 0.00 65535.00 FORMAT "%8.2" ECU_ADDRESS 0x7F97FE /end MEASUREMENT
/begin MEASUREMENT EngM_tiSegTwo "Dauer der vergangenen beiden Segmente" UWORD TimeDT 1 100 0.00 65535.00 FORMAT "%8.2" ECU_ADDRESS 0x7F9800 /end MEASUREMENT
/begin MEASUREMENT EngM_trqFrc "aktuelles Reibmoment" SWORD Trq 1 100 -3276.800 3276.700 FORMAT "%8.3" ECU_ADDRESS 0x7F9802 /end MEASUREMENT
/begin MEASUREMENT EngM_trqFrcMin "minimum Reibmoment" SWORD Trq 1 100 -3276.800 3276.700 FORMAT "%8.3" ECU_ADDRESS 0x7F9804 /end MEASUREMENT
/begin MEASUREMENT EngM_tTrqFrc_mp "Ausgewählte Temperatur für die Reibmomentenberechnung" SWORD Temp_Cels 1 100 -3549.940 3003.560 FORMAT "%8.3" ECU_ADDRESS 0x802B5C /end MEASUREMENT
/begin MEASUREMENT EngPrt_facAirOvhtLim_mp "Korrekturfaktor Ladelufttemperatur" SWORD Fact 1 100 -4.000000 3.999878 FORMAT "%8.6" ECU_ADDRESS 0x802B62 /end MEASUREMENT
/begin MEASUREMENT EngPrt_facAPLim_mp "Korrekturfaktor höhenabhängige Drehzahlkorrektur" SWORD Fact 1 100 -4.000000 3.999878 FORMAT "%8.6" ECU_ADDRESS 0x802B64 /end MEASUREMENT
/begin MEASUREMENT EngPrt_facCTOvhtLim_mp "Ueberhitzungsschutz in Abhaengigkeit von Motortemperatur und Fahrgeschwindigkeit" SWORD Fact 1 100 -4.000000 3.999878 FORMAT "%8.6" ECU_ADDRESS 0x802B66 /end MEASUREMENT
/begin MEASUREMENT EngPrt_facCTOvhtSwt_mp "Ueberhitzungsschutz (Motortemp. und Fahrgeschw.) nach Rampenschalter" SWORD Fact 1 100 -4.000000 3.999878 FORMAT "%8.6" ECU_ADDRESS 0x802B68 /end MEASUREMENT
/begin MEASUREMENT EngPrt_facFlClgLim_mp "Korrekturfaktor Kraftstofftemperatur" SWORD Fact 1 100 -4.000000 3.999878 FORMAT "%8.6" ECU_ADDRESS 0x802B6A /end MEASUREMENT
/begin MEASUREMENT EngPrt_facOilOvhtLim_mp "Korrekturfaktor Öltemperatur" SWORD Fact 1 100 -4.000000 3.999878 FORMAT "%8.6" ECU_ADDRESS 0x802B6C /end MEASUREMENT
/begin MEASUREMENT EngPrt_facPrtLimCorr "Begrenzungsmengenkorrekturfaktor" SWORD Fact 1 100 -4.000000 3.999878 FORMAT "%8.6" ECU_ADDRESS 0x7F9806 /end MEASUREMENT
/begin MEASUREMENT EngPrt_facTempPreTrbn_mp "Begrenzungsfaktor zur Limitierung der Temperatur vor der Turbine" SWORD Fact 1 100 -4.000000 3.999878 FORMAT "%8.6" ECU_ADDRESS 0x802B6E /end MEASUREMENT
/begin MEASUREMENT EngPrt_facTnkTempLim_mp "Korrekturfaktor Tankeintrittstemperatur" SWORD Fact 1 100 -4.000000 3.999878 FORMAT "%8.6" ECU_ADDRESS 0x802B70 /end MEASUREMENT
/begin MEASUREMENT EngPrt_pVal_mp "Meßpunkt der Druckauswahl für Korrektur der Volllasterhöhung" SWORD Pres_hPa 1 100 -32768.00 32767.00 FORMAT "%8.2" ECU_ADDRESS 0x802B72 /end MEASUREMENT
/begin MEASUREMENT EngPrt_stFlClgDSP "Flag für dynamisches Schaltprogramm" UBYTE OneToOne 1 100 0.00 255.0 FORMAT "%5.1" ECU_ADDRESS 0x7F93C3 /end MEASUREMENT
/begin MEASUREMENT EngPrt_stOvrSpd "Überdrehzahl-Status" UBYTE OneToOne 1 100 0.00 255.0 FORMAT "%5.1" ECU_ADDRESS 0x7F93C4 /end MEASUREMENT
/begin MEASUREMENT EngPrt_stOvrSpdMon "Zustand der Überdrehzahl-Überwachung" UBYTE OneToOne 1 100 0.00 255.0 FORMAT "%5.1" ECU_ADDRESS 0x7F93C5 /end MEASUREMENT
/begin MEASUREMENT EngPrt_stTempPrtShiftUp "Hochschaltanforderung bei Übertemperatur" UBYTE OneToOne 1 100 0.00 255.0 FORMAT "%5.1" ECU_ADDRESS 0x7F93C6 /end MEASUREMENT
/begin MEASUREMENT EngPrt_stThrCloAct "Status ob Drosselklappe schließen aktiv ist" UBYTE OneToOne 1 100 0.00 255.0 FORMAT "%5.1" ECU_ADDRESS 0x7F93C7 /end MEASUREMENT
/begin MEASUREMENT EngPrt_stThrCloMon "Status ob Drosselklappe schließen im Überwachungszustand" UBYTE OneToOne 1 100 0.00 255.0 FORMAT "%5.1" ECU_ADDRESS 0x7F93C8 /end MEASUREMENT
/begin MEASUREMENT EngPrt_swtOilOvhtPrv "Softwareschalter Öltemperaturüberhitzungsschutz" UBYTE OneToOne 1 100 0.00 255.0 FORMAT "%5.1" ECU_ADDRESS 0x7F93C9 /end MEASUREMENT
/begin MEASUREMENT EngPrt_swtTempPreTrbn "Schalter zum Auswählen der Temperatur entweder aus Modellrechnung (1) oder vom Sensor (0)" UBYTE OneToOne 1 100 0.00 255.0 FORMAT "%5.1" ECU_ADDRESS 0x7F93CA /end MEASUREMENT
/begin MEASUREMENT EngPrt_tFuelVirt_mp "virtuelle Kraftstofftemperatur" SWORD Temp_Cels 1 100 -3549.940 3003.560 FORMAT "%8.3" ECU_ADDRESS 0x802B74 /end MEASUREMENT
/begin MEASUREMENT EngPrt_tFuel_mp "Kraftstofftemperatur" SWORD Temp_Cels 1 100 -3549.940 3003.560 FORMAT "%8.3" ECU_ADDRESS 0x802B76 /end MEASUREMENT
/begin MEASUREMENT EngPrt_tPreTrbn_mp "Temperaturwert vor der Turbine zur Berechnung des Korrekturfaktors" SWORD Temp_Cels 1 100 -3549.940 3003.560 FORMAT "%8.3" ECU_ADDRESS 0x802B78 /end MEASUREMENT
/begin MEASUREMENT EngPrt_trqAST "Momentenbegrenzung von AST" SWORD Trq 1 100 -3276.800 3276.700 FORMAT "%8.3" ECU_ADDRESS 0x7F9808 /end MEASUREMENT
/begin MEASUREMENT EngPrt_trqIncLoad "Volllasterhöhung des Motorschutzes" SWORD Trq 1 100 -3276.800 3276.700 FORMAT "%8.3" ECU_ADDRESS 0x7F980A /end MEASUREMENT
/begin MEASUREMENT EngPrt_trqIncLoadClt_mp "Meßpunkt der motortemperaturabhängigen Volllasterhöhung" SWORD Trq 1 100 -3276.800 3276.700 FORMAT "%8.3" ECU_ADDRESS 0x802B7A /end MEASUREMENT
/begin MEASUREMENT EngPrt_trqLim "Begrenzungsmoment zum Schutz vor zu hohem Drehmoment (als inneres Motormoment)" SWORD Trq 1 100 -3276.800 3276.700 FORMAT "%8.3" ECU_ADDRESS 0x7F980C /end MEASUREMENT
/begin MEASUREMENT EngPrt_trqLimP_mp "Motorschutz Drehmomentenbegrenzung durch Atmosphärendruck" SWORD Trq 1 100 -3276.800 3276.700 FORMAT "%8.3" ECU_ADDRESS 0x802B7C /end MEASUREMENT
/begin MEASUREMENT EngPrt_trqLimrVn_mp "Begrenzungmoment aufgrund Verhältnis v/n" SWORD Trq 1 100 -3276.800 3276.700 FORMAT "%8.3" ECU_ADDRESS 0x802B7E /end MEASUREMENT
/begin MEASUREMENT EngPrt_trqNEcoLim_mp "Begrenzungsmoment für AST Eingriff" SWORD Trq 1 100 -3276.800 3276.700 FORMAT "%8.3" ECU_ADDRESS 0x802B80 /end MEASUREMENT
/begin MEASUREMENT EngPrt_trqNLim "Begrenzungsmoment zum Schutz vor zu hoher Drehzahl (als inneres Motormoment)" SWORD Trq 1 100 -3276.800 3276.700 FORMAT "%8.3" ECU_ADDRESS 0x7F980E /end MEASUREMENT
/begin MEASUREMENT EngPrt_trqPrtLim "resultierendes Begrenzungsmoment für Motormechanikschutz (inneres Motormoment)" SWORD Trq 1 100 -3276.800 3276.700 FORMAT "%8.3" ECU_ADDRESS 0x7F9810 /end MEASUREMENT
/begin MEASUREMENT Eng_dnAvrg "gemittelte Drehzahländerung pro Sekunde" SWORD dn_dZ20 1 100 -327680.0 327670.0 FORMAT "%8.1" ECU_ADDRESS 0x7F9812 /end MEASUREMENT
/begin MEASUREMENT Eng_dtEngCorr_mp "der fuer Eng_tEng zu korregierende Temperaturwert nach dem Kennfeld" SWORD TempDiff_Kelv 1 100 -3276.800 3276.700 FORMAT "%8.3" ECU_ADDRESS 0x802B24 /end MEASUREMENT
/begin MEASUREMENT Eng_dtEngSub_mp "der subtrahierte Temperaturwert vor dem Kennfeld" SWORD TempDiff_Kelv 1 100 -3276.800 3276.700 FORMAT "%8.3" ECU_ADDRESS 0x802B26 /end MEASUREMENT
/begin MEASUREMENT Eng_nAvrg "mittlere Motordrehzahl" SWORD EngN 1 100 -32768.00 32767.00 FORMAT "%8.2" ECU_ADDRESS 0x7F9814 /end MEASUREMENT
/begin MEASUREMENT Eng_nCurr "aktuelle Motordrehzahl" SWORD EngN 1 100 -32768.00 32767.00 FORMAT "%8.2" ECU_ADDRESS 0x7F9816 /end MEASUREMENT
/begin MEASUREMENT Eng_stEngSpd "status der Motordrehzahl" UBYTE OneToOne 1 100 0.00 255.0 FORMAT "%5.1" ECU_ADDRESS 0x7F93CB /end MEASUREMENT
/begin MEASUREMENT Eng_tEng "Motortemperatur" SWORD Temp_Cels 1 100 -3549.940 3003.560 FORMAT "%8.3" ECU_ADDRESS 0x7F9818 /end MEASUREMENT
/begin MEASUREMENT Eng_tFld "Motortemperatur-Feld [°C]" SWORD Temp_Cels 1 100 -3549.940 3003.560 FORMAT "%8.3" ARRAY_SIZE 5 ECU_ADDRESS 0x7F9D34 /end MEASUREMENT
/begin MEASUREMENT Eng_trqCrvMax "maximales Moment des Momentenintervalls (über Drehzahl)" SWORD Trq 1 100 -3276.800 3276.700 FORMAT "%8.3" ECU_ADDRESS 0x7F981C /end MEASUREMENT
/begin MEASUREMENT ErLpCD_OrdGlwLamp "Message vom Fehlerlampen Handler and Glühzeitsteuerung, steuert die Glühlampe bei Systemlampenfehlern an." UBYTE OneToOne 1 100 0.00 255.0 FORMAT "%5.1" ECU_ADDRESS 0x7F93CC /end MEASUREMENT
/begin MEASUREMENT ErLpCD_rHWEMILOut_mp "Meßpunkt des Ausgangswertes vom MIL-Signal zur Hardware" UWORD OneToOne 1 100 0.00 65535.00 FORMAT "%8.2" ECU_ADDRESS 0x802B82 /end MEASUREMENT
/begin MEASUREMENT ErLpCD_rHWESysLampOut_mp "Meßpunkt des Ausgangswertes vom Systemlampe-Signal zur Hardware" UWORD OneToOne 1 100 0.00 65535.00 FORMAT "%8.2" ECU_ADDRESS 0x802B84 /end MEASUREMENT
/begin MEASUREMENT ErLpCD_stMil "Gesamtatus der MIL und Status der Aktivierungsquellen" UBYTE OneToOne 1 100 0.00 255.0 FORMAT "%5.1" ECU_ADDRESS 0x7F93CD /end MEASUREMENT
/begin MEASUREMENT ErLpCD_stMilReq "Status der externen MIL Ansteuerungs Anforderung (Achtung: wechselt während der Ansteuerung dauernd den Zustand)" UBYTE OneToOne 1 100 0.00 255.0 FORMAT "%5.1" ECU_ADDRESS 0x7F93CE /end MEASUREMENT
/begin MEASUREMENT ErLpCD_stMIL_mp "Testzustand und Fehlerspeicheranforderung der MIL" UBYTE OneToOne 1 100 0.00 255.0 FORMAT "%5.1" ECU_ADDRESS 0x802B86 /end MEASUREMENT
/begin MEASUREMENT ErLpCD_stSysLamp "Gesamtatus der System Lampe und Status der Aktivierungsquellen" UBYTE OneToOne 1 100 0.00 255.0 FORMAT "%5.1" ECU_ADDRESS 0x7F93CF /end MEASUREMENT
/begin MEASUREMENT ErLpCD_stSysLampOut "Status der Systemlampe" UBYTE OneToOne 1 100 0.00 255.0 FORMAT "%5.1" ECU_ADDRESS 0x7F93D0 /end MEASUREMENT
/begin MEASUREMENT ErLpCD_stSysLampReq "Status der externen Systemlampen  Ansteuerungs Anforderung (Achtung: wechselt während der Ansteuerung dauernd den Zustand)" UBYTE OneToOne 1 100 0.00 255.0 FORMAT "%5.1" ECU_ADDRESS 0x7F93D1 /end MEASUREMENT
/begin MEASUREMENT ErLpCD_stSysLamp_mp "Testzustand und Anforderung durch Fehlerspeicher für Systemlampe" UBYTE OneToOne 1 100 0.00 255.0 FORMAT "%5.1" ECU_ADDRESS 0x802B87 /end MEASUREMENT
/begin MEASUREMENT ErLpCD_swtMIL "Satusinformation des MIL-Lampen Schalters" UBYTE OneToOne 1 100 0.00 255.0 FORMAT "%5.1" ECU_ADDRESS 0x7F93D2 /end MEASUREMENT
/begin MEASUREMENT ErLpCD_swtSYS "Satusinformation des SYS-Lampen Schalters" UBYTE OneToOne 1 100 0.00 255.0 FORMAT "%5.1" ECU_ADDRESS 0x7F93D3 /end MEASUREMENT
/begin MEASUREMENT Ertm_tiload_u32 "CPU Last [%]" ULONG Ertm_Tim 1 100 0.00 42949672.9500 FORMAT "%13.4" ECU_ADDRESS 0x801AAC /end MEASUREMENT
/begin MEASUREMENT Ertm_timax_u32 "maximale Laufzeit des Idle Task nach dem Start von ERCOS [%]" ULONG Ertm_Tim 1 100 0.00 42949672.9500 FORMAT "%13.4" ECU_ADDRESS 0x801AB0 /end MEASUREMENT
/begin MEASUREMENT Ertm_tiProc_u32 "Idle Task Laufzeit [%]" ULONG Ertm_Tim 1 100 0.00 42949672.9500 FORMAT "%13.4" ECU_ADDRESS 0x801AA8 /end MEASUREMENT
/begin MEASUREMENT ESS_nBattMin "Leerlaufdrehzahl wegen schwacher Batterie" SWORD EngN 1 100 -32768.00 32767.00 FORMAT "%8.2" ECU_ADDRESS 0x7F97D8 /end MEASUREMENT
/begin MEASUREMENT ESS_nMax "Hoechstdrehzahl für ESS" SWORD EngN 1 100 -32768.00 32767.00 FORMAT "%8.2" ECU_ADDRESS 0x7F97DA /end MEASUREMENT
/begin MEASUREMENT ESS_nMin "Leerlaufdrehzahl aus ESS" SWORD EngN 1 100 -32768.00 32767.00 FORMAT "%8.2" ECU_ADDRESS 0x7F97DC /end MEASUREMENT
/begin MEASUREMENT ESS_pwrDes "Leistungsbedarf aller Aggregate des Bordnetzes" SWORD Pwr 1 100 -308831.1 308821.7 FORMAT "%8.1" ECU_ADDRESS 0x7F97DE /end MEASUREMENT
/begin MEASUREMENT ESS_pwrLead "Vorhaltleistung des el. Bordnetzes" SWORD Pwr 1 100 -308831.1 308821.7 FORMAT "%8.1" ECU_ADDRESS 0x7F97E0 /end MEASUREMENT
/begin MEASUREMENT ESS_stNBattFFRes_mp "Drehzahl Resetbedingung für batteriespannungsabhängige Leerlaufsolldrehzahlerhöhung" UBYTE OneToOne 1 100 0.00 255.0 FORMAT "%5.1" ECU_ADDRESS 0x802B88 /end MEASUREMENT
/begin MEASUREMENT ESS_stNBattFFSet_mp "Drehzahl Setbedingung für batteriespannungsabhängige Leerlaufsolldrehzahlerhöhung" UBYTE OneToOne 1 100 0.00 255.0 FORMAT "%5.1" ECU_ADDRESS 0x802B89 /end MEASUREMENT
/begin MEASUREMENT ESS_stStrtDoneFFSet_mp "Startabwurf Set-Bedingung für batteriespannungsabhängige Leerlaufsolldrehzahlerhöhung" UBYTE OneToOne 1 100 0.00 255.0 FORMAT "%5.1" ECU_ADDRESS 0x802B8A /end MEASUREMENT
/begin MEASUREMENT ESS_stUBattFFRes_mp "Reset-Bedingung batteriespannungsabhängige Leerlaufsolldrehzahlerhöhung" UBYTE OneToOne 1 100 0.00 255.0 FORMAT "%5.1" ECU_ADDRESS 0x802B8B /end MEASUREMENT
/begin MEASUREMENT ESS_stUBattFFSet_mp "Set-Bedingung batteriespannungsabhängige Leerlaufsolldrehzahlerhöhung" UBYTE OneToOne 1 100 0.00 255.0 FORMAT "%5.1" ECU_ADDRESS 0x802B8C /end MEASUREMENT
/begin MEASUREMENT ETClb_ctInjCycl_mp "Aktuelle Anzahl der Einspritzzyklen für die Ansteuerdauerkalibrierung" UWORD OneToOne 1 100 0.00 65535.00 FORMAT "%8.2" ECU_ADDRESS 0x802BF4 /end MEASUREMENT
/begin MEASUREMENT ETClb_ctLrn_mp "Lernzykluszähler für jeden Raildruck-Kalibrierpunkt der Ansteuerdauerkalibrierung" UWORD OneToOne 1 100 0.00 65535.00 FORMAT "%8.2" ARRAY_SIZE 3 ECU_ADDRESS 0x802B90 /end MEASUREMENT
/begin MEASUREMENT ETClb_dtiETFlt0_mp "Gefilterte Ansteuerdauerdifferenz der Ansteuerdauerkalibrierung für jeden Zylinder beim Raildruck-Kalibrierpunkt 0" SWORD InjTime_us 1 100 -32768.00 32767.00 FORMAT "%8.2" ARRAY_SIZE 6 ECU_ADDRESS 0x802B96 /end MEASUREMENT
/begin MEASUREMENT ETClb_dtiETFlt1_mp "Gefilterte Ansteuerdauerdifferenz der Ansteuerdauerkalibrierung für jeden Zylinder beim Raildruck-Kalibrierpunkt 1" SWORD InjTime_us 1 100 -32768.00 32767.00 FORMAT "%8.2" ARRAY_SIZE 6 ECU_ADDRESS 0x802BA2 /end MEASUREMENT
/begin MEASUREMENT ETClb_dtiETFlt2_mp "Gefilterte Ansteuerdauerdifferenz der Ansteuerdauerkalibrierung für jeden Zylinder beim Raildruck-Kalibrierpunkt 2" SWORD InjTime_us 1 100 -32768.00 32767.00 FORMAT "%8.2" ARRAY_SIZE 6 ECU_ADDRESS 0x802BAE /end MEASUREMENT
/begin MEASUREMENT ETClb_numCylCur_mp "Aktueller Zylinder für die Ansteuerdauerkalibrierung bei jedem Raildruck-Kalibrierpunkt" UBYTE OneToOne 1 100 0.00 255.0 FORMAT "%5.1" ARRAY_SIZE 3 ECU_ADDRESS 0x802BBA /end MEASUREMENT
/begin MEASUREMENT ETClb_numPres_mp "Aktueller Raildruck-Kalibrierpunkt der Ansteuerdauerkalibrierung" UBYTE OneToOne 1 100 0.00 255.0 FORMAT "%5.1" ECU_ADDRESS 0x802BF6 /end MEASUREMENT
/begin MEASUREMENT ETClb_numRailPresClbPnt_mp "Anzahl der Raildruck-Kalibrierpunkte für die Ansteuerdauerkalibrierung" UBYTE OneToOne 1 100 0.00 255.0 FORMAT "%5.1" ECU_ADDRESS 0x802BF7 /end MEASUREMENT
/begin MEASUREMENT ETClb_stCor "Statusanzeige der Freigaben für die Ansteuerdauerkorrektur der Nullmengenkalibrierung" UBYTE OneToOne 1 100 0.00 255.0 FORMAT "%5.1" ECU_ADDRESS 0x7F93AA /end MEASUREMENT
/begin MEASUREMENT ETClb_stDemCor_mp "Anforderung der Ansteuerdauerkorrektur der Ansteuerdauerkalibrierung" UBYTE OneToOne 1 100 0.00 255.0 FORMAT "%5.1" ECU_ADDRESS 0x802BF8 /end MEASUREMENT
/begin MEASUREMENT ETClb_stEvalResult_mp "Ergebnis der Ansteuerdauerkalibrierungs-Einspritzungen" UBYTE ETClb_Eval_Rslt 1 100 0.00 2.00000000000 FORMAT "%13.11" ECU_ADDRESS 0x802BFE /end MEASUREMENT
/begin MEASUREMENT ETClb_stEval_mp "Zustand des Zustandsautomaten zur Auswertung der Ansteuerdauerkalibrierung" UBYTE ETClb_Eval_State 1 100 0.00 2.00000000000 FORMAT "%13.11" ARRAY_SIZE 3 ECU_ADDRESS 0x802BFB /end MEASUREMENT
/begin MEASUREMENT ETClb_stRlsCylCor_mp "Zylinderspezifische Freigabe der Ansteuerdauerkorrektur der Ansteuerdauerkalibrierung" UBYTE OneToOne 1 100 0.00 255.0 FORMAT "%5.1" ECU_ADDRESS 0x802BF9 /end MEASUREMENT
/begin MEASUREMENT ETClb_st_mp "Zustand der Ansteuerdauerkalibrierung" UBYTE ETClb_State 1 100 0.00 3.00000000000 FORMAT "%13.11" ECU_ADDRESS 0x802BFA /end MEASUREMENT
/begin MEASUREMENT ETClb_swtCorActv "SW-Schalter zur Aktivierung der Ansteuerdauerkorrektur der Nullmengenkalibrierung" UBYTE OneToOne 1 100 0.00 255.0 FORMAT "%5.1" ECU_ADDRESS 0x7F93AB /end MEASUREMENT
/begin MEASUREMENT ETClb_swtQckClb_mp "Anzeiger der Umschaltung auf schnelle Ansteuerdauerkalibrierung" UBYTE OneToOne 1 100 0.00 255.0 FORMAT "%5.1" ECU_ADDRESS 0x802BBD /end MEASUREMENT
/begin MEASUREMENT ETClb_tiETCor0_mp "Ansteuerdauerkorrekturwert der Ansteuerdauer-Kalibrierung für den Raildruck-Kalibrierpunkt 0" SWORD InjTime_us 1 100 -32768.00 32767.00 FORMAT "%8.2" ARRAY_SIZE 6 ECU_ADDRESS 0x802BBE /end MEASUREMENT
/begin MEASUREMENT ETClb_tiETCor1_mp "Ansteuerdauerkorrekturwert der Ansteuerdauer-Kalibrierung für den Raildruck-Kalibrierpunkt 1" SWORD InjTime_us 1 100 -32768.00 32767.00 FORMAT "%8.2" ARRAY_SIZE 6 ECU_ADDRESS 0x802BCA /end MEASUREMENT
/begin MEASUREMENT ETClb_tiETCor2_mp "Ansteuerdauerkorrekturwert der Ansteuerdauer-Kalibrierung für den Raildruck-Kalibrierpunkt 2" SWORD InjTime_us 1 100 -32768.00 32767.00 FORMAT "%8.2" ARRAY_SIZE 6 ECU_ADDRESS 0x802BD6 /end MEASUREMENT
/begin MEASUREMENT ETClb_tiETCur_mp "Aktuelle Ansteuerdauer der Ansteuerdauer-Kalibrierung für jeden Raildruck-Kalibrierpunkt" SWORD InjTime_us 1 100 -32768.00 32767.00 FORMAT "%8.2" ARRAY_SIZE 3 ECU_ADDRESS 0x802BE2 /end MEASUREMENT
/begin MEASUREMENT ETClb_tiETMinEff_mp "Ansteuerdauer der Nullmenge des aktuellen Zylinder fuer jeden Raildruck-Kalibrierpunkt" SWORD InjTime_us 1 100 -32768.00 32767.00 FORMAT "%8.2" ARRAY_SIZE 3 ECU_ADDRESS 0x802BE8 /end MEASUREMENT
/begin MEASUREMENT ETClb_tiInjInit_mp "Injektor-Betriebsstundenzähler der Ansteuerdauer-Kalibrierung" ULONG TimeEngOn 1 100 0.00 4294967295.00 FORMAT "%13.2" ECU_ADDRESS 0x802BF0 /end MEASUREMENT
/begin MEASUREMENT FanCD_numFanCtlr1ErrCnt_mp "Anzahl der bisher empfangenen Fehler der gleichen Fehlerart" UBYTE OneToOne 1 100 0.00 255.0 FORMAT "%5.1" ECU_ADDRESS 0x802C00 /end MEASUREMENT
/begin MEASUREMENT FanCD_numFanCtlr2ErrCnt_mp "Anzahl bisher empfangener LOW Pegel für Fehlerart FanCD_ stFanCtlr2ErrStrt_ mp" UBYTE OneToOne 1 100 0.00 255.0 FORMAT "%5.1" ECU_ADDRESS 0x802C01 /end MEASUREMENT
/begin MEASUREMENT FanCD_rFan1HWE_mp "Duty Cycle für Actuator" SWORD DtyCyc 1 100 -327.6800 327.6700 FORMAT "%8.4" ECU_ADDRESS 0x802C02 /end MEASUREMENT
/begin MEASUREMENT FanCD_rFan2HWE_mp "dem HWK übergebenes TV der Lüfterendstufe A_T_MLR2" SWORD DtyCyc 1 100 -327.6800 327.6700 FORMAT "%8.4" ECU_ADDRESS 0x802C04 /end MEASUREMENT
/begin MEASUREMENT FanCD_stFanCtlr1ErrStrt_mp "Fehlerart die aktuell entprellt wird Lüftersteuergerät 1" UBYTE OneToOne 1 100 0.00 255.0 FORMAT "%5.1" ECU_ADDRESS 0x802C06 /end MEASUREMENT
/begin MEASUREMENT FanCD_stFanCtlr2ErrStrt_mp "Fehlerart die aktuell entprellt wird Lüftersteuergerät 2" UBYTE OneToOne 1 100 0.00 255.0 FORMAT "%5.1" ECU_ADDRESS 0x802C07 /end MEASUREMENT
/begin MEASUREMENT FanCD_stShutOff "Aktueller Zustand der Lüfterabschalt-Statemachine" UBYTE OneToOne 1 100 0.00 255.0 FORMAT "%5.1" ECU_ADDRESS 0x7F93DA /end MEASUREMENT
/begin MEASUREMENT FanCD_swtFanShutOff "Schalter zur Deaktivierung der Lüfterabschaltung bei Nicht-Öffnen des Hauptrelais." UBYTE OneToOne 1 100 0.00 255.0 FORMAT "%5.1" ECU_ADDRESS 0x7F93DB /end MEASUREMENT
/begin MEASUREMENT FanCtl_dcycFan1 "Tastverhältnis für Lüfter 1" SWORD DtyCyc 1 100 -327.6800 327.6700 FORMAT "%8.4" ECU_ADDRESS 0x7F985E /end MEASUREMENT
/begin MEASUREMENT FanCtl_dcycFan1BSG_mp "Duty Cycle für fan1 mit BSG-Anforderung , maximum und ramp" SWORD DtyCyc 1 100 -327.6800 327.6700 FORMAT "%8.4" ECU_ADDRESS 0x802C08 /end MEASUREMENT
/begin MEASUREMENT FanCtl_dcycFan2 "Tastverhältnis für Lüfter 2" SWORD DtyCyc 1 100 -327.6800 327.6700 FORMAT "%8.4" ECU_ADDRESS 0x7F9860 /end MEASUREMENT
/begin MEASUREMENT FanCtl_dcycFan2BSG_mp "Dutycycle für fan1 mit BSG-Request, Maximum und Rampe" SWORD DtyCyc 1 100 -327.6800 327.6700 FORMAT "%8.4" ECU_ADDRESS 0x802C0A /end MEASUREMENT
/begin MEASUREMENT FanCtl_factACReqCorr_mp "Drehzahlabhängige zusatzlast durch AC" SWORD Fact 1 100 -4.000000 3.999878 FORMAT "%8.6" ECU_ADDRESS 0x802C0C /end MEASUREMENT
/begin MEASUREMENT FanCtl_factApReq_mp "Kühlbedarf bei Anfahren in der Höhe" SWORD Fact 1 100 -4.000000 3.999878 FORMAT "%8.6" ECU_ADDRESS 0x802C0E /end MEASUREMENT
/begin MEASUREMENT FanCtl_nFan1 "Berechnete Umdrehung für Fan1" SWORD EngN 1 100 -32768.00 32767.00 FORMAT "%8.2" ECU_ADDRESS 0x7F9862 /end MEASUREMENT
/begin MEASUREMENT FanCtl_nFan2 "Drehzahl für Lüfter 2 mit ausgeblendeten Drehzahlbereichen" SWORD EngN 1 100 -32768.00 32767.00 FORMAT "%8.2" ECU_ADDRESS 0x7F9864 /end MEASUREMENT
/begin MEASUREMENT FanCtl_prcACReq_mp "Leistungsanforderung von AC" SWORD Prc 1 100 -327.6800 327.6700 FORMAT "%8.4" ECU_ADDRESS 0x802C10 /end MEASUREMENT
/begin MEASUREMENT FanCtl_prcAC_mp "relative zusatzbelastung von AC" SWORD Prc 1 100 -327.6800 327.6700 FORMAT "%8.4" ECU_ADDRESS 0x802C12 /end MEASUREMENT
/begin MEASUREMENT FanCtl_prcAddReq_mp "Geregelte und umgewandelte Ausgangtemperatur des Kühlmittels  von Ausfluss" SWORD Prc 1 100 -327.6800 327.6700 FORMAT "%8.4" ECU_ADDRESS 0x802C14 /end MEASUREMENT
/begin MEASUREMENT FanCtl_prcCAN "relative Kühlleistung in Prozent für CAN" SWORD Prc 1 100 -327.6800 327.6700 FORMAT "%8.4" ECU_ADDRESS 0x7F9866 /end MEASUREMENT
/begin MEASUREMENT FanCtl_prcCanReq_mp "Berechnete Leistungsanforderung von CAN-Message" SWORD Prc 1 100 -327.6800 327.6700 FORMAT "%8.4" ECU_ADDRESS 0x802C16 /end MEASUREMENT
/begin MEASUREMENT FanCtl_prcClntInc_mp "Messwert für die Zusatzkühlung der angeforderten motortemperatur von CAN" SWORD Prc 1 100 -327.6800 327.6700 FORMAT "%8.4" ECU_ADDRESS 0x802C18 /end MEASUREMENT
/begin MEASUREMENT FanCtl_prcCtl_mp "Angeforderte Kühlungstemperatur am Ausfluss. Convertiert zur Leistung" SWORD Prc 1 100 -327.6800 327.6700 FORMAT "%8.4" ECU_ADDRESS 0x802C1A /end MEASUREMENT
/begin MEASUREMENT FanCtl_prcFan_mp "Berechnete Leistungsanforderung von CAN-Message" SWORD Prc 1 100 -327.6800 327.6700 FORMAT "%8.4" ECU_ADDRESS 0x802C1C /end MEASUREMENT
/begin MEASUREMENT FanCtl_prcQDes_mp "Kühlleistung für Fan nach Maximum" SWORD Prc 1 100 -327.6800 327.6700 FORMAT "%8.4" ECU_ADDRESS 0x802C1E /end MEASUREMENT
/begin MEASUREMENT FanCtl_prcRampFan1_mp "Kühlleistung für hydrofan nach maximum und rampe" SWORD Prc 1 100 -327.6800 327.6700 FORMAT "%8.4" ECU_ADDRESS 0x802C20 /end MEASUREMENT
/begin MEASUREMENT FanCtl_prcRampFan2_mp "Kühlleistung für Lüfter 2 nach maximum und rampe" SWORD Prc 1 100 -327.6800 327.6700 FORMAT "%8.4" ECU_ADDRESS 0x802C22 /end MEASUREMENT
/begin MEASUREMENT FanCtl_stAfterrunRamp "Status der Rampe" UBYTE OneToOne 1 100 0.00 255.0 FORMAT "%5.1" ECU_ADDRESS 0x7F93DC /end MEASUREMENT
/begin MEASUREMENT FanCtl_stOut "Zustand Lüfternachlauf" UBYTE OneToOne 1 100 0.00 255.0 FORMAT "%5.1" ECU_ADDRESS 0x7F93DD /end MEASUREMENT
/begin MEASUREMENT FanCtl_stShutOffRamp "Status der Elektrolüfterabschaltrampe" UBYTE OneToOne 1 100 0.00 255.0 FORMAT "%5.1" ECU_ADDRESS 0x7F93DE /end MEASUREMENT
/begin MEASUREMENT FanCtl_stStrt "Startstatus - Drehzahl- und Zeitabhängig" UBYTE OneToOne 1 100 0.00 255.0 FORMAT "%5.1" ECU_ADDRESS 0x7F93DF /end MEASUREMENT
/begin MEASUREMENT FanCtl_swtClgModVar "Schalterzustand des Kühlleistungsvariantenschalters" UBYTE OneToOne 1 100 0.00 255.0 FORMAT "%5.1" ECU_ADDRESS 0x7F93E0 /end MEASUREMENT
/begin FUNCTION egsys_ttrbmod_uic ""
 /begin OUT_MEASUREMENT EGSys_cpEGTrbn_mp EGSys_etaChrg_mp EGSys_facPT1Chrg_mp EGSys_pwrCmpr_mp EGSys_rPresCmpr_mp EGSys_tAvrgEGTrbn_mp /end OUT_MEASUREMENT
/end FUNCTION
/begin FUNCTION egsys_ttubemod "Temperaturmodell für Abgasrohr"
 /begin DEF_CHARACTERISTIC EGSys_AlpFreeCnvtTube_C EGSys_cpTube_C EGSys_lDiamTube_C EGSys_lLngthTube_C EGSys_NuTubeEnv_CUR EGSys_NuTube_CUR EGSys_rSqTube_C EGSys_tEGTubeDfl_C EGSys_tTubeDfl_C EGSys_tTubeIKi_C EGSys_tTubeIKiPos_C EGSys_tTubeIKiNeg_C EGSys_tTubeIWinPos_C EGSys_tTubeIWinNeg_C /end DEF_CHARACTERISTIC
 /begin OUT_MEASUREMENT EGSys_AlpEGTube_mp EGSys_AlpTubeEnv_mp EGSys_cndHtEGi_mp EGSys_cndHtEGo_mp EGSys_cpEGTube_mp EGSys_dtTube_mp EGSys_dwTubeIn_mp EGSys_dwTubeOut_mp EGSys_dwTube_mp EGSys_NuTubeEnv_mp EGSys_NuTube_mp EGSys_ReTubeEnvInpCrv_mp EGSys_ReTubeEnv_mp EGSys_ReTubeInpCrv_mp EGSys_ReTube_mp EGSys_sqTube_mp EGSys_tAvrgEGTube_mp EGSys_tDiffEGTube_mp EGSys_tDiffTubeEnv_mp EGSys_tMidEGTube_mp EGSys_tMidTubeEnv_mp /end OUT_MEASUREMENT
/end FUNCTION
/begin FUNCTION egsys_ttubemod_msg "" /begin OUT_MEASUREMENT EGSys_tEGPstTube EGSys_tTube /end OUT_MEASUREMENT /end FUNCTION
/begin FUNCTION egsys_ttubemod_uic "" /end FUNCTION
/begin FUNCTION egt_copy2nsync_msg "" /begin OUT_MEASUREMENT EGT_st EGT_tiRgn /end OUT_MEASUREMENT /end FUNCTION
/begin FUNCTION egt_copy2nsync_uic "" /begin DEF_CHARACTERISTIC EGT_st_Vector EGT_st_Channel /end DEF_CHARACTERISTIC /begin OUT_MEASUREMENT EGT_stByp_mp /end OUT_MEASUREMENT /end FUNCTION
/begin FUNCTION egt_corgn "Regenerationskoordinator Abgasnachbehandlung" /begin DEF_CHARACTERISTIC EGT_swtEGTActv_C EGT_tiRmpSlpMax_C /end DEF_CHARACTERISTIC /end FUNCTION
/begin FUNCTION egt_corgn_msg "" /begin OUT_MEASUREMENT EGT_stCoRgn EGT_stTSync EGT_swtEGTActv EGT_tiRgnTSync /end OUT_MEASUREMENT /end FUNCTION
/begin FUNCTION egt_corgn_uic "" /begin DEF_CHARACTERISTIC EGT_stTSync_Vector EGT_stTSync_Channel /end DEF_CHARACTERISTIC
 /begin OUT_MEASUREMENT EGT_stIntOld_mp EGT_stInt_mp EGT_stSubCoRgn_mp EGT_stTmp_mp EGT_stTSyncByp_mp /end OUT_MEASUREMENT
/end FUNCTION
/begin FUNCTION emccd "Komponententreiber der Motorlagersteuerung"
 /begin DEF_CHARACTERISTIC EMCCD_DebExcTempDef_C EMCCD_DebExcTempOk_C EMCCD_DebNoLoadDef_C EMCCD_DebNoLoadOk_C EMCCD_DebShortCircBatDef_C EMCCD_DebShortCircBatOk_C EMCCD_DebShortCircGndDef_C EMCCD_DebShortCircGndOk_C EMCCD_stEngMntCtl_Init_C EMCCD_swtEnOut_C EMCCD_swtInvOut_C EMCCD_tiG2checkDfpTmr_C EMCCD_tiG2OFFTmr_C EMCCD_tiM1checkDfpTmr_C EMCCD_tiM1OFFTmr_C /end DEF_CHARACTERISTIC
/end FUNCTION
/begin FUNCTION emccd_uic ""
 /begin OUT_MEASUREMENT EMCCD_stEngMntCtl1_mp EMCCD_stOutHWEG2_mp EMCCD_stOutHWEM1_mp /end OUT_MEASUREMENT
/end FUNCTION
/begin FUNCTION eng "Motor" /begin DEF_CHARACTERISTIC Eng_ctEngSpdDiffCalc_C Eng_trqSpd_CUR /end DEF_CHARACTERISTIC /begin IN_MEASUREMENT Eng_nAvrg /end IN_MEASUREMENT /end FUNCTION
/begin FUNCTION engm "Motormechanik"
 /begin DEF_CHARACTERISTIC EngM_dLimitCond_ASD_CA EngM_dLimitCond_Common_CA EngM_dLimitCond_FBC_CA EngM_dLimitCond_Joint_CA EngM_dLimitCond_LiGov_CA EngM_dLimitCond_Pilot_CA EngM_nLimitInj_C EngM_nLimitThreshHyst_CA EngM_nLimitThresh_CA EngM_nSwtCoMa_C EngM_numLimitInj_C /end DEF_CHARACTERISTIC
/end FUNCTION
/begin FUNCTION engmon_irrcmb "Verbrennungserkennung mit Lambdasonde"
 /begin DEF_CHARACTERISTIC EngMon_DebIrrCmbStepUp_C EngMon_DebIrrCmbStepDown_C EngMon_DebIrrCmbDef_C EngMon_DebIrrCmbOk_C EngMon_nMonActv_C EngMon_rO2MaxVal_C EngMon_stActv_C EngMon_tiFltPT1_C EngMon_tiDel_C EngMon_tiMonActv_C /end DEF_CHARACTERISTIC
/end FUNCTION
/begin FUNCTION engmon_irrcmb_msg "" /begin OUT_MEASUREMENT EngMon_stShOffIrrCmb /end OUT_MEASUREMENT /end FUNCTION
/begin FUNCTION engmon_irrcmb_uic "" /begin OUT_MEASUREMENT EngMon_rO2Thres_mp EngMon_stMon_mp EngMon_stTstRslt_mp /end OUT_MEASUREMENT /end FUNCTION
/begin FUNCTION engm_ang ""
 /begin DEF_CHARACTERISTIC EngM_ctOfsCaSCrS_C EngM_ctPhWhlRev_C EngM_ctPostSync_C EngM_ctReSync_C EngM_ctVerSync_C EngM_nMaxStrt_C EngM_numPin_C EngM_nWaitIncSig_C EngM_phiDelayPhNoSig_C EngM_phiDeltaExtSync_C EngM_phiDelta_C EngM_phiFrstInjInt_C EngM_phiInt_C EngM_phiMax_C EngM_phiTDC_C EngM_stSyncBefGap_C EngM_swtExitOfs_C EngM_swtFirSeqFBC_C EngM_swtSyncViaCAN_C EngM_tiCpuTimeOut_C EngM_tiDiffInt_C EngM_tiWaitIncSig_C /end DEF_CHARACTERISTIC
/end FUNCTION
/begin FUNCTION engm_angdiag "Diagnose des Kurbelwellen- und Nockenwellensignals"
 /begin DEF_CHARACTERISTIC EngM_ctSpdtoZero_C EngM_DebIncCaSErrSigDef_C EngM_DebIncCaSErrSigOK_C EngM_DebIncCaSNoSigDef_C EngM_DebIncCrSErrSigDef_C EngM_DebIncCrSErrSigOK_C EngM_DebIncOfsSigCaSCrSDef_C EngM_DebPhCrSErrSigDef_C EngM_nMinDiag_C /end DEF_CHARACTERISTIC
/end FUNCTION
/begin FUNCTION engm_angdiag_uic ""
 /begin OUT_MEASUREMENT EngM_ctIncErrSigDiagCaSDef_mp EngM_ctIncErrSigDiagCaSOk_mp EngM_ctIncErrSigDiagCrSDef_mp EngM_ctIncErrSigDiagCrSOK_mp EngM_ctIncErrSigDiagmaxCaSDef_mp EngM_ctIncErrSigDiagmaxCaSOk_mp EngM_ctIncErrSigDiagmaxCrSDef_mp EngM_ctIncNoSigDiagCaS_mp EngM_ctIncNoSigDiagmaxCaS_mp EngM_ctPhErrSigDiagCrSDef_mp EngM_ctPhErrSigDiagmaxCrSDef_mp EngM_ctSpdtoZero_mp /end OUT_MEASUREMENT
/end FUNCTION
/begin FUNCTION engm_ang_msg ""
 /begin OUT_MEASUREMENT EngM_nDyn EngM_numInt EngM_numLastTDC EngM_numSyncTDC EngM_numTDC EngM_phiDiffTDC EngM_phiInt EngM_phiIntExt EngM_phiTDC EngM_stCaSExt EngM_stCaSVerifyDiag EngM_stErrCanExt EngM_stEvent EngM_stInjCharSetVal EngM_stNext EngM_stNextExt EngM_stSync EngM_tiSeg EngM_tiSegLimAvrg EngM_tiSegTwo /end OUT_MEASUREMENT
/end FUNCTION
/begin FUNCTION engm_ang_uic ""
 /begin OUT_MEASUREMENT EngM_ctIntOvrLoad_mp EngM_ctPostSync_mp EngM_ctReSync_mp EngM_ctVerSync_mp EngM_numRevCnt_mp EngM_phiIntExtCorr_mp EngM_SchedDelta_mp EngM_SchedIndex_mp EngM_SchedLimitInt_mp EngM_SchedSegID_mp EngM_stEventEnable_mp EngM_stEventServed_mp EngM_tiDiffInt_mp /end OUT_MEASUREMENT
/end FUNCTION
/begin FUNCTION engm_backup "Start und Betrieb des Motors nur mit Nockenwellensignal"
 /begin DEF_CHARACTERISTIC EngM_nMaxStrtBackUp_C EngM_stBackUpVar_C EngM_stEnaBackUp_C /end DEF_CHARACTERISTIC
/end FUNCTION
/begin FUNCTION engm_backup_uic "" /end FUNCTION
/begin FUNCTION engm_chkd "" /begin DEF_CHARACTERISTIC EngM_swtNumCylVal_C EngM_swtNumCylType_C /end DEF_CHARACTERISTIC /end FUNCTION
/begin FUNCTION engm_engmntctl "Motorlagersteuerung"
 /begin DEF_CHARACTERISTIC EngM_rNOnOffGL_CUR EngM_rNOnOffML_CUR EngM_swtEngMntCtlVal_C EngM_swtEngMntCtlType_C EngM_swtModeGL_C EngM_swtModeML_C EngM_trqHysGL_C EngM_trqHysML_C EngM_trqValGL_C EngM_trqValML_C EngM_vHiHysGL_C EngM_vHiHysML_C EngM_vHiValGL_C EngM_vHiValML_C EngM_vLoHysGL_C EngM_vLoHysML_C EngM_vLoValGL_C EngM_vLoValML_C /end DEF_CHARACTERISTIC
 /begin IN_MEASUREMENT Eng_nAvrg /end IN_MEASUREMENT
/end FUNCTION
/begin FUNCTION engm_engmntctl_msg ""
 /begin OUT_MEASUREMENT EngM_stEngMntCtl EngM_stEngMntCtl_GTL1 EngM_stEngMntCtl_GTL2 EngM_stEngMntCtl_MLS1 EngM_stEngMntCtl_MLS2 EngM_swtEngMntCtl /end OUT_MEASUREMENT
/end FUNCTION
/begin FUNCTION engm_engmntctl_uic "" /begin OUT_MEASUREMENT EngM_stStatGL_mp EngM_stStatML_mp /end OUT_MEASUREMENT /end FUNCTION
/begin FUNCTION engm_msg "" /begin OUT_MEASUREMENT EngM_numCyl EngM_stSpd /end OUT_MEASUREMENT /end FUNCTION
/begin FUNCTION engm_rev_msg "" /begin OUT_MEASUREMENT EngM_ctRevIni EngM_ctRevSta /end OUT_MEASUREMENT /end FUNCTION
/begin FUNCTION engm_soptst "" /end FUNCTION
/begin FUNCTION engm_trqfrc "aktuelles Reibmoment" /begin DEF_CHARACTERISTIC EngM_swtTempTrqFrc_C EngM_trqFrcMin_CUR EngM_trqFrc_MAP /end DEF_CHARACTERISTIC /begin IN_MEASUREMENT EngM_tTrqFrc_mp Eng_nAvrg /end IN_MEASUREMENT /end FUNCTION
/begin FUNCTION engm_trqfrc_msg "" /begin OUT_MEASUREMENT EngM_swtTempTrqFrc EngM_trqFrc EngM_trqFrcMin /end OUT_MEASUREMENT /end FUNCTION
/begin FUNCTION engm_trqfrc_uic "" /begin OUT_MEASUREMENT EngM_tTrqFrc_mp /end OUT_MEASUREMENT /end FUNCTION
/begin FUNCTION engm_uic "" /end FUNCTION
/begin FUNCTION engprt "Motormechanikschutz"
 /begin DEF_CHARACTERISTIC EngPrt_DebSigDef_C EngPrt_DebSigOk_C EngPrt_nOvrSpd_C EngPrt_nThrClo_C EngPrt_nThrOpen_C EngPrt_qLimP_MAP EngPrt_dtrqUpNLim_C EngPrt_dtrqDwnNLim_C EngPrt_rThrCloAct_C EngPrt_rThrClo_C EngPrt_swtLimPMap_C EngPrt_swtTrqLimEco_C EngPrt_tiDelOvrSpd_C EngPrt_tiThrClo_C EngPrt_trqLimP_MAP EngPrt_trqLimrVnNoPI_MAP EngPrt_trqNEcoLim_CUR EngPrt_trqNLimSpr_CUR EngPrt_trqNLim_CUR /end DEF_CHARACTERISTIC
 /begin IN_MEASUREMENT APSCD_pVal Eng_nAvrg VehDa_rVn /end IN_MEASUREMENT
/end FUNCTION
/begin FUNCTION engprt_msg ""
 /begin OUT_MEASUREMENT EngPrt_stOvrSpd EngPrt_stOvrSpdMon EngPrt_stTempPrtShiftUp EngPrt_stThrCloAct EngPrt_stThrCloMon EngPrt_trqAST EngPrt_trqLim EngPrt_trqNLim EngPrt_trqPrtLim /end OUT_MEASUREMENT
/end FUNCTION
/begin FUNCTION engprt_prtlim_var_uic ""
 /begin OUT_MEASUREMENT EngPrt_facAirOvhtLim_mp EngPrt_facAPLim_mp EngPrt_facCTOvhtLim_mp EngPrt_facCTOvhtSwt_mp EngPrt_facFlClgLim_mp EngPrt_facOilOvhtLim_mp EngPrt_facTempPreTrbn_mp EngPrt_facTnkTempLim_mp EngPrt_pVal_mp EngPrt_tFuelVirt_mp EngPrt_tFuel_mp EngPrt_tPreTrbn_mp EngPrt_trqIncLoadClt_mp /end OUT_MEASUREMENT
/end FUNCTION
/begin FUNCTION engprt_uic "" /begin OUT_MEASUREMENT EngPrt_trqLimP_mp EngPrt_trqLimrVn_mp EngPrt_trqNEcoLim_mp /end OUT_MEASUREMENT /end FUNCTION
/begin FUNCTION engprt_var ""
 /begin DEF_CHARACTERISTIC EngPrt_dfacCTOvhtUp_C EngPrt_dfacCTOvhtDwn_C EngPrt_facFlClgDSPHysXLow_C EngPrt_facFlClgDSPHysXHigh_C EngPrt_stFlClgDSPHysYLow_C EngPrt_stFlClgDSPHysYHigh_C EngPrt_facAirOvhtPrv_MAP EngPrt_facAPCorr_MAP EngPrt_facBPAPIncLoadCorr_MAP EngPrt_facCTOvhtPrv_MAP EngPrt_facFlTempLim_MAP EngPrt_facOilOvhtPrv_MAP EngPrt_facTempPreTrbn_MAP EngPrt_facTnkTempLim_MAP EngPrt_nIncLoadHigh_C EngPrt_nIncLoadLow_C EngPrt_nOvhtThresHigh_C EngPrt_nOvhtThresLow_C EngPrt_tiPreTrbnPT1_C EngPrt_swtAPBP_C EngPrt_swtEGSys2_C EngPrt_swtFlTempVirtEna_C EngPrt_swtOilOvhtPrevVal_C EngPrt_swtOilOvhtPrevType_C EngPrt_swtTempPreTrbnVal_C EngPrt_swtTempPreTrbnType_C EngPrt_tAirHysShiftHigh_C EngPrt_tAirHysShiftLow_C EngPrt_tClntHysShiftHigh_C EngPrt_tClntHysShiftLow_C EngPrt_tEngOilHysShiftHigh_C EngPrt_tEngOilHysShiftLow_C EngPrt_tFuelVirt_MAP EngPrt_trqIncLoad_MAP /end DEF_CHARACTERISTIC
 /begin IN_MEASUREMENT APSCD_pVal CTSCD_tClntCan EngM_ctRevSta EngPrt_pVal_mp EngPrt_tFuel_mp EngPrt_tPreTrbn_mp Eng_nAvrg Eng_tEng FTSCD_tFuel IATSCD_tAir OTSCD_tEngOil TTSCD_tTnk VSSCD_v /end IN_MEASUREMENT
/end FUNCTION
/begin FUNCTION engprt_var_msg ""
 /begin OUT_MEASUREMENT EngPrt_facPrtLimCorr EngPrt_stFlClgDSP EngPrt_swtOilOvhtPrv EngPrt_swtTempPreTrbn EngPrt_trqIncLoad /end OUT_MEASUREMENT
/end FUNCTION
/begin FUNCTION eng_msg "" /begin OUT_MEASUREMENT Eng_dnAvrg Eng_nAvrg Eng_nCurr Eng_trqCrvMax /end OUT_MEASUREMENT /end FUNCTION
/begin FUNCTION eng_teng "Motortemperatur" /begin DEF_CHARACTERISTIC Eng_dtEng_MAP /end DEF_CHARACTERISTIC /begin IN_MEASUREMENT EngM_ctRevSta Eng_dtEngSub_mp /end IN_MEASUREMENT /end FUNCTION
/begin FUNCTION eng_teng_msg "" /begin OUT_MEASUREMENT Eng_tEng Eng_tFld /end OUT_MEASUREMENT /end FUNCTION
/begin FUNCTION eng_teng_uic "" /begin OUT_MEASUREMENT Eng_dtEngCorr_mp Eng_dtEngSub_mp /end OUT_MEASUREMENT /end FUNCTION
/begin FUNCTION eng_var "" /end FUNCTION
/begin FUNCTION eng_var_msg "" /begin OUT_MEASUREMENT Eng_stEngSpd /end OUT_MEASUREMENT /end FUNCTION
/begin FUNCTION ercosrtm "" /begin DEF_CHARACTERISTIC Ertm_swMaxReset_u8 Ertm_tiMeasTime_u16 /end DEF_CHARACTERISTIC /end FUNCTION
/begin FUNCTION ercosrtm_msg "" /begin OUT_MEASUREMENT Ertm_tiload_u32 Ertm_timax_u32 Ertm_tiProc_u32 /end OUT_MEASUREMENT /end FUNCTION
/begin FUNCTION erlpcd "Fehlerlampe Komponententreiber"
 /begin DEF_CHARACTERISTIC ErLpCD_tiDebMILReqOnDef_C ErLpCD_tiDebMILReqOnOk_C ErLpCD_stMilInvOut_C ErLpCD_stPwrStgLampActv_C ErLpCD_stPwrStgLampDia_C ErLpCD_stPwrStgMilActv_C ErLpCD_stPwrStgMilDia_C ErLpCD_stSysLampInvOut_C ErLpCD_swtMILVal_C ErLpCD_swtMILType_C ErLpCD_swtSYSVal_C ErLpCD_swtSYSType_C ErLpCD_tiSysLampBlkDia_C ErLp_tiMilDefectTime_C ErLp_tiMilOkTime_C ErLp_MilEngN_C ErLp_tiMilMax_C ErLp_tiMilTst_C ErLp_tiMilDel_C ErLp_tiMilBlk_C ErLp_swtMilEn_C ErLp_swtSysEqGlwLamp_C ErLp_tiSysLampDefectTime_C ErLp_tiSysLampOkTime_C ErLp_SysLampEngN_C ErLp_tiSysLampMax_C ErLp_tiSysLampTst_C ErLp_tiSysLampDel_C ErLp_tiSysLampBlk_C ErLp_swtSysLampEn_C /end DEF_CHARACTERISTIC
/end FUNCTION
/begin FUNCTION erlpcd_msg ""
 /begin OUT_MEASUREMENT ErLpCD_OrdGlwLamp ErLpCD_stMil ErLpCD_stMilReq ErLpCD_stSysLamp ErLpCD_stSysLampOut ErLpCD_stSysLampReq ErLpCD_swtMIL ErLpCD_swtSYS /end OUT_MEASUREMENT
/end FUNCTION
/begin FUNCTION erlpcd_uic ""
 /begin OUT_MEASUREMENT ErLpCD_rHWEMILOut_mp ErLpCD_rHWESysLampOut_mp ErLpCD_stMIL_mp ErLpCD_stSysLamp_mp /end OUT_MEASUREMENT
/end FUNCTION
/begin FUNCTION error "" /end FUNCTION
/begin FUNCTION ess_getnmin "Leerlaufanhebung bei schwacher Batterie"
 /begin DEF_CHARACTERISTIC ESS_nBattIncrMin_C ESS_nBattMinThres_C ESS_nBattMin_C ESS_nLIBattThres_C ESS_tiDelayUBattFFSet_C ESS_uLIBattThresFFSet_C /end DEF_CHARACTERISTIC
/end FUNCTION
/begin FUNCTION ess_getnmin_uic "" /end FUNCTION
/begin FUNCTION ess_getnmin_var ""
 /begin DEF_CHARACTERISTIC ESS_tiDelayStrtDoneFFSet_C ESS_tiDelayUBattFFRes_C ESS_uLIBattThresFFRes_C /end DEF_CHARACTERISTIC
/end FUNCTION
/begin FUNCTION ess_getnmin_var_uic ""
 /begin OUT_MEASUREMENT ESS_stNBattFFRes_mp ESS_stNBattFFSet_mp ESS_stStrtDoneFFSet_mp ESS_stUBattFFRes_mp ESS_stUBattFFSet_mp /end OUT_MEASUREMENT
/end FUNCTION
/begin FUNCTION ess_msg "" /begin OUT_MEASUREMENT ESS_nBattMin ESS_nMax ESS_nMin ESS_pwrDes ESS_pwrLead /end OUT_MEASUREMENT /end FUNCTION
/begin FUNCTION ess_updatedem "" /end FUNCTION
/begin FUNCTION ess_updatedem_uic "" /end FUNCTION
/begin FUNCTION etclb_calibration "Ansteuerdauer Kalibrierung"
 /begin DEF_CHARACTERISTIC ETClb_ctLrnThresQck_C ETClb_ctLrnThres_C ETClb_dpRailLim_CA ETClb_facFltQck_C ETClb_facFlt_C ETClb_numCyclMeas_C ETClb_numCyclNoDyn_C ETClb_numCyclStartEnergize_C ETClb_pRailSet_CA ETClb_SigThres_CA ETClb_swtCorActvVal_C ETClb_swtCorActvType_C ETClb_swtWrDflVal_C ETClb_tiInjThresQck_C ETClb_tiInjThres_C ETClb_volEffectiveMin_CA ETClb_vStartClb_CA ETClb_vStopClb_CA /end DEF_CHARACTERISTIC
 /begin OUT_MEASUREMENT ETClb_ctLrn_mp ETClb_dtiETFlt0_mp ETClb_dtiETFlt1_mp ETClb_dtiETFlt2_mp ETClb_numCylCur_mp ETClb_swtQckClb_mp ETClb_tiETCor0_mp ETClb_tiETCor1_mp ETClb_tiETCor2_mp ETClb_tiETCur_mp ETClb_tiETMinEff_mp ETClb_tiInjInit_mp /end OUT_MEASUREMENT
/end FUNCTION
/begin FUNCTION etclb_calibration_msg "" /begin OUT_MEASUREMENT ETClb_stCor ETClb_swtCorActv /end OUT_MEASUREMENT /end FUNCTION
/begin FUNCTION etclb_calibration_uic ""
 /begin OUT_MEASUREMENT ETClb_ctInjCycl_mp ETClb_numPres_mp ETClb_numRailPresClbPnt_mp ETClb_stDemCor_mp ETClb_stRlsCylCor_mp ETClb_st_mp /end OUT_MEASUREMENT
/end FUNCTION
/begin FUNCTION etclb_eval "Auswertung von Einspritzungen fuer die Ansteuerdauer Kalibrierung"
 /begin DEF_CHARACTERISTIC ETClb_DebETMaxDefect_C ETClb_DebETMaxOk_C ETClb_DebETMinDefect_C ETClb_DebETMinOk_C ETClb_tiETStep_CA ETClb_tiET_MAX_CA ETClb_tiET_MIN_CA /end DEF_CHARACTERISTIC
 /begin OUT_MEASUREMENT ETClb_stEval_mp /end OUT_MEASUREMENT
/end FUNCTION
/begin FUNCTION etclb_eval_uic "" /begin OUT_MEASUREMENT ETClb_stEvalResult_mp /end OUT_MEASUREMENT /end FUNCTION
/begin FUNCTION etclb_lib ""
 /begin DEF_CHARACTERISTIC ETClb_ctDflLrn_CA ETClb_dtiDflETFlt0_CA ETClb_dtiDflETFlt1_CA ETClb_dtiDflETFlt2_CA ETClb_numDflCylCur_CA ETClb_swtDflQckClb_C ETClb_tiDflETCur_CA ETClb_tiDflInjInit_C /end DEF_CHARACTERISTIC
/end FUNCTION
/begin FUNCTION etclb_lib_uic "" /end FUNCTION
/begin FUNCTION fancd_co "Komponententreiber Lüfter Koordination"
 /begin DEF_CHARACTERISTIC FanCD_ctShutOffPeriods_C FanCD_tiDebFan1Ctlr1Def_C FanCD_tiDebFan1Ctlr1Ok_C FanCD_tiDebFan1Ctlr2Def_C FanCD_tiDebFan1Ctlr2Ok_C FanCD_tiDebFan2Ctlr1Def_C FanCD_tiDebFan2Ctlr1Ok_C FanCD_tiDebFan2Ctlr2Def_C FanCD_tiDebFan2Ctlr2Ok_C FanCD_tiDebFanCtlr1Def_C FanCD_tiDebFanCtlr1Ok_C FanCD_tiDebFanCtlr2Def_C FanCD_tiDebFanCtlr2Ok_C FanCD_Fan1DebExcTempDef_C FanCD_Fan1DebExcTempOk_C FanCD_Fan1DebNoLoadDef_C FanCD_Fan1DebNoLoadOk_C FanCD_Fan1DebShortCircBatDef_C FanCD_Fan1DebShortCircBatOk_C FanCD_Fan1DebShortCircGndDef_C FanCD_Fan1DebShortCircGndOk_C FanCD_Fan2DebExcTempDef_C FanCD_Fan2DebExcTempOk_C FanCD_Fan2DebNoLoadDef_C FanCD_Fan2DebNoLoadOk_C FanCD_Fan2DebShortCircBatDef_C FanCD_Fan2DebShortCircBatOk_C FanCD_Fan2DebShortCircGndDef_C FanCD_Fan2DebShortCircGndOk_C FanCD_tiFanCtlr1Min_C FanCD_tiFanCtlr1Max_C FanCD_tiFanCtlr2Min_C FanCD_tiFanCtlr2Max_C FanCD_tiFanCtlr3Min_C FanCD_tiFanCtlr3Max_C FanCD_tiFanCtlr4Min_C FanCD_tiFanCtlr4Max_C FanCD_tiFanCtlr5Min_C FanCD_tiFanCtlr5Max_C FanCD_tiFanCtlr6Min_C FanCD_tiFanCtlr6Max_C FanCD_tiFanCtlrErrIdlMin_C FanCD_tiFanCtlrErrIdlMax_C FanCD_numErrThres_C FanCD_rFan1Tst_C FanCD_rFan2Tst_C FanCD_rShutOff_CA FanCD_stStage1InvOut_C FanCD_tiStage1Per_C FanCD_stStage2InvOut_C FanCD_tiStage2Per_C FanCD_swtFanShutOffVal_C FanCD_swtFanShutOffType_C FanCD_tiFan1BtwTst_C FanCD_tiFan2BtwTst_C FanCD_tiFANcheckDfpTmr_C FanCD_tiFanOFFTmr_C FanCD_tiShutOffBreak_C FanCD_tiShutOffPeriod_C /end DEF_CHARACTERISTIC
/end FUNCTION
/begin FUNCTION fancd_co_uic ""
 /begin OUT_MEASUREMENT FanCD_numFanCtlr1ErrCnt_mp FanCD_numFanCtlr2ErrCnt_mp FanCD_rFan1HWE_mp FanCD_rFan2HWE_mp FanCD_stFanCtlr1ErrStrt_mp FanCD_stFanCtlr2ErrStrt_mp /end OUT_MEASUREMENT
/end FUNCTION
/begin FUNCTION fancd_msg "" /begin OUT_MEASUREMENT FanCD_stShutOff FanCD_swtFanShutOff /end OUT_MEASUREMENT /end FUNCTION
/begin FUNCTION fanctl_co "Lüftersteuerung Koordination"
 /begin DEF_CHARACTERISTIC FanCtl_dcycBSGmax_C FanCtl_dcycCtTThres1_C FanCtl_dcycCtTThres2_C FanCtl_dcycFan1HiLim_C FanCtl_dcycFan1LoLim_C FanCtl_dcycFan1Preset1_C FanCtl_dcycFan1Preset2_C FanCtl_dcycFan1Preset3_MAP FanCtl_dcycFan1ShutOff_C FanCtl_dcycFan1_CUR FanCtl_dcycFan2HiLim_C FanCtl_dcycFan2LoLim_C FanCtl_dcycFan2Preset1_C FanCtl_dcycFan2Preset2_C FanCtl_dcycFan2Preset3_MAP FanCtl_dcycFan2ShutOff_C FanCtl_dcycFan2_CUR FanCtl_dcycRampBSGUp_C FanCtl_dcycRampBSGDown_C FanCtl_dtClntDesCorrDfl_C FanCtl_dtClntDesCorr_MAP FanCtl_dtClntDesDiff_MAP FanCtl_dtCtTClntDiffThres1_C FanCtl_dtCtTClntDiffThres2_C FanCtl_factACReqCorr_CUR FanCtl_factApReqCorr_CUR FanCtl_factApReq_MAP FanCtl_factARBaseCor_CUR FanCtl_factBattCorr1_CUR FanCtl_factBattCorr2_CUR FanCtl_factCorr_CUR FanCtl_nFan1Base_MAP FanCtl_nFan1MinThres1_C FanCtl_nFan1MaxThres1_C FanCtl_nFan1MinThres2_C FanCtl_nFan1MaxThres2_C FanCtl_nFan1MinThres3_C FanCtl_nFan1MaxThres3_C FanCtl_nFan1MinThres4_C FanCtl_nFan1MaxThres4_C FanCtl_nFan1MinThres5_C FanCtl_nFan1MaxThres5_C FanCtl_nFan1XLow_C FanCtl_nFan1XHigh_C FanCtl_stFan1YLow_C FanCtl_stFan1YHigh_C FanCtl_nFan1Min_C FanCtl_nFan2Base_MAP FanCtl_nFan2MinThres1_C FanCtl_nFan2MaxThres1_C FanCtl_nFan2MinThres2_C FanCtl_nFan2MaxThres2_C FanCtl_nFan2MinThres3_C FanCtl_nFan2MaxThres3_C FanCtl_nFan2MinThres4_C FanCtl_nFan2MaxThres4_C FanCtl_nFan2MinThres5_C FanCtl_nFan2MaxThres5_C FanCtl_nFan2XLow_C FanCtl_nFan2XHigh_C FanCtl_stFan2YLow_C FanCtl_stFan2YHigh_C FanCtl_nFan2Min_C FanCtl_pACCDDfl_C FanCtl_pAcHigh_C FanCtl_pAcLow_C FanCtl_RglIKi_C FanCtl_RglIKiPos_C FanCtl_RglIKiNeg_C FanCtl_RglIWinPos_C FanCtl_RglIWinNeg_C FanCtl_tiPT1Neg_C FanCtl_tiPT1Pos_C FanCtl_dprcRampFan1Up_C FanCtl_dprcRampFan1Down_C FanCtl_dprcRampFan2Up_C FanCtl_dprcRampFan2Down_C FanCtl_prcARTime_C FanCtl_prcCanReq_CUR FanCtl_prcClntInc_CUR FanCtl_prcCnv_MAP FanCtl_prcCtl_MAP FanCtl_prcFanDfl_C FanCtl_prcHiLimI_C FanCtl_prcLoLimI_C FanCtl_prcHiLim_C FanCtl_prcLoLim_C FanCtl_prcQKakt_MAP FanCtl_prcQKdeakt_CUR FanCtl_prcRelClntDesPreset_C FanCtl_stFanVar_C FanCtl_swtClgModVarVal_C FanCtl_swtClgModVarType_C FanCtl_tARThres_CUR FanCtl_tClntCrit_MAP FanCtl_tClntDesPreset_C FanCtl_tClntDesRaw_MAP FanCtl_tClntDes_MAP FanCtl_dtCOTSCritXLow_C FanCtl_dtCOTSCritXHi_C FanCtl_stCOTSCritYLow_C FanCtl_stCOTSCritYHi_C FanCtl_tCOTSCrit_C FanCtl_tCOTSPreset_C FanCtl_tCTSCritXLow_C FanCtl_tCTSCritXHi_C FanCtl_stCTSCritYLow_C FanCtl_stCTSCritYHi_C FanCtl_tiAfterrunFan1_C FanCtl_tiAfterrunFan2_C FanCtl_tiARBase_MAP FanCtl_tiARCor1_MAP FanCtl_tiARCor2_MAP FanCtl_tiARmax_C FanCtl_tiARmin_C FanCtl_tiAROilCorDfl_C FanCtl_tiAROilCor_CUR FanCtl_tiARShutOffFan1_C FanCtl_tiARShutOffFan2_C FanCtl_tiClntDesCorrDly1_C FanCtl_tiClntDesCorrDly2_C FanCtl_tiStartDly_C FanCtl_vPreset2_C FanCtl_vPreset_C /end DEF_CHARACTERISTIC
 /begin IN_MEASUREMENT APSCD_pVal BattCD_u CoEng_dvolFlConsumFlt CoEng_trqInrSet CTSCD_tClnt CTSCD_tClntCan CtTCtl_dtClntDiff EATSCD_tAir Eng_nAvrg FanCtl_dcycFan1 FanCtl_dcycFan2 FanCtl_dtClntDes_mp FanCtl_dvolFlConsumFltHold_mp FanCtl_nFan1 FanCtl_nFan2 FanCtl_pAc_mp FanCtl_prcRelClntDes2_mp FanCtl_tClntDesFlt_mp FanCtl_tCTSCurr_mp FanCtl_vCurr2_mp FanCtl_vCurr_mp FrmMng_stClgGearbx IATSCD_tAir OTSCD_tEngOil VSSCD_v /end IN_MEASUREMENT
 /begin OUT_MEASUREMENT FanCtl_dcycFan1BSG_mp FanCtl_dcycFan2BSG_mp FanCtl_factACReqCorr_mp FanCtl_factApReq_mp FanCtl_prcACReq_mp FanCtl_prcAC_mp FanCtl_prcAddReq_mp FanCtl_prcCanReq_mp FanCtl_prcClntInc_mp FanCtl_prcCtl_mp FanCtl_prcFan_mp FanCtl_prcQDes_mp FanCtl_prcRampFan1_mp FanCtl_prcRampFan2_mp /end OUT_MEASUREMENT
/end FUNCTION
/begin FUNCTION fanctl_co_msg ""
 /begin OUT_MEASUREMENT FanCtl_dcycFan1 FanCtl_dcycFan2 FanCtl_nFan1 FanCtl_nFan2 FanCtl_prcCAN FanCtl_stAfterrunRamp FanCtl_stOut FanCtl_stShutOffRamp FanCtl_stStrt FanCtl_swtClgModVar /end OUT_MEASUREMENT
/end FUNCTION
/begin COMPU_METHOD AngleCrS "Winkel Kurbelwelle" RAT_FUNC "%6.4" "[deg CrS]" COEFFS 0 42.6666666666667 0 0 0 1 /end COMPU_METHOD
/begin COMPU_METHOD Area "Flaeche mit hoher Aufloesung" RAT_FUNC "%6.5" "[m*m]" COEFFS 0 8192 0 0 0 1 /end COMPU_METHOD
/begin COMPU_METHOD dn_dZ20 "Motorbeschleunigung pro Zeit (dn/dt) (im 20 ms Raster)" RAT_FUNC "%6.1" "[rpm/s]" COEFFS 0 0.1 0 0 0 1 /end COMPU_METHOD
/begin COMPU_METHOD DtyCyc "Tastverhaeltnis" RAT_FUNC "%6.4" "[%]" COEFFS 0 100 0 0 0 1 /end COMPU_METHOD
/begin COMPU_METHOD EngN "Motordrehzahl" RAT_FUNC "%6.2" "[rpm]" COEFFS 0 1 0 0 0 1 /end COMPU_METHOD
/begin COMPU_METHOD EngTempFldSel "Verbale Umrechnung für Auswahl aus dem Motortemperatur-Feld Eng_tFld" TAB_VERB "%6.3" "" COMPU_TAB_REF EngTempFldSel /end COMPU_METHOD
/begin COMPU_VTAB EngTempFldSel "Verbale Umrechnung für Auswahl aus dem Motortemperatur-Feld Eng_tFld" TAB_VERB 5 0 "Coolant_Temperature" 1 "Oil_Temperature" 2 "Engine_Temperature" 3 "Fuel_Temperature" 4 "Coolant_Temperature_CAN" /end COMPU_VTAB
/begin COMPU_METHOD Ertm_Tim "Umrechunung für die Idle Task Laufzeit [%]" RAT_FUNC "%6.4" "[%]" COEFFS 0 100 0 0 0 1 /end COMPU_METHOD
/begin COMPU_METHOD ETClb_Eval_Rslt "Umrechnung der Zustände der  Ansteuerdauerkalibrierungsauswertung" TAB_VERB "%6.3" "-" COMPU_TAB_REF ETClb_Eval_Rslt /end COMPU_METHOD
/begin COMPU_VTAB ETClb_Eval_Rslt "Umrechnung der Zustände der  Ansteuerdauerkalibrierungsauswertung" TAB_VERB 3 0 "ZFC_ST_CLB_CONT" 1 "ZFC_ST_CLB_END" 2 "ZFC_ST_CLB_ERR" /end COMPU_VTAB
/begin COMPU_METHOD ETClb_Eval_State "Umrechnung der Zustände der Ausgabe des Zustandsautomaten der Evaluierung der Nullmengenkalibrierung" TAB_VERB "%6.3" "-" COMPU_TAB_REF ETClb_Eval_State /end COMPU_METHOD
/begin COMPU_VTAB ETClb_Eval_State "Umrechnung der Zustände der Ausgabe des Zustandsautomaten der Evaluierung der Nullmengenkalibrierung" TAB_VERB 3 0 "ETCLB_ST_EVAL_INIT" 1 "ETCLB_ST_EVAL_ADD" 2 "ETCLB_ST_EVAL_SUB" /end COMPU_VTAB
/begin COMPU_METHOD ETClb_State "Zustand des Zusandsautmaten der Ansteuerdauerkalibrierung" TAB_VERB "%6.3" "-" COMPU_TAB_REF ETClb_State /end COMPU_METHOD
/begin COMPU_VTAB ETClb_State "Zustand des Zusandsautmaten der Ansteuerdauerkalibrierung" TAB_VERB 4 0 "ETCLB_ST_NOT_ACTV" 1 "ETCLB_ST_START_ENERGIZE" 2 "ETCLB_ST_MEASURE" 3 "ETCLB_ST_EVALUATE" /end COMPU_VTAB
/begin COMPU_METHOD Fact "Faktor mit Auflösung 1 / 8192, hauptsächlich für einen Faktorenbereich 0...1 verwendet" RAT_FUNC "%6.5" "[-]" COEFFS 0 8192 0 0 0 1 /end COMPU_METHOD
/begin COMPU_METHOD Fact_PT1 "Faktor um die Zeitkonstante eines PT1 filters festzulegen (Taupunktermittlung)" RAT_FUNC "%6.4" "[W/K]" COEFFS 0 128 0 0 0 1 /end COMPU_METHOD
/begin COMPU_METHOD FlConsum_l_h "Kraftstoffverbrauch" RAT_FUNC "%6.4" "[l/h]" COEFFS 0 100 0 0 0 1 /end COMPU_METHOD
/begin COMPU_METHOD HeatCapacity "Waermekapazitaet einer Substanz" RAT_FUNC "%6.3" "[J/K]" COEFFS 0 10 0 0 0 1 /end COMPU_METHOD
/begin COMPU_METHOD InjMass "Einspritzmenge" RAT_FUNC "%6.4" "[mg/hub]" COEFFS 0 100 0 0 0 1 /end COMPU_METHOD
/begin COMPU_METHOD InjQntInj "Einspritzmenge der einzelnen Einspritzung" RAT_FUNC "%6.4" "mm^3/inj" COEFFS 0 100 0 0 0 1 /end COMPU_METHOD
/begin COMPU_METHOD InjTime_us "Zeit in Microsekunden für das Einspritztiming" RAT_FUNC "%6.2" "[us]" COEFFS 0 1 0 0 0 1 /end COMPU_METHOD
/begin COMPU_METHOD Ki_Kelv_Sec "Verstärkungskonstante für Integrator für zeitliche Ableitung der Temperatur" RAT_FUNC "%6.4" "1/s" COEFFS 0 429.4967296 0 0 0 1 /end COMPU_METHOD
/begin COMPU_METHOD Ki_Temp2Prc "Integralzunahme (Temperatur zu Prozent)" RAT_FUNC "%7.6" "[%/(s deg C)]" COEFFS 0 42949.67296 0 0 0 1 /end COMPU_METHOD
/begin COMPU_METHOD Ki_Trq2TrqT "Integrale Verstärkung Ki (Getriebeausgangsmoment über die Zeit aufintegriert)" RAT_FUNC "%6.4" "[Nms]" COEFFS 0 858.9934592 0 0 0 1 /end COMPU_METHOD
/begin COMPU_METHOD Ki_Trq2TrqT2 "Integrale Verstärkung Ki (Kupplungsmoment über die Zeit aufintegriert)" RAT_FUNC "%6.4" "[Nms]" COEFFS 0 429.4967296 0 0 0 1 /end COMPU_METHOD
/begin COMPU_METHOD Length1 "Abstand in Meter" RAT_FUNC "%6.4" "[m]" COEFFS 0 128 0 0 0 1 /end COMPU_METHOD
/begin COMPU_METHOD O2 "Sauerstoffkonzentration" RAT_FUNC "%8.7" "[-]" COEFFS 0 100000 0 0 0 1 /end COMPU_METHOD
/begin COMPU_METHOD OneToOne "eins zu eins (physikalischer Wert ist gleich dem internen Wert)" RAT_FUNC "%6.2" "[-]" COEFFS 0 1 0 0 0 1 /end COMPU_METHOD
/begin COMPU_METHOD Period "Periodendauer" RAT_FUNC "%6.3" "[ms]" COEFFS 0 10 0 0 0 1 /end COMPU_METHOD
/begin COMPU_METHOD Prc "Prozent, gleiche interne Auflösung wie Fact, aber Darstellung in Prozent (0...100%)" RAT_FUNC "%6.4" "[%]" COEFFS 0 100 0 0 0 1 /end COMPU_METHOD
/begin COMPU_METHOD PresAC_hPa "Druck (Klimatisierung) angezeigt in [hPa]" RAT_FUNC "%6.2" "[hPa]" COEFFS 0 0.5 0 0 0 1 /end COMPU_METHOD
/begin COMPU_METHOD Pres_hPa "Druck (angezeigt in [hPa])" RAT_FUNC "%6.2" "[hPa]" COEFFS 0 1 0 0 0 1 /end COMPU_METHOD
/begin COMPU_METHOD Pres_Rail "Raildruck in hPa" RAT_FUNC "%6.0" "[hPa]" COEFFS 0 0.01 0 0 0 1 /end COMPU_METHOD
/begin COMPU_METHOD Pwr "Leistung" RAT_FUNC "%6.2" "[W]" COEFFS 0 0.10610329539459 0 0 0 1 /end COMPU_METHOD
/begin COMPU_METHOD Pwr1 "Leistung mit Hoher Aufloesung" RAT_FUNC "%6.3" "[W]" COEFFS 0 10 0 0 0 1 /end COMPU_METHOD
/begin COMPU_METHOD ReynoldsNum "Reynolds Nummer um den thermischen Koeffizienten zu bestimmen" RAT_FUNC "%6.0" "[-]" COEFFS 0 0.01 0 0 0 1 /end COMPU_METHOD
/begin COMPU_METHOD RmpDtyCyc "Rampengradient für Tastverhältnis" RAT_FUNC "%6.5" "[%/s]" COEFFS 0 6553.6 0 0 0 1 /end COMPU_METHOD
/begin COMPU_METHOD RmpPrc "Prozent Rampengradient" RAT_FUNC "%6.5" "[%/s]" COEFFS 0 6553.6 0 0 0 1 /end COMPU_METHOD
/begin COMPU_METHOD RmpTrq "Rampengradient für Motormoment" RAT_FUNC "%6.4" "[Nm/s]" COEFFS 0 655.36 0 0 0 1 /end COMPU_METHOD
/begin COMPU_METHOD Rmp_Fact "Rampenfaktorgradient" RAT_FUNC "%8.7" "[1/s]" COEFFS 0 536870.912 0 0 0 1 /end COMPU_METHOD
/begin COMPU_METHOD SpecificHeat "spezifische Waermekapazitaet einer Substanz" RAT_FUNC "%7.6" "[J/g/K]" COEFFS 0 10000 0 0 0 1 /end COMPU_METHOD
/begin COMPU_METHOD TempDiff_Kelv "Offsettemperatur dargestellt in [K]" RAT_FUNC "%6.3" "[ deg C ]" COEFFS 0 10 0 0 0 1 /end COMPU_METHOD
/begin COMPU_METHOD Temp_Cels "Temperatur dargestellt in °C (gleiche interne Darstellung wie Temp_Kelv)" RAT_FUNC "%6.1" "[deg C]" COEFFS 0 10 2731.4 0 0 1 /end COMPU_METHOD
/begin COMPU_METHOD Temp_Kelv_Sec "Temperaturaenderungsrate" RAT_FUNC "%6.4" "[deg C/s]" COEFFS 0 100 0 0 0 1 /end COMPU_METHOD
/begin COMPU_METHOD ThermalCoEff "Waermekoeffiziens einer Substanz" RAT_FUNC "%6.3" "[W/m/m/K]" COEFFS 0 10 0 0 0 1 /end COMPU_METHOD
/begin COMPU_METHOD TimeDelay_s "Zeitkonstante T1 (in s) für PT1, DT1, etc." RAT_FUNC "%9.3" "[s]" COEFFS 0 0 1 0 0.00023283064365387 0 /end COMPU_METHOD
/begin COMPU_METHOD TimeDT "Abtastzeit (in us) für Library Regler, Filter, etc." RAT_FUNC "%6.2" "[us]" COEFFS 0 1 0 0 0 1 /end COMPU_METHOD
/begin COMPU_METHOD TimeEngOn "Motorbetriebszeit in Sekunden" RAT_FUNC "%6.2" "[s]" COEFFS 0 1 0 0 0 1 /end COMPU_METHOD
/begin COMPU_METHOD TimeRed "Zeit in Sekunden mit reduzierter Auflösung für Ein/Ausgänge von KL/KF (sint16)" RAT_FUNC "%6.3" "[s]" COEFFS 0 6.25 0 0 0 1 /end COMPU_METHOD
/begin COMPU_METHOD TimeSys_us "Zeit in [us] mit Systemzeit-Auflösung" RAT_FUNC "%6.3" "us" COEFFS 0 3.4965 0 0 0 1 /end COMPU_METHOD
/begin COMPU_METHOD Time_ms "Zeit in ms für Fehlerentprellung (DSM) und SW-Timer" RAT_FUNC "%6.1" "[ms]" COEFFS 0 0.1 0 0 0 1 /end COMPU_METHOD
/begin COMPU_METHOD Time_s "Zeit in s für Fehlerentprellung (DSM) und SW-Timer" RAT_FUNC "%6.4" "[s]" COEFFS 0 100 0 0 0 1 /end COMPU_METHOD
/begin COMPU_METHOD Time_us "Zeit in Mikrosekunden für Fehlerentprellung (DSM) und SW-Timer" RAT_FUNC "%8.0" "[us]" COEFFS 0 0.0001 0 0 0 1 /end COMPU_METHOD
/begin COMPU_METHOD Trq "Motormoment" RAT_FUNC "%6.3" "[Nm]" COEFFS 0 10 0 0 0 1 /end COMPU_METHOD
/begin COMPU_METHOD Vel "Fahrzeuggeschwindigkeit, gleiche interne Auflösung wie Vel_SI" RAT_FUNC "%6.4" "[km/h]" COEFFS 0 100 0 0 0 1 /end COMPU_METHOD
/begin COMPU_METHOD VelToN "Verhältnis Fahrzeuggeschwindigkeit zu Motordrehzahl v/n" RAT_FUNC "%8.7" "[(km/h)/rpm]" COEFFS 0 100000 0 0 0 1 /end COMPU_METHOD
/begin COMPU_METHOD Volt_Batt "Batteriespannung" RAT_FUNC "%6.1" "[mV]" COEFFS 0 0.0492252911173131 0 0 0 1 /end COMPU_METHOD
/begin COMPU_METHOD default "" RAT_FUNC "%6.2" "" COEFFS 0 1 0 0 0 1 /end COMPU_METHOD
/begin RECORD_LAYOUT Kf_Xs16_Ys16_Ws16 NO_AXIS_PTS_X 1 SWORD NO_AXIS_PTS_Y 2 SWORD AXIS_PTS_X 3 SWORD INDEX_INCR DIRECT AXIS_PTS_Y 4 SWORD INDEX_INCR DIRECT FNC_VALUES 5 SWORD COLUMN_DIR DIRECT /end RECORD_LAYOUT
/begin RECORD_LAYOUT Kl_Xs16_Ws16 NO_AXIS_PTS_X 1 SWORD AXIS_PTS_X 2 SWORD INDEX_INCR DIRECT FNC_VALUES 3 SWORD COLUMN_DIR DIRECT /end RECORD_LAYOUT
/begin RECORD_LAYOUT Kwb_Ws16 FNC_VALUES 1 SWORD COLUMN_DIR DIRECT /end RECORD_LAYOUT
/begin RECORD_LAYOUT Kwb_Wu16 FNC_VALUES 1 UWORD COLUMN_DIR DIRECT /end RECORD_LAYOUT
/begin RECORD_LAYOUT Kwb_Wu8 FNC_VALUES 1 UBYTE COLUMN_DIR DIRECT /end RECORD_LAYOUT
/begin RECORD_LAYOUT Kw_Ws16 FNC_VALUES 1 SWORD COLUMN_DIR DIRECT /end RECORD_LAYOUT
/begin RECORD_LAYOUT Kw_Ws32 FNC_VALUES 1 SLONG COLUMN_DIR DIRECT /end RECORD_LAYOUT
/begin RECORD_LAYOUT Kw_Wu16 FNC_VALUES 1 UWORD COLUMN_DIR DIRECT /end RECORD_LAYOUT
/begin RECORD_LAYOUT Kw_Wu32 FNC_VALUES 1 ULONG COLUMN_DIR DIRECT /end RECORD_LAYOUT
/begin RECORD_LAYOUT Kw_Wu8 FNC_VALUES 1 UBYTE COLUMN_DIR DIRECT /end RECORD_LAYOUT
/end MODULE
/end PROJECT
