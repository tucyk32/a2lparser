ASAP2_VERSION 1 3
/begin PROJECT C177 "EDC16CP"
/begin HEADER "" VERSION "VCP7A3" PROJECT_NO C177 /end HEADER
/begin MODULE DIM ""
/begin MOD_COMMON "" BYTE_ORDER MSB_FIRST ALIGNMENT_BYTE 1 ALIGNMENT_WORD 2 ALIGNMENT_LONG 4 ALIGNMENT_FLOAT32_IEEE 4 /end MOD_COMMON
/begin CHARACTERISTIC Signals_adFreeApplic1_C "adresse eines frei applizierbaren Signals" VALUE 0x1C0F94 Kw_Wu32 4294967295.00 OneToOne 0.00 4294967295.00 FORMAT "%13.2" /end CHARACTERISTIC
/begin CHARACTERISTIC Signals_numTypFreeApplic1_C "Datentyp eines frei applizierbaren Signals" VALUE 0x1C0F98 Kw_Wu8 5.00000000000 SigDatatyp 0.00 5.00000000000 FORMAT "%13.11" /end CHARACTERISTIC
/begin CHARACTERISTIC Signals_adFreeApplic2_C "adresse eines frei applizierbaren Signals" VALUE 0x1C0F9C Kw_Wu32 4294967295.00 OneToOne 0.00 4294967295.00 FORMAT "%13.2" /end CHARACTERISTIC
/begin CHARACTERISTIC Signals_numTypFreeApplic2_C "Datentyp eines frei applizierbaren Signals" VALUE 0x1C0FA0 Kw_Wu8 5.00000000000 SigDatatyp 0.00 5.00000000000 FORMAT "%13.11" /end CHARACTERISTIC
/begin CHARACTERISTIC Signals_adFreeApplic3_C "adresse eines frei applizierbaren Signals" VALUE 0x1C0FA4 Kw_Wu32 4294967295.00 OneToOne 0.00 4294967295.00 FORMAT "%13.2" /end CHARACTERISTIC
/begin CHARACTERISTIC Signals_numTypFreeApplic3_C "Datentyp eines frei applizierbaren Signals" VALUE 0x1C0FA8 Kw_Wu8 5.00000000000 SigDatatyp 0.00 5.00000000000 FORMAT "%13.11" /end CHARACTERISTIC
/begin CHARACTERISTIC Signals_adFreeApplic4_C "Adresse eines frei applizierbaren Signals" VALUE 0x1C0FAC Kw_Wu32 4294967295.00 OneToOne 0.00 4294967295.00 FORMAT "%13.2" /end CHARACTERISTIC
/begin CHARACTERISTIC Signals_numTypFreeApplic4_C "Datentyp für freiapplizierbare Signals" VALUE 0x1C0FB0 Kw_Wu8 5.00000000000 SigDatatyp 0.00 5.00000000000 FORMAT "%13.11" /end CHARACTERISTIC
/begin CHARACTERISTIC Rail_DebMeUn0MaxDef_C "Fehlerentprellzeit für Überwachung auf positive Regelabweichung" VALUE 0x1E5928 Kw_Wu16 655350.0 Time_ms 0.00 655350.0 FORMAT "%8.1" /end CHARACTERISTIC
/begin CHARACTERISTIC Rail_DebMeUn0MaxOk_C "Heilungsentprellzeit für Überwachung auf positive Regelabweichung" VALUE 0x1E592A Kw_Wu16 655350.0 Time_ms 0.00 655350.0 FORMAT "%8.1" /end CHARACTERISTIC
/begin CHARACTERISTIC Rail_DebMeUn1MaxDef_C "Fehlerentprellzeit für Überwachung auf positive Regelabweichung und Sollwert des Volumenstroms durch die Zumesseinheit" VALUE 0x1E592C Kw_Wu16 655350.0 Time_ms 0.00 655350.0 FORMAT "%8.1" /end CHARACTERISTIC
/begin CHARACTERISTIC Rail_DebMeUn1MaxOk_C "Heilungsentprellzeit für Überwachung auf positive Regelabweichung und Sollwert des Volumenstroms durch die Zumesseinheit" VALUE 0x1E592E Kw_Wu16 655350.0 Time_ms 0.00 655350.0 FORMAT "%8.1" /end CHARACTERISTIC
/begin CHARACTERISTIC Rail_DebMeUn2MaxDef_C "Fehlerentprellzeit für negative Regelabweichung bei Nullförderung" VALUE 0x1E5930 Kw_Wu16 655350.0 Time_ms 0.00 655350.0 FORMAT "%8.1" /end CHARACTERISTIC
/begin CHARACTERISTIC Rail_DebMeUn2MaxOk_C "Heilungsentprellzeit für negative Regelabweichung bei Nullförderung" VALUE 0x1E5932 Kw_Wu16 655350.0 Time_ms 0.00 655350.0 FORMAT "%8.1" /end CHARACTERISTIC
/begin CHARACTERISTIC Rail_DebMeUn3MaxDef_C "Fehlerentprellzeit für minimalen Raildruck" VALUE 0x1E5934 Kw_Wu16 655350.0 Time_ms 0.00 655350.0 FORMAT "%8.1" /end CHARACTERISTIC
/begin CHARACTERISTIC Rail_DebMeUn3MaxOk_C "Heilungsentprellzeit für minimalen Raildruck" VALUE 0x1E5936 Kw_Wu16 655350.0 Time_ms 0.00 655350.0 FORMAT "%8.1" /end CHARACTERISTIC
/begin CHARACTERISTIC Rail_DebMeUn4MaxDef_C "Fehlerentprellzeit für maximalen Raildruck" VALUE 0x1E5938 Kw_Wu16 655350.0 Time_ms 0.00 655350.0 FORMAT "%8.1" /end CHARACTERISTIC
/begin CHARACTERISTIC Rail_DebMeUn4MaxOk_C "Heilungsentprellzeit für maximalen Raildruck" VALUE 0x1E593A Kw_Wu16 655350.0 Time_ms 0.00 655350.0 FORMAT "%8.1" /end CHARACTERISTIC
/begin CHARACTERISTIC Rail_DebPCV0MaxDef_C "Fehlerentprellzeit für Überwachung auf positive Regelabweichung" VALUE 0x1E5A0E Kw_Wu16 655350.0 Time_ms 0.00 655350.0 FORMAT "%8.1" /end CHARACTERISTIC
/begin CHARACTERISTIC Rail_DebPCV0MaxOk_C "Heilungsentprellzeit für Überwachung auf positive Regelabweichung" VALUE 0x1E5A10 Kw_Wu16 655350.0 Time_ms 0.00 655350.0 FORMAT "%8.1" /end CHARACTERISTIC
/begin CHARACTERISTIC Rail_DebPCV1MaxDef_C "Fehlerentprellzeit für positive Regelabweichung kombiniert mit Stellgröße Druckregelventil" VALUE 0x1E5A12 Kw_Wu16 655350.0 Time_ms 0.00 655350.0 FORMAT "%8.1" /end CHARACTERISTIC
/begin CHARACTERISTIC Rail_DebPCV1MaxOk_C "Heilungsentprellzeit für positive Regelaweichung kombiniert mit Stellgröße Druckregelventil" VALUE 0x1E5A14 Kw_Wu16 655350.0 Time_ms 0.00 655350.0 FORMAT "%8.1" /end CHARACTERISTIC
/begin CHARACTERISTIC Rail_DebPCV2MaxDef_C "Fehlerentprellzeit für negative Regelabweichung kombiniert mit Stellgröße Druckregelventil" VALUE 0x1E5A16 Kw_Wu16 655350.0 Time_ms 0.00 655350.0 FORMAT "%8.1" /end CHARACTERISTIC
/begin CHARACTERISTIC Rail_DebPCV2MaxOk_C "Heilungsentprellzeit für negative Regelabweichung kombiniert mit Stellgröße Druckregelventil" VALUE 0x1E5A18 Kw_Wu16 655350.0 Time_ms 0.00 655350.0 FORMAT "%8.1" /end CHARACTERISTIC
/begin CHARACTERISTIC Rail_DebPCV3MaxDef_C "Fehlerentprellzeit für minimalen Raildruck" VALUE 0x1E5A1A Kw_Wu16 655350.0 Time_ms 0.00 655350.0 FORMAT "%8.1" /end CHARACTERISTIC
/begin CHARACTERISTIC Rail_DebPCV3MaxOk_C "Heilungsentprellzeit für minimalen Raildruck" VALUE 0x1E5A1C Kw_Wu16 655350.0 Time_ms 0.00 655350.0 FORMAT "%8.1" /end CHARACTERISTIC
/begin CHARACTERISTIC Rail_DebPCV4MaxDef_C "Fehlerentprellzeit für maximalen Raildruck" VALUE 0x1E5A1E Kw_Wu16 655350.0 Time_ms 0.00 655350.0 FORMAT "%8.1" /end CHARACTERISTIC
/begin CHARACTERISTIC Rail_DebPCV4MaxOk_C "Heilungsentprellzeit für maximalen Raildruck" VALUE 0x1E5A20 Kw_Wu16 655350.0 Time_ms 0.00 655350.0 FORMAT "%8.1" /end CHARACTERISTIC
/begin CHARACTERISTIC Rail_DebPCV5MaxDef_C "Fehlerentprellzeit für Plausibilisierung Raildruck mit Strom durch das PCV" VALUE 0x1E5A22 Kw_Wu16 655350.0 Time_ms 0.00 655350.0 FORMAT "%8.1" /end CHARACTERISTIC
/begin CHARACTERISTIC Rail_DebPCV5MaxOk_C "Heilungsentprellzeit für Plausibilisierung Raildruck mit Strom durch das PCV" VALUE 0x1E5A24 Kw_Wu16 655350.0 Time_ms 0.00 655350.0 FORMAT "%8.1" /end CHARACTERISTIC
/begin CHARACTERISTIC Rail_dpSetPointDec_C "maximaler Raildruck-Sollwertabfall pro Sekunde" VALUE 0x1E6A08 Kw_Ws16 26214000. PresRail_sec -13107200. 13106800. FORMAT "%8.0" /end CHARACTERISTIC
/begin CHARACTERISTIC Rail_dpSetPointInc_MAP "maximaler Raildruck-Sollwertanstieg pro Sekunde, abhängig von der Motordrehzahl und der Einspritzmenge" MAP 0x1E6A0A Kf_Xs16_Ys16_Ws16 13000000. PresRail_sec 0.00 13000000. FORMAT "%8.0" EXTENDED_LIMITS -13107200. 13106800.
 /begin AXIS_DESCR STD_AXIS Eng_nAvrg EngN 12 0.00 6000.000 FORMAT "%8.3" EXTENDED_LIMITS -32768.00 32767.00 DEPOSIT ABSOLUTE /end AXIS_DESCR
 /begin AXIS_DESCR STD_AXIS InjCtl_qSetUnBal InjMass 8 0.00 327.6700 FORMAT "%8.4" EXTENDED_LIMITS -327.6800 327.6700 DEPOSIT ABSOLUTE /end AXIS_DESCR
/end CHARACTERISTIC
/begin CHARACTERISTIC Rail_dtiRgnRmpUp_C "positive Rampensteigung zur Umschaltung auf Regenerationswert Raildrucksollwert" VALUE 0x1E69FC Kw_Wu32 65535999.9847 Rmp 0.00 65535999.9847 FORMAT "%13.4" /end CHARACTERISTIC
/begin CHARACTERISTIC Rail_dtiRgnRmpDwn_C "negative Rampensteigung zur Umschaltung auf Regenerationswert Raildrucksollwert" VALUE 0x1E6A00 Kw_Wu32 65535999.9847 Rmp 0.00 65535999.9847 FORMAT "%13.4" /end CHARACTERISTIC
/begin CHARACTERISTIC Rail_dvolLeak_MAP "Leckage-Kennfled für Druckregelung über Zumesseinheit" MAP 0x1E5C36 Kf_Xs16_Ys16_Ws16 150000.0 Qp_mm3_sec 0.00 150000.0 FORMAT "%8.1" EXTENDED_LIMITS -327680.0 327670.0
 /begin AXIS_DESCR STD_AXIS Rail_pSetPoint Pres_Rail 10 0.00 1800000. FORMAT "%8.0" EXTENDED_LIMITS -3276800. 3276700. DEPOSIT ABSOLUTE /end AXIS_DESCR
 /begin AXIS_DESCR STD_AXIS FlSys_t Temp_Cels 10 -50.14000 149.8600 FORMAT "%8.4" EXTENDED_LIMITS -3549.940 3003.560 DEPOSIT ABSOLUTE /end AXIS_DESCR
/end CHARACTERISTIC
/begin CHARACTERISTIC Rail_dvolPreCtlBas_MAP "Basisvorsteuerkennfeld für Druckregelung über Zumesseinheit" MAP 0x1E5D2A Kf_Xs16_Ys16_Ws16 150000.0 Qp_mm3_sec 0.00 150000.0 FORMAT "%8.1" EXTENDED_LIMITS -327680.0 327670.0
 /begin AXIS_DESCR STD_AXIS Eng_nAvrg EngN 16 0.00 6000.000 FORMAT "%8.3" EXTENDED_LIMITS -32768.00 32767.00 DEPOSIT ABSOLUTE /end AXIS_DESCR
 /begin AXIS_DESCR STD_AXIS Rail_qPreCtlBas_mp InjMassCyc 16 0.00 327.6700 FORMAT "%8.4" EXTENDED_LIMITS -327.6800 327.6700 DEPOSIT ABSOLUTE /end AXIS_DESCR
/end CHARACTERISTIC
/begin CHARACTERISTIC Rail_dvolPreCtlOfs_MAP "Offset Kennlinie des Vorsteuerwerts (Regelung über Zumesseinheit)" MAP 0x1E5F6E Kf_Xs16_Ys16_Ws16 150000.0 Qp_mm3_sec 0.00 150000.0 FORMAT "%8.1" EXTENDED_LIMITS -327680.0 327670.0
 /begin AXIS_DESCR STD_AXIS Eng_nAvrg EngN 8 0.00 6000.000 FORMAT "%8.3" EXTENDED_LIMITS -32768.00 32767.00 DEPOSIT ABSOLUTE /end AXIS_DESCR
 /begin AXIS_DESCR STD_AXIS InjCtl_qSetUnBal InjMass 8 0.00 327.6700 FORMAT "%8.4" EXTENDED_LIMITS -327.6800 327.6700 DEPOSIT ABSOLUTE /end AXIS_DESCR
/end CHARACTERISTIC
/begin CHARACTERISTIC Rail_dvolPreCtlPoI1_MAP "Vorsteuerkennfeld abhängig von der Nacheinspritzmenge 1 für die Druckregelung über Zumesseinheit" MAP 0x1E6012 Kf_Xs16_Ys16_Ws16 150000.0 Qp_mm3_sec 0.00 150000.0 FORMAT "%8.1" EXTENDED_LIMITS -327680.0 327670.0
 /begin AXIS_DESCR STD_AXIS Eng_nAvrg EngN 4 0.00 6000.000 FORMAT "%8.3" EXTENDED_LIMITS -32768.00 32767.00 DEPOSIT ABSOLUTE /end AXIS_DESCR
 /begin AXIS_DESCR STD_AXIS InjCrv_qPoI1Des_mp InjMassInj 4 0.00 327.6700 FORMAT "%8.4" EXTENDED_LIMITS -327.6800 327.6700 DEPOSIT ABSOLUTE /end AXIS_DESCR
/end CHARACTERISTIC
/begin CHARACTERISTIC Rail_dvolPreCtlPoI2_MAP "Vorsteuerkennfeld abhängig von der Nacheinspritzmenge 2 für die Druckregelung über Zumesseinheit" MAP 0x1E6046 Kf_Xs16_Ys16_Ws16 150000.0 Qp_mm3_sec 0.00 150000.0 FORMAT "%8.1" EXTENDED_LIMITS -327680.0 327670.0
 /begin AXIS_DESCR STD_AXIS Eng_nAvrg EngN 4 0.00 6000.000 FORMAT "%8.3" EXTENDED_LIMITS -32768.00 32767.00 DEPOSIT ABSOLUTE /end AXIS_DESCR
 /begin AXIS_DESCR STD_AXIS InjCrv_qPoI2Des_mp InjMassInj 4 0.00 327.6700 FORMAT "%8.4" EXTENDED_LIMITS -327.6800 327.6700 DEPOSIT ABSOLUTE /end AXIS_DESCR
/end CHARACTERISTIC
/begin CHARACTERISTIC Rail_dvolPreCtl_C "Fernsteuerwert für Vorsteuerwert für die Druckregelung über Zumesseinheit" VALUE 0x1E6080 Kw_Ws16 150000.0 Qp_mm3_sec 0.00 150000.0 FORMAT "%8.1" EXTENDED_LIMITS -327680.0 327670.0 /end CHARACTERISTIC
/begin CHARACTERISTIC Rail_dvolRedOfsLim_C "Schwelle fuer Kraftstoffmenge  zur Verringerung  des Offsetwertes fuer PCV" VALUE 0x1E6084 Kw_Ws16 655350.0 Qp_mm3_sec -327680.0 327670.0 FORMAT "%8.1" /end CHARACTERISTIC
/begin CHARACTERISTIC Rail_facLeakAged_C "Faktor zur Bestimmung des maximal möglichen Volumenstroms bei einem gealterten System" VALUE 0x1E607A Kw_Ws16 1.000000 Fact 0.00 1.000000 FORMAT "%8.6" EXTENDED_LIMITS -4.000000 3.999878 /end CHARACTERISTIC
/begin CHARACTERISTIC Rail_facSetPointAPSCor_CUR "Gewichtungsfaktor, abhängig vom Atmosphärendruck für die Sollwertkorrektur des Raildrucks" CURVE 0x1E75E0 Kl_Xs16_Ws16 1.000000 Fact 0.00 1.000000 FORMAT "%8.6" EXTENDED_LIMITS -4.000000 3.999878
 /begin AXIS_DESCR STD_AXIS APSCD_pVal Pres_hPa 8 0.00 3500.000 FORMAT "%8.3" EXTENDED_LIMITS -32768.00 32767.00 DEPOSIT ABSOLUTE /end AXIS_DESCR
/end CHARACTERISTIC
/begin CHARACTERISTIC Rail_facSetPointATSCor_CUR "Gewichtungsfaktor, abhängig von der Ansauglufttemperatur für die Sollwertkorrektur des Raildrucks" CURVE 0x1E7602 Kl_Xs16_Ws16 1.000000 Fact 0.00 1.000000 FORMAT "%8.6" EXTENDED_LIMITS -4.000000 3.999878
 /begin AXIS_DESCR STD_AXIS IATSCD_tAir Temp_Cels 8 -50.14000 199.8600 FORMAT "%8.4" EXTENDED_LIMITS -3549.940 3003.560 DEPOSIT ABSOLUTE /end AXIS_DESCR
/end CHARACTERISTIC
/begin CHARACTERISTIC Rail_facSetPointETSCor_CUR "Gewichtungsfaktor, abhängig von der Motortemperatur für die Sollwertkorrektur des Raildrucks" CURVE 0x1E7624 Kl_Xs16_Ws16 1.000000 Fact 0.00 1.000000 FORMAT "%8.6" EXTENDED_LIMITS -4.000000 3.999878
 /begin AXIS_DESCR STD_AXIS InjCrv_tEng Temp_Cels 8 -50.14000 199.8600 FORMAT "%8.4" EXTENDED_LIMITS -3549.940 3003.560 DEPOSIT ABSOLUTE /end AXIS_DESCR
/end CHARACTERISTIC
/begin CHARACTERISTIC Rail_facSetPointFTSCor_CUR "Gewichtungsfaktor, abhängig von der Kraftstofftemperatur für Raildruck-Sollwertkorrektur" CURVE 0x1E6FA0 Kl_Xs16_Ws16 1.000000 Fact 0.00 1.000000 FORMAT "%8.6" EXTENDED_LIMITS -4.000000 3.999878
 /begin AXIS_DESCR STD_AXIS FTSCD_tFuel Temp_Cels 8 -50.14000 149.8600 FORMAT "%8.4" EXTENDED_LIMITS -3549.940 3003.560 DEPOSIT ABSOLUTE /end AXIS_DESCR
/end CHARACTERISTIC
/begin CHARACTERISTIC Rail_dvolMeUnSetMin_C "minimal zulässiger Volumenstrom durch Zumesseinheit für Raildrucküberwachung" VALUE 0x1E593C Kw_Ws16 50000.00 Qp_mm3_sec 0.00 50000.00 FORMAT "%8.2" EXTENDED_LIMITS -327680.0 327670.0 /end CHARACTERISTIC
/begin CHARACTERISTIC Rail_pMeUnPeakMax_C "Maximal zulässiger Raildruck" VALUE 0x1E593E Kw_Ws16 1800000. Pres_Rail 0.00 1800000. FORMAT "%8.0" EXTENDED_LIMITS -3276800. 3276700. /end CHARACTERISTIC
/begin CHARACTERISTIC Rail_pMeUnDvtMax_C "Maximal zulässige Regelabweichung für Raildrucküberwachung" VALUE 0x1E5940 Kw_Ws16 1800000. Pres_Rail 0.00 1800000. FORMAT "%8.0" EXTENDED_LIMITS -3276800. 3276700. /end CHARACTERISTIC
/begin CHARACTERISTIC Rail_qMeUnLoIdle_C "Mengenschwelle zur Erkennung der Schubbedingung bei der Raildrucküberwachung" VALUE 0x1E5942 Kw_Ws16 327.6700 InjMassCyc 0.00 327.6700 FORMAT "%8.4" EXTENDED_LIMITS -327.6800 327.6700 /end CHARACTERISTIC
/begin CHARACTERISTIC Rail_stMonMeUnRls_C "Generelle Freigabemaske für Überwachungen der Druckregelung über Zumesseinheit" VALUE 0x1E5944 Kw_Wu16 65535.00 OneToOne 0.00 65535.00 FORMAT "%8.2" /end CHARACTERISTIC
/begin CHARACTERISTIC Rail_tMeUnLoIdle_C "Systemtemperaturschwelle für die Raildrucküberwachung" VALUE 0x1E5946 Kw_Ws16 200.0000 Temp_Cels -50.14000 149.8600 FORMAT "%8.4" EXTENDED_LIMITS -3549.940 3003.560 /end CHARACTERISTIC
/begin CHARACTERISTIC Rail_pPCVDvtMax_C "maximale positive Soll/Ist Druckdifferenz" VALUE 0x1E5A26 Kw_Ws16 3600000. Pres_Rail -1800000. 1800000. FORMAT "%8.0" EXTENDED_LIMITS -3276800. 3276700. /end CHARACTERISTIC
/begin CHARACTERISTIC Rail_pPCVSetMax_C "Maximal zulässiger Solldruck für Raildrucküberwachung" VALUE 0x1E5A28 Kw_Ws16 1800000. Pres_Rail 0.00 1800000. FORMAT "%8.0" EXTENDED_LIMITS -3276800. 3276700. /end CHARACTERISTIC
/begin CHARACTERISTIC Rail_pPCVDvtMin_C "maximale negative Soll/Ist Druckdifferenz" VALUE 0x1E5A2A Kw_Ws16 3600000. Pres_Rail -1800000. 1800000. FORMAT "%8.0" EXTENDED_LIMITS -3276800. 3276700. /end CHARACTERISTIC
/begin CHARACTERISTIC Rail_pPCVSetMin_C "Minimal zulässiger Solldruck für Raildrucküberwachung" VALUE 0x1E5A2C Kw_Ws16 1800000. Pres_Rail 0.00 1800000. FORMAT "%8.0" EXTENDED_LIMITS -3276800. 3276700. /end CHARACTERISTIC
/begin CHARACTERISTIC Rail_pAbsDvtMax_C "Maximaler Betrag der Regelabweichung für Raildrucküberwachung" VALUE 0x1E5A2E Kw_Ws16 3600000. Pres_Rail -1800000. 1800000. FORMAT "%8.0" EXTENDED_LIMITS -3276800. 3276700. /end CHARACTERISTIC
/begin CHARACTERISTIC Rail_tiThresMonEna_C "Zeitschwelle für Freigabe der Plausibilisierung des Raildrucks während der Raildrucküberwachung" VALUE 0x1E5A30 Kw_Wu16 655350.0 Time_ms 0.00 655350.0 FORMAT "%8.1" /end CHARACTERISTIC
/begin CHARACTERISTIC Rail_qMonEnaMax_C "Maximale Menge für Raildrucküberwachung" VALUE 0x1E5A32 Kw_Ws16 327.6700 InjMassCyc 0.00 327.6700 FORMAT "%8.4" EXTENDED_LIMITS -327.6800 327.6700 /end CHARACTERISTIC
/begin CHARACTERISTIC Rail_nMonEnaMin_C "Minimale Drehzahl für Raildrucküberwachung" VALUE 0x1E5A34 Kw_Ws16 6000.000 EngN 0.00 6000.000 FORMAT "%8.3" EXTENDED_LIMITS -32768.00 32767.00 /end CHARACTERISTIC
/begin CHARACTERISTIC Rail_nMonEnaMax_C "Maximale Drehzahl für Raildrucküberwachung" VALUE 0x1E5A36 Kw_Ws16 6000.000 EngN 0.00 6000.000 FORMAT "%8.3" EXTENDED_LIMITS -32768.00 32767.00 /end CHARACTERISTIC
/begin CHARACTERISTIC Rail_pPCVPeakMax_C "Maximal zulässiger Raildruck" VALUE 0x1E5A38 Kw_Ws16 1800000. Pres_Rail 0.00 1800000. FORMAT "%8.0" EXTENDED_LIMITS -3276800. 3276700. /end CHARACTERISTIC
/begin CHARACTERISTIC Rail_stMonPCVRls_C "Generelle Freigabemaske für Überwachungen der Druckregelung über Druckregelventil" VALUE 0x1E5A3A Kw_Wu16 65535.00 OneToOne 0.00 65535.00 FORMAT "%8.2" /end CHARACTERISTIC
/begin CHARACTERISTIC Rail_pMeUnDvtMax_CUR "Maximal zulässige Regelabweichung für Raildrucküberwachung als Funktion der Drehzahl" CURVE 0x1E5948 Kl_Xs16_Ws16 3600000. Pres_Rail -1800000. 1800000. FORMAT "%8.0" EXTENDED_LIMITS -3276800. 3276700.
 /begin AXIS_DESCR STD_AXIS Eng_nAvrg EngN 16 0.00 6000.000 FORMAT "%8.3" EXTENDED_LIMITS -32768.00 32767.00 DEPOSIT ABSOLUTE /end AXIS_DESCR
/end CHARACTERISTIC
/begin CHARACTERISTIC Rail_pMeUnDvtMin_CUR "Minimal zulässige Regelabweichung für Raildrucküberwachung als Funktion der Drehzahl" CURVE 0x1E598A Kl_Xs16_Ws16 3600000. Pres_Rail -1800000. 1800000. FORMAT "%8.0" EXTENDED_LIMITS -3276800. 3276700.
 /begin AXIS_DESCR STD_AXIS Eng_nAvrg EngN 16 0.00 6000.000 FORMAT "%8.3" EXTENDED_LIMITS -32768.00 32767.00 DEPOSIT ABSOLUTE /end AXIS_DESCR
/end CHARACTERISTIC
/begin CHARACTERISTIC Rail_pMeUnPeakMin_CUR "Minimal zulässiger Raildruck als Funktion der Motordrehzahl" CURVE 0x1E59CC Kl_Xs16_Ws16 1800000. Pres_Rail 0.00 1800000. FORMAT "%8.0" EXTENDED_LIMITS -3276800. 3276700.
 /begin AXIS_DESCR STD_AXIS Eng_nAvrg EngN 16 0.00 6000.000 FORMAT "%8.3" EXTENDED_LIMITS -32768.00 32767.00 DEPOSIT ABSOLUTE /end AXIS_DESCR
/end CHARACTERISTIC
/begin CHARACTERISTIC Rail_pNIPCVMax_MAP "Obere Grenze für Drucksensorplausibilisierung" MAP 0x1E5A3C Kf_Xs16_Ys16_Ws16 1800000. Pres_Rail 0.00 1800000. FORMAT "%8.0" EXTENDED_LIMITS -3276800. 3276700.
 /begin AXIS_DESCR STD_AXIS Eng_nAvrg EngN 6 0.00 6000.000 FORMAT "%8.3" EXTENDED_LIMITS -32768.00 32767.00 DEPOSIT ABSOLUTE /end AXIS_DESCR
 /begin AXIS_DESCR STD_AXIS PCVCD_iActVal Curr 12 0.00 5000.000 FORMAT "%8.3" EXTENDED_LIMITS -32768.00 32767.00 DEPOSIT ABSOLUTE /end AXIS_DESCR
/end CHARACTERISTIC
/begin CHARACTERISTIC Rail_pNIPCVMin_MAP "Untere Grenze für Drucksensorplausibilisierung" MAP 0x1E5AF4 Kf_Xs16_Ys16_Ws16 1800000. Pres_Rail 0.00 1800000. FORMAT "%8.0" EXTENDED_LIMITS -3276800. 3276700.
 /begin AXIS_DESCR STD_AXIS Eng_nAvrg EngN 6 0.00 6000.000 FORMAT "%8.3" EXTENDED_LIMITS -32768.00 32767.00 DEPOSIT ABSOLUTE /end AXIS_DESCR
 /begin AXIS_DESCR STD_AXIS PCVCD_iActVal Curr 12 0.00 5000.000 FORMAT "%8.3" EXTENDED_LIMITS -32768.00 32767.00 DEPOSIT ABSOLUTE /end AXIS_DESCR
/end CHARACTERISTIC
/begin CHARACTERISTIC Rail_pPCVCloseOfs_CUR "Vorsteuer Offset um das Druckregelventil geschlossen zu halten" CURVE 0x1E6086 Kl_Xs16_Ws16 6553500. Pres_Rail -3276800. 3276700. FORMAT "%8.0"
 /begin AXIS_DESCR STD_AXIS Rail_pSetPoint Pres_Rail 4 0.00 1800000. FORMAT "%8.0" EXTENDED_LIMITS -3276800. 3276700. DEPOSIT ABSOLUTE /end AXIS_DESCR
/end CHARACTERISTIC
/begin CHARACTERISTIC Rail_pPCVDvtMax_CUR "maximale Regelabweichung als Funktion der Drehzahl für die Raildrucküberwachung" CURVE 0x1E5BAC Kl_Xs16_Ws16 3600000. Pres_Rail -1800000. 1800000. FORMAT "%8.0" EXTENDED_LIMITS -3276800. 3276700.
 /begin AXIS_DESCR STD_AXIS Eng_nAvrg EngN 16 0.00 6000.000 FORMAT "%8.3" EXTENDED_LIMITS -32768.00 32767.00 DEPOSIT ABSOLUTE /end AXIS_DESCR
/end CHARACTERISTIC
/begin CHARACTERISTIC Rail_pPCVPeakMin_CUR "Minimal zulässiger Raildruck als Funktion der Motordrehzahl" CURVE 0x1E5BEE Kl_Xs16_Ws16 1800000. Pres_Rail 0.00 1800000. FORMAT "%8.0" EXTENDED_LIMITS -3276800. 3276700.
 /begin AXIS_DESCR STD_AXIS Eng_nAvrg EngN 16 0.00 6000.000 FORMAT "%8.3" EXTENDED_LIMITS -32768.00 32767.00 DEPOSIT ABSOLUTE /end AXIS_DESCR
/end CHARACTERISTIC
/begin CHARACTERISTIC Rail_pPCVRedOfs_CUR "Vorsteuerreduzierung für schnelleren Druckabbau über das Druckregelventil" CURVE 0x1E6098 Kl_Xs16_Ws16 6553500. Pres_Rail -3276800. 3276700. FORMAT "%8.0"
 /begin AXIS_DESCR STD_AXIS Rail_pSetPoint Pres_Rail 4 0.00 1800000. FORMAT "%8.0" EXTENDED_LIMITS -3276800. 3276700. DEPOSIT ABSOLUTE /end AXIS_DESCR
/end CHARACTERISTIC
/begin CHARACTERISTIC Rail_pPeakMinZFC_C "Minimaler Raildruck für die Überwachung bei aktiver ZFC" VALUE 0x1E764C Kw_Ws16 1800000. Pres_Rail 0.00 1800000. FORMAT "%8.0" EXTENDED_LIMITS -3276800. 3276700. /end CHARACTERISTIC
/begin CHARACTERISTIC Rail_pPreCtl_C "Fernsteuerwert für Vorsteuerwert für die Druckregelung über Druckregelventil" VALUE 0x1E6320 Kw_Ws16 1800000. Pres_Rail 0.00 1800000. FORMAT "%8.0" EXTENDED_LIMITS -3276800. 3276700. /end CHARACTERISTIC
/begin CHARACTERISTIC Rail_pPreCtl_MAP "Vorsteuerkennfeld für die Druckregelung über Druckregelventil" MAP 0x1E60AA Kf_Xs16_Ys16_Ws16 1800000. Pres_Rail 0.00 1800000. FORMAT "%8.0" EXTENDED_LIMITS -3276800. 3276700.
 /begin AXIS_DESCR STD_AXIS Eng_nAvrg EngN 16 0.00 6000.000 FORMAT "%8.3" EXTENDED_LIMITS -32768.00 32767.00 DEPOSIT ABSOLUTE /end AXIS_DESCR
 /begin AXIS_DESCR STD_AXIS Rail_pSetPoint Pres_Rail 16 0.00 1800000. FORMAT "%8.0" EXTENDED_LIMITS -3276800. 3276700. DEPOSIT ABSOLUTE /end AXIS_DESCR
/end CHARACTERISTIC
/begin CHARACTERISTIC Rail_pRedOfsLim_C "Raildruckschwelle zur Reduzierung des Vorsteueroffsets des Druckregelventils" VALUE 0x1E62EE Kw_Ws16 6553500. Pres_Rail -3276800. 3276700. FORMAT "%8.0" /end CHARACTERISTIC
/begin CHARACTERISTIC Rail_pSetPointAPSCor_MAP "atmosphärendruckabhängiger Sollwertkorrektur des Raildrucks" MAP 0x1E731C Kf_Xs16_Ys16_Ws16 1800000. Pres_Rail 0.00 1800000. FORMAT "%8.0" EXTENDED_LIMITS -3276800. 3276700.
 /begin AXIS_DESCR STD_AXIS Eng_nAvrg EngN 12 0.00 6000.000 FORMAT "%8.3" EXTENDED_LIMITS -32768.00 32767.00 DEPOSIT ABSOLUTE /end AXIS_DESCR
 /begin AXIS_DESCR STD_AXIS InjCtl_qCurr InjMass 8 0.00 327.6700 FORMAT "%8.4" EXTENDED_LIMITS -327.6800 327.6700 DEPOSIT ABSOLUTE /end AXIS_DESCR
/end CHARACTERISTIC
/begin CHARACTERISTIC Rail_pSetPointATSCor_MAP "ansauglufttemperaturabhängige Sollwertkorrektur des Raildrucks" MAP 0x1E7408 Kf_Xs16_Ys16_Ws16 1800000. Pres_Rail 0.00 1800000. FORMAT "%8.0" EXTENDED_LIMITS -3276800. 3276700.
 /begin AXIS_DESCR STD_AXIS Eng_nAvrg EngN 12 0.00 6000.000 FORMAT "%8.3" EXTENDED_LIMITS -32768.00 32767.00 DEPOSIT ABSOLUTE /end AXIS_DESCR
 /begin AXIS_DESCR STD_AXIS InjCtl_qCurr InjMass 8 0.00 327.6700 FORMAT "%8.4" EXTENDED_LIMITS -327.6800 327.6700 DEPOSIT ABSOLUTE /end AXIS_DESCR
/end CHARACTERISTIC
/begin CHARACTERISTIC Rail_pSetPointBase2_MAP "2. Basiskennfeld für den Raildruck-Sollwert" MAP 0x1E6AF6 Kf_Xs16_Ys16_Ws16 1800000. Pres_Rail 0.00 1800000. FORMAT "%8.0" EXTENDED_LIMITS -3276800. 3276700.
 /begin AXIS_DESCR STD_AXIS Eng_nAvrg EngN 16 0.00 6000.000 FORMAT "%8.3" EXTENDED_LIMITS -32768.00 32767.00 DEPOSIT ABSOLUTE /end AXIS_DESCR
 /begin AXIS_DESCR STD_AXIS InjCtl_qCurr InjMass 16 0.00 327.6700 FORMAT "%8.4" EXTENDED_LIMITS -327.6800 327.6700 DEPOSIT ABSOLUTE /end AXIS_DESCR
/end CHARACTERISTIC
/begin CHARACTERISTIC Rail_pSetPointBase_MAP "Basiskennfeld für den Raildruck-Sollwert" MAP 0x1E6D3A Kf_Xs16_Ys16_Ws16 1800000. Pres_Rail 0.00 1800000. FORMAT "%8.0" EXTENDED_LIMITS -3276800. 3276700.
 /begin AXIS_DESCR STD_AXIS Eng_nAvrg EngN 16 0.00 6000.000 FORMAT "%8.3" EXTENDED_LIMITS -32768.00 32767.00 DEPOSIT ABSOLUTE /end AXIS_DESCR
 /begin AXIS_DESCR STD_AXIS InjCtl_qCurr InjMass 16 0.00 327.6700 FORMAT "%8.4" EXTENDED_LIMITS -327.6800 327.6700 DEPOSIT ABSOLUTE /end AXIS_DESCR
/end CHARACTERISTIC
/begin CHARACTERISTIC Rail_pSetPointBattMin_CUR "batteriespannungsabhängige Kennlinie für den Raildruck-Sollwert" CURVE 0x1E6F7E Kl_Xs16_Ws16 1800000. Pres_Rail 0.00 1800000. FORMAT "%8.0" EXTENDED_LIMITS -3276800. 3276700.
 /begin AXIS_DESCR STD_AXIS BattCD_u Volt_Batt 4 0.00 23991.73 FORMAT "%8.2" EXTENDED_LIMITS -665674.1 665653.8 DEPOSIT ABSOLUTE /end AXIS_DESCR
/end CHARACTERISTIC
/begin CHARACTERISTIC Rail_pSetPointETSCor_MAP "motortemperaturabhängige Sollwertkorrektur des Raildrucks" MAP 0x1E74F4 Kf_Xs16_Ys16_Ws16 1800000. Pres_Rail 0.00 1800000. FORMAT "%8.0" EXTENDED_LIMITS -3276800. 3276700.
 /begin AXIS_DESCR STD_AXIS Eng_nAvrg EngN 12 0.00 6000.000 FORMAT "%8.3" EXTENDED_LIMITS -32768.00 32767.00 DEPOSIT ABSOLUTE /end AXIS_DESCR
 /begin AXIS_DESCR STD_AXIS InjCtl_qCurr InjMass 8 0.00 327.6700 FORMAT "%8.4" EXTENDED_LIMITS -327.6800 327.6700 DEPOSIT ABSOLUTE /end AXIS_DESCR
/end CHARACTERISTIC
/begin CHARACTERISTIC Rail_pSetPointFTSCor_MAP "Basiswert der kraftstofftemperaturabhängigen Raildruck-Sollwertkorrektur" MAP 0x1E6FC2 Kf_Xs16_Ys16_Ws16 1800000. Pres_Rail 0.00 1800000. FORMAT "%8.0" EXTENDED_LIMITS -3276800. 3276700.
 /begin AXIS_DESCR STD_AXIS Eng_nAvrg EngN 12 0.00 6000.000 FORMAT "%8.3" EXTENDED_LIMITS -32768.00 32767.00 DEPOSIT ABSOLUTE /end AXIS_DESCR
 /begin AXIS_DESCR STD_AXIS InjCtl_qCurr InjMass 8 0.00 327.6700 FORMAT "%8.4" EXTENDED_LIMITS -327.6800 327.6700 DEPOSIT ABSOLUTE /end AXIS_DESCR
/end CHARACTERISTIC
/begin CHARACTERISTIC Rail_pSetPointInit_C "Initialwert des Raildrucksollwert" VALUE 0x1E6F90 Kw_Ws16 6553500. Pres_Rail -3276800. 3276700. FORMAT "%8.0" /end CHARACTERISTIC
/begin CHARACTERISTIC Rail_pSetPointLimNFlTemp_C "maximaler Raildrucksollwert, abhängig von der Motordrehzahl und der Kraftstofftemperatur" VALUE 0x1E70AE Kw_Ws16 1800000. Pres_Rail 0.00 1800000. FORMAT "%8.0" EXTENDED_LIMITS -3276800. 3276700. /end CHARACTERISTIC
/begin CHARACTERISTIC Rail_pSetPointMaxDef_C "maximaler Raildruck-Sollwert im Fehlerfall" VALUE 0x1E70B0 Kw_Ws16 1800000. Pres_Rail 0.00 1800000. FORMAT "%8.0" EXTENDED_LIMITS -3276800. 3276700. /end CHARACTERISTIC
/begin CHARACTERISTIC Rail_pSetPointMax_MAP "maximaler Raildruck Sollwert, abhängig von der Motordrehzahl und der Einspritzmenge" MAP 0x1E70B2 Kf_Xs16_Ys16_Ws16 1800000. Pres_Rail 0.00 1800000. FORMAT "%8.0" EXTENDED_LIMITS -3276800. 3276700.
 /begin AXIS_DESCR STD_AXIS Eng_nAvrg EngN 16 0.00 6000.000 FORMAT "%8.3" EXTENDED_LIMITS -32768.00 32767.00 DEPOSIT ABSOLUTE /end AXIS_DESCR
 /begin AXIS_DESCR STD_AXIS InjCtl_qCurr InjMass 8 0.00 327.6700 FORMAT "%8.4" EXTENDED_LIMITS -327.6800 327.6700 DEPOSIT ABSOLUTE /end AXIS_DESCR
/end CHARACTERISTIC
/begin CHARACTERISTIC Rail_pSetPointMinDef_C "minimaler Raildruck-Sollwert im Fehlerfall" VALUE 0x1E71E6 Kw_Ws16 1800000. Pres_Rail 0.00 1800000. FORMAT "%8.0" EXTENDED_LIMITS -3276800. 3276700. /end CHARACTERISTIC
/begin CHARACTERISTIC Rail_pSetPointMin_MAP "minimaler Raildruck-Sollwert, abhängig von der Motordrehzahl und der Einspritzmenge" MAP 0x1E71E8 Kf_Xs16_Ys16_Ws16 1800000. Pres_Rail 0.00 1800000. FORMAT "%8.0" EXTENDED_LIMITS -3276800. 3276700.
 /begin AXIS_DESCR STD_AXIS Eng_nAvrg EngN 8 0.00 6000.000 FORMAT "%8.3" EXTENDED_LIMITS -32768.00 32767.00 DEPOSIT ABSOLUTE /end AXIS_DESCR
 /begin AXIS_DESCR STD_AXIS InjCtl_qCurr InjMass 16 0.00 327.6700 FORMAT "%8.4" EXTENDED_LIMITS -327.6800 327.6700 DEPOSIT ABSOLUTE /end AXIS_DESCR
/end CHARACTERISTIC
/begin CHARACTERISTIC Rail_pSetPointRed_C "Offset zur Absenkung des Raildrucksollwert im Systemfehlerfall" VALUE 0x1E6F92 Kw_Ws16 6553500. Pres_Rail -3276800. 3276700. FORMAT "%8.0" /end CHARACTERISTIC
/begin CHARACTERISTIC Rail_pSetPointRgnBas1_MAP "Grundwertkennfeld 1 des Raildrucksollwerts bei Regeneration in Abhängigkeit des Motorbetriebspunkts" MAP 0x1E6324 Kf_Xs16_Ys16_Ws16 1800000. Pres_Rail 0.00 1800000. FORMAT "%8.0" EXTENDED_LIMITS -3276800. 3276700.
 /begin AXIS_DESCR STD_AXIS Eng_nAvrg EngN 16 0.00 6000.000 FORMAT "%8.3" EXTENDED_LIMITS -32768.00 32767.00 DEPOSIT ABSOLUTE /end AXIS_DESCR
 /begin AXIS_DESCR STD_AXIS InjCtl_qCurr InjMass 16 0.00 327.6700 FORMAT "%8.4" EXTENDED_LIMITS -327.6800 327.6700 DEPOSIT ABSOLUTE /end AXIS_DESCR
/end CHARACTERISTIC
/begin CHARACTERISTIC Rail_pSetPointRgnBas2_MAP "Grundwertkennfeld 2 des Raildrucksollwerts bei Regeneration in Abhängigkeit des Motorbetriebspunkts" MAP 0x1E6568 Kf_Xs16_Ys16_Ws16 1800000. Pres_Rail 0.00 1800000. FORMAT "%8.0" EXTENDED_LIMITS -3276800. 3276700.
 /begin AXIS_DESCR STD_AXIS Eng_nAvrg EngN 16 0.00 6000.000 FORMAT "%8.3" EXTENDED_LIMITS -32768.00 32767.00 DEPOSIT ABSOLUTE /end AXIS_DESCR
 /begin AXIS_DESCR STD_AXIS InjCtl_qCurr InjMass 16 0.00 327.6700 FORMAT "%8.4" EXTENDED_LIMITS -327.6800 327.6700 DEPOSIT ABSOLUTE /end AXIS_DESCR
/end CHARACTERISTIC
/begin CHARACTERISTIC Rail_pSetPointRgnBas3_MAP "Grundwertkennfeld 3 des Raildrucksollwerts bei Regeneration in Abhängigkeit des Motorbetriebspunkts" MAP 0x1E67AC Kf_Xs16_Ys16_Ws16 1800000. Pres_Rail 0.00 1800000. FORMAT "%8.0" EXTENDED_LIMITS -3276800. 3276700.
 /begin AXIS_DESCR STD_AXIS Eng_nAvrg EngN 16 0.00 6000.000 FORMAT "%8.3" EXTENDED_LIMITS -32768.00 32767.00 DEPOSIT ABSOLUTE /end AXIS_DESCR
 /begin AXIS_DESCR STD_AXIS InjCtl_qCurr InjMass 16 0.00 327.6700 FORMAT "%8.4" EXTENDED_LIMITS -327.6800 327.6700 DEPOSIT ABSOLUTE /end AXIS_DESCR
/end CHARACTERISTIC
/begin CHARACTERISTIC Rail_pSetPointRgn_Vector "Bypass-Label, nicht editieren !" VALUE 0x1C0B42 Kw_Wu8 255.0 OneToOne 0.00 255.0 FORMAT "%5.1" /end CHARACTERISTIC
/begin CHARACTERISTIC Rail_pSetPointRgn_Channel "Bypass-Label, nicht editieren !" VALUE 0x1C0B43 Kw_Wu8 255.0 OneToOne 0.00 255.0 FORMAT "%5.1" /end CHARACTERISTIC
/begin CHARACTERISTIC Rail_pSetPointZFCMax_C "Maximaler Raildrucksollwert bei aktiver Nullmengenkalibrierung" VALUE 0x1E764E Kw_Ws16 1800000. Pres_Rail 0.00 1800000. FORMAT "%8.0" EXTENDED_LIMITS -3276800. 3276700. /end CHARACTERISTIC
/begin CHARACTERISTIC Rail_pSetPointZFCMin_C "Minimaler Raildrucksollwert bei aktiver Nullmengenkalibrierung" VALUE 0x1E7650 Kw_Ws16 1800000. Pres_Rail 0.00 1800000. FORMAT "%8.0" EXTENDED_LIMITS -3276800. 3276700. /end CHARACTERISTIC
/begin CHARACTERISTIC Rail_pSetPoint_C "Fernsteuerwert des Raildrucksollwert" VALUE 0x1E7646 Kw_Ws16 1800000. Pres_Rail 0.00 1800000. FORMAT "%8.0" EXTENDED_LIMITS -3276800. 3276700. /end CHARACTERISTIC
/begin CHARACTERISTIC Rail_pSetPoint_Vector "Bypass-Label für Rail_pSetPoint (Nicht verstellen!)" VALUE 0x1C0B44 Kw_Wu8 255.0 OneToOne 0.00 255.0 FORMAT "%5.1" /end CHARACTERISTIC
/begin CHARACTERISTIC Rail_pSetPoint_Channel "Bypass-Label für Rail_pSetPoint (Nicht verstellen!)" VALUE 0x1C0B45 Kw_Wu8 255.0 OneToOne 0.00 255.0 FORMAT "%5.1" /end CHARACTERISTIC
/begin CHARACTERISTIC Rail_qMeUnCtlType_CUR "Kennlinie zur mengenabhängigen Umschaltung auf Druckregelung über Zumesseinheit" CURVE 0x1E5896 Kl_Xs16_Ws16 327.6700 InjMassCyc 0.00 327.6700 FORMAT "%8.4" EXTENDED_LIMITS -327.6800 327.6700
 /begin AXIS_DESCR STD_AXIS Eng_nAvrg EngN 8 0.00 6000.000 FORMAT "%8.3" EXTENDED_LIMITS -32768.00 32767.00 DEPOSIT ABSOLUTE /end AXIS_DESCR
/end CHARACTERISTIC
/begin CHARACTERISTIC Rail_qPCVCtlType_CUR "Kennlinie zur mengenabhängigen Umschaltung auf Druckregelung über Druckregelventil" CURVE 0x1E58B8 Kl_Xs16_Ws16 327.6700 InjMassCyc 0.00 327.6700 FORMAT "%8.4" EXTENDED_LIMITS -327.6800 327.6700
 /begin AXIS_DESCR STD_AXIS Eng_nAvrg EngN 8 0.00 6000.000 FORMAT "%8.3" EXTENDED_LIMITS -32768.00 32767.00 DEPOSIT ABSOLUTE /end AXIS_DESCR
/end CHARACTERISTIC
/begin CHARACTERISTIC Rail_qRedOfsLim_C "Schwelle fuer Einspritzmenge zur Verringerung des Offsetwertes fuer PCV" VALUE 0x1E62F0 Kw_Ws16 655.3500 InjMassInj -327.6800 327.6700 FORMAT "%8.4" /end CHARACTERISTIC
/begin CHARACTERISTIC Rail_rPeakMinSlpZFC_C "Rampensteigung bei minimalem Raildruck nach Kalibrierung der ZFC" VALUE 0x1E7652 Kw_Ws16 100.0000 Prc 0.00 100.0000 FORMAT "%8.4" EXTENDED_LIMITS -327.6800 327.6700 /end CHARACTERISTIC
/begin CHARACTERISTIC Rail_rZFCInitDwn_CUR "Faktor für anfänglichen Raildrucksollwert des PT1 FIlters abwärts" CURVE 0x1E7654 Kl_Xs16_Ws16 100.0000 Prc 0.00 100.0000 FORMAT "%8.4" EXTENDED_LIMITS -327.6800 327.6700
 /begin AXIS_DESCR STD_AXIS ZFC_pRailSetPoint_mp Pres_Rail 3 0.00 1800000. FORMAT "%8.0" EXTENDED_LIMITS -3276800. 3276700. DEPOSIT ABSOLUTE /end AXIS_DESCR
/end CHARACTERISTIC
/begin CHARACTERISTIC Rail_rZFCInitUp_CUR "Faktor für anfänglichen Raildrucksollwert des PT1 Filters (aufwärts)" CURVE 0x1E7662 Kl_Xs16_Ws16 100.0000 Prc 0.00 100.0000 FORMAT "%8.4" EXTENDED_LIMITS -327.6800 327.6700
 /begin AXIS_DESCR STD_AXIS ZFC_pRailSetPoint_mp Pres_Rail 3 0.00 1800000. FORMAT "%8.0" EXTENDED_LIMITS -3276800. 3276700. DEPOSIT ABSOLUTE /end AXIS_DESCR
/end CHARACTERISTIC
/begin CHARACTERISTIC Rail_stDesBaseMsk_C "Maske zur Einspritzcharakteristik für den Basissollwert des Raildrucks" VALUE 0x1E6F94 Kw_Wu8 255.0 OneToOne 0.00 255.0 FORMAT "%5.1" /end CHARACTERISTIC
/begin CHARACTERISTIC Rail_stPreCtlMeUnSel_C "Schalter-Auswahl für die Vorsteuerung der Zumesseinheit" VALUE 0x1E607C Kw_Wu8 255.0 OneToOne 0.00 255.0 FORMAT "%5.1" /end CHARACTERISTIC
/begin CHARACTERISTIC Rail_stRgnDelMsk_C "Maske für die Deaktivierung der Raildrucksollwerteberechnung im Regenerationsbetrieb" VALUE 0x1E6F98 Kw_Wu32 4294967295.00 OneToOne 0.00 4294967295.00 FORMAT "%13.2" /end CHARACTERISTIC
/begin CHARACTERISTIC Rail_stRgnMsk1_C "Bitmaske 1 für Aktivierung  des Raildrucksollwert Regenerationsmodes" VALUE 0x1E69F0 Kw_Wu32 2147483647.00 OneToOne 0.00 2147483647.00 FORMAT "%13.2" EXTENDED_LIMITS 0.00 4294967295.00 /end CHARACTERISTIC
/begin CHARACTERISTIC Rail_stRgnMsk2_C "Bitmaske 2 für Aktivierung  des Raildrucksollwert Regenerationsmodes" VALUE 0x1E69F4 Kw_Wu32 2147483647.00 OneToOne 0.00 2147483647.00 FORMAT "%13.2" EXTENDED_LIMITS 0.00 4294967295.00 /end CHARACTERISTIC
/begin CHARACTERISTIC Rail_stRgnMsk3_C "Bitmaske 3 für Aktivierung  des Raildrucksollwert Regenerationsmodes" VALUE 0x1E69F8 Kw_Wu32 2147483647.00 OneToOne 0.00 2147483647.00 FORMAT "%13.2" EXTENDED_LIMITS 0.00 4294967295.00 /end CHARACTERISTIC
/begin CHARACTERISTIC Rail_stRgnMsk_C "Bitmaske für Aktivierung  des Raildrucksollwert Regenerationsmodes" VALUE 0x1E6A04 Kw_Wu32 4294967295.00 OneToOne 0.00 4294967295.00 FORMAT "%13.2" /end CHARACTERISTIC
/begin CHARACTERISTIC Rail_stSetPointSel_C "Schalterauswahl für die Raildruck-Sollwertberechnung" VALUE 0x1E6F9C Kw_Wu8 255.0 OneToOne 0.00 255.0 FORMAT "%5.1" /end CHARACTERISTIC
/begin CHARACTERISTIC Rail_swtDvolPreCtl_C "Schalter zur Fernsteuerung des Vorsteuerwerts für die Zumesseinheit" VALUE 0x1E6082 Kw_Wu8 1.000 OneToOne 0.00 1.000 FORMAT "%5.3" EXTENDED_LIMITS 0.00 255.0 /end CHARACTERISTIC
/begin CHARACTERISTIC Rail_swtPPreCtl_C "Schalter zur Fernsteuerung des Vorsteuerwerts für Druckregelventil" VALUE 0x1E6322 Kw_Wu8 1.000 OneToOne 0.00 1.000 FORMAT "%5.3" EXTENDED_LIMITS 0.00 255.0 /end CHARACTERISTIC
/begin CHARACTERISTIC Rail_swtPreCtlVal_C "Schalterwert, Raildruckregler mit / ohne Vorsteuerung" VALUE 0x1E5C30 Kw_Wu8 1.000 OneToOne 0.00 1.000 FORMAT "%5.3" EXTENDED_LIMITS 0.00 255.0 /end CHARACTERISTIC
/begin CHARACTERISTIC Rail_swtPreCtlType_C "Auswahl, Schalterwert aus Datensatz oder EEPROM" VALUE 0x1E5C31 Kw_Wu8 0.00 OneToOne 2.000 2.000 FORMAT "%5.3" EXTENDED_LIMITS 0.00 255.0 /end CHARACTERISTIC
/begin CHARACTERISTIC Rail_swtPressVal_C "Schalterwert, Umschaltung zwischen Steuern und Regeln anhand Absolut- / Differenzwert des Raildrucks" VALUE 0x1E5C32 Kw_Wu8 1.000 OneToOne 0.00 1.000 FORMAT "%5.3" EXTENDED_LIMITS 0.00 255.0 /end CHARACTERISTIC
/begin CHARACTERISTIC Rail_swtPressType_C "Auswahl, Schalterwert aus Datensatz oder EEPROM" VALUE 0x1E5C33 Kw_Wu8 0.00 OneToOne 2.000 2.000 FORMAT "%5.3" EXTENDED_LIMITS 0.00 255.0 /end CHARACTERISTIC
/begin CHARACTERISTIC Rail_swtPSetPoint_C "Schalter zur Fernsteuerung des Raildrucksollwerts" VALUE 0x1E7648 Kw_Wu8 1.000 OneToOne 0.00 1.000 FORMAT "%5.3" EXTENDED_LIMITS 0.00 255.0 /end CHARACTERISTIC
/begin CHARACTERISTIC Rail_swtWindUpVal_C "Schalterwert, Raildruckregler mit eingefrorenem oder rückgerechnetem I-Anteil" VALUE 0x1E5C34 Kw_Wu8 1.000 OneToOne 0.00 1.000 FORMAT "%5.3" EXTENDED_LIMITS 0.00 255.0 /end CHARACTERISTIC
/begin CHARACTERISTIC Rail_swtWindUpType_C "Auswahl, Schalterwert aus Datensatz oder EEPROM" VALUE 0x1E5C35 Kw_Wu8 0.00 OneToOne 2.000 2.000 FORMAT "%5.3" EXTENDED_LIMITS 0.00 255.0 /end CHARACTERISTIC
/begin CHARACTERISTIC Rail_tiMeUnCtlTypeDel_C "Zeitverzögerung im Schubbetrieb bis zur Umschaltung auf Druckregelung über Zumesseinheit" VALUE 0x1E58DA Kw_Wu16 655350.0 Time_ms 0.00 655350.0 FORMAT "%8.1" /end CHARACTERISTIC
/begin CHARACTERISTIC Rail_tiPCVRmpDur_CUR "Laufzeit der Rampe um vom aktuellen Sollwert auf den neuen PCVClose-Wert zu rampen" CURVE 0x1E62F2 Kl_Xs16_Ws16 655350.0 Time_ms -327680.0 327670.0 FORMAT "%8.1"
 /begin AXIS_DESCR STD_AXIS Eng_nAvrg EngN 10 0.00 6000.000 FORMAT "%8.3" EXTENDED_LIMITS -32768.00 32767.00 DEPOSIT ABSOLUTE /end AXIS_DESCR
/end CHARACTERISTIC
/begin CHARACTERISTIC Rail_tiPCVRmpToOfs_C "Laufzeit der Rampe um vom reduzierten Offsetwert auf den Offsetwert zu rampen" VALUE 0x1E631C Kw_Ws16 300.0000 Time_ms 0.00 300.0000 FORMAT "%8.4" EXTENDED_LIMITS -327680.0 327670.0 /end CHARACTERISTIC
/begin CHARACTERISTIC Rail_tiPCVRmpToRedOfs_C "Laufzeit der Rampe um vom Offsetwert auf den reduzierten Offsetwert zu rampen" VALUE 0x1E631E Kw_Ws16 300.0000 Time_ms 0.00 300.0000 FORMAT "%8.4" EXTENDED_LIMITS -327680.0 327670.0 /end CHARACTERISTIC
/begin CHARACTERISTIC Rail_tiSwtCtlTypeDel_C "Verzögerungszeit bis zur Freigabe der Umschaltung des Regelprinzips" VALUE 0x1E58DC Kw_Wu16 655350.0 Time_ms 0.00 655350.0 FORMAT "%8.1" /end CHARACTERISTIC
/begin CHARACTERISTIC Rail_tiZFCDemDel_C "Verzögerungszeit für Umschaltung auf geschlossenes Druckregelventil bei aktiver Lernphase der ZFC" VALUE 0x1E7670 Kw_Wu16 655350.0 Time_ms 0.00 655350.0 FORMAT "%8.1" /end CHARACTERISTIC
/begin CHARACTERISTIC Rail_tiZFCPT1_C "Parameter für ZFC Raildrucksollwert PT1 filter" VALUE 0x1E7674 Kw_Wu32 1073.7408 TimeDelay_s 0.0010000001 1073.7418 FORMAT "%9.4" EXTENDED_LIMITS 0.0000010000000 4294.9673 /end CHARACTERISTIC
/begin CHARACTERISTIC Rail_tMeUnCtlType_CUR "Kennlinie zur temperaturabhängigen Umschaltung auf Druckregelung über Zumesseinheit" CURVE 0x1E58DE Kl_Xs16_Ws16 200.0000 Temp_Cels -50.14000 149.8600 FORMAT "%8.4" EXTENDED_LIMITS -3549.940 3003.560
 /begin AXIS_DESCR STD_AXIS Eng_nAvrg EngN 8 0.00 6000.000 FORMAT "%8.3" EXTENDED_LIMITS -32768.00 32767.00 DEPOSIT ABSOLUTE /end AXIS_DESCR
/end CHARACTERISTIC
/begin CHARACTERISTIC Rail_tOvrRunThres_C "Systemtemperaturschwelle zur Umschaltung auf Druckregelung über Zumesseinheit bei Schubbetrieb" VALUE 0x1E5900 Kw_Ws16 200.0000 Temp_Cels -50.14000 149.8600 FORMAT "%8.4" EXTENDED_LIMITS -3549.940 3003.560 /end CHARACTERISTIC
/begin CHARACTERISTIC Rail_tPCVCtlType_CUR "Kennlinie zur temperaturabhängigen Umschaltung auf Druckregelung über Druckregelventil" CURVE 0x1E5902 Kl_Xs16_Ws16 200.0000 Temp_Cels -50.14000 149.8600 FORMAT "%8.4" EXTENDED_LIMITS -3549.940 3003.560
 /begin AXIS_DESCR STD_AXIS Eng_nAvrg EngN 8 0.00 6000.000 FORMAT "%8.3" EXTENDED_LIMITS -32768.00 32767.00 DEPOSIT ABSOLUTE /end AXIS_DESCR
/end CHARACTERISTIC
/begin CHARACTERISTIC Rail_tSwtCtlTypeHi_C "Obere Hystereseschwelle der Systemtemperatur bis zur Freigabe der Umschaltung des Regelprinzips" VALUE 0x1E5924 Kw_Ws16 200.0000 Temp_Cels -50.14000 149.8600 FORMAT "%8.4" EXTENDED_LIMITS -3549.940 3003.560 /end CHARACTERISTIC
/begin CHARACTERISTIC Rail_tSwtCtlTypeLo_C "Untere Hystereseschwelle der Systemtemperatur bis zur Freigabe der Umschaltung des Regelprinzips" VALUE 0x1E5926 Kw_Ws16 200.0000 Temp_Cels -50.14000 149.8600 FORMAT "%8.4" EXTENDED_LIMITS -3549.940 3003.560 /end CHARACTERISTIC
/begin CHARACTERISTIC Rail_volInjVlvCtl_C "Steuervolumen der Injektoren" VALUE 0x1E607E Kw_Ws16 10.00000 InjQntInj 0.00 10.00000 FORMAT "%8.5" EXTENDED_LIMITS -327.6800 327.6700 /end CHARACTERISTIC
/begin CHARACTERISTIC Rtmo_adStart_cu32 "Startadresse der zu messenden Funktion" VALUE 0x1E76CC Kw_Wu32 4294967295.00 OneToOne 0.00 4294967295.00 FORMAT "%13.2" /end CHARACTERISTIC
/begin CHARACTERISTIC Rtmo_stSampleTime_cu8 "Messzykluszeit: 0: keine Messung; 1-253: 100 ms Raster für jeden 1-253 Durchgang; 254: 10/20ms; 255: segment sync." VALUE 0x1E76D0 Kw_Wu8 255.0 OneToOne 0.00 255.0 FORMAT "%5.1" /end CHARACTERISTIC
/begin CHARACTERISTIC Rtmo_swMinMaxReset_cu8 "Reset Min/Max Werte durch Setzen auf 1" VALUE 0x1E76D1 Kw_Wu8 1.000 OneToOne 0.00 1.000 FORMAT "%5.3" EXTENDED_LIMITS 0.00 255.0 /end CHARACTERISTIC
/begin CHARACTERISTIC Sig_LimLowDigital_C "Unterer Grenzwert für Stellertests mit digitaler Stellgröße" VALUE 0x1C120E Kw_Ws16 65535.00 OneToOne -32768.00 32767.00 FORMAT "%8.2" /end CHARACTERISTIC
/begin CHARACTERISTIC Sig_LimUpDigital_C "Oberer Grenzwert für Stellertests mit digitaler Stellgröße" VALUE 0x1C1210 Kw_Ws16 1.000000 OneToOne 0.00 1.000000 FORMAT "%8.6" EXTENDED_LIMITS -32768.00 32767.00 /end CHARACTERISTIC
/begin CHARACTERISTIC Sig_LimLown_C "Unterer Grenzwert für Stellertests mit Drehzahl Stellgröße" VALUE 0x1C1212 Kw_Ws16 65535.00 EngN -32768.00 32767.00 FORMAT "%8.2" /end CHARACTERISTIC
/begin CHARACTERISTIC Sig_LimUpn_C "Oberer Grenzwert für Stellertests mit Drehzahl Stellgröße" VALUE 0x1C1214 Kw_Ws16 65535.00 EngN -32768.00 32767.00 FORMAT "%8.2" /end CHARACTERISTIC
/begin CHARACTERISTIC Sig_LimLowPwm_C "Unterer Grenzwert für Stellertests mit PWM Stellgröße" VALUE 0x1C1216 Kw_Ws16 655.3500 DtyCyc -327.6800 327.6700 FORMAT "%8.4" /end CHARACTERISTIC
/begin CHARACTERISTIC Sig_LimUpPwm_C "Oberer Grenzwert für Stellertests mit PWM Stellgröße" VALUE 0x1C1218 Kw_Ws16 655.3500 DtyCyc -327.6800 327.6700 FORMAT "%8.4" /end CHARACTERISTIC
/begin CHARACTERISTIC Signals_PID0x1C_C "Info für Generic Scan Tool (OBD-Tester) für welche Vorschrift das Fahrzeug appliziert wurde" VALUE 0x1C120C Kw_Wu8 8.00000000000 SigSupLeg 1.00000000000 9.00000000000 FORMAT "%13.11" /end CHARACTERISTIC
/begin CHARACTERISTIC signals_tiTstDemHeal_C "Minimale Zeit ohne Stellertestanforderung nach Verriegelung wegen Zeitüberschreitung." VALUE 0x1E76D4 Kw_Wu16 655350.0 Time_ms 0.00 655350.0 FORMAT "%8.1" /end CHARACTERISTIC
/begin CHARACTERISTIC signals_tiTstDemMax_C "Maximale zulässige Testzeit für Stellertest über Diagnosetester" VALUE 0x1E76D6 Kw_Wu16 655350.0 Time_ms 0.00 655350.0 FORMAT "%8.1" /end CHARACTERISTIC
/begin CHARACTERISTIC signals_TmrBehaviour_C "Verhalten der Zeitbegrenzung für Stellertest" VALUE 0x1E76D8 Kw_Wu8 255.0 OneToOne 0.00 255.0 FORMAT "%5.1" /end CHARACTERISTIC
/begin CHARACTERISTIC signals_TstDemMaxEngN_C "Maximale Drehzahl für Stellertest über Diagnosetester" VALUE 0x1E76DA Kw_Ws16 65535.00 EngN -32768.00 32767.00 FORMAT "%8.2" /end CHARACTERISTIC
/begin CHARACTERISTIC signals_TstDemMaxVSSCDV_C "Maximale Geschwindigkeit für Stellertest über Diagnosetester" VALUE 0x1E76DC Kw_Ws16 655.3500 Vel -327.6800 327.6700 FORMAT "%8.4" /end CHARACTERISTIC
/begin CHARACTERISTIC SigTst_ACEn_C "Stellertestüberwachung Freigabemaske für Klimaanlage Ausgang" VALUE 0x1E76DE Kw_Wu8 7.000 OneToOne 0.00 7.000 FORMAT "%5.3" EXTENDED_LIMITS 0.00 255.0 /end CHARACTERISTIC
/begin CHARACTERISTIC SigTst_ADPEn_C "Stellertestüberwachung Freigabemaske für Additivpumpe" VALUE 0x1E76DF Kw_Wu8 7.000 OneToOne 0.00 7.000 FORMAT "%5.3" EXTENDED_LIMITS 0.00 255.0 /end CHARACTERISTIC
/begin CHARACTERISTIC SigTst_AOHtCDHt1En_C "Stellertestüberwachung Freigabemaske für Zuheizer1 Ausgang" VALUE 0x1E76E0 Kw_Wu8 7.000 OneToOne 0.00 7.000 FORMAT "%5.3" EXTENDED_LIMITS 0.00 255.0 /end CHARACTERISTIC
/begin CHARACTERISTIC SigTst_AOHtCDHt2En_C "Stellertestüberwachung Freigabemaske für Zuheizer2 Ausgang" VALUE 0x1E76E1 Kw_Wu8 7.000 OneToOne 0.00 7.000 FORMAT "%5.3" EXTENDED_LIMITS 0.00 255.0 /end CHARACTERISTIC
/begin CHARACTERISTIC SigTst_AltRLYExcEn_C "Stellertestüberwachung Freigabemaske für die Generatorerregung" VALUE 0x1E76E2 Kw_Wu8 7.000 OneToOne 0.00 7.000 FORMAT "%5.3" EXTENDED_LIMITS 0.00 255.0 /end CHARACTERISTIC
/begin CHARACTERISTIC SigTst_BPAEn_C "Stellertestüberwachung Freigabemaske für Ladedrucksteller" VALUE 0x1E76E3 Kw_Wu8 7.000 OneToOne 0.00 7.000 FORMAT "%5.3" EXTENDED_LIMITS 0.00 255.0 /end CHARACTERISTIC
/begin CHARACTERISTIC SigTst_CtApEn_C "Stelltestüberwachung Freigabemaske für den Kühlmittelumwälzpumpe - Nachlauf" VALUE 0x1E76E4 Kw_Wu8 7.000 OneToOne 0.00 7.000 FORMAT "%5.3" EXTENDED_LIMITS 0.00 255.0 /end CHARACTERISTIC
/begin CHARACTERISTIC SigTst_CtTEn_C "Stelltestüberwachung Freigabemaske für den Kühlmittelthermostaten" VALUE 0x1E76E5 Kw_Wu8 7.000 OneToOne 0.00 7.000 FORMAT "%5.3" EXTENDED_LIMITS 0.00 255.0 /end CHARACTERISTIC
/begin CHARACTERISTIC SigTst_EGREn_C "Stellertestüberwachung Freigabemaske für Abgasrückführpositionssteller" VALUE 0x1E76E6 Kw_Wu8 7.000 OneToOne 0.00 7.000 FORMAT "%5.3" EXTENDED_LIMITS 0.00 255.0 /end CHARACTERISTIC
/begin CHARACTERISTIC SigTst_EGRClgBypVlvEn_C "Stelltestüberwachung Freigabemaske für den Kühlerbypass der Abgasrückführungventils" VALUE 0x1E76E7 Kw_Wu8 7.000 OneToOne 0.00 7.000 FORMAT "%5.3" EXTENDED_LIMITS 0.00 255.0 /end CHARACTERISTIC
/begin CHARACTERISTIC SigTst_ENGMENGEn_C "Stellertestüberwachung Freigabemaske für Motorlager Ausgang" VALUE 0x1E76E8 Kw_Wu8 7.000 OneToOne 0.00 7.000 FORMAT "%5.3" EXTENDED_LIMITS 0.00 255.0 /end CHARACTERISTIC
/begin CHARACTERISTIC SigTst_ENGMGEAREn_C "Stellertestüberwachung Freigabemaske für Getriebelager Ausgang" VALUE 0x1E76E9 Kw_Wu8 7.000 OneToOne 0.00 7.000 FORMAT "%5.3" EXTENDED_LIMITS 0.00 255.0 /end CHARACTERISTIC
/begin CHARACTERISTIC SigTst_Fan1En_C "Tester Anforderung Überwachung Enable maske für Fan1" VALUE 0x1E76EA Kw_Wu8 7.000 OneToOne 0.00 7.000 FORMAT "%5.3" EXTENDED_LIMITS 0.00 255.0 /end CHARACTERISTIC
/begin CHARACTERISTIC SigTst_Fan2En_C "Tester Anforderung Überwachung Enable maske für Fan1" VALUE 0x1E76EB Kw_Wu8 7.000 OneToOne 0.00 7.000 FORMAT "%5.3" EXTENDED_LIMITS 0.00 255.0 /end CHARACTERISTIC
/begin CHARACTERISTIC SigTst_FlPpCDEn_C "Stellertestüberwachung Freigabemaske für Kraftstoffumwälzpumpe" VALUE 0x1E76EC Kw_Wu8 7.000 OneToOne 0.00 7.000 FORMAT "%5.3" EXTENDED_LIMITS 0.00 255.0 /end CHARACTERISTIC
/begin CHARACTERISTIC SigTst_GLWLAMPEn_C "Stellertestüberwachung Freigabemaske für Glühanzeige" VALUE 0x1E76ED Kw_Wu8 7.000 OneToOne 0.00 7.000 FORMAT "%5.3" EXTENDED_LIMITS 0.00 255.0 /end CHARACTERISTIC
/begin CHARACTERISTIC SigTst_GLWRLYEn_C "Stellertestüberwachung Freigabemaske für Glüh Relay" VALUE 0x1E76EE Kw_Wu8 7.000 OneToOne 0.00 7.000 FORMAT "%5.3" EXTENDED_LIMITS 0.00 255.0 /end CHARACTERISTIC
/begin CHARACTERISTIC SigTst_LSUCDHt0En_C "Auswahlmake für Überwachungsbedingungen des Lambda Sensor Stellertests" VALUE 0x1E76EF Kw_Wu8 7.000 OneToOne 0.00 7.000 FORMAT "%5.3" EXTENDED_LIMITS 0.00 255.0 /end CHARACTERISTIC
/begin CHARACTERISTIC SigTst_MILLAMPEn_C "Stellertestüberwachung Freigabemaske für MIL (OBD-Lampe)" VALUE 0x1E76F0 Kw_Wu8 7.000 OneToOne 0.00 7.000 FORMAT "%5.3" EXTENDED_LIMITS 0.00 255.0 /end CHARACTERISTIC
/begin CHARACTERISTIC SigTst_MeUnEn_C "Stellertestüberwachung Freigabemaske für Zumesseinheit" VALUE 0x1E76F1 Kw_Wu8 7.000 OneToOne 0.00 7.000 FORMAT "%5.3" EXTENDED_LIMITS 0.00 255.0 /end CHARACTERISTIC
/begin CHARACTERISTIC SigTst_PCVEn_C "Stellertestüberwachung Freigabemaske für Druckregelventil" VALUE 0x1E76F2 Kw_Wu8 7.000 OneToOne 0.00 7.000 FORMAT "%5.3" EXTENDED_LIMITS 0.00 255.0 /end CHARACTERISTIC
/begin CHARACTERISTIC SigTst_PFltRLYHtgEn_C "Stelltestüberwachung Freigabemaske für Partikelfilterheizung" VALUE 0x1E76F3 Kw_Wu8 7.000 OneToOne 0.00 7.000 FORMAT "%5.3" EXTENDED_LIMITS 0.00 255.0 /end CHARACTERISTIC
/begin CHARACTERISTIC SigTst_PSPEn_C "Stellertestüberwachung Freigabemaske für Vorförderpumpen  Ausgang" VALUE 0x1E76F4 Kw_Wu8 7.000 OneToOne 0.00 7.000 FORMAT "%5.3" EXTENDED_LIMITS 0.00 255.0 /end CHARACTERISTIC
/begin CHARACTERISTIC SigTst_SYSLAMPEn_C "Stellertestüberwachung Freigabemaske für Systemlampe" VALUE 0x1E76F5 Kw_Wu8 7.000 OneToOne 0.00 7.000 FORMAT "%5.3" EXTENDED_LIMITS 0.00 255.0 /end CHARACTERISTIC
/begin CHARACTERISTIC SigTst_StrtCDRLYOffRlyEn_C "Stellertestüberwachung Freigabemaske für das Starter Aus-Relais" VALUE 0x1E76F6 Kw_Wu8 7.000 OneToOne 0.00 7.000 FORMAT "%5.3" EXTENDED_LIMITS 0.00 255.0 /end CHARACTERISTIC
/begin CHARACTERISTIC SigTst_StrtCDRLYOnRlyEn_C "Stellertestüberwachung Freigabemaske für das Starter Ein-Relais" VALUE 0x1E76F7 Kw_Wu8 7.000 OneToOne 0.00 7.000 FORMAT "%5.3" EXTENDED_LIMITS 0.00 255.0 /end CHARACTERISTIC
/begin CHARACTERISTIC SigTst_TVAEn_C "Stellertestüberwachung Freigabemaske für Drosselklappensteller" VALUE 0x1E76F8 Kw_Wu8 7.000 OneToOne 0.00 7.000 FORMAT "%5.3" EXTENDED_LIMITS 0.00 255.0 /end CHARACTERISTIC
/begin CHARACTERISTIC SigTst_VSAEn_C "Stellertestüberwachung Freigabemaske für Drallniveausteller" VALUE 0x1E76F9 Kw_Wu8 7.000 OneToOne 0.00 7.000 FORMAT "%5.3" EXTENDED_LIMITS 0.00 255.0 /end CHARACTERISTIC
/begin CHARACTERISTIC Sig_aDSMOffset_C "Offset fuer Umrechung SG->DSM fuer Beschleunigung" VALUE 0x1C0FB4 Kw_Ws16 65535.00 OneToOne -32768.00 32767.00 FORMAT "%8.2" /end CHARACTERISTIC
/begin CHARACTERISTIC Sig_aDSMScale_C "Skalierung Umrechungs Faktor SG->DSM fuer Beschleunigung" VALUE 0x1C0FB6 Kw_Wu16 6.553500 FactHigh 0.00 6.553500 FORMAT "%8.6" /end CHARACTERISTIC
/begin CHARACTERISTIC Sig_aCANOffset_C "Offset fuer Umrechung SG->CAN fuer Beschleunigung" VALUE 0x1C0FB8 Kw_Ws16 65535.00 OneToOne -32768.00 32767.00 FORMAT "%8.2" /end CHARACTERISTIC
/begin CHARACTERISTIC Sig_aCANScale_C "Skalierung Umrechungs Faktor SG->CAN fuer Beschleunigung" VALUE 0x1C0FBA Kw_Wu16 6.553500 FactHigh 0.00 6.553500 FORMAT "%8.6" /end CHARACTERISTIC
/begin CHARACTERISTIC Sig_aDIAOffset_C "Offset fuer Umrechung SG->DIA fuer Beschleunigung" VALUE 0x1C0FBC Kw_Ws16 65535.00 OneToOne -32768.00 32767.00 FORMAT "%8.2" /end CHARACTERISTIC
/begin CHARACTERISTIC Sig_aDIAScale_C "Skalierung Umrechungs Faktor SG->DIA fuer Beschleunigung" VALUE 0x1C0FBE Kw_Wu16 6.553500 FactHigh 0.00 6.553500 FORMAT "%8.6" /end CHARACTERISTIC
/begin CHARACTERISTIC Sig_Carb_dtDSMOffset_C "Signals Offset für Umrechung  Temperaturdifferenz Intern nach DSM mit CARB Normierung" VALUE 0x1C0FC0 Kw_Ws16 65535.00 OneToOne -32768.00 32767.00 FORMAT "%8.2" /end CHARACTERISTIC
/begin CHARACTERISTIC Sig_Carb_dtDSMScale_C "Signals Skalierungsfaktor für Umrechung  Temperaturdifferenz Intern nach DSM mit CARB Normierung" VALUE 0x1C0FC2 Kw_Wu16 7.999878 Fact 0.00 7.999878 FORMAT "%8.6" /end CHARACTERISTIC
/begin CHARACTERISTIC Sig_Carb_dtCANOffset_C "Signals Offset für Umrechung  Temperaturdifferenz Intern nach CAN mit CARB Normierung" VALUE 0x1C0FC4 Kw_Ws16 65535.00 OneToOne -32768.00 32767.00 FORMAT "%8.2" /end CHARACTERISTIC
/begin CHARACTERISTIC Sig_Carb_dtCANScale_C "Signals Skalierungsfaktor für Umrechung  Temperaturdifferenz Intern nach CAN mit CARB Normierung" VALUE 0x1C0FC6 Kw_Wu16 7.999878 Fact 0.00 7.999878 FORMAT "%8.6" /end CHARACTERISTIC
/begin CHARACTERISTIC Sig_Carb_dtDIAOffset_C "Signals Offset für Umrechung  Temperaturdifferenz Intern nach Diagnose mit CARB Normierung" VALUE 0x1C0FC8 Kw_Ws16 65535.00 OneToOne -32768.00 32767.00 FORMAT "%8.2" /end CHARACTERISTIC
/begin CHARACTERISTIC Sig_Carb_dtDIAScale_C "Signals Skalierungsfaktor für Umrechung  Temperaturdifferenz Intern nach Diagnose mit CARB Normierung" VALUE 0x1C0FCA Kw_Wu16 7.999878 Fact 0.00 7.999878 FORMAT "%8.6" /end CHARACTERISTIC
/begin CHARACTERISTIC Sig_Carb_lDSMOffset_C "Signals Offset für Umrechung  Fahrstrecke Intern nach DSM mit CARB Normierung" VALUE 0x1C0FCC Kw_Ws16 65535.00 OneToOne -32768.00 32767.00 FORMAT "%8.2" /end CHARACTERISTIC
/begin CHARACTERISTIC Sig_Carb_lDSMScale_C "Signals Skalierungsfaktor für Umrechung  Fahrstrecke Intern nach DSM mit CARB Normierung" VALUE 0x1C0FCE Kw_Wu16 7.999878 Fact 0.00 7.999878 FORMAT "%8.6" /end CHARACTERISTIC
/begin CHARACTERISTIC Sig_Carb_lCANOffset_C "Signals Offset für Umrechung  Fahrstrecke Intern nach CAN mit CARB Normierung" VALUE 0x1C0FD0 Kw_Ws16 65535.00 OneToOne -32768.00 32767.00 FORMAT "%8.2" /end CHARACTERISTIC
/begin CHARACTERISTIC Sig_Carb_lCANScale_C "Signals Skalierungsfaktor für Umrechung  Fahrstrecke Intern nach CAN mit CARB Normierung" VALUE 0x1C0FD2 Kw_Wu16 7.999878 Fact 0.00 7.999878 FORMAT "%8.6" /end CHARACTERISTIC
/begin CHARACTERISTIC Sig_Carb_lDIAOffset_C "Signals Offset für Umrechung  Fahrstrecke Intern nach Diagnoseschnittstelle mit CARB Normierung" VALUE 0x1C0FD4 Kw_Ws16 65535.00 OneToOne -32768.00 32767.00 FORMAT "%8.2" /end CHARACTERISTIC
/begin CHARACTERISTIC Sig_Carb_lDIAScale_C "Signals Skalierungsfaktor für Umrechung  Fahrstrecke Intern nach Diagnoseschnittstelle mit CARB Normierung" VALUE 0x1C0FD6 Kw_Wu16 7.999878 Fact 0.00 7.999878 FORMAT "%8.6" /end CHARACTERISTIC
/begin CHARACTERISTIC Sig_Carb_mAirTimDSMOffset_C "Offset fuer Umrechung SG->DSM fuer Luftmasse pro Zeit (OBD)" VALUE 0x1C0FD8 Kw_Ws16 65535.00 OneToOne -32768.00 32767.00 FORMAT "%8.2" /end CHARACTERISTIC
/begin CHARACTERISTIC Sig_Carb_mAirTimDSMScale_C "Skalierung Umrechungs Faktor SG->DSM fuer Luftmasse pro Zeit (OBD)" VALUE 0x1C0FDA Kw_Wu16 7.999878 Fact 0.00 7.999878 FORMAT "%8.6" /end CHARACTERISTIC
/begin CHARACTERISTIC Sig_Carb_mAirTimCANOffset_C "Offset fuer Umrechung SG->CAN fuer Luftmasse pro Zeit (OBD)" VALUE 0x1C0FDC Kw_Ws16 65535.00 OneToOne -32768.00 32767.00 FORMAT "%8.2" /end CHARACTERISTIC
/begin CHARACTERISTIC Sig_Carb_mAirTimCANScale_C "Skalierung Umrechungs Faktor SG->CAN fuer Luftmasse pro Zeit (OBD)" VALUE 0x1C0FDE Kw_Wu16 7.999878 Fact 0.00 7.999878 FORMAT "%8.6" /end CHARACTERISTIC
/begin CHARACTERISTIC Sig_Carb_mAirTimDIAOffset_C "Offset fuer Umrechung SG->DIA fuer Luftmasse pro Zeit (OBD)" VALUE 0x1C0FE0 Kw_Ws16 65535.00 OneToOne -32768.00 32767.00 FORMAT "%8.2" /end CHARACTERISTIC
/begin CHARACTERISTIC Sig_Carb_mAirTimDIAScale_C "Skalierung Umrechungs Faktor SG->DIA fuer Luftmasse pro Zeit (OBD)" VALUE 0x1C0FE2 Kw_Wu16 7.999878 Fact 0.00 7.999878 FORMAT "%8.6" /end CHARACTERISTIC
/begin CHARACTERISTIC Sig_Carb_nDSMOffset_C "Offset fuer Umrechung SG->DSM fuer Drehzahl (OBD)" VALUE 0x1C0FE4 Kw_Ws16 65535.00 OneToOne -32768.00 32767.00 FORMAT "%8.2" /end CHARACTERISTIC
/begin CHARACTERISTIC Sig_Carb_nDSMScale_C "Skalierung Umrechungs Faktor SG->DSM fuer Drehzahl (OBD)" VALUE 0x1C0FE6 Kw_Wu16 7.999878 Fact 0.00 7.999878 FORMAT "%8.6" /end CHARACTERISTIC
/begin CHARACTERISTIC Sig_Carb_nCANOffset_C "Offset fuer Umrechung SG->CAN fuer Drehzahl (OBD)" VALUE 0x1C0FE8 Kw_Ws16 65535.00 OneToOne -32768.00 32767.00 FORMAT "%8.2" /end CHARACTERISTIC
/begin CHARACTERISTIC Sig_Carb_nCANScale_C "Skalierung Umrechungs Faktor SG->CAN fuer Drehzahl (OBD)" VALUE 0x1C0FEA Kw_Wu16 7.999878 Fact 0.00 7.999878 FORMAT "%8.6" /end CHARACTERISTIC
/begin CHARACTERISTIC Sig_Carb_nDIAOffset_C "Offset fuer Umrechung SG->DIA fuer Drehzahl (OBD)" VALUE 0x1C0FEC Kw_Ws16 65535.00 OneToOne -32768.00 32767.00 FORMAT "%8.2" /end CHARACTERISTIC
/begin CHARACTERISTIC Sig_Carb_nDIAScale_C "Skalierung Umrechungs Faktor SG->DIA fuer Drehzahl (OBD)" VALUE 0x1C0FEE Kw_Wu16 7.999878 Fact 0.00 7.999878 FORMAT "%8.6" /end CHARACTERISTIC
/begin CHARACTERISTIC Sig_Carb_pDSMOffset_C "Offset fuer Umrechung SG->DSM fuer Druck (OBD)" VALUE 0x1C0FF0 Kw_Ws16 65535.00 OneToOne -32768.00 32767.00 FORMAT "%8.2" /end CHARACTERISTIC
/begin CHARACTERISTIC Sig_Carb_pDSMScale_C "Skalierung Umrechungs Faktor SG->DSM fuer Druck (OBD)" VALUE 0x1C0FF2 Kw_Wu16 7.999878 Fact 0.00 7.999878 FORMAT "%8.6" /end CHARACTERISTIC
/begin CHARACTERISTIC Sig_Carb_pCANOffset_C "Offset fuer Umrechung SG->CAN fuer Druck (OBD)" VALUE 0x1C0FF4 Kw_Ws16 65535.00 OneToOne -32768.00 32767.00 FORMAT "%8.2" /end CHARACTERISTIC
/begin CHARACTERISTIC Sig_Carb_pCANScale_C "Skalierung Umrechungs Faktor SG->CAN fuer Druck (OBD)" VALUE 0x1C0FF6 Kw_Wu16 7.999878 Fact 0.00 7.999878 FORMAT "%8.6" /end CHARACTERISTIC
/begin CHARACTERISTIC Sig_Carb_pDIAOffset_C "Offset fuer Umrechung SG->DIA fuer Druck (OBD)" VALUE 0x1C0FF8 Kw_Ws16 65535.00 OneToOne -32768.00 32767.00 FORMAT "%8.2" /end CHARACTERISTIC
/begin CHARACTERISTIC Sig_Carb_pDIAScale_C "Skalierung Umrechungs Faktor SG->DIA fuer Druck (OBD)" VALUE 0x1C0FFA Kw_Wu16 7.999878 Fact 0.00 7.999878 FORMAT "%8.6" /end CHARACTERISTIC
/begin CHARACTERISTIC Sig_Carb_rDSMOffset_C "Offset fuer Umrechung SG->DSM fuer Verhältnis (OBD)" VALUE 0x1C0FFC Kw_Ws16 65535.00 OneToOne -32768.00 32767.00 FORMAT "%8.2" /end CHARACTERISTIC
/begin CHARACTERISTIC Sig_Carb_rDSMScale_C "Skalierung Umrechungs Faktor SG->DSM fuer Verhältnis (OBD)" VALUE 0x1C0FFE Kw_Wu16 7.999878 Fact 0.00 7.999878 FORMAT "%8.6" /end CHARACTERISTIC
/begin CHARACTERISTIC Sig_Carb_rCANOffset_C "Offset fuer Umrechung SG->CAN fuer Verhältnis (OBD)" VALUE 0x1C1000 Kw_Ws16 65535.00 OneToOne -32768.00 32767.00 FORMAT "%8.2" /end CHARACTERISTIC
/begin CHARACTERISTIC Sig_Carb_rCANScale_C "Skalierung Umrechungs Faktor SG->CAN fuer Verhältnis (OBD)" VALUE 0x1C1002 Kw_Wu16 7.999878 Fact 0.00 7.999878 FORMAT "%8.6" /end CHARACTERISTIC
/begin CHARACTERISTIC Sig_Carb_rDIAOffset_C "Offset fuer Umrechung SG->DIA fuer Verhältnis (OBD)" VALUE 0x1C1004 Kw_Ws16 65535.00 OneToOne -32768.00 32767.00 FORMAT "%8.2" /end CHARACTERISTIC
/begin CHARACTERISTIC Sig_Carb_rDIAScale_C "Skalierung Umrechungs Faktor SG->DIA fuer Verhältnis (OBD)" VALUE 0x1C1006 Kw_Wu16 7.999878 Fact 0.00 7.999878 FORMAT "%8.6" /end CHARACTERISTIC
/begin CHARACTERISTIC Sig_Carb_tiDynDSMOffset_C "Offset für Umrechnung SG -> DSM für Zeit (OBD)" VALUE 0x1C1008 Kw_Ws16 65535.00 OneToOne -32768.00 32767.00 FORMAT "%8.2" /end CHARACTERISTIC
/begin CHARACTERISTIC Sig_Carb_tiDynDSMScale_C "Skalierung Umrechnungs Faktor SG -> DSM für Zeit (OBD)" VALUE 0x1C100A Kw_Wu16 7.999878 Fact 0.00 7.999878 FORMAT "%8.6" /end CHARACTERISTIC
/begin CHARACTERISTIC Sig_Carb_tiDynCANOffset_C "Offset für Umrechnung SG -> CAN für Zeit (OBD)" VALUE 0x1C100C Kw_Ws16 65535.00 OneToOne -32768.00 32767.00 FORMAT "%8.2" /end CHARACTERISTIC
/begin CHARACTERISTIC Sig_Carb_tiDynCANScale_C "Skalierung Umrechnungs Faktor SG -> CAN für Zeit (OBD)" VALUE 0x1C100E Kw_Wu16 7.999878 Fact 0.00 7.999878 FORMAT "%8.6" /end CHARACTERISTIC
/begin CHARACTERISTIC Sig_Carb_tiDynDIAOffset_C "Offset für Umrechnung SG -> DIA für Zeit (OBD)" VALUE 0x1C1010 Kw_Ws16 65535.00 OneToOne -32768.00 32767.00 FORMAT "%8.2" /end CHARACTERISTIC
/begin CHARACTERISTIC Sig_Carb_tiDynDIAScale_C "Skalierung Umrechnungs Faktor SG -> DIA für Zeit (OBD)" VALUE 0x1C1012 Kw_Wu16 7.999878 Fact 0.00 7.999878 FORMAT "%8.6" /end CHARACTERISTIC
/begin CHARACTERISTIC Sig_Carb_tiDSMOffset_C "Offset fuer Umrechung SG->DSM fuer Zeit (OBD)" VALUE 0x1C1014 Kw_Ws16 65535.00 OneToOne -32768.00 32767.00 FORMAT "%8.2" /end CHARACTERISTIC
/begin CHARACTERISTIC Sig_Carb_tiDSMScale_C "Skalierung Umrechungs Faktor SG->DSM fuer Zeit (OBD)" VALUE 0x1C1016 Kw_Wu16 7.999878 Fact 0.00 7.999878 FORMAT "%8.6" /end CHARACTERISTIC
/begin CHARACTERISTIC Sig_Carb_tiCANOffset_C "Offset fuer Umrechung SG->CAN fuer Zeit (OBD)" VALUE 0x1C1018 Kw_Ws16 65535.00 OneToOne -32768.00 32767.00 FORMAT "%8.2" /end CHARACTERISTIC
/begin CHARACTERISTIC Sig_Carb_tiCANScale_C "Skalierung Umrechungs Faktor SG->CAN fuer Zeit (OBD)" VALUE 0x1C101A Kw_Wu16 7.999878 Fact 0.00 7.999878 FORMAT "%8.6" /end CHARACTERISTIC
/begin CHARACTERISTIC Sig_Carb_tiDIAOffset_C "Offset fuer Umrechung SG->DIA fuer Zeit (OBD)" VALUE 0x1C101C Kw_Ws16 65535.00 OneToOne -32768.00 32767.00 FORMAT "%8.2" /end CHARACTERISTIC
/begin CHARACTERISTIC Sig_Carb_tiDIAScale_C "Skalierung Umrechungs Faktor SG->DIA fuer Zeit (OBD)" VALUE 0x1C101E Kw_Wu16 7.999878 Fact 0.00 7.999878 FORMAT "%8.6" /end CHARACTERISTIC
/begin CHARACTERISTIC Sig_Carb_tDSMOffset_C "Offset fuer Umrechung SG->DSM fuer Temperatur (OBD)" VALUE 0x1C1020 Kw_Ws16 65535.00 OneToOne -32768.00 32767.00 FORMAT "%8.2" /end CHARACTERISTIC
/begin CHARACTERISTIC Sig_Carb_tDSMScale_C "Skalierung Umrechungs Faktor SG->DSM fuer Temperatur (OBD)" VALUE 0x1C1022 Kw_Wu16 7.999878 Fact 0.00 7.999878 FORMAT "%8.6" /end CHARACTERISTIC
/begin CHARACTERISTIC Sig_Carb_tCANOffset_C "Offset fuer Umrechung SG->CAN fuer Temperatur (OBD)" VALUE 0x1C1024 Kw_Ws16 65535.00 OneToOne -32768.00 32767.00 FORMAT "%8.2" /end CHARACTERISTIC
/begin CHARACTERISTIC Sig_Carb_tCANScale_C "Skalierung Umrechungs Faktor SG->CAN fuer Temperatur (OBD)" VALUE 0x1C1026 Kw_Wu16 7.999878 Fact 0.00 7.999878 FORMAT "%8.6" /end CHARACTERISTIC
/begin CHARACTERISTIC Sig_Carb_tDIAOffset_C "Offset fuer Umrechung SG->DIA fuer Temperatur (OBD)" VALUE 0x1C1028 Kw_Ws16 65535.00 OneToOne -32768.00 32767.00 FORMAT "%8.2" /end CHARACTERISTIC
/begin CHARACTERISTIC Sig_Carb_tDIAScale_C "Skalierung Umrechungs Faktor SG->DIA fuer Temperatur (OBD)" VALUE 0x1C102A Kw_Wu16 7.999878 Fact 0.00 7.999878 FORMAT "%8.6" /end CHARACTERISTIC
/begin CHARACTERISTIC Sig_Carb_vDSMOffset_C "Offset fuer Umrechung SG->DSM fuer Geschwindigkeit (OBD)" VALUE 0x1C102C Kw_Ws16 65535.00 OneToOne -32768.00 32767.00 FORMAT "%8.2" /end CHARACTERISTIC
/begin CHARACTERISTIC Sig_Carb_vDSMScale_C "Skalierung Umrechungs Faktor SG->DSM fuer Geschwindigkeit (OBD)" VALUE 0x1C102E Kw_Wu16 7.999878 Fact 0.00 7.999878 FORMAT "%8.6" /end CHARACTERISTIC
/begin CHARACTERISTIC Sig_Carb_vCANOffset_C "Offset fuer Umrechung SG->CAN fuer Geschwindigkeit (OBD)" VALUE 0x1C1030 Kw_Ws16 65535.00 OneToOne -32768.00 32767.00 FORMAT "%8.2" /end CHARACTERISTIC
/begin CHARACTERISTIC Sig_Carb_vCANScale_C "Skalierung Umrechungs Faktor SG->CAN fuer Geschwindigkeit (OBD)" VALUE 0x1C1032 Kw_Wu16 7.999878 Fact 0.00 7.999878 FORMAT "%8.6" /end CHARACTERISTIC
/begin CHARACTERISTIC Sig_Carb_vDIAOffset_C "Offset fuer Umrechung SG->DIA fuer Geschwindigkeit (OBD)" VALUE 0x1C1034 Kw_Ws16 65535.00 OneToOne -32768.00 32767.00 FORMAT "%8.2" /end CHARACTERISTIC
/begin CHARACTERISTIC Sig_Carb_vDIAScale_C "Skalierung Umrechungs Faktor SG->DIA fuer Geschwindigkeit (OBD)" VALUE 0x1C1036 Kw_Wu16 7.999878 Fact 0.00 7.999878 FORMAT "%8.6" /end CHARACTERISTIC
/begin CHARACTERISTIC Sig_CnsmpDSMOffset_C "Offset für Umrechnung SG -> DSM für Verbrauch" VALUE 0x1C1038 Kw_Ws16 65535.00 OneToOne -32768.00 32767.00 FORMAT "%8.2" /end CHARACTERISTIC
/begin CHARACTERISTIC Sig_CnsmpDSMScale_C "Skalierung für Umrechnung SG -> DSM für Verbrauch" VALUE 0x1C103A Kw_Wu16 6.553500 FactHigh 0.00 6.553500 FORMAT "%8.6" /end CHARACTERISTIC
/begin CHARACTERISTIC Sig_CnsmpCANOffset_C "Offset fuer Umrechnung SG->CAN Verbrauch" VALUE 0x1C103C Kw_Ws16 65535.00 OneToOne -32768.00 32767.00 FORMAT "%8.2" /end CHARACTERISTIC
/begin CHARACTERISTIC Sig_CnsmpCANScale_C "Skalierung Umrechnung SG -> CAN für Verbrauch" VALUE 0x1C103E Kw_Wu16 6.553500 FactHigh 0.00 6.553500 FORMAT "%8.6" /end CHARACTERISTIC
/begin CHARACTERISTIC Sig_CnsmpDIAOffset_C "Offset Umrechnung SG -> Diagnose für Verbrauch" VALUE 0x1C1040 Kw_Ws16 65535.00 OneToOne -32768.00 32767.00 FORMAT "%8.2" /end CHARACTERISTIC
/begin CHARACTERISTIC Sig_CnsmpDIAScale_C "Steigung für Umrechnung SG -> Diagnoseschnittstelle für Verbrauch" VALUE 0x1C1042 Kw_Wu16 6.553500 FactHigh 0.00 6.553500 FORMAT "%8.6" /end CHARACTERISTIC
/begin CHARACTERISTIC Sig_dcycDSMOffset_C "Offset Umrechung SG->DSM für Tastverhältnisse" VALUE 0x1C1044 Kw_Ws16 65535.00 OneToOne -32768.00 32767.00 FORMAT "%8.2" /end CHARACTERISTIC
/begin CHARACTERISTIC Sig_dcycDSMScale_C "Skalierung Umrechung SG->DSM für Tastverhältnisse" VALUE 0x1C1046 Kw_Wu16 6.553500 FactHigh 0.00 6.553500 FORMAT "%8.6" /end CHARACTERISTIC
/begin CHARACTERISTIC Sig_dcycCANOffset_C "Offset Umrechung SG->CAN für Tastverhältnisse" VALUE 0x1C1048 Kw_Ws16 65535.00 OneToOne -32768.00 32767.00 FORMAT "%8.2" /end CHARACTERISTIC
/begin CHARACTERISTIC Sig_dcycCANScale_C "Skalierung Umrechung SG->CAN für Tastverhältnisse" VALUE 0x1C104A Kw_Wu16 6.553500 FactHigh 0.00 6.553500 FORMAT "%8.6" /end CHARACTERISTIC
/begin CHARACTERISTIC Sig_dcycDIAOffset_C "Offset Umrechung SG->Diagnoseschnittstelle für Tastverhältnisse" VALUE 0x1C104C Kw_Ws16 65535.00 OneToOne -32768.00 32767.00 FORMAT "%8.2" /end CHARACTERISTIC
/begin CHARACTERISTIC Sig_dcycDIAScale_C "Skalierung Umrechung SG->Diagnoseschnittstelle für Tastverhältnisse" VALUE 0x1C104E Kw_Wu16 6.553500 FactHigh 0.00 6.553500 FORMAT "%8.6" /end CHARACTERISTIC
/begin CHARACTERISTIC Sig_fas1DSMOffset_C "Offset fuer Umrechung SG->DSM fuer ein frei applizierbares Signal" VALUE 0x1C1050 Kw_Ws16 65535.00 OneToOne -32768.00 32767.00 FORMAT "%8.2" /end CHARACTERISTIC
/begin CHARACTERISTIC Sig_fas1DSMScale_C "Skalierung Umrechungs Faktor SG->DSM fuer ein frei applizierbares Signal" VALUE 0x1C1052 Kw_Wu16 6.553500 FactHigh 0.00 6.553500 FORMAT "%8.6" /end CHARACTERISTIC
/begin CHARACTERISTIC Sig_fas1CANOffset_C "Offset fuer Umrechung SG->CAN fuer ein frei applizierbares Signal" VALUE 0x1C1054 Kw_Ws16 65535.00 OneToOne -32768.00 32767.00 FORMAT "%8.2" /end CHARACTERISTIC
/begin CHARACTERISTIC Sig_fas1CANScale_C "Skalierung Umrechungs Faktor SG->CAN fuer ein frei applizierbares Signal" VALUE 0x1C1056 Kw_Wu16 6.553500 FactHigh 0.00 6.553500 FORMAT "%8.6" /end CHARACTERISTIC
/begin CHARACTERISTIC Sig_fas1DIAOffset_C "Offset fuer Umrechung SG->DIA fuer ein frei applizierbares Signal" VALUE 0x1C1058 Kw_Ws16 65535.00 OneToOne -32768.00 32767.00 FORMAT "%8.2" /end CHARACTERISTIC
/begin CHARACTERISTIC Sig_fas1DIAScale_C "Skalierung Umrechungs Faktor SG->DIA fuer ein frei applizierbares Signal" VALUE 0x1C105A Kw_Wu16 6.553500 FactHigh 0.00 6.553500 FORMAT "%8.6" /end CHARACTERISTIC
/begin CHARACTERISTIC Sig_fas2DSMOffset_C "Offset fuer Umrechung SG->DSM fuer ein frei applizierbares Signal" VALUE 0x1C105C Kw_Ws16 65535.00 OneToOne -32768.00 32767.00 FORMAT "%8.2" /end CHARACTERISTIC
/begin CHARACTERISTIC Sig_fas2DSMScale_C "Skalierung Umrechungs Faktor SG->DSM fuer ein frei applizierbares Signal" VALUE 0x1C105E Kw_Wu16 6.553500 FactHigh 0.00 6.553500 FORMAT "%8.6" /end CHARACTERISTIC
/begin CHARACTERISTIC Sig_fas2CANOffset_C "Offset fuer Umrechung SG->CAN fuer ein frei applizierbares Signal" VALUE 0x1C1060 Kw_Ws16 65535.00 OneToOne -32768.00 32767.00 FORMAT "%8.2" /end CHARACTERISTIC
/begin CHARACTERISTIC Sig_fas2CANScale_C "Skalierung Umrechungs Faktor SG->CAN fuer ein frei applizierbares Signal" VALUE 0x1C1062 Kw_Wu16 6.553500 FactHigh 0.00 6.553500 FORMAT "%8.6" /end CHARACTERISTIC
/begin CHARACTERISTIC Sig_fas2DIAOffset_C "Offset fuer Umrechung SG->DIA fuer ein frei applizierbares Signal" VALUE 0x1C1064 Kw_Ws16 65535.00 OneToOne -32768.00 32767.00 FORMAT "%8.2" /end CHARACTERISTIC
/begin CHARACTERISTIC Sig_fas2DIAScale_C "Skalierung Umrechungs Faktor SG->DIA fuer ein frei applizierbares Signal" VALUE 0x1C1066 Kw_Wu16 6.553500 FactHigh 0.00 6.553500 FORMAT "%8.6" /end CHARACTERISTIC
/begin CHARACTERISTIC Sig_fas3DSMOffset_C "Offset fuer Umrechung SG->DSM fuer ein frei applizierbares Signal" VALUE 0x1C1068 Kw_Ws16 65535.00 OneToOne -32768.00 32767.00 FORMAT "%8.2" /end CHARACTERISTIC
/begin CHARACTERISTIC Sig_fas3DSMScale_C "Skalierung Umrechungs Faktor SG->DSM fuer ein frei applizierbares Signal" VALUE 0x1C106A Kw_Wu16 6.553500 FactHigh 0.00 6.553500 FORMAT "%8.6" /end CHARACTERISTIC
/begin CHARACTERISTIC Sig_fas3CANOffset_C "Offset fuer Umrechung SG->CAN fuer ein frei applizierbares Signal" VALUE 0x1C106C Kw_Ws16 65535.00 OneToOne -32768.00 32767.00 FORMAT "%8.2" /end CHARACTERISTIC
/begin CHARACTERISTIC Sig_fas3CANScale_C "Skalierung Umrechungs Faktor SG->CAN fuer ein frei applizierbares Signal" VALUE 0x1C106E Kw_Wu16 6.553500 FactHigh 0.00 6.553500 FORMAT "%8.6" /end CHARACTERISTIC
/begin CHARACTERISTIC Sig_fas3DIAOffset_C "Offset fuer Umrechung SG->DIA fuer ein frei applizierbares Signal" VALUE 0x1C1070 Kw_Ws16 65535.00 OneToOne -32768.00 32767.00 FORMAT "%8.2" /end CHARACTERISTIC
/begin CHARACTERISTIC Sig_fas3DIAScale_C "Skalierung Umrechungs Faktor SG->DIA fuer ein frei applizierbares Signal" VALUE 0x1C1072 Kw_Wu16 6.553500 FactHigh 0.00 6.553500 FORMAT "%8.6" /end CHARACTERISTIC
/begin CHARACTERISTIC Sig_fas4DSMOffset_C "Offset Umrechnung SG -> DSM für frei applizierbares Signal" VALUE 0x1C1074 Kw_Ws16 65535.00 OneToOne -32768.00 32767.00 FORMAT "%8.2" /end CHARACTERISTIC
/begin CHARACTERISTIC Sig_fas4DSMScale_C "Skalierung Umrechnung Faktor SG -> DSM für frei applizierbares Signal" VALUE 0x1C1076 Kw_Wu16 6.553500 FactHigh 0.00 6.553500 FORMAT "%8.6" /end CHARACTERISTIC
/begin CHARACTERISTIC Sig_fas4CANOffset_C "Offset für Umrechnung SG -> CAN für frei applizierbare Signale" VALUE 0x1C1078 Kw_Ws16 65535.00 OneToOne -32768.00 32767.00 FORMAT "%8.2" /end CHARACTERISTIC
/begin CHARACTERISTIC Sig_fas4CANScale_C "Skalierung Umrechnungs Faktor SG -> CAN für frei applizierbares Signal" VALUE 0x1C107A Kw_Wu16 6.553500 FactHigh 0.00 6.553500 FORMAT "%8.6" /end CHARACTERISTIC
/begin CHARACTERISTIC Sig_fas4DIAOffset_C "Offset für Umrechnung SG -> DIA für frei applizierbares Signal" VALUE 0x1C107C Kw_Ws16 65535.00 OneToOne -32768.00 32767.00 FORMAT "%8.2" /end CHARACTERISTIC
/begin CHARACTERISTIC Sig_fas4DIAScale_C "Skalierung Umrechnung Faktor SG -> DIA für frei applizierbares Signal" VALUE 0x1C107E Kw_Wu16 6.553500 FactHigh 0.00 6.553500 FORMAT "%8.6" /end CHARACTERISTIC
/begin CHARACTERISTIC Sig_HighByteDSMOffset_C "Offset für Umrechnung SG -> DSM für High Byte" VALUE 0x1C1080 Kw_Ws16 65535.00 OneToOne -32768.00 32767.00 FORMAT "%8.2" /end CHARACTERISTIC
/begin CHARACTERISTIC Sig_HighByteDSMScale_C "Skalierung für Umrechnung SG -> DSM für High Byte" VALUE 0x1C1082 Kw_Wu16 6.553500 FactHigh 0.00 6.553500 FORMAT "%8.6" /end CHARACTERISTIC
/begin CHARACTERISTIC Sig_HighByteCANOffset_C "Offset für Umrechnung SG -> CAN für High Byte" VALUE 0x1C1084 Kw_Ws16 65535.00 OneToOne -32768.00 32767.00 FORMAT "%8.2" /end CHARACTERISTIC
/begin CHARACTERISTIC Sig_HighByteCANScale_C "Skalierung für Umrechnung SG -> CAN für High Byte" VALUE 0x1C1086 Kw_Wu16 6.553500 FactHigh 0.00 6.553500 FORMAT "%8.6" /end CHARACTERISTIC
/begin CHARACTERISTIC Sig_HighByteDIAOffset_C "Offset für Umrechnung SG -> Diagnoseschnittstelle für High Byte" VALUE 0x1C1088 Kw_Ws16 65535.00 OneToOne -32768.00 32767.00 FORMAT "%8.2" /end CHARACTERISTIC
/begin CHARACTERISTIC Sig_HighByteDIAScale_C "Skalierung für Umrechnung SG -> Diagnoseschnittstelle für High Byte" VALUE 0x1C108A Kw_Wu16 6.553500 FactHigh 0.00 6.553500 FORMAT "%8.6" /end CHARACTERISTIC
/begin CHARACTERISTIC Sig_lLvlDSMOffset_C "Offset Umrechung SG -> DSM für kleine Längenwerte (z.B. Ölniveau)" VALUE 0x1C108C Kw_Ws16 65535.00 OneToOne -32768.00 32767.00 FORMAT "%8.2" /end CHARACTERISTIC
/begin CHARACTERISTIC Sig_lLvlDSMScale_C "Skalierung Umrechung SG -> DSM für kleine Längenwerte (z.B. Ölniveau)" VALUE 0x1C108E Kw_Wu16 6.553500 FactHigh 0.00 6.553500 FORMAT "%8.6" /end CHARACTERISTIC
/begin CHARACTERISTIC Sig_lLvlCANOffset_C "Offset Umrechung SG -> CAN für kleine Längenwerte (z.B. Ölniveau)" VALUE 0x1C1090 Kw_Ws16 65535.00 OneToOne -32768.00 32767.00 FORMAT "%8.2" /end CHARACTERISTIC
/begin CHARACTERISTIC Sig_lLvlCANScale_C "Skalierung Umrechung SG -> CAN für kleine Längenwerte (z.B. Ölniveau)" VALUE 0x1C1092 Kw_Wu16 6.553500 FactHigh 0.00 6.553500 FORMAT "%8.6" /end CHARACTERISTIC
/begin CHARACTERISTIC Sig_lLvlDIAOffset_C "Offset Umrechung SG -> DIA für kleine Längenwerte (z.B. Ölniveau)" VALUE 0x1C1094 Kw_Ws16 65535.00 OneToOne -32768.00 32767.00 FORMAT "%8.2" /end CHARACTERISTIC
/begin CHARACTERISTIC Sig_lLvlDIAScale_C "Skalierung Umrechung SG -> DIA für kleine Längenwerte (z.B. Ölniveau)" VALUE 0x1C1096 Kw_Wu16 6.553500 FactHigh 0.00 6.553500 FORMAT "%8.6" /end CHARACTERISTIC
/begin CHARACTERISTIC Sig_lDSMOffset_C "Offset Umrechnung SG -> DSM" VALUE 0x1C1098 Kw_Ws16 65535.00 OneToOne -32768.00 32767.00 FORMAT "%8.2" /end CHARACTERISTIC
/begin CHARACTERISTIC Sig_lDSMScale_C "Skalierung Umrechnung SG -> DSM" VALUE 0x1C109A Kw_Wu16 6.553500 FactHigh 0.00 6.553500 FORMAT "%8.6" /end CHARACTERISTIC
/begin CHARACTERISTIC Sig_lCANOffset_C "Offset Umrechnung SG -> CAN" VALUE 0x1C109C Kw_Ws16 65535.00 OneToOne -32768.00 32767.00 FORMAT "%8.2" /end CHARACTERISTIC
/begin CHARACTERISTIC Sig_lCANScale_C "Skalierung Umrechnung SG -> CAN" VALUE 0x1C109E Kw_Wu16 6.553500 FactHigh 0.00 6.553500 FORMAT "%8.6" /end CHARACTERISTIC
/begin CHARACTERISTIC Sig_lDIAOffset_C "Offset Umrechnung SG -> DIA" VALUE 0x1C10A0 Kw_Ws16 65535.00 OneToOne -32768.00 32767.00 FORMAT "%8.2" /end CHARACTERISTIC
/begin CHARACTERISTIC Sig_lDIAScale_C "Skalierung Umrechnung SG -> DIA" VALUE 0x1C10A2 Kw_Wu16 6.553500 FactHigh 0.00 6.553500 FORMAT "%8.6" /end CHARACTERISTIC
/begin CHARACTERISTIC Sig_mAirCylDSMOffset_C "Offset Umrechung SG->DSM für Luftmasse pro Zylinder" VALUE 0x1C10A4 Kw_Ws16 65535.00 OneToOne -32768.00 32767.00 FORMAT "%8.2" /end CHARACTERISTIC
/begin CHARACTERISTIC Sig_mAirCylDSMScale_C "Skalierung Umrechung SG->DSM für Luftmasse pro Zylinder" VALUE 0x1C10A6 Kw_Wu16 6.553500 FactHigh 0.00 6.553500 FORMAT "%8.6" /end CHARACTERISTIC
/begin CHARACTERISTIC Sig_mAirCylCANOffset_C "Offset Umrechung SG->CAN für Luftmasse pro Zylinder" VALUE 0x1C10A8 Kw_Ws16 65535.00 OneToOne -32768.00 32767.00 FORMAT "%8.2" /end CHARACTERISTIC
/begin CHARACTERISTIC Sig_mAirCylCANScale_C "Skalierung Umrechung SG->CAN für Luftmasse pro Zylinder" VALUE 0x1C10AA Kw_Wu16 6.553500 FactHigh 0.00 6.553500 FORMAT "%8.6" /end CHARACTERISTIC
/begin CHARACTERISTIC Sig_mAirCylDIAOffset_C "Offset Umrechung SG->Diagnoseschnittstelle für Luftmasse pro Zylinder" VALUE 0x1C10AC Kw_Ws16 65535.00 OneToOne -32768.00 32767.00 FORMAT "%8.2" /end CHARACTERISTIC
/begin CHARACTERISTIC Sig_mAirCylDIAScale_C "Skalierung Umrechung SG->Diagnoseschnittstelle für Luftmasse pro Zylinder" VALUE 0x1C10AE Kw_Wu16 6.553500 FactHigh 0.00 6.553500 FORMAT "%8.6" /end CHARACTERISTIC
/begin CHARACTERISTIC Sig_mAirTimDSMOffset_C "Offset Umrechung SG->DSM für Luftmasse pro Zeiteinheit" VALUE 0x1C10B0 Kw_Ws16 65535.00 OneToOne -32768.00 32767.00 FORMAT "%8.2" /end CHARACTERISTIC
/begin CHARACTERISTIC Sig_mAirTimDSMScale_C "Skalierung Umrechung SG->DSM für Luftmasse pro Zeiteinheit" VALUE 0x1C10B2 Kw_Wu16 6.553500 FactHigh 0.00 6.553500 FORMAT "%8.6" /end CHARACTERISTIC
/begin CHARACTERISTIC Sig_mAirTimCANOffset_C "Offset Umrechung SG->CAN für Luftmasse pro Zeiteinheit" VALUE 0x1C10B4 Kw_Ws16 65535.00 OneToOne -32768.00 32767.00 FORMAT "%8.2" /end CHARACTERISTIC
/begin CHARACTERISTIC Sig_mAirTimCANScale_C "Skalierung Umrechung SG->CAN für Luftmasse pro Zeiteinheit" VALUE 0x1C10B6 Kw_Wu16 6.553500 FactHigh 0.00 6.553500 FORMAT "%8.6" /end CHARACTERISTIC
/begin CHARACTERISTIC Sig_mAirTimDIAOffset_C "Offset Umrechung SG->Diagnoseschnittstelle für Luftmasse pro Zeiteinheit" VALUE 0x1C10B8 Kw_Ws16 65535.00 OneToOne -32768.00 32767.00 FORMAT "%8.2" /end CHARACTERISTIC
/begin CHARACTERISTIC Sig_mAirTimDIAScale_C "Skalierung Umrechung SG->Diagnoseschnittstelle für Luftmasse pro Zeiteinheit" VALUE 0x1C10BA Kw_Wu16 6.553500 FactHigh 0.00 6.553500 FORMAT "%8.6" /end CHARACTERISTIC
/begin CHARACTERISTIC Sig_mAirDSMOffset_C "Offset Umrechung SG->DSM für Luftmasse" VALUE 0x1C10BC Kw_Ws16 65535.00 OneToOne -32768.00 32767.00 FORMAT "%8.2" /end CHARACTERISTIC
/begin CHARACTERISTIC Sig_mAirDSMScale_C "Skalierung Umrechung SG->DSM für Luftmasse" VALUE 0x1C10BE Kw_Wu16 6.553500 FactHigh 0.00 6.553500 FORMAT "%8.6" /end CHARACTERISTIC
/begin CHARACTERISTIC Sig_mAirCANOffset_C "Offset Umrechung SG->CAN für Luftmasse" VALUE 0x1C10C0 Kw_Ws16 65535.00 OneToOne -32768.00 32767.00 FORMAT "%8.2" /end CHARACTERISTIC
/begin CHARACTERISTIC Sig_mAirCANScale_C "Skalierung Umrechung SG->CAN für Luftmasse" VALUE 0x1C10C2 Kw_Wu16 6.553500 FactHigh 0.00 6.553500 FORMAT "%8.6" /end CHARACTERISTIC
/begin CHARACTERISTIC Sig_mAirDIAOffset_C "Offset Umrechung SG->Diagnoseschnittstelle für Luftmasse" VALUE 0x1C10C4 Kw_Ws16 65535.00 OneToOne -32768.00 32767.00 FORMAT "%8.2" /end CHARACTERISTIC
/begin CHARACTERISTIC Sig_mAirDIAScale_C "Skalierung Umrechung SG->Diagnoseschnittstelle für Luftmasse" VALUE 0x1C10C6 Kw_Wu16 6.553500 FactHigh 0.00 6.553500 FORMAT "%8.6" /end CHARACTERISTIC
/begin CHARACTERISTIC Sig_mDSMOffset_C "Offset Umrechung SG->DSM" VALUE 0x1C10C8 Kw_Ws16 65535.00 OneToOne -32768.00 32767.00 FORMAT "%8.2" /end CHARACTERISTIC
/begin CHARACTERISTIC Sig_mDSMScale_C "Skalierung Umrechung SG->DSM" VALUE 0x1C10CA Kw_Wu16 6.553500 FactHigh 0.00 6.553500 FORMAT "%8.6" /end CHARACTERISTIC
/begin CHARACTERISTIC Sig_mCANOffset_C "Offset Umrechung SG->CAN" VALUE 0x1C10CC Kw_Ws16 65535.00 OneToOne -32768.00 32767.00 FORMAT "%8.2" /end CHARACTERISTIC
/begin CHARACTERISTIC Sig_mCANScale_C "Skalierung Umrechung SG->CAN" VALUE 0x1C10CE Kw_Wu16 6.553500 FactHigh 0.00 6.553500 FORMAT "%8.6" /end CHARACTERISTIC
/begin CHARACTERISTIC Sig_mDIAOffset_C "Offset Umrechung SG->DIA" VALUE 0x1C10D0 Kw_Ws16 65535.00 OneToOne -32768.00 32767.00 FORMAT "%8.2" /end CHARACTERISTIC
/begin CHARACTERISTIC Sig_mDIAScale_C "Skalierung Umrechung SG->DIA" VALUE 0x1C10D2 Kw_Wu16 6.553500 FactHigh 0.00 6.553500 FORMAT "%8.6" /end CHARACTERISTIC
/begin CHARACTERISTIC Sig_nCmpTstDSMOffset_C "Offset Umrechung SG -> DSM für Drehzahlsignale für Kompressionstest" VALUE 0x1C10D4 Kw_Ws16 65535.00 OneToOne -32768.00 32767.00 FORMAT "%8.2" /end CHARACTERISTIC
/begin CHARACTERISTIC Sig_nCmpTstDSMScale_C "Skalierung Umrechung SG -> DSM für Drehzahlsignale für Kompressionstest" VALUE 0x1C10D6 Kw_Wu16 6.553500 FactHigh 0.00 6.553500 FORMAT "%8.6" /end CHARACTERISTIC
/begin CHARACTERISTIC Sig_nCmpTstCANOffset_C "Offset Umrechung SG -> CAN für Drehzahlsignale bei Kompressionstest" VALUE 0x1C10D8 Kw_Ws16 65535.00 OneToOne -32768.00 32767.00 FORMAT "%8.2" /end CHARACTERISTIC
/begin CHARACTERISTIC Sig_nCmpTstCANScale_C "Skalierung Umrechung SG -> CAN für Drehzahlsignale für Kompressionstest" VALUE 0x1C10DA Kw_Wu16 6.553500 FactHigh 0.00 6.553500 FORMAT "%8.6" /end CHARACTERISTIC
/begin CHARACTERISTIC Sig_nCmpTstDIAOffset_C "Offset Umrechung SG -> DIA für Drehzahlsignale für Kompressionstest" VALUE 0x1C10DC Kw_Ws16 65535.00 OneToOne -32768.00 32767.00 FORMAT "%8.2" /end CHARACTERISTIC
/begin CHARACTERISTIC Sig_nCmpTstDIAScale_C "Skalierung Umrechung SG -> DIA für Drehzahlsignale für Kompressionstest" VALUE 0x1C10DE Kw_Wu16 6.553500 FactHigh 0.00 6.553500 FORMAT "%8.6" /end CHARACTERISTIC
/begin CHARACTERISTIC Sig_NoUnitDSMOffset_C "Offset Umrechnung SG ->DSM" VALUE 0x1C10E0 Kw_Ws16 65535.00 OneToOne -32768.00 32767.00 FORMAT "%8.2" /end CHARACTERISTIC
/begin CHARACTERISTIC Sig_NoUnitDSMScale_C "Skalierung Umrechnung SG -> DSM" VALUE 0x1C10E2 Kw_Wu16 6.553500 FactHigh 0.00 6.553500 FORMAT "%8.6" /end CHARACTERISTIC
/begin CHARACTERISTIC Sig_NoUnitCANOffset_C "Offset Umrechnung SG -> CAN" VALUE 0x1C10E4 Kw_Ws16 65535.00 OneToOne -32768.00 32767.00 FORMAT "%8.2" /end CHARACTERISTIC
/begin CHARACTERISTIC Sig_NoUnitCANScale_C "Skalierung Umrechnung SG -> CAN" VALUE 0x1C10E6 Kw_Wu16 6.553500 FactHigh 0.00 6.553500 FORMAT "%8.6" /end CHARACTERISTIC
/begin CHARACTERISTIC Sig_NoUnitDIAOffset_C "Offset Umrechnung SG -> DIA" VALUE 0x1C10E8 Kw_Ws16 65535.00 OneToOne -32768.00 32767.00 FORMAT "%8.2" /end CHARACTERISTIC
/begin CHARACTERISTIC Sig_NoUnitDIAScale_C "Skalierung Umrechnung SG -> DIA" VALUE 0x1C10EA Kw_Wu16 6.553500 FactHigh 0.00 6.553500 FORMAT "%8.6" /end CHARACTERISTIC
/begin CHARACTERISTIC Sig_nDSMOffset_C "Offset Umrechung SG->DSM für Drehzahlsignale" VALUE 0x1C10EC Kw_Ws16 65535.00 OneToOne -32768.00 32767.00 FORMAT "%8.2" /end CHARACTERISTIC
/begin CHARACTERISTIC Sig_nDSMScale_C "Skalierung Umrechung SG->DSM für Drehzahlsignale" VALUE 0x1C10EE Kw_Wu16 6.553500 FactHigh 0.00 6.553500 FORMAT "%8.6" /end CHARACTERISTIC
/begin CHARACTERISTIC Sig_nCANOffset_C "Offset Umrechung SG<->CAN für Drehzahlsignale" VALUE 0x1C10F0 Kw_Ws16 65535.00 OneToOne -32768.00 32767.00 FORMAT "%8.2" /end CHARACTERISTIC
/begin CHARACTERISTIC Sig_nCANScale_C "Skalierung Umrechung SG->CAN für Drehzahlsignale" VALUE 0x1C10F2 Kw_Wu16 6.553500 FactHigh 0.00 6.553500 FORMAT "%8.6" /end CHARACTERISTIC
/begin CHARACTERISTIC Sig_nDIAOffset_C "Offset Umrechung SG->DIA für Drehzahlsignale" VALUE 0x1C10F4 Kw_Ws16 65535.00 OneToOne -32768.00 32767.00 FORMAT "%8.2" /end CHARACTERISTIC
/begin CHARACTERISTIC Sig_nDIAScale_C "Skalierung Umrechung SG->DIA für Drehzahlsignale" VALUE 0x1C10F6 Kw_Wu16 6.553500 FactHigh 0.00 6.553500 FORMAT "%8.6" /end CHARACTERISTIC
/begin CHARACTERISTIC Sig_OneToOneDSMOffset_C "Offset Umrechung SG->DSM" VALUE 0x1C10F8 Kw_Ws16 65535.00 OneToOne -32768.00 32767.00 FORMAT "%8.2" /end CHARACTERISTIC
/begin CHARACTERISTIC Sig_OneToOneDSMScale_C "Skalierung Umrechung SG->DSM" VALUE 0x1C10FA Kw_Wu16 6.553500 FactHigh 0.00 6.553500 FORMAT "%8.6" /end CHARACTERISTIC
/begin CHARACTERISTIC Sig_OneToOneCANOffset_C "Offset Umrechung SG->CAN" VALUE 0x1C10FC Kw_Ws16 65535.00 OneToOne -32768.00 32767.00 FORMAT "%8.2" /end CHARACTERISTIC
/begin CHARACTERISTIC Sig_OneToOneCANScale_C "Skalierung Umrechung SG->CAN" VALUE 0x1C10FE Kw_Wu16 6.553500 FactHigh 0.00 6.553500 FORMAT "%8.6" /end CHARACTERISTIC
/begin CHARACTERISTIC Sig_OneToOneDIAOffset_C "Offset Umrechung SG->DIA" VALUE 0x1C1100 Kw_Ws16 65535.00 OneToOne -32768.00 32767.00 FORMAT "%8.2" /end CHARACTERISTIC
/begin CHARACTERISTIC Sig_OneToOneDIAScale_C "Skalierung Umrechung SG->DIA" VALUE 0x1C1102 Kw_Wu16 6.553500 FactHigh 0.00 6.553500 FORMAT "%8.6" /end CHARACTERISTIC
/begin CHARACTERISTIC Sig_OnOffDSMOffset_C "Offset Umrechung SG->DSM für Digitalsignale" VALUE 0x1C1104 Kw_Ws16 65535.00 OneToOne -32768.00 32767.00 FORMAT "%8.2" /end CHARACTERISTIC
/begin CHARACTERISTIC Sig_OnOffDSMScale_C "Skalierung Umrechung SG->DSM für Digitalsignale" VALUE 0x1C1106 Kw_Wu16 6.553500 FactHigh 0.00 6.553500 FORMAT "%8.6" /end CHARACTERISTIC
/begin CHARACTERISTIC Sig_OnOffCANOffset_C "Offset Umrechung SG->CAN für Digitalsignale" VALUE 0x1C1108 Kw_Ws16 65535.00 OneToOne -32768.00 32767.00 FORMAT "%8.2" /end CHARACTERISTIC
/begin CHARACTERISTIC Sig_OnOffCANScale_C "Skalierung Umrechung SG->CAN für Digitalsignale" VALUE 0x1C110A Kw_Wu16 6.553500 FactHigh 0.00 6.553500 FORMAT "%8.6" /end CHARACTERISTIC
/begin CHARACTERISTIC Sig_OnOffDIAOffset_C "Offset Umrechung SG->DIA für Digitalsignale" VALUE 0x1C110C Kw_Ws16 65535.00 OneToOne -32768.00 32767.00 FORMAT "%8.2" /end CHARACTERISTIC
/begin CHARACTERISTIC Sig_OnOffDIAScale_C "Skalierung Umrechung SG->DIA für Digitalsignale" VALUE 0x1C110E Kw_Wu16 6.553500 FactHigh 0.00 6.553500 FORMAT "%8.6" /end CHARACTERISTIC
/begin CHARACTERISTIC Sig_pACDSMOffset_C "Offset für Klimadruck Umrechnung für Fehlerspeicher" VALUE 0x1C1110 Kw_Ws16 65535.00 OneToOne -32768.00 32767.00 FORMAT "%8.2" /end CHARACTERISTIC
/begin CHARACTERISTIC Sig_pACDSMScale_C "Steigung für Umrechnung des Klimadrucks für Fehlerspeicher" VALUE 0x1C1112 Kw_Wu16 6.553500 FactHigh 0.00 6.553500 FORMAT "%8.6" /end CHARACTERISTIC
/begin CHARACTERISTIC Sig_pACCANOffset_C "Offset für Klimadruck Umrechnung für CAN" VALUE 0x1C1114 Kw_Ws16 65535.00 OneToOne -32768.00 32767.00 FORMAT "%8.2" /end CHARACTERISTIC
/begin CHARACTERISTIC Sig_pACCANScale_C "Steigung für Klimadruck Umrechnung für CAN" VALUE 0x1C1116 Kw_Wu16 6.553500 FactHigh 0.00 6.553500 FORMAT "%8.6" /end CHARACTERISTIC
/begin CHARACTERISTIC Sig_pACDIAOffset_C "Offset für Klimadruck Umrechnung für Diagnose" VALUE 0x1C1118 Kw_Ws16 65535.00 OneToOne -32768.00 32767.00 FORMAT "%8.2" /end CHARACTERISTIC
/begin CHARACTERISTIC Sig_pACDIAScale_C "Steigung für Klimadruck Umrechnung für Diagnose" VALUE 0x1C111A Kw_Wu16 6.553500 FactHigh 0.00 6.553500 FORMAT "%8.6" /end CHARACTERISTIC
/begin CHARACTERISTIC Sig_phiCrSDSMOffset_C "Offset fuer Umrechnung SG -> DSM fuer Winkel" VALUE 0x1C121A Kw_Ws16 65535.00 OneToOne -32768.00 32767.00 FORMAT "%8.2" /end CHARACTERISTIC
/begin CHARACTERISTIC Sig_phiCrSDSMScale_C "Skalierung Umrechnungsfaktor SG -> DSM fuer Winkel" VALUE 0x1C121C Kw_Wu16 6.553500 FactHigh 0.00 6.553500 FORMAT "%8.6" /end CHARACTERISTIC
/begin CHARACTERISTIC Sig_phiCrSCANOffset_C "Offset fuer Umrechnung SG zum CAN fuer Winkel" VALUE 0x1C121E Kw_Ws16 65535.00 OneToOne -32768.00 32767.00 FORMAT "%8.2" /end CHARACTERISTIC
/begin CHARACTERISTIC Sig_phiCrSCANScale_C "Skalierung Umrechnungsfaktor SG -> CAN fuer Winkel" VALUE 0x1C1220 Kw_Wu16 6.553500 FactHigh 0.00 6.553500 FORMAT "%8.6" /end CHARACTERISTIC
/begin CHARACTERISTIC Sig_phiCrSDIAOffset_C "Offset fuer Umrechnung SG -> DIA fuer Winkel" VALUE 0x1C1222 Kw_Ws16 65535.00 OneToOne -32768.00 32767.00 FORMAT "%8.2" /end CHARACTERISTIC
/begin CHARACTERISTIC Sig_phiCrSDIAScale_C "Skalierung Umrechnungsfaktor SG -> DIA fuer Winkel" VALUE 0x1C1224 Kw_Wu16 6.553500 FactHigh 0.00 6.553500 FORMAT "%8.6" /end CHARACTERISTIC
/begin CHARACTERISTIC Sig_phiHResolDSMOffset_C "Offset für Umrechnung SG -> DSM für Winkel mit hoher Auflösung" VALUE 0x1C111C Kw_Ws16 65535.00 OneToOne -32768.00 32767.00 FORMAT "%8.2" /end CHARACTERISTIC
/begin CHARACTERISTIC Sig_phiHResolDSMScale_C "Skalierung für Umrechnung SG -> DSM für Winkel mit hoher Auflösung" VALUE 0x1C111E Kw_Wu16 6.553500 FactHigh 0.00 6.553500 FORMAT "%8.6" /end CHARACTERISTIC
/begin CHARACTERISTIC Sig_phiHResolCANOffset_C "Offset für Umrechnung SG -> CAN für Winkel mit hoher Auflösung" VALUE 0x1C1120 Kw_Ws16 65535.00 OneToOne -32768.00 32767.00 FORMAT "%8.2" /end CHARACTERISTIC
/begin CHARACTERISTIC Sig_phiHResolCANScale_C "Skalierung für Umrechnung SG -> CAN für Winkel mit hoher Auflösung" VALUE 0x1C1122 Kw_Wu16 6.553500 FactHigh 0.00 6.553500 FORMAT "%8.6" /end CHARACTERISTIC
/begin CHARACTERISTIC Sig_phiHResolDIAOffset_C "Offset für Umrechnung SG -> Diagnoseschnittstelle für Winkel mit hoher Auflösung" VALUE 0x1C1124 Kw_Ws16 65535.00 OneToOne -32768.00 32767.00 FORMAT "%8.2" /end CHARACTERISTIC
/begin CHARACTERISTIC Sig_phiHResolDIAScale_C "Skalierung für Umrechnung SG -> Diagnoseschnittstelle für Winkel mit hoher Auflösung" VALUE 0x1C1126 Kw_Wu16 6.553500 FactHigh 0.00 6.553500 FORMAT "%8.6" /end CHARACTERISTIC
/begin CHARACTERISTIC Sig_phiDSMOffset_C "Offset fuer Umrechung SG->DSM fuer Winkel" VALUE 0x1C1128 Kw_Ws16 65535.00 OneToOne -32768.00 32767.00 FORMAT "%8.2" /end CHARACTERISTIC
/begin CHARACTERISTIC Sig_phiDSMScale_C "Skalierung Umrechungs Faktor SG->DSM fuer Winkel" VALUE 0x1C112A Kw_Wu16 6.553500 FactHigh 0.00 6.553500 FORMAT "%8.6" /end CHARACTERISTIC
/begin CHARACTERISTIC Sig_phiCANOffset_C "Offset fuer Umrechung SG->CAN fuer Winkel" VALUE 0x1C112C Kw_Ws16 65535.00 OneToOne -32768.00 32767.00 FORMAT "%8.2" /end CHARACTERISTIC
/begin CHARACTERISTIC Sig_phiCANScale_C "Skalierung Umrechungs Faktor SG->CAN fuer Winkel" VALUE 0x1C112E Kw_Wu16 6.553500 FactHigh 0.00 6.553500 FORMAT "%8.6" /end CHARACTERISTIC
/begin CHARACTERISTIC Sig_phiDIAOffset_C "Offset fuer Umrechung SG->DIA fuer Winkel" VALUE 0x1C1130 Kw_Ws16 65535.00 OneToOne -32768.00 32767.00 FORMAT "%8.2" /end CHARACTERISTIC
/begin CHARACTERISTIC Sig_phiDIAScale_C "Skalierung Umrechungs Faktor SG->DIA fuer Winkel" VALUE 0x1C1132 Kw_Wu16 6.553500 FactHigh 0.00 6.553500 FORMAT "%8.6" /end CHARACTERISTIC
/begin CHARACTERISTIC Sig_pRailDSMOffset_C "offset für Umrechnung ecu -> dsm" VALUE 0x1C1226 Kw_Ws16 65535.00 OneToOne -32768.00 32767.00 FORMAT "%8.2" /end CHARACTERISTIC
/begin CHARACTERISTIC Sig_pRailDSMScale_C "Skalierung für Umrechnung ecu -> dsm" VALUE 0x1C1228 Kw_Wu16 6.553500 FactHigh 0.00 6.553500 FORMAT "%8.6" /end CHARACTERISTIC
/begin CHARACTERISTIC Sig_pRailCANOffset_C "Offset für Umrechnung ecu -> can" VALUE 0x1C122A Kw_Ws16 65535.00 OneToOne -32768.00 32767.00 FORMAT "%8.2" /end CHARACTERISTIC
/begin CHARACTERISTIC Sig_pRailCANScale_C "Skalierung für Umrechnung ecu -> can" VALUE 0x1C122C Kw_Wu16 6.553500 FactHigh 0.00 6.553500 FORMAT "%8.6" /end CHARACTERISTIC
/begin CHARACTERISTIC Sig_pRailDIAOffset_C "Offset für Umrechnung ecu -> dia" VALUE 0x1C122E Kw_Ws16 65535.00 OneToOne -32768.00 32767.00 FORMAT "%8.2" /end CHARACTERISTIC
/begin CHARACTERISTIC Sig_pRailDIAScale_C "Skalierung für Umrechnung ecu -> dia" VALUE 0x1C1230 Kw_Wu16 6.553500 FactHigh 0.00 6.553500 FORMAT "%8.6" /end CHARACTERISTIC
/begin CHARACTERISTIC Sig_pwrDSMOffset_C "Offset Umrechung SG->DSM für Leistung" VALUE 0x1C1134 Kw_Ws16 65535.00 OneToOne -32768.00 32767.00 FORMAT "%8.2" /end CHARACTERISTIC
/begin CHARACTERISTIC Sig_pwrDSMScale_C "Skalierung Umrechung SG->DSM für Leistung" VALUE 0x1C1136 Kw_Wu16 6.553500 FactHigh 0.00 6.553500 FORMAT "%8.6" /end CHARACTERISTIC
/begin CHARACTERISTIC Sig_pwrCANOffset_C "Offset Umrechnung SG -> CAN für Leistung" VALUE 0x1C1138 Kw_Ws16 65535.00 OneToOne -32768.00 32767.00 FORMAT "%8.2" /end CHARACTERISTIC
/begin CHARACTERISTIC Sig_pwrCANScale_C "Skalierung Umrechung SG->CAN für Leistung" VALUE 0x1C113A Kw_Wu16 6.553500 FactHigh 0.00 6.553500 FORMAT "%8.6" /end CHARACTERISTIC
/begin CHARACTERISTIC Sig_pwrDIAOffset_C "Offset Umrechung SG->Diagnoseschnittstelle für Leistung" VALUE 0x1C113C Kw_Ws16 65535.00 OneToOne -32768.00 32767.00 FORMAT "%8.2" /end CHARACTERISTIC
/begin CHARACTERISTIC Sig_pwrDIAScale_C "Skalierung Umrechung SG->Diagnoseschnittstelle für Leistung" VALUE 0x1C113E Kw_Wu16 6.553500 FactHigh 0.00 6.553500 FORMAT "%8.6" /end CHARACTERISTIC
/begin CHARACTERISTIC Sig_pDSMOffset_C "Offset Umrechung SG->DSM für Druck" VALUE 0x1C1140 Kw_Ws16 65535.00 OneToOne -32768.00 32767.00 FORMAT "%8.2" /end CHARACTERISTIC
/begin CHARACTERISTIC Sig_pDSMScale_C "Skalierung Umrechung SG->DSM für Druck" VALUE 0x1C1142 Kw_Wu16 6.553500 FactHigh 0.00 6.553500 FORMAT "%8.6" /end CHARACTERISTIC
/begin CHARACTERISTIC Sig_pCANOffset_C "Offset Umrechung SG->CAN für Druck" VALUE 0x1C1144 Kw_Ws16 65535.00 OneToOne -32768.00 32767.00 FORMAT "%8.2" /end CHARACTERISTIC
/begin CHARACTERISTIC Sig_pCANScale_C "Skalierung Umrechung SG->CAN für Druck" VALUE 0x1C1146 Kw_Wu16 6.553500 FactHigh 0.00 6.553500 FORMAT "%8.6" /end CHARACTERISTIC
/begin CHARACTERISTIC Sig_pDIAOffset_C "Offset Umrechung SG->Diagnoseschnittstelle für Druck" VALUE 0x1C1148 Kw_Ws16 65535.00 OneToOne -32768.00 32767.00 FORMAT "%8.2" /end CHARACTERISTIC
/begin CHARACTERISTIC Sig_pDIAScale_C "Skalierung Umrechung SG->Diagnoseschnittstelle für Druck" VALUE 0x1C114A Kw_Wu16 6.553500 FactHigh 0.00 6.553500 FORMAT "%8.6" /end CHARACTERISTIC
/begin CHARACTERISTIC Sig_qdiffSysDSMOffset_C "Offset für Umrechnung SG -> DSM für Differenzmenge System" VALUE 0x1C114C Kw_Ws16 65535.00 OneToOne -32768.00 32767.00 FORMAT "%8.2" /end CHARACTERISTIC
/begin CHARACTERISTIC Sig_qdiffSysDSMScale_C "Skalierung für Umrechnung SG -> DSM für Differenzmenge System" VALUE 0x1C114E Kw_Wu16 6.553500 FactHigh 0.00 6.553500 FORMAT "%8.6" /end CHARACTERISTIC
/begin CHARACTERISTIC Sig_qdiffSysCANOffset_C "Offset für Umrechnung SG -> CAN für Diffrenzmenge System" VALUE 0x1C1150 Kw_Ws16 65535.00 OneToOne -32768.00 32767.00 FORMAT "%8.2" /end CHARACTERISTIC
/begin CHARACTERISTIC Sig_qdiffSysCANScale_C "Skalierung für Umrechnung SG -> CAN für Differenzmenge System" VALUE 0x1C1152 Kw_Wu16 6.553500 FactHigh 0.00 6.553500 FORMAT "%8.6" /end CHARACTERISTIC
/begin CHARACTERISTIC Sig_qdiffSysDIAOffset_C "Offset für Umrechnung SG -> Diagnoseschnittstelle für Differenzmenge System" VALUE 0x1C1154 Kw_Ws16 65535.00 OneToOne -32768.00 32767.00 FORMAT "%8.2" /end CHARACTERISTIC
/begin CHARACTERISTIC Sig_qdiffSysDIAScale_C "Skalierung für Umrechnung SG -> Diagnoseschnittstelle für Differenzmenge System" VALUE 0x1C1156 Kw_Wu16 6.553500 FactHigh 0.00 6.553500 FORMAT "%8.6" /end CHARACTERISTIC
/begin CHARACTERISTIC Sig_qdiffDSMOffset_C "Offset für Umrechnung SG -> DSM für Differenzmenge" VALUE 0x1C1158 Kw_Ws16 65535.00 OneToOne -32768.00 32767.00 FORMAT "%8.2" /end CHARACTERISTIC
/begin CHARACTERISTIC Sig_qdiffDSMScale_C "Skalierung für Umrechnung SG -> DSM für Differenzmenge" VALUE 0x1C115A Kw_Wu16 6.553500 FactHigh 0.00 6.553500 FORMAT "%8.6" /end CHARACTERISTIC
/begin CHARACTERISTIC Sig_qdiffCANOffset_C "Offset für Umrechnung SG -> CAN für Differenzmenge" VALUE 0x1C115C Kw_Ws16 65535.00 OneToOne -32768.00 32767.00 FORMAT "%8.2" /end CHARACTERISTIC
/begin CHARACTERISTIC Sig_qdiffCANScale_C "Skalierung für Umrechnung SG -> CAN für Differenzmenge" VALUE 0x1C115E Kw_Wu16 6.553500 FactHigh 0.00 6.553500 FORMAT "%8.6" /end CHARACTERISTIC
/begin CHARACTERISTIC Sig_qdiffDIAOffset_C "Offset für Umrechnung SG -> Diagnoseschnittstelle für Differenzmenge" VALUE 0x1C1160 Kw_Ws16 65535.00 OneToOne -32768.00 32767.00 FORMAT "%8.2" /end CHARACTERISTIC
/begin CHARACTERISTIC Sig_qdiffDIAScale_C "Skalierung für Umrechnung  SG -> Diagnoseschnittstelle für Differenzmenge" VALUE 0x1C1162 Kw_Wu16 6.553500 FactHigh 0.00 6.553500 FORMAT "%8.6" /end CHARACTERISTIC
/begin CHARACTERISTIC Sig_qDSMOffset_C "Offset fuer Umrechung SG->DSM fuer Menge" VALUE 0x1C1164 Kw_Ws16 65535.00 OneToOne -32768.00 32767.00 FORMAT "%8.2" /end CHARACTERISTIC
/begin CHARACTERISTIC Sig_qDSMScale_C "Skalierung Umrechungs Faktor SG->DSM fuer Menge" VALUE 0x1C1166 Kw_Wu16 6.553500 FactHigh 0.00 6.553500 FORMAT "%8.6" /end CHARACTERISTIC
/begin CHARACTERISTIC Sig_qCANOffset_C "Offset fuer Umrechung SG->CAN fuer Menge" VALUE 0x1C1168 Kw_Ws16 65535.00 OneToOne -32768.00 32767.00 FORMAT "%8.2" /end CHARACTERISTIC
/begin CHARACTERISTIC Sig_qCANScale_C "Skalierung Umrechungs Faktor SG->CAN fuer Menge" VALUE 0x1C116A Kw_Wu16 6.553500 FactHigh 0.00 6.553500 FORMAT "%8.6" /end CHARACTERISTIC
/begin CHARACTERISTIC Sig_qDIAOffset_C "Offset fuer Umrechung SG->DIA fuer Menge" VALUE 0x1C116C Kw_Ws16 65535.00 OneToOne -32768.00 32767.00 FORMAT "%8.2" /end CHARACTERISTIC
/begin CHARACTERISTIC Sig_qDIAScale_C "Skalierung Umrechungs Faktor SG->DIA fuer Menge" VALUE 0x1C116E Kw_Wu16 6.553500 FactHigh 0.00 6.553500 FORMAT "%8.6" /end CHARACTERISTIC
/begin CHARACTERISTIC Sig_resDSMOffset_C "Offset Umrechung SG->DSM für Widerstand" VALUE 0x1C1170 Kw_Ws16 65535.00 OneToOne -32768.00 32767.00 FORMAT "%8.2" /end CHARACTERISTIC
/begin CHARACTERISTIC Sig_resDSMScale_C "Skalierung Umrechung SG->DSM für Widerstand" VALUE 0x1C1172 Kw_Wu16 6.553500 FactHigh 0.00 6.553500 FORMAT "%8.6" /end CHARACTERISTIC
/begin CHARACTERISTIC Sig_resCANOffset_C "Offset Umrechung SG->CAN für Widerstand" VALUE 0x1C1174 Kw_Ws16 65535.00 OneToOne -32768.00 32767.00 FORMAT "%8.2" /end CHARACTERISTIC
/begin CHARACTERISTIC Sig_resCANScale_C "Skalierung Umrechung SG->CAN für Widerstand" VALUE 0x1C1176 Kw_Wu16 6.553500 FactHigh 0.00 6.553500 FORMAT "%8.6" /end CHARACTERISTIC
/begin CHARACTERISTIC Sig_resDIAOffset_C "Offset Umrechung SG->Diagnoseschnittstelle für Widerstand" VALUE 0x1C1178 Kw_Ws16 65535.00 OneToOne -32768.00 32767.00 FORMAT "%8.2" /end CHARACTERISTIC
/begin CHARACTERISTIC Sig_resDIAScale_C "Skalierung Umrechung SG->Diagnoseschnittstelle für Widerstand" VALUE 0x1C117A Kw_Wu16 6.553500 FactHigh 0.00 6.553500 FORMAT "%8.6" /end CHARACTERISTIC
/begin CHARACTERISTIC Sig_rDSMOffset_C "Offset Umrechung SG->DSM für Verhältnisse" VALUE 0x1C117C Kw_Ws16 65535.00 OneToOne -32768.00 32767.00 FORMAT "%8.2" /end CHARACTERISTIC
/begin CHARACTERISTIC Sig_rDSMScale_C "Skalierung Umrechung SG->DSM für Verhältnisse" VALUE 0x1C117E Kw_Wu16 6.553500 FactHigh 0.00 6.553500 FORMAT "%8.6" /end CHARACTERISTIC
/begin CHARACTERISTIC Sig_rCANOffset_C "Offset Umrechung SG->CAN für Verhältnisse" VALUE 0x1C1180 Kw_Ws16 65535.00 OneToOne -32768.00 32767.00 FORMAT "%8.2" /end CHARACTERISTIC
/begin CHARACTERISTIC Sig_rCANScale_C "Skalierung Umrechung SG->CAN für Verhältnisse" VALUE 0x1C1182 Kw_Wu16 6.553500 FactHigh 0.00 6.553500 FORMAT "%8.6" /end CHARACTERISTIC
/begin CHARACTERISTIC Sig_rDIAOffset_C "Offset Umrechung SG->Diagnoseschnittstelle für Verhältnisse" VALUE 0x1C1184 Kw_Ws16 65535.00 OneToOne -32768.00 32767.00 FORMAT "%8.2" /end CHARACTERISTIC
/begin CHARACTERISTIC Sig_rDIAScale_C "Skalierung Umrechung SG->Diagnoseschnittstelle für Verhältnisse" VALUE 0x1C1186 Kw_Wu16 6.553500 FactHigh 0.00 6.553500 FORMAT "%8.6" /end CHARACTERISTIC
/begin CHARACTERISTIC Sig_strokeDSMOffset_C "Offset Umrechnung der Pumpenhübe SG -> DSM" VALUE 0x1C1188 Kw_Ws16 65535.00 OneToOne -32768.00 32767.00 FORMAT "%8.2" /end CHARACTERISTIC
/begin CHARACTERISTIC Sig_strokeDSMScale_C "Skalierung Umrechnung der Pumpenhübe SG -> DSM" VALUE 0x1C118A Kw_Wu16 6.553500 FactHigh 0.00 6.553500 FORMAT "%8.6" /end CHARACTERISTIC
/begin CHARACTERISTIC Sig_strokeCANOffset_C "Offset Umrechnung der Pumpenhübe SG -> CAN" VALUE 0x1C118C Kw_Ws16 65535.00 OneToOne -32768.00 32767.00 FORMAT "%8.2" /end CHARACTERISTIC
/begin CHARACTERISTIC Sig_strokeCANScale_C "Skalierung Umrechnung der Pumpenhübe SG -> CAN" VALUE 0x1C118E Kw_Wu16 6.553500 FactHigh 0.00 6.553500 FORMAT "%8.6" /end CHARACTERISTIC
/begin CHARACTERISTIC Sig_strokeDIAOffset_C "Offset Umrechnung der Pumpenhübe SG -> DIA" VALUE 0x1C1190 Kw_Ws16 65535.00 OneToOne -32768.00 32767.00 FORMAT "%8.2" /end CHARACTERISTIC
/begin CHARACTERISTIC Sig_strokeDIAScale_C "Skalierung Umrechnung der Pumpenhübe SG -> DIA" VALUE 0x1C1192 Kw_Wu16 6.553500 FactHigh 0.00 6.553500 FORMAT "%8.6" /end CHARACTERISTIC
/begin CHARACTERISTIC Sig_tiGlwDSMOffset_C "Offset der Umrechnung SG -> DSM für Glühzeit" VALUE 0x1C1194 Kw_Ws16 65535.00 OneToOne -32768.00 32767.00 FORMAT "%8.2" /end CHARACTERISTIC
/begin CHARACTERISTIC Sig_tiGlwDSMScale_C "Skalierung der Umrechnung SG -> DSM für Glühzeit" VALUE 0x1C1196 Kw_Wu16 6.553500 FactHigh 0.00 6.553500 FORMAT "%8.6" /end CHARACTERISTIC
/begin CHARACTERISTIC Sig_tiGlwCANOffset_C "Offset der Umechnung SG -> CAN für Glühzeit" VALUE 0x1C1198 Kw_Ws16 65535.00 OneToOne -32768.00 32767.00 FORMAT "%8.2" /end CHARACTERISTIC
/begin CHARACTERISTIC Sig_tiGlwCANScale_C "Skalierung der Umrechnung SG -> CAN für Glühzeit" VALUE 0x1C119A Kw_Wu16 6.553500 FactHigh 0.00 6.553500 FORMAT "%8.6" /end CHARACTERISTIC
/begin CHARACTERISTIC Sig_tiGlwDIAOffset_C "Offset der Umrechnung SG -> Diagnoseschnittstelle für Glühzeit" VALUE 0x1C119C Kw_Ws16 65535.00 OneToOne -32768.00 32767.00 FORMAT "%8.2" /end CHARACTERISTIC
/begin CHARACTERISTIC Sig_tiGlwDIAScale_C "Skalierung der Umrechnung SG -> Diagnoseschnittstelle für Glühzeit" VALUE 0x1C119E Kw_Wu16 6.553500 FactHigh 0.00 6.553500 FORMAT "%8.6" /end CHARACTERISTIC
/begin CHARACTERISTIC Sig_tiDSMOffset_C "Offset für Umrechnung SG -> DSM für Zeit" VALUE 0x1C11A0 Kw_Ws16 65535.00 OneToOne -32768.00 32767.00 FORMAT "%8.2" /end CHARACTERISTIC
/begin CHARACTERISTIC Sig_tiDSMScale_C "Skalierung für Umrechnung SG -> DSM für Zeit" VALUE 0x1C11A2 Kw_Wu16 6.553500 FactHigh 0.00 6.553500 FORMAT "%8.6" /end CHARACTERISTIC
/begin CHARACTERISTIC Sig_tiCANOffset_C "Offset für Umrechnung SG -> CAN für Zeit" VALUE 0x1C11A4 Kw_Ws16 65535.00 OneToOne -32768.00 32767.00 FORMAT "%8.2" /end CHARACTERISTIC
/begin CHARACTERISTIC Sig_tiCANScale_C "Skalierung für Umrechnung SG -> CAN für Zeit" VALUE 0x1C11A6 Kw_Wu16 6.553500 FactHigh 0.00 6.553500 FORMAT "%8.6" /end CHARACTERISTIC
/begin CHARACTERISTIC Sig_tiDIAOffset_C "Offset für Umrechnung SG -> Diagnoseschnittstelle für Zeit" VALUE 0x1C11A8 Kw_Ws16 65535.00 OneToOne -32768.00 32767.00 FORMAT "%8.2" /end CHARACTERISTIC
/begin CHARACTERISTIC Sig_tiDIAScale_C "Skalierung für Umrechnung SG -> Diagnoseschnittstelle für Zeit" VALUE 0x1C11AA Kw_Wu16 6.553500 FactHigh 0.00 6.553500 FORMAT "%8.6" /end CHARACTERISTIC
/begin CHARACTERISTIC Sig_trqhighDSMOffset_C "Offset Umrechnung SG -> DSM für höhere Momente" VALUE 0x1C11AC Kw_Ws16 65535.00 OneToOne -32768.00 32767.00 FORMAT "%8.2" /end CHARACTERISTIC
/begin CHARACTERISTIC Sig_trqhighDSMScale_C "Skalierung Umrechnung SG -> DSM für höhere Momente" VALUE 0x1C11AE Kw_Wu16 6.553500 FactHigh 0.00 6.553500 FORMAT "%8.6" /end CHARACTERISTIC
/begin CHARACTERISTIC Sig_trqhighCANOffset_C "Offset Umrechnung SG -> CAN für höhere Moment" VALUE 0x1C11B0 Kw_Ws16 65535.00 OneToOne -32768.00 32767.00 FORMAT "%8.2" /end CHARACTERISTIC
/begin CHARACTERISTIC Sig_trqhighCANScale_C "Skalierung Umrechnung SG -> CAN für höhere Momente" VALUE 0x1C11B2 Kw_Wu16 6.553500 FactHigh 0.00 6.553500 FORMAT "%8.6" /end CHARACTERISTIC
/begin CHARACTERISTIC Sig_trqhighDIAOffset_C "Offset Umrechnung SG -> Diagnoseschnittstelle für höhere Momente" VALUE 0x1C11B4 Kw_Ws16 65535.00 OneToOne -32768.00 32767.00 FORMAT "%8.2" /end CHARACTERISTIC
/begin CHARACTERISTIC Sig_trqhighDIAScale_C "Skalierung Umrechnung SG -> Diagnoseschnittstelle für höhere Momente" VALUE 0x1C11B6 Kw_Wu16 6.553500 FactHigh 0.00 6.553500 FORMAT "%8.6" /end CHARACTERISTIC
/begin CHARACTERISTIC Sig_trqDSMOffset_C "Offset Umrechung SG->DSM für Drehmoment" VALUE 0x1C11B8 Kw_Ws16 65535.00 OneToOne -32768.00 32767.00 FORMAT "%8.2" /end CHARACTERISTIC
/begin CHARACTERISTIC Sig_trqDSMScale_C "Skalierung Umrechung SG->DSM für Drehmoment" VALUE 0x1C11BA Kw_Wu16 6.553500 FactHigh 0.00 6.553500 FORMAT "%8.6" /end CHARACTERISTIC
/begin CHARACTERISTIC Sig_trqCANOffset_C "Offset Umrechung SG->CAN für Drehmoment" VALUE 0x1C11BC Kw_Ws16 65535.00 OneToOne -32768.00 32767.00 FORMAT "%8.2" /end CHARACTERISTIC
/begin CHARACTERISTIC Sig_trqCANScale_C "Skalierung Umrechung SG->CAN für Drehmoment" VALUE 0x1C11BE Kw_Wu16 6.553500 FactHigh 0.00 6.553500 FORMAT "%8.6" /end CHARACTERISTIC
/begin CHARACTERISTIC Sig_trqDIAOffset_C "Offset Umrechung SG->Diagnoseschnittstelle für Drehmoment" VALUE 0x1C11C0 Kw_Ws16 65535.00 OneToOne -32768.00 32767.00 FORMAT "%8.2" /end CHARACTERISTIC
/begin CHARACTERISTIC Sig_trqDIAScale_C "Skalierung Umrechung SG->Diagnoseschnittstelle für Drehmoment" VALUE 0x1C11C2 Kw_Wu16 6.553500 FactHigh 0.00 6.553500 FORMAT "%8.6" /end CHARACTERISTIC
/begin CHARACTERISTIC Sig_tDSMOffset_C "Offset Umrechung SG->DSM für Temperatur" VALUE 0x1C11C4 Kw_Ws16 65535.00 OneToOne -32768.00 32767.00 FORMAT "%8.2" /end CHARACTERISTIC
/begin CHARACTERISTIC Sig_tDSMScale_C "Skalierung Umrechung SG->DSM für Temperatur" VALUE 0x1C11C6 Kw_Wu16 6.553500 FactHigh 0.00 6.553500 FORMAT "%8.6" /end CHARACTERISTIC
/begin CHARACTERISTIC Sig_tCANOffset_C "Offset Umrechung SG->CAN für Temperatur" VALUE 0x1C11C8 Kw_Ws16 65535.00 OneToOne -32768.00 32767.00 FORMAT "%8.2" /end CHARACTERISTIC
/begin CHARACTERISTIC Sig_tCANScale_C "Skalierung Umrechung SG->CAN für Temperatur" VALUE 0x1C11CA Kw_Wu16 6.553500 FactHigh 0.00 6.553500 FORMAT "%8.6" /end CHARACTERISTIC
/begin CHARACTERISTIC Sig_tDIAOffset_C "Offset Umrechung SG->Diagnoseschnittstelle für Temperatur" VALUE 0x1C11CC Kw_Ws16 65535.00 OneToOne -32768.00 32767.00 FORMAT "%8.2" /end CHARACTERISTIC
/begin CHARACTERISTIC Sig_tDIAScale_C "Skalierung Umrechung SG->Diagnoseschnittstelle für Temperatur" VALUE 0x1C11CE Kw_Wu16 6.553500 FactHigh 0.00 6.553500 FORMAT "%8.6" /end CHARACTERISTIC
/begin CHARACTERISTIC Sig_uBattDSMOffset_C "Offset fuer Umrechung SG->DSM fuer Batteriespannung" VALUE 0x1C11D0 Kw_Ws16 65535.00 OneToOne -32768.00 32767.00 FORMAT "%8.2" /end CHARACTERISTIC
/begin CHARACTERISTIC Sig_uBattDSMScale_C "Skalierung Umrechungs Faktor SG->DSM fuer Batteriespannung" VALUE 0x1C11D2 Kw_Wu16 6.553500 FactHigh 0.00 6.553500 FORMAT "%8.6" /end CHARACTERISTIC
/begin CHARACTERISTIC Sig_uBattCANOffset_C "Offset fuer Umrechung SG->CAN fuer Batteriespannung" VALUE 0x1C11D4 Kw_Ws16 65535.00 OneToOne -32768.00 32767.00 FORMAT "%8.2" /end CHARACTERISTIC
/begin CHARACTERISTIC Sig_uBattCANScale_C "Skalierung Umrechungs Faktor SG->CAN fuer Batteriespannung" VALUE 0x1C11D6 Kw_Wu16 6.553500 FactHigh 0.00 6.553500 FORMAT "%8.6" /end CHARACTERISTIC
/begin CHARACTERISTIC Sig_uBattDIAOffset_C "Offset fuer Umrechung SG->DIA fuer Batteriespannung" VALUE 0x1C11D8 Kw_Ws16 65535.00 OneToOne -32768.00 32767.00 FORMAT "%8.2" /end CHARACTERISTIC
/begin CHARACTERISTIC Sig_uBattDIAScale_C "Skalierung Umrechungs Faktor SG->DIA fuer Batteriespannung" VALUE 0x1C11DA Kw_Wu16 6.553500 FactHigh 0.00 6.553500 FORMAT "%8.6" /end CHARACTERISTIC
/begin CHARACTERISTIC Sig_uDSMOffset_C "Offset Umrechung SG->DSM für Spannung" VALUE 0x1C11DC Kw_Ws16 65535.00 OneToOne -32768.00 32767.00 FORMAT "%8.2" /end CHARACTERISTIC
/begin CHARACTERISTIC Sig_uDSMScale_C "Skalierung Umrechung SG->DSM für Spannungen" VALUE 0x1C11DE Kw_Wu16 6.553500 FactHigh 0.00 6.553500 FORMAT "%8.6" /end CHARACTERISTIC
/begin CHARACTERISTIC Sig_uCANOffset_C "Offset Umrechung SG->CAN für Spannung" VALUE 0x1C11E0 Kw_Ws16 65535.00 OneToOne -32768.00 32767.00 FORMAT "%8.2" /end CHARACTERISTIC
/begin CHARACTERISTIC Sig_uCANScale_C "Skalierung Umrechung SG->CAN für Spannung" VALUE 0x1C11E2 Kw_Wu16 6.553500 FactHigh 0.00 6.553500 FORMAT "%8.6" /end CHARACTERISTIC
/begin CHARACTERISTIC Sig_uDIAOffset_C "Offset Umrechung SG->Diagnoseschnittstelle für Spannung" VALUE 0x1C11E4 Kw_Ws16 65535.00 OneToOne -32768.00 32767.00 FORMAT "%8.2" /end CHARACTERISTIC
/begin CHARACTERISTIC Sig_uDIAScale_C "Skalierung Umrechung SG->Diagnoseschnittstelle für Spannung" VALUE 0x1C11E6 Kw_Wu16 6.553500 FactHigh 0.00 6.553500 FORMAT "%8.6" /end CHARACTERISTIC
/begin CHARACTERISTIC Sig_volHighDSMOffset_C "Offset Umrechnung der High-Volumsmenge SG -> DSM" VALUE 0x1C11E8 Kw_Ws16 65535.00 OneToOne -32768.00 32767.00 FORMAT "%8.2" /end CHARACTERISTIC
/begin CHARACTERISTIC Sig_volHighDSMScale_C "Skalierung Umrechnung der High-Volumsmenge SG -> DSM" VALUE 0x1C11EA Kw_Wu16 6.553500 FactHigh 0.00 6.553500 FORMAT "%8.6" /end CHARACTERISTIC
/begin CHARACTERISTIC Sig_volHighCANOffset_C "Offset Umrechnung der High-Volumsmenge SG -> can" VALUE 0x1C11EC Kw_Ws16 65535.00 OneToOne -32768.00 32767.00 FORMAT "%8.2" /end CHARACTERISTIC
/begin CHARACTERISTIC Sig_volHighCANScale_C "Skalierung Umrechnung der High-Volumsmenge SG -> CAN" VALUE 0x1C11EE Kw_Wu16 6.553500 FactHigh 0.00 6.553500 FORMAT "%8.6" /end CHARACTERISTIC
/begin CHARACTERISTIC Sig_volHighDIAOffset_C "Offset Umrechnung der High-Volumsmenge SG -> DIA" VALUE 0x1C11F0 Kw_Ws16 65535.00 OneToOne -32768.00 32767.00 FORMAT "%8.2" /end CHARACTERISTIC
/begin CHARACTERISTIC Sig_volHighDIAScale_C "Skalierung Umrechnung der High-Volumsmenge SG -> dia" VALUE 0x1C11F2 Kw_Wu16 6.553500 FactHigh 0.00 6.553500 FORMAT "%8.6" /end CHARACTERISTIC
/begin CHARACTERISTIC Sig_volDSMOffset_C "Offset Umrechnung der Volumsmenge SG -> DSM" VALUE 0x1C11F4 Kw_Ws16 65535.00 OneToOne -32768.00 32767.00 FORMAT "%8.2" /end CHARACTERISTIC
/begin CHARACTERISTIC Sig_volDSMScale_C "Skalierung Umrechnung der Volumsmenge SG -> DSM" VALUE 0x1C11F6 Kw_Wu16 6.553500 FactHigh 0.00 6.553500 FORMAT "%8.6" /end CHARACTERISTIC
/begin CHARACTERISTIC Sig_volCANOffset_C "Offset Umrechnung der Volumsmenge SG -> CAN" VALUE 0x1C11F8 Kw_Ws16 65535.00 OneToOne -32768.00 32767.00 FORMAT "%8.2" /end CHARACTERISTIC
/begin CHARACTERISTIC Sig_volCANScale_C "Skalierung Umrechnung der Volumsmenge SG -> CAN" VALUE 0x1C11FA Kw_Wu16 6.553500 FactHigh 0.00 6.553500 FORMAT "%8.6" /end CHARACTERISTIC
/begin CHARACTERISTIC Sig_volDIAOffset_C "Offset Umrechnung der Volumsmenge SG -> DIA" VALUE 0x1C11FC Kw_Ws16 65535.00 OneToOne -32768.00 32767.00 FORMAT "%8.2" /end CHARACTERISTIC
/begin CHARACTERISTIC Sig_volDIAScale_C "Skalierung Umrechnung der Volumsmenge SG -> DIA" VALUE 0x1C11FE Kw_Wu16 6.553500 FactHigh 0.00 6.553500 FORMAT "%8.6" /end CHARACTERISTIC
/begin CHARACTERISTIC Sig_vDSMOffset_C "Offset Umrechung SG->DSM für Fahrgeschwindigkeit" VALUE 0x1C1200 Kw_Ws16 65535.00 OneToOne -32768.00 32767.00 FORMAT "%8.2" /end CHARACTERISTIC
/begin CHARACTERISTIC Sig_vDSMScale_C "Skalierung Umrechung SG->DSM für Fahrgeschwindigkeit" VALUE 0x1C1202 Kw_Wu16 6.553500 FactHigh 0.00 6.553500 FORMAT "%8.6" /end CHARACTERISTIC
/begin CHARACTERISTIC Sig_vCANOffset_C "Offset Umrechung SG->CAN für Fahrgeschwindigkeit" VALUE 0x1C1204 Kw_Ws16 65535.00 OneToOne -32768.00 32767.00 FORMAT "%8.2" /end CHARACTERISTIC
/begin CHARACTERISTIC Sig_vCANScale_C "Skalierung Umrechung SG->CAN für Fahrgeschwindigkeit" VALUE 0x1C1206 Kw_Wu16 6.553500 FactHigh 0.00 6.553500 FORMAT "%8.6" /end CHARACTERISTIC
/begin CHARACTERISTIC Sig_vDIAOffset_C "Offset Umrechung SG->Diagnoseschnittstelle für Fahrgeschwindigkeit" VALUE 0x1C1208 Kw_Ws16 65535.00 OneToOne -32768.00 32767.00 FORMAT "%8.2" /end CHARACTERISTIC
/begin CHARACTERISTIC Sig_vDIAScale_C "Skalierung Umrechung SG->Diagnoseschnittstelle für Fahrgeschwindigkeit" VALUE 0x1C120A Kw_Wu16 6.553500 FactHigh 0.00 6.553500 FORMAT "%8.6" /end CHARACTERISTIC
/begin CHARACTERISTIC SOPTst_stShOffPathActv_C "aktive Abschaltpfade während der Initialisierung" VALUE 0x1E76FC Kw_Wu8 255.0 OneToOne 0.00 255.0 FORMAT "%5.1" /end CHARACTERISTIC
/begin CHARACTERISTIC SOPTst_tiWaitOVMOff_C "Verzögerung beim Ausschalten des diskreten Überspannungsmonitor" VALUE 0x1E7700 Kw_Wu32 6.00000000000 Time_msUI 0.00 6.00000000000 FORMAT "%13.11" EXTENDED_LIMITS 0.00 4294967295.00 /end CHARACTERISTIC
/begin CHARACTERISTIC SrvPmp_pwrAdjValDef_C "Standardwert für Abgleich Leistungsanforderung Servopumpe (Lenkung)" VALUE 0x1E7704 Kw_Ws16 0.00 Fact 1.000000 1.000000 FORMAT "%8.6" EXTENDED_LIMITS -4.000000 3.999878 /end CHARACTERISTIC
/begin CHARACTERISTIC SrvPmp_pwrAdjValMax_C "Maximalwert für Abgleich Leistungsanforderung Servopumpe (Lenkung)" VALUE 0x1E7706 Kw_Ws16 3.199951 Fact 0.00 3.199951 FORMAT "%8.6" EXTENDED_LIMITS -4.000000 3.999878 /end CHARACTERISTIC
/begin CHARACTERISTIC SrvPmp_pwrAdjValMin_C "Minimalwert für Abgleich Leistungsanforderung Servopumpe (Lenkung)" VALUE 0x1E7708 Kw_Ws16 3.199951 Fact 0.00 3.199951 FORMAT "%8.6" EXTENDED_LIMITS -4.000000 3.999878 /end CHARACTERISTIC
/begin CHARACTERISTIC SrvPmp_pwrDes_C "mittlerer Leistungsbedarf der Servopumpe" VALUE 0x1E770A Kw_Ws16 318830.8 Pwr -308831.1 9999.689 FORMAT "%8.1" EXTENDED_LIMITS -308831.1 308821.7 /end CHARACTERISTIC
/begin CHARACTERISTIC SSpMon_DebSRCHighSplyVltgDef1_C "Fehlerentprellung SRC High für Sensorversorgungsspannung 1" VALUE 0x1E770C Kw_Wu16 655350.0 Time_ms 0.00 655350.0 FORMAT "%8.1" /end CHARACTERISTIC
/begin CHARACTERISTIC SSpMon_DebSRCHighSplyVltgOk1_C "Heilungsentprellung SRC High für Sensorversorgungsspannung 1" VALUE 0x1E770E Kw_Wu16 655350.0 Time_ms 0.00 655350.0 FORMAT "%8.1" /end CHARACTERISTIC
/begin CHARACTERISTIC SSpMon_DebSRCHighSplyVltgDef2_C "Fehlerentprellung SRC High für Sensorversorgungsspannung 2" VALUE 0x1E7710 Kw_Wu16 655350.0 Time_ms 0.00 655350.0 FORMAT "%8.1" /end CHARACTERISTIC
/begin CHARACTERISTIC SSpMon_DebSRCHighSplyVltgOk2_C "Heilungsentprellung SRC High für Sensorversorgungsspannung 2" VALUE 0x1E7712 Kw_Wu16 655350.0 Time_ms 0.00 655350.0 FORMAT "%8.1" /end CHARACTERISTIC
/begin CHARACTERISTIC SSpMon_DebSRCHighSplyVltgDef3_C "Fehlerentprellung SRC High für Sensorversorgungsspannung 3" VALUE 0x1E7714 Kw_Wu16 655350.0 Time_ms 0.00 655350.0 FORMAT "%8.1" /end CHARACTERISTIC
/begin CHARACTERISTIC SSpMon_DebSRCHighSplyVltgOk3_C "Heilungsentprellung SRC High für Sensorversorgungsspannung 3" VALUE 0x1E7716 Kw_Wu16 655350.0 Time_ms 0.00 655350.0 FORMAT "%8.1" /end CHARACTERISTIC
/begin CHARACTERISTIC SSpMon_DebSRCLowSplyVltgDef1_C "Defektentprellung SRC Low für Sensorversorgungsspannung 1" VALUE 0x1E7718 Kw_Wu16 655350.0 Time_ms 0.00 655350.0 FORMAT "%8.1" /end CHARACTERISTIC
/begin CHARACTERISTIC SSpMon_DebSRCLowSplyVltgOk1_C "Heilungsentprellung SRC Low für Sensorversorgungsspannung 1" VALUE 0x1E771A Kw_Wu16 655350.0 Time_ms 0.00 655350.0 FORMAT "%8.1" /end CHARACTERISTIC
/begin CHARACTERISTIC SSpMon_DebSRCLowSplyVltgDef2_C "Defektentprellung SRC Low für Sensorversorgungsspannung 2" VALUE 0x1E771C Kw_Wu16 655350.0 Time_ms 0.00 655350.0 FORMAT "%8.1" /end CHARACTERISTIC
/begin CHARACTERISTIC SSpMon_DebSRCLowSplyVltgOk2_C "Heilungsentprellung SRC Low für Sensorversorgungsspannung 2" VALUE 0x1E771E Kw_Wu16 655350.0 Time_ms 0.00 655350.0 FORMAT "%8.1" /end CHARACTERISTIC
/begin CHARACTERISTIC SSpMon_DebSRCLowSplyVltgDef3_C "Defektentprellung SRC Low für Sensorversorgungsspannung 3" VALUE 0x1E7720 Kw_Wu16 655350.0 Time_ms 0.00 655350.0 FORMAT "%8.1" /end CHARACTERISTIC
/begin CHARACTERISTIC SSpMon_DebSRCLowSplyVltgOk3_C "Heilungsentprellung SRC Low für Sensorversorgungsspannung 3" VALUE 0x1E7722 Kw_Wu16 655350.0 Time_ms 0.00 655350.0 FORMAT "%8.1" /end CHARACTERISTIC
/begin CHARACTERISTIC StrtCD_uSRCMinOffRly_C "SRC-Min des Spannungsrohwertes" VALUE 0x1E7724 Kw_Ws16 5000.000 Volt 0.00 5000.000 FORMAT "%8.3" EXTENDED_LIMITS -160156.4 160151.5 /end CHARACTERISTIC
/begin CHARACTERISTIC StrtCD_uSRCMaxOffRly_C "SRC-Max des Spannungsrohwertes" VALUE 0x1E7726 Kw_Ws16 5000.000 Volt 0.00 5000.000 FORMAT "%8.3" EXTENDED_LIMITS -160156.4 160151.5 /end CHARACTERISTIC
/begin CHARACTERISTIC StrtCD_uLinOffRly_CUR "Linearisierungskennlinie fuer Klemme 50 Aus-Relais" CURVE 0x1E7728 Kl_Xs16_Ws16 5000.000 Volt 0.00 5000.000 FORMAT "%8.3" EXTENDED_LIMITS -160156.4 160151.5
 /begin AXIS_DESCR STD_AXIS StrtCD_uPhyValOffRly Volt 2 0.00 5000.000 FORMAT "%8.3" EXTENDED_LIMITS -160156.4 160151.5 DEPOSIT ABSOLUTE /end AXIS_DESCR
/end CHARACTERISTIC
/begin CHARACTERISTIC StrtCD_uSRCMinOnRly_C "SRC-Min des Spannungsrohwertes" VALUE 0x1E7748 Kw_Ws16 5000.000 Volt 0.00 5000.000 FORMAT "%8.3" EXTENDED_LIMITS -160156.4 160151.5 /end CHARACTERISTIC
/begin CHARACTERISTIC StrtCD_uSRCMaxOnRly_C "SRC-Max des Spannungsrohwertes" VALUE 0x1E774A Kw_Ws16 5000.000 Volt 0.00 5000.000 FORMAT "%8.3" EXTENDED_LIMITS -160156.4 160151.5 /end CHARACTERISTIC
/begin CHARACTERISTIC StrtCD_uLinOnRly_CUR "Linearisierungskennlinie fuer Klemme 50 Ein-Relais" CURVE 0x1E774C Kl_Xs16_Ws16 5000.000 Volt 0.00 5000.000 FORMAT "%8.3" EXTENDED_LIMITS -160156.4 160151.5
 /begin AXIS_DESCR STD_AXIS StrtCD_uPhyValOnRly Volt 2 0.00 5000.000 FORMAT "%8.3" EXTENDED_LIMITS -160156.4 160151.5 DEPOSIT ABSOLUTE /end AXIS_DESCR
/end CHARACTERISTIC
/begin CHARACTERISTIC StrtCD_stInvOutOffRly_C "Invertiertes Signal des Starter Aus-Relais" VALUE 0x1E7732 Kw_Wu8 1.000 OneToOne 0.00 1.000 FORMAT "%5.3" EXTENDED_LIMITS 0.00 255.0 /end CHARACTERISTIC
/begin CHARACTERISTIC StrtCD_stInvOutOnRly_C "Invertiertes Signal des Starter Ein-Relais" VALUE 0x1E7756 Kw_Wu8 1.000 OneToOne 0.00 1.000 FORMAT "%5.3" EXTENDED_LIMITS 0.00 255.0 /end CHARACTERISTIC
/begin CHARACTERISTIC StrtCD_stPwrStgDiaOffRly_C "Aktivierung der Abschaltbedingungen der Endstufendiagnose" VALUE 0x1E7733 Kw_Wu8 255.0 OneToOne 0.00 255.0 FORMAT "%5.1" /end CHARACTERISTIC
/begin CHARACTERISTIC StrtCD_stPwrStgDiaOnRly_C "Aktivierung der Abschaltbedingungen der Endstufendiagnose" VALUE 0x1E7757 Kw_Wu8 255.0 OneToOne 0.00 255.0 FORMAT "%5.1" /end CHARACTERISTIC
/begin CHARACTERISTIC StrtCD_tiNoLoadDefOfR_C "Fehlerentprellzeit für Leerlauf des Starter Aus Relais" VALUE 0x1E7734 Kw_Wu16 655350.0 Time_ms 0.00 655350.0 FORMAT "%8.1" /end CHARACTERISTIC
/begin CHARACTERISTIC StrtCD_tiNoLoadOkOfR_C "Heilungsentprellzeit für Leerlauf des Starter Aus-Relais" VALUE 0x1E7736 Kw_Wu16 655350.0 Time_ms 0.00 655350.0 FORMAT "%8.1" /end CHARACTERISTIC
/begin CHARACTERISTIC StrtCD_tiNoLoadDefOnR_C "Fehlerentprellzeit für Leerlauf des Starter Ein-Relais" VALUE 0x1E7758 Kw_Wu16 655350.0 Time_ms 0.00 655350.0 FORMAT "%8.1" /end CHARACTERISTIC
/begin CHARACTERISTIC StrtCD_tiNoLoadOkOnR_C "Heilungsentprellzeit für Leerlauf des Starter Ein-Relais" VALUE 0x1E775A Kw_Wu16 655350.0 Time_ms 0.00 655350.0 FORMAT "%8.1" /end CHARACTERISTIC
/begin CHARACTERISTIC StrtCD_tiShrtBatDefOfR_C "Fehlerentprellzeit für Kurzschluß nach U-Batt des Starter Aus-Relais" VALUE 0x1E7738 Kw_Wu16 655350.0 Time_ms 0.00 655350.0 FORMAT "%8.1" /end CHARACTERISTIC
/begin CHARACTERISTIC StrtCD_tiShrtBatOkOfR_C "Heilungsentprellzeit für Kurzschluß nach U-Batt des Starter Aus-Relais" VALUE 0x1E773A Kw_Wu16 655350.0 Time_ms 0.00 655350.0 FORMAT "%8.1" /end CHARACTERISTIC
/begin CHARACTERISTIC StrtCD_tiShrtBatDefOnR_C "Fehlerentprellzeit für Kurzschluß nach U-Batt des Starter Ein-Relais" VALUE 0x1E775C Kw_Wu16 655350.0 Time_ms 0.00 655350.0 FORMAT "%8.1" /end CHARACTERISTIC
/begin CHARACTERISTIC StrtCD_tiShrtBatOkOnR_C "Heilungsentprellzeit für Kurzschluß nach U-Batt des Starter Ein-Relais" VALUE 0x1E775E Kw_Wu16 655350.0 Time_ms 0.00 655350.0 FORMAT "%8.1" /end CHARACTERISTIC
/begin CHARACTERISTIC StrtCD_tiShrtGndDefOfR_C "Fehlerentprellzeit für Kurzschluß nach Masse des Starter Aus-Relais" VALUE 0x1E773C Kw_Wu16 655350.0 Time_ms 0.00 655350.0 FORMAT "%8.1" /end CHARACTERISTIC
/begin CHARACTERISTIC StrtCD_tiShrtGndOkOfR_C "Heilungsentprellzeit für Kurzschluß nach Masse des Starter Aus-Relais" VALUE 0x1E773E Kw_Wu16 655350.0 Time_ms 0.00 655350.0 FORMAT "%8.1" /end CHARACTERISTIC
/begin CHARACTERISTIC StrtCD_tiShrtGndDefOnR_C "Fehlerentprellzeit für Kurzschluß nach Masse des Starter Ein-Relais" VALUE 0x1E7760 Kw_Wu16 655350.0 Time_ms 0.00 655350.0 FORMAT "%8.1" /end CHARACTERISTIC
/begin CHARACTERISTIC StrtCD_tiShrtGndOkOnR_C "Heilungsentprellzeit für Kurzschluß nach Masse des Starter Ein-Relais" VALUE 0x1E7762 Kw_Wu16 655350.0 Time_ms 0.00 655350.0 FORMAT "%8.1" /end CHARACTERISTIC
/begin CHARACTERISTIC StrtCD_uNoLoadMaxOffR_C "Maximalspannung für Lastabfall" VALUE 0x1E7740 Kw_Ws16 5000.000 Volt 0.00 5000.000 FORMAT "%8.3" EXTENDED_LIMITS -160156.4 160151.5 /end CHARACTERISTIC
/begin CHARACTERISTIC StrtCD_uNoLoadMaxOnR_C "Maximalspannung für Lastabfall" VALUE 0x1E7764 Kw_Ws16 5000.000 Volt 0.00 5000.000 FORMAT "%8.3" EXTENDED_LIMITS -160156.4 160151.5 /end CHARACTERISTIC
/begin CHARACTERISTIC StrtCD_uNoLoadMinOffR_C "Minimalspannung für Lastabfall" VALUE 0x1E7742 Kw_Ws16 5000.000 Volt 0.00 5000.000 FORMAT "%8.3" EXTENDED_LIMITS -160156.4 160151.5 /end CHARACTERISTIC
/begin CHARACTERISTIC StrtCD_uNoLoadMinOnR_C "Minimalspannung für Lastabfall" VALUE 0x1E7766 Kw_Ws16 5000.000 Volt 0.00 5000.000 FORMAT "%8.3" EXTENDED_LIMITS -160156.4 160151.5 /end CHARACTERISTIC
/begin CHARACTERISTIC StrtCD_uShortBatMinOffR_C "Minimalspannung für Kurzschluß nach U-Batt." VALUE 0x1E7744 Kw_Ws16 5000.000 Volt 0.00 5000.000 FORMAT "%8.3" EXTENDED_LIMITS -160156.4 160151.5 /end CHARACTERISTIC
/begin CHARACTERISTIC StrtCD_uShortBatMinOnR_C "Minimalspannung für Kurzschluß nach U-Batt." VALUE 0x1E7768 Kw_Ws16 5000.000 Volt 0.00 5000.000 FORMAT "%8.3" EXTENDED_LIMITS -160156.4 160151.5 /end CHARACTERISTIC
/begin CHARACTERISTIC StrtCD_uShortGndMaxOffR_C "Maximalspannung für Kurzschluß nach U-Batt" VALUE 0x1E7746 Kw_Ws16 5000.000 Volt 0.00 5000.000 FORMAT "%8.3" EXTENDED_LIMITS -160156.4 160151.5 /end CHARACTERISTIC
/begin CHARACTERISTIC StrtCD_uShortGndMaxOnR_C "Maximalspannung für Kurzschluß nach Masse" VALUE 0x1E776A Kw_Ws16 5000.000 Volt 0.00 5000.000 FORMAT "%8.3" EXTENDED_LIMITS -160156.4 160151.5 /end CHARACTERISTIC
/begin CHARACTERISTIC StSysCtl_CntEepWrtAtm_C "Max. EEProm Schreibversuche" VALUE 0x1E7A2E Kw_Wu8 3.000 OneToOne 0.00 3.000 FORMAT "%5.3" EXTENDED_LIMITS 0.00 255.0 /end CHARACTERISTIC
/begin CHARACTERISTIC StSysCtl_ctCaSImpT50On_C "Zählschwelle für Nockenwellenimpulse seit T50 ein für Erkennung kein Kurbelwellensignal" VALUE 0x1E7A28 Kw_Wu16 65535.00 OneToOne 0.00 65535.00 FORMAT "%8.2" /end CHARACTERISTIC
/begin CHARACTERISTIC StSysCtl_nThresEngaErr_C "Drehzahlschwelle zur Einspurfehler Detektion" VALUE 0x1E7A30 Kw_Ws16 6000.000 EngN 0.00 6000.000 FORMAT "%8.3" EXTENDED_LIMITS -32768.00 32767.00 /end CHARACTERISTIC
/begin CHARACTERISTIC StSysCtl_nThresEngaN_C "Drehzahlschwelle für Stillstandserkennung" VALUE 0x1E7A32 Kw_Ws16 6000.000 EngN 0.00 6000.000 FORMAT "%8.3" EXTENDED_LIMITS -32768.00 32767.00 /end CHARACTERISTIC
/begin CHARACTERISTIC StSysCtl_nThresEngT_CUR "motortemperaturabhängige Drehzahlschwelle" CURVE 0x1E7A34 Kl_Xs16_Ws16 6000.000 EngN 0.00 6000.000 FORMAT "%8.3" EXTENDED_LIMITS -32768.00 32767.00
 /begin AXIS_DESCR STD_AXIS Eng_tEng Temp_Cels 7 -50.14000 199.8600 FORMAT "%8.4" EXTENDED_LIMITS -3549.940 3003.560 DEPOSIT ABSOLUTE /end AXIS_DESCR
/end CHARACTERISTIC
/begin CHARACTERISTIC StSysCtl_nThresZeroN_C "Drehzahl zum Testen des Motorstillstandes" VALUE 0x1E7A52 Kw_Ws16 6000.000 EngN 0.00 6000.000 FORMAT "%8.3" EXTENDED_LIMITS -32768.00 32767.00 /end CHARACTERISTIC
/begin CHARACTERISTIC StSysCtl_stT50CDOff_C "Applizierbarer Wert bei ausgeschaltener Funktion" VALUE 0x1E7A54 Kw_Wu8 1.000 OneToOne 0.00 1.000 FORMAT "%5.3" EXTENDED_LIMITS 0.00 255.0 /end CHARACTERISTIC
/begin CHARACTERISTIC StSysCtl_stT50CDOn_C "Applizierbarer Wert bei ausgeschaltener Funktion" VALUE 0x1E7A55 Kw_Wu8 1.000 OneToOne 0.00 1.000 FORMAT "%5.3" EXTENDED_LIMITS 0.00 255.0 /end CHARACTERISTIC
/begin CHARACTERISTIC StSysCtl_swtEnResetDisengage_C "Starterausspurenbit zurücksetzen im Nachlauf (1: enable; 0: disable)" VALUE 0x1E7A56 Kw_Wu8 1.000 OneToOne 0.00 1.000 FORMAT "%5.3" EXTENDED_LIMITS 0.00 255.0 /end CHARACTERISTIC
/begin CHARACTERISTIC StSysCtl_swtEnResetRelease_C "Schalter, der das Zurücksetzen der Starterfreigabe im Nachlauf ermöglicht" VALUE 0x1E7A2A Kw_Wu8 1.000 OneToOne 0.00 1.000 FORMAT "%5.3" EXTENDED_LIMITS 0.00 255.0 /end CHARACTERISTIC
/begin CHARACTERISTIC StSysCtl_swtRlyErrIgn_C "Relais-Fehler kann den Start abbrechen" VALUE 0x1E7A57 Kw_Wu8 1.000 OneToOne 0.00 1.000 FORMAT "%5.3" EXTENDED_LIMITS 0.00 255.0 /end CHARACTERISTIC
/begin CHARACTERISTIC StSysCtl_swtStStrtLock_C "K15 Sperre (0: inaktiv/1: aktiv)" VALUE 0x1E7A58 Kw_Wu8 1.000 OneToOne 0.00 1.000 FORMAT "%5.3" EXTENDED_LIMITS 0.00 255.0 /end CHARACTERISTIC
/begin CHARACTERISTIC StSysCtl_swtStSysCtlMn_C "Hauptschalter der Startersteuerung (1: SW/0: HW)" VALUE 0x1E7A59 Kw_Wu8 1.000 OneToOne 0.00 1.000 FORMAT "%5.3" EXTENDED_LIMITS 0.00 255.0 /end CHARACTERISTIC
/begin CHARACTERISTIC StSysCtl_swtStSysCtlMode_C "Startersteuerung Modus (0: BSG/Kessy/1: ECU)" VALUE 0x1E7A5A Kw_Wu8 1.000 OneToOne 0.00 1.000 FORMAT "%5.3" EXTENDED_LIMITS 0.00 255.0 /end CHARACTERISTIC
/begin CHARACTERISTIC StSysCtl_tiEngaErr_C "Zeit für Erkennung eines Einspurfehlers" VALUE 0x1E7A5C Kw_Wu16 655140.0 Time_ms 0.00 655140.0 FORMAT "%8.1" EXTENDED_LIMITS 0.00 655350.0 /end CHARACTERISTIC
/begin CHARACTERISTIC StSysCtl_tiIlsNPlausDef_C "Fehlerentprellzeit für Interlock nicht plausibel" VALUE 0x1E7A5E Kw_Wu16 655350.0 Time_ms 0.00 655350.0 FORMAT "%8.1" /end CHARACTERISTIC
/begin CHARACTERISTIC StSysCtl_tiIlsNPlausOk_C "Heilungsentprellzeit für Interlock nicht plausibel" VALUE 0x1E7A60 Kw_Wu16 655350.0 Time_ms 0.00 655350.0 FORMAT "%8.1" /end CHARACTERISTIC
/begin CHARACTERISTIC StSysCtl_tiOnlyOffRly_C "Zeit bis zum Auschalten des Aus-Relais" VALUE 0x1E7A62 Kw_Wu16 655140.0 Time_ms 0.00 655140.0 FORMAT "%8.1" EXTENDED_LIMITS 0.00 655350.0 /end CHARACTERISTIC
/begin CHARACTERISTIC StSysCtl_tiRlyDiag_C "Zeit zwischen den Relais beim Ausschalten" VALUE 0x1E7A64 Kw_Wu16 655140.0 Time_ms 0.00 655140.0 FORMAT "%8.1" EXTENDED_LIMITS 0.00 655350.0 /end CHARACTERISTIC
/begin CHARACTERISTIC StSysCtl_tiT50on_C "T50 Zeitschwelle für Erkennung kein Kurbelwellensignal" VALUE 0x1E7A2C Kw_Wu16 655140.0 Time_ms 0.00 655140.0 FORMAT "%8.1" EXTENDED_LIMITS 0.00 655350.0 /end CHARACTERISTIC
/begin CHARACTERISTIC StSysCtl_tiT50ROneRly1Def_C "Entprellzeit für Rückmeldeleitung immer noch High Ein-Relais defekt" VALUE 0x1E7A66 Kw_Wu16 655350.0 Time_ms 0.00 655350.0 FORMAT "%8.1" /end CHARACTERISTIC
/begin CHARACTERISTIC StSysCtl_tiT50ROneRly1Ok_C "Entprellzeit für Fehlerheilung bei Rückmeldeleitung immer noch High Ein-Relais" VALUE 0x1E7A68 Kw_Wu16 655350.0 Time_ms 0.00 655350.0 FORMAT "%8.1" /end CHARACTERISTIC
/begin CHARACTERISTIC StSysCtl_tiT50ROneRly2Def_C "Entprellzeit für Fehlererkennung Rückmeldeleitung immer noch High Aus-Relais" VALUE 0x1E7A6A Kw_Wu16 655350.0 Time_ms 0.00 655350.0 FORMAT "%8.1" /end CHARACTERISTIC
/begin CHARACTERISTIC StSysCtl_tiT50ROneRly2Ok_C "Entprellzeit für Fehlerheilung Rückmeldeleitung immer noch High Aus-Relais" VALUE 0x1E7A6C Kw_Wu16 655350.0 Time_ms 0.00 655350.0 FORMAT "%8.1" /end CHARACTERISTIC
/begin CHARACTERISTIC StSysCtl_tiT50RZeroDef_C "Entprellzeit für Fehlererkennung Rückmeldeleitung immer noch LOW" VALUE 0x1E7A6E Kw_Wu16 655350.0 Time_ms 0.00 655350.0 FORMAT "%8.1" /end CHARACTERISTIC
/begin CHARACTERISTIC StSysCtl_tiT50RZeroOk_C "Entprellzeit für Fehlerheilung bei Rückmeldeleitung immer noch LOW" VALUE 0x1E7A70 Kw_Wu16 655350.0 Time_ms 0.00 655350.0 FORMAT "%8.1" /end CHARACTERISTIC
/begin CHARACTERISTIC StSysCtl_tiThresAddCor_C "Additionswert für Timerwert im Notfahrmodus" VALUE 0x1E7A72 Kw_Wu16 655140.0 Time_ms 0.00 655140.0 FORMAT "%8.1" EXTENDED_LIMITS 0.00 655350.0 /end CHARACTERISTIC
/begin CHARACTERISTIC StSysCtl_tiThresEngT_CUR "motortemperaturabhängige Maximalzeit" CURVE 0x1E7A74 Kl_Xs16_Ws16 327570.0 Time_ms 0.00 327570.0 FORMAT "%8.1" EXTENDED_LIMITS -327680.0 327670.0
 /begin AXIS_DESCR STD_AXIS Eng_tEng Temp_Cels 7 -50.14000 199.8600 FORMAT "%8.4" EXTENDED_LIMITS -3549.940 3003.560 DEPOSIT ABSOLUTE /end AXIS_DESCR
/end CHARACTERISTIC
/begin CHARACTERISTIC StSysCtl_tiThresVel_C "Fahrgeschwindigkeitszeitschwelle" VALUE 0x1E7A92 Kw_Wu16 655140.0 Time_ms 0.00 655140.0 FORMAT "%8.1" EXTENDED_LIMITS 0.00 655350.0 /end CHARACTERISTIC
/begin CHARACTERISTIC StSysCtl_tiThresZeroN_C "Zeit zum Testen des Motorstillstandes" VALUE 0x1E7A94 Kw_Wu16 655140.0 Time_ms 0.00 655140.0 FORMAT "%8.1" EXTENDED_LIMITS 0.00 655350.0 /end CHARACTERISTIC
/begin CHARACTERISTIC StSysCtl_TMaxNrm_MAP "Zeit für Startmomenten Verzögerung" MAP 0x1E7A96 Kf_Xs16_Ys16_Ws16 10000.00 Time_ms 0.00 10000.00 FORMAT "%8.2" EXTENDED_LIMITS -327680.0 327670.0
 /begin AXIS_DESCR STD_AXIS Eng_tEng Temp_Cels 10 -50.14000 149.8600 FORMAT "%8.4" EXTENDED_LIMITS -3549.940 3003.560 DEPOSIT ABSOLUTE /end AXIS_DESCR
 /begin AXIS_DESCR STD_AXIS GlwCtl_tiPreGlw GlwCtl_Time_ms 10 0.00 335500.0 FORMAT "%8.1" EXTENDED_LIMITS 0.00 6553500. DEPOSIT ABSOLUTE /end AXIS_DESCR
/end CHARACTERISTIC
/begin CHARACTERISTIC StSysCtl_vThresVel_C "Fahrgeschwindigkeitsschwelle" VALUE 0x1E7B8A Kw_Ws16 300.0000 Vel 0.00 300.0000 FORMAT "%8.4" EXTENDED_LIMITS -327.6800 327.6700 /end CHARACTERISTIC
/begin CHARACTERISTIC StSys_ctRevMin_C "Umdrehungszählerschwelle seit Initialisierung" VALUE 0x1E7770 Kw_Wu16 200.0000 OneToOne 0.00 200.0000 FORMAT "%8.4" EXTENDED_LIMITS 0.00 65535.00 /end CHARACTERISTIC
/begin CHARACTERISTIC StSys_nAdjMax_C "Abgleichende-Drehzahl" VALUE 0x1E7796 Kw_Ws16 65535.00 EngN -32768.00 32767.00 FORMAT "%8.2" /end CHARACTERISTIC
/begin CHARACTERISTIC StSys_nEngOffHi_C "obere Drehzahlschwelle: Motor geht während dem Start aus" VALUE 0x1E776C Kw_Ws16 65535.00 EngN -32768.00 32767.00 FORMAT "%8.2" /end CHARACTERISTIC
/begin CHARACTERISTIC StSys_nEngOffLo_C "untere Drehzahlschwelle: Motor geht während dem Start aus" VALUE 0x1E776E Kw_Ws16 65535.00 EngN -32768.00 32767.00 FORMAT "%8.2" /end CHARACTERISTIC
/begin CHARACTERISTIC StSys_nStrtCutOut_MAP "Kennfeld zur Bestimmung der Startabwurf-Drehzahl" MAP 0x1E7772 Kf_Xs16_Ys16_Ws16 6000.000 EngN 0.00 6000.000 FORMAT "%8.3" EXTENDED_LIMITS -32768.00 32767.00
 /begin AXIS_DESCR STD_AXIS Eng_tEng Temp_Cels 2 -50.14000 149.8600 FORMAT "%8.4" EXTENDED_LIMITS -3549.940 3003.560 DEPOSIT ABSOLUTE /end AXIS_DESCR
 /begin AXIS_DESCR STD_AXIS APSCD_pVal Pres_hPa 4 0.00 3500.000 FORMAT "%8.3" EXTENDED_LIMITS -32768.00 32767.00 DEPOSIT ABSOLUTE /end AXIS_DESCR
/end CHARACTERISTIC
/begin CHARACTERISTIC StSys_tiRlsHtg_C "Zeitverzögerung für den Freigabestatus des Heizungssystems ist auf TRUE zu setzen" VALUE 0x1E7792 Kw_Wu16 655350.0 Time_ms 0.00 655350.0 FORMAT "%8.1" /end CHARACTERISTIC
/begin CHARACTERISTIC StSys_tiStrtCutOut_C "Startabwurf-Sperrzeit" VALUE 0x1E7794 Kw_Wu16 655350.0 Time_ms 0.00 655350.0 FORMAT "%8.1" /end CHARACTERISTIC
/begin CHARACTERISTIC StSys_trqAdjMax_C "maximales Moment fuer den Startabgleich" VALUE 0x1E7798 Kw_Ws16 6553.500 Trq -3276.800 3276.700 FORMAT "%8.3" /end CHARACTERISTIC
/begin CHARACTERISTIC StSys_trqAdjVal_C "Abgleichwert fuer das Startmoment" VALUE 0x1E779A Kw_Ws16 6553.500 Trq -3276.800 3276.700 FORMAT "%8.3" /end CHARACTERISTIC
/begin CHARACTERISTIC StSys_trqStrtAddCor_C "Startbasismomenterhöhung für Notfahrmodus" VALUE 0x1E779C Kw_Ws16 1000.000 Trq 0.00 1000.000 FORMAT "%8.3" EXTENDED_LIMITS -3276.800 3276.700 /end CHARACTERISTIC
/begin CHARACTERISTIC StSys_trqStrtBas_MAP "Basismoment fuer den Start" MAP 0x1E779E Kf_Xs16_Ys16_Ws16 3276.700 Trq 0.00 3276.700 FORMAT "%8.3" EXTENDED_LIMITS -3276.800 3276.700
 /begin AXIS_DESCR STD_AXIS Eng_nAvrg EngN 9 0.00 6000.000 FORMAT "%8.3" EXTENDED_LIMITS -32768.00 32767.00 DEPOSIT ABSOLUTE /end AXIS_DESCR
 /begin AXIS_DESCR STD_AXIS Eng_tEng Temp_Cels 10 -50.14000 199.8600 FORMAT "%8.4" EXTENDED_LIMITS -3549.940 3003.560 DEPOSIT ABSOLUTE /end AXIS_DESCR
/end CHARACTERISTIC
/begin CHARACTERISTIC StSys_trqStrt_MAP "Kennfeld für Startmoment ab Klemme 50" MAP 0x1E787C Kf_Xs16_Ys16_Ws16 3276.700 Trq 0.00 3276.700 FORMAT "%8.3" EXTENDED_LIMITS -3276.800 3276.700
 /begin AXIS_DESCR STD_AXIS Eng_nAvrg EngN 9 0.00 6000.000 FORMAT "%8.3" EXTENDED_LIMITS -32768.00 32767.00 DEPOSIT ABSOLUTE /end AXIS_DESCR
 /begin AXIS_DESCR STD_AXIS Eng_tEng Temp_Cels 10 -50.14000 199.8600 FORMAT "%8.4" EXTENDED_LIMITS -3549.940 3003.560 DEPOSIT ABSOLUTE /end AXIS_DESCR
/end CHARACTERISTIC
/begin MEASUREMENT Rail_dpSetPointInc "maximaler Raildruck-Sollwertanstieg pro Sekunde" SWORD PresRail_sec 1 100 -13107200. 13106800. FORMAT "%8.0" ECU_ADDRESS 0x7F9B38 /end MEASUREMENT
/begin MEASUREMENT Rail_dvolInjVlvCtl_mp "Korrekturwert der Vorsteuerung unter Berücksichtigung der Steuermengen für die Injektoren" SWORD Qp_mm3_sec 1 100 -327680.0 327670.0 FORMAT "%8.1" ECU_ADDRESS 0x803770 /end MEASUREMENT
/begin MEASUREMENT Rail_dvolLeak_mp "Leckage des Hochdrucksystems" SWORD Qp_mm3_sec 1 100 -327680.0 327670.0 FORMAT "%8.1" ECU_ADDRESS 0x803772 /end MEASUREMENT
/begin MEASUREMENT Rail_dvolPreCtlBas_mp "Basisvorsteuerwert aus Kennfeld für die Druckregelung über Zumesseinheit" SWORD Qp_mm3_sec 1 100 -327680.0 327670.0 FORMAT "%8.1" ECU_ADDRESS 0x803774 /end MEASUREMENT
/begin MEASUREMENT Rail_dvolPreCtlInit_mp "Initialisierungswert der Vorsteuerung für die Druckregelung über Zumesseinheit" SWORD Qp_mm3_sec 1 100 -327680.0 327670.0 FORMAT "%8.1" ECU_ADDRESS 0x803776 /end MEASUREMENT
/begin MEASUREMENT Rail_dvolPreCtlOfs_mp "Offset aus Kennfeld für die Vorsteuerung der Druckregelung über Zumesseinheit" SWORD Qp_mm3_sec 1 100 -327680.0 327670.0 FORMAT "%8.1" ECU_ADDRESS 0x803778 /end MEASUREMENT
/begin MEASUREMENT Rail_dvolPreCtlPoI1_mp "Vorsteuerwert abhängig von der Nacheinspritzmenge 1 für die Druckregelung über Zumesseinheit" SWORD Qp_mm3_sec 1 100 -327680.0 327670.0 FORMAT "%8.1" ECU_ADDRESS 0x80377A /end MEASUREMENT
/begin MEASUREMENT Rail_dvolPreCtlPoI2_mp "Vorsteuerwert abhängig von der Nacheinspritzmenge 2 für die Druckregelung über Zumesseinheit" SWORD Qp_mm3_sec 1 100 -327680.0 327670.0 FORMAT "%8.1" ECU_ADDRESS 0x80377C /end MEASUREMENT
/begin MEASUREMENT Rail_dvolPreCtl_mp "Vorsteuerwert für die Druckregelung über Zumesseinheit" SWORD Qp_mm3_sec 1 100 -327680.0 327670.0 FORMAT "%8.1" ECU_ADDRESS 0x80377E /end MEASUREMENT
/begin MEASUREMENT Rail_facPCVTiRmpVal_mp "aktueller Rampenwert der Rampe bei Umschaltung von Regelung über Druckregelventil auf Regelung über Zumesseinheit" SWORD Fact 1 100 -4.000000 3.999878 FORMAT "%8.6" ECU_ADDRESS 0x803782 /end MEASUREMENT
/begin MEASUREMENT Rail_facSetPointAPSCor "Gewichtungsfaktor für atmosphärendruckabhängige Sollwertkorrektur des Raildrucks" SWORD Fact 1 100 -4.000000 3.999878 FORMAT "%8.6" ECU_ADDRESS 0x7F9B40 /end MEASUREMENT
/begin MEASUREMENT Rail_facSetPointATSCor "Gewichtungsfaktor für ansauglufttemperaturabhängige Sollwertkorrektur des Raildrucks" SWORD Fact 1 100 -4.000000 3.999878 FORMAT "%8.6" ECU_ADDRESS 0x7F9B42 /end MEASUREMENT
/begin MEASUREMENT Rail_facSetPointETSCor "Gewichtungsfaktor für motortemperaturabhängige Sollwertkorrektur des Raildrucks" SWORD Fact 1 100 -4.000000 3.999878 FORMAT "%8.6" ECU_ADDRESS 0x7F9B44 /end MEASUREMENT
/begin MEASUREMENT Rail_facSetPointFTSCor_mp "Gewichtungsfaktor für kraftstofftemperaturabhängige Sollwertkorrektur des Raildruckreglers" SWORD Fact 1 100 -4.000000 3.999878 FORMAT "%8.6" ECU_ADDRESS 0x8037A8 /end MEASUREMENT
/begin MEASUREMENT Rail_facTiRmpVal_mp "aktueller Rampenwert wenn von Offset-Kennlinie auf Reduzierter Offset-Kennlinie und andersherum gerampt wird" SWORD Fact 1 100 -4.000000 3.999878 FORMAT "%8.6" ECU_ADDRESS 0x803784 /end MEASUREMENT
/begin MEASUREMENT Rail_pMeUnDvtMax_mp "Ausgang der Kennlinie Rail_pMeUnDvtMax_CUR" SWORD Pres_Rail 1 100 -3276800. 3276700. FORMAT "%8.0" ECU_ADDRESS 0x803754 /end MEASUREMENT
/begin MEASUREMENT Rail_pMeUnDvtMin_mp "Ausgang der Kennlinie Rail_pMeUnDvtMin_CUR" SWORD Pres_Rail 1 100 -3276800. 3276700. FORMAT "%8.0" ECU_ADDRESS 0x803756 /end MEASUREMENT
/begin MEASUREMENT Rail_pMeUnPeakMin_mp "Ausgang der Kennlinie Rail_pMeUnPeakMin_CUR" SWORD Pres_Rail 1 100 -3276800. 3276700. FORMAT "%8.0" ECU_ADDRESS 0x803758 /end MEASUREMENT
/begin MEASUREMENT Rail_pNIPCVMax_mp "Ausgang des Kennfelds Rail_pNIPCVMax_MAP" SWORD Pres_Rail 1 100 -3276800. 3276700. FORMAT "%8.0" ECU_ADDRESS 0x803760 /end MEASUREMENT
/begin MEASUREMENT Rail_pNIPCVMin_mp "Ausgang des Kennfelds Rail_pNIPCVMax_MAP" SWORD Pres_Rail 1 100 -3276800. 3276700. FORMAT "%8.0" ECU_ADDRESS 0x803762 /end MEASUREMENT
/begin MEASUREMENT Rail_pPCVClose_mp "Steuergröße um das Druckregelventil geschlossen zu halten" SWORD Pres_Rail 1 100 -3276800. 3276700. FORMAT "%8.0" ECU_ADDRESS 0x803786 /end MEASUREMENT
/begin MEASUREMENT Rail_pPCVCtlDT1_mp "DT1-Anteil des Druckreglers über Druckregelventil" SWORD Pres_Rail 1 100 -3276800. 3276700. FORMAT "%8.0" ECU_ADDRESS 0x80373E /end MEASUREMENT
/begin MEASUREMENT Rail_pPCVCtlI_mp "I-Anteil des Druckreglers über Druckregelventil" SWORD Pres_Rail 1 100 -3276800. 3276700. FORMAT "%8.0" ECU_ADDRESS 0x803740 /end MEASUREMENT
/begin MEASUREMENT Rail_pPCVCtlPILim_mp "DT1-Anteil des Druckreglers über Druckregelventil (begrenzt)" SWORD Pres_Rail 1 100 -3276800. 3276700. FORMAT "%8.0" ECU_ADDRESS 0x803742 /end MEASUREMENT
/begin MEASUREMENT Rail_pPCVCtlP_mp "P-Anteil des Druckreglers über Druckregelventil" SWORD Pres_Rail 1 100 -3276800. 3276700. FORMAT "%8.0" ECU_ADDRESS 0x803744 /end MEASUREMENT
/begin MEASUREMENT Rail_pPCVDvtMax_mp "Ausgang der Kennlinie Rail_pPCVDvtMax_CUR" SWORD Pres_Rail 1 100 -3276800. 3276700. FORMAT "%8.0" ECU_ADDRESS 0x803764 /end MEASUREMENT
/begin MEASUREMENT Rail_pPCVInitI_mp "Initialisierung I-Anteil des Druckreglers über Druckregelventil, beim Umschalten von Zumesseinheit auf Druckregelventil" SWORD Pres_Rail 1 100 -3276800. 3276700. FORMAT "%8.0" ECU_ADDRESS 0x803746 /end MEASUREMENT
/begin MEASUREMENT Rail_pPCVOfs_mp "Rampenschalterausgang für die Steuergröße um das Druckregelventil geschlossen zu halten" SWORD Pres_Rail 1 100 -3276800. 3276700. FORMAT "%8.0" ECU_ADDRESS 0x803788 /end MEASUREMENT
/begin MEASUREMENT Rail_pPCVPeakMin_mp "Ausgang der Kennlinie Rail_pPCVPeakMin_CUR" SWORD Pres_Rail 1 100 -3276800. 3276700. FORMAT "%8.0" ECU_ADDRESS 0x803766 /end MEASUREMENT
/begin MEASUREMENT Rail_pPreCtl_mp "Vorsteuerwert für die Druckregelung über Druckregelventil" SWORD Pres_Rail 1 100 -3276800. 3276700. FORMAT "%8.0" ECU_ADDRESS 0x80378A /end MEASUREMENT
/begin MEASUREMENT Rail_pSetPoint "Raildruck-sollwert" SWORD Pres_Rail 1 100 -3276800. 3276700. FORMAT "%8.0" ECU_ADDRESS 0x7F9B4A /end MEASUREMENT
/begin MEASUREMENT Rail_pSetPointActUnlim "Unlimitierter Sollwert nach Regenerationsschalter" SWORD Pres_Rail 1 100 -3276800. 3276700. FORMAT "%8.0" ECU_ADDRESS 0x7F9B4C /end MEASUREMENT
/begin MEASUREMENT Rail_pSetPointAddCor "Schnittstelle für Erweiterungen der Korrekturen für den Raildrucksollwert" SWORD Pres_Rail 1 100 -3276800. 3276700. FORMAT "%8.0" ECU_ADDRESS 0x7F9B4E /end MEASUREMENT
/begin MEASUREMENT Rail_pSetPointAPSCor_mp "Raildruck-Korrekturwert, abhängig vom Atmosphärendruck" SWORD Pres_Rail 1 100 -3276800. 3276700. FORMAT "%8.0" ECU_ADDRESS 0x8037AA /end MEASUREMENT
/begin MEASUREMENT Rail_pSetPointATSCor_mp "Raildruck-Korrekturwert, abhängig von der Ansauglufttemperatur" SWORD Pres_Rail 1 100 -3276800. 3276700. FORMAT "%8.0" ECU_ADDRESS 0x8037AC /end MEASUREMENT
/begin MEASUREMENT Rail_pSetPointBase_mp "Basissollwert des Raildrucks" SWORD Pres_Rail 1 100 -3276800. 3276700. FORMAT "%8.0" ECU_ADDRESS 0x803794 /end MEASUREMENT
/begin MEASUREMENT Rail_pSetPointBattMin_mp "batteriespannungsabhängig korrigierter Raildruck-Sollwert" SWORD Pres_Rail 1 100 -3276800. 3276700. FORMAT "%8.0" ECU_ADDRESS 0x803796 /end MEASUREMENT
/begin MEASUREMENT Rail_pSetPointCor_mp "korrigierter Raildruck Sollwert, abhängig vom projektspezifischen Eingriff und von Umgebungsbedingungen" SWORD Pres_Rail 1 100 -3276800. 3276700. FORMAT "%8.0" ECU_ADDRESS 0x803798 /end MEASUREMENT
/begin MEASUREMENT Rail_pSetPointDec_mp "maximaler Raildruck-Sollwertabfall pro Schedulesequenz" SWORD Pres_Rail 1 100 -3276800. 3276700. FORMAT "%8.0" ECU_ADDRESS 0x80379A /end MEASUREMENT
/begin MEASUREMENT Rail_pSetPointDynLim_mp "Raildruck Sollwert mir dynamischer Begrenzung" SWORD Pres_Rail 1 100 -3276800. 3276700. FORMAT "%8.0" ECU_ADDRESS 0x80379C /end MEASUREMENT
/begin MEASUREMENT Rail_pSetPointEnvCor "Raildruck-Korrekturwert, abhängig von den Umgebungsbedingungen" SWORD Pres_Rail 1 100 -3276800. 3276700. FORMAT "%8.0" ECU_ADDRESS 0x7F9B50 /end MEASUREMENT
/begin MEASUREMENT Rail_pSetPointETSCor_mp "Raildruck-Korrekturwert, abhängig von der Motortemperatur" SWORD Pres_Rail 1 100 -3276800. 3276700. FORMAT "%8.0" ECU_ADDRESS 0x8037AE /end MEASUREMENT
/begin MEASUREMENT Rail_pSetPointFlTempCor "Raildruck-Korrekturwert, abhängig von der Kraftstofftemperatur" SWORD Pres_Rail 1 100 -3276800. 3276700. FORMAT "%8.0" ECU_ADDRESS 0x7F9B52 /end MEASUREMENT
/begin MEASUREMENT Rail_pSetPointFlTempLim_mp "Begrenzter Raildruck-Sollwert unter Berücksichtigung der Kraftstofftemperatur-Korrektur" SWORD Pres_Rail 1 100 -3276800. 3276700. FORMAT "%8.0" ECU_ADDRESS 0x80379E /end MEASUREMENT
/begin MEASUREMENT Rail_pSetPointInc_mp "maximaler Raildruck-Sollwertanstieg pro Schedulesequenz" SWORD Pres_Rail 1 100 -3276800. 3276700. FORMAT "%8.0" ECU_ADDRESS 0x8037A0 /end MEASUREMENT
/begin MEASUREMENT Rail_pSetPointLimNFlTemp "maximaler Raildrucksollwert, abhängig von der Kraftstofftemperatur und der Motordrehzahl" SWORD Pres_Rail 1 100 -3276800. 3276700. FORMAT "%8.0" ECU_ADDRESS 0x7F9B54 /end MEASUREMENT
/begin MEASUREMENT Rail_pSetPointLim_mp "Raildrucksollwert nach Bereichsbegrenzung im Normalbetrieb" SWORD Pres_Rail 1 100 -3276800. 3276700. FORMAT "%8.0" ECU_ADDRESS 0x8037A2 /end MEASUREMENT
/begin MEASUREMENT Rail_pSetPointMax "maximaler Raildrucksollwert" SWORD Pres_Rail 1 100 -3276800. 3276700. FORMAT "%8.0" ECU_ADDRESS 0x7F9B56 /end MEASUREMENT
/begin MEASUREMENT Rail_pSetPointMin "minimaler Raildrucksollwert" SWORD Pres_Rail 1 100 -3276800. 3276700. FORMAT "%8.0" ECU_ADDRESS 0x7F9B58 /end MEASUREMENT
/begin MEASUREMENT Rail_pSetPointOut_mp "Raildruck-Sollwert nach Eingriff der Regeneration" SWORD Pres_Rail 1 100 -3276800. 3276700. FORMAT "%8.0" ECU_ADDRESS 0x8037A4 /end MEASUREMENT
/begin MEASUREMENT Rail_pSetPointRgn "Raildruck-Sollwert im Regenerationsbetrieb" SWORD Pres_Rail 1 100 -3276800. 3276700. FORMAT "%8.0" ECU_ADDRESS 0x7F9B5A /end MEASUREMENT
/begin MEASUREMENT Rail_pSetPointSubst "Externe Anforderung für den Raildruck-Sollwert" SWORD Pres_Rail 1 100 -3276800. 3276700. FORMAT "%8.0" ECU_ADDRESS 0x7F9B5C /end MEASUREMENT
/begin MEASUREMENT Rail_pSetPointZFC_mp "Raildrucksollwert nach Eingriff der Nullmengenkalibrierung" SWORD Pres_Rail 1 100 -3276800. 3276700. FORMAT "%8.0" ECU_ADDRESS 0x8037A6 /end MEASUREMENT
/begin MEASUREMENT Rail_pWindUp_mp "rückgerechneter I-Anteil wenn Stellerbegrenzung erreicht ist" SWORD Pres_Rail 1 100 -3276800. 3276700. FORMAT "%8.0" ECU_ADDRESS 0x803748 /end MEASUREMENT
/begin MEASUREMENT Rail_pZFCInit_mp "anfänglicher ZFC Raildrucksollwert für PT1 Filter" SWORD Pres_Rail 1 100 -3276800. 3276700. FORMAT "%8.0" ECU_ADDRESS 0x8037B0 /end MEASUREMENT
/begin MEASUREMENT Rail_qMeUnCtlType_mp "mengenabhängige Hystereseschwelle zur Umschaltung auf Druckregelung über Zumesseinheit" SWORD InjMassCyc 1 100 -327.6800 327.6700 FORMAT "%8.4" ECU_ADDRESS 0x80374A /end MEASUREMENT
/begin MEASUREMENT Rail_qPCVCtlType_mp "mengenabhängige Hystereseschwelle zur Umschaltung auf Druckregelung über Druckregelventil" SWORD InjMassCyc 1 100 -327.6800 327.6700 FORMAT "%8.4" ECU_ADDRESS 0x80374C /end MEASUREMENT
/begin MEASUREMENT Rail_qPreCtlBas_mp "ausgewählte Einspritzmenge für die Vorsteuerung" SWORD InjMassCyc 1 100 -327.6800 327.6700 FORMAT "%8.4" ECU_ADDRESS 0x803780 /end MEASUREMENT
/begin MEASUREMENT Rail_RgnVal_mp "Wert für Regenerationsstatus der Raildrucksollwertes" ULONG EGTSwt 1 100 0.00 262.143999939 FORMAT "%13.9" ECU_ADDRESS 0x803790 /end MEASUREMENT
/begin MEASUREMENT Rail_stCtlType "Status Regelkonzept und verwendetes Regelprinzip" UBYTE OneToOne 1 100 0.00 255.0 FORMAT "%5.1" ECU_ADDRESS 0x7F94FC /end MEASUREMENT
/begin MEASUREMENT Rail_stMeUnMon0_mp "Zustandsbits für Überwachung auf positive Regelabweichung" UBYTE OneToOne 1 100 0.00 255.0 FORMAT "%5.1" ECU_ADDRESS 0x80375A /end MEASUREMENT
/begin MEASUREMENT Rail_stMeUnMon1_mp "Zustandsbits für Überwachung auf positive Regelabweichung und Sollwert des Volumenstroms durch die Zumesseinheit" UBYTE OneToOne 1 100 0.00 255.0 FORMAT "%5.1" ECU_ADDRESS 0x80375B /end MEASUREMENT
/begin MEASUREMENT Rail_stMeUnMon2_mp "Zustandsbits für Überwachung auf negative Regelabweichung bei Nullförderung" UBYTE OneToOne 1 100 0.00 255.0 FORMAT "%5.1" ECU_ADDRESS 0x80375C /end MEASUREMENT
/begin MEASUREMENT Rail_stMeUnMon3_mp "Zustandsbits für Überwachung auf minimalen Raildruck" UBYTE OneToOne 1 100 0.00 255.0 FORMAT "%5.1" ECU_ADDRESS 0x80375D /end MEASUREMENT
/begin MEASUREMENT Rail_stMeUnMon4_mp "Zustandsbits für Überwachung auf maximalen Raildruck" UBYTE OneToOne 1 100 0.00 255.0 FORMAT "%5.1" ECU_ADDRESS 0x80375E /end MEASUREMENT
/begin MEASUREMENT Rail_stPCVMon0_mp "Zustandsbits für Überwachung auf positive Regelabweichung" UBYTE OneToOne 1 100 0.00 255.0 FORMAT "%5.1" ECU_ADDRESS 0x803768 /end MEASUREMENT
/begin MEASUREMENT Rail_stPCVMon1_mp "Zustandsbits für Überwachung auf positive Regelabweichung kombiniert mit Stellgröße des Druckregelventils" UBYTE OneToOne 1 100 0.00 255.0 FORMAT "%5.1" ECU_ADDRESS 0x803769 /end MEASUREMENT
/begin MEASUREMENT Rail_stPCVMon2_mp "Zustandsbits für Überwachung auf negative Regelabweichung kombiniert mit Stellgröße des Druckregelventils" UBYTE OneToOne 1 100 0.00 255.0 FORMAT "%5.1" ECU_ADDRESS 0x80376A /end MEASUREMENT
/begin MEASUREMENT Rail_stPCVMon3_mp "Zustandsbits für Überwachung auf minimalen Raildruck" UBYTE OneToOne 1 100 0.00 255.0 FORMAT "%5.1" ECU_ADDRESS 0x80376B /end MEASUREMENT
/begin MEASUREMENT Rail_stPCVMon4_mp "Zustandsbits für Überwachung auf maximalen Raildruck" UBYTE OneToOne 1 100 0.00 255.0 FORMAT "%5.1" ECU_ADDRESS 0x80376C /end MEASUREMENT
/begin MEASUREMENT Rail_stPCVMon5_mp "Zustandsbits für Plausibilisierung des Raildrucks mit dem Strom durch das Druckregelventil" UWORD OneToOne 1 100 0.00 65535.00 FORMAT "%8.2" ECU_ADDRESS 0x80376E /end MEASUREMENT
/begin MEASUREMENT Rail_stPeakMinZFC_mp "Zustand des Automaten ""Bestimmung der Mindestschwelle des Raildrucks""" UBYTE OneToOne 1 100 0.00 255.0 FORMAT "%5.1" ECU_ADDRESS 0x8037B2 /end MEASUREMENT
/begin MEASUREMENT Rail_stSwtCon_mp "Status der Umschaltbedingungen für das Regelprinzip" UBYTE OneToOne 1 100 0.00 255.0 FORMAT "%5.1" ECU_ADDRESS 0x80374E /end MEASUREMENT
/begin MEASUREMENT Rail_stZFCDem_mp "Status für geschlossenes Druckregelventil bei aktiver Lernphase der ZFC" UBYTE OneToOne 1 100 0.00 255.0 FORMAT "%5.1" ECU_ADDRESS 0x80378C /end MEASUREMENT
/begin MEASUREMENT Rail_swtPreCtl "Raildruckregler mit / ohne Vorsteuerung" UBYTE OneToOne 1 100 0.00 255.0 FORMAT "%5.1" ECU_ADDRESS 0x7F94FE /end MEASUREMENT
/begin MEASUREMENT Rail_swtPress "Umschaltung zwischen Steuern und Regeln anhand Absolut/Differenzwert des Raildrucks" UBYTE OneToOne 1 100 0.00 255.0 FORMAT "%5.1" ECU_ADDRESS 0x7F94FF /end MEASUREMENT
/begin MEASUREMENT Rail_swtWindUp "Raildruckregler mit eingefrorenem oder rückgerechnetem I-Anteil" UBYTE OneToOne 1 100 0.00 255.0 FORMAT "%5.1" ECU_ADDRESS 0x7F9500 /end MEASUREMENT
/begin MEASUREMENT Rail_tiMeUn0Deb_mp "MeUn0: Messpunkt fuer laufende Entprellzaehler" UWORD Time_ms 1 100 0.00 655350.0 FORMAT "%8.1" ECU_ADDRESS 0x7FD048 /end MEASUREMENT
/begin MEASUREMENT Rail_tiMeUn1Deb_mp "MeUn1: Messpunkt fuer laufende Entprellzaehler" UWORD Time_ms 1 100 0.00 655350.0 FORMAT "%8.1" ECU_ADDRESS 0x7FD04A /end MEASUREMENT
/begin MEASUREMENT Rail_tiMeUn2Deb_mp "MeUn2: Messpunkt fuer laufende Entprellzaehler" UWORD Time_ms 1 100 0.00 655350.0 FORMAT "%8.1" ECU_ADDRESS 0x7FD04C /end MEASUREMENT
/begin MEASUREMENT Rail_tiMeUn3Deb_mp "MeUn3: Messpunkt fuer laufende Entprellzaehler" UWORD Time_ms 1 100 0.00 655350.0 FORMAT "%8.1" ECU_ADDRESS 0x7FD04E /end MEASUREMENT
/begin MEASUREMENT Rail_tiMeUn4Deb_mp "MeUn4: Messpunkt fuer laufende Entprellzaehler" UWORD Time_ms 1 100 0.00 655350.0 FORMAT "%8.1" ECU_ADDRESS 0x7FD050 /end MEASUREMENT
/begin MEASUREMENT Rail_tiPCV0Deb_mp "PCV0: Messpunkt fuer laufende Entprellzaehler" UWORD Time_ms 1 100 0.00 655350.0 FORMAT "%8.1" ECU_ADDRESS 0x7FD052 /end MEASUREMENT
/begin MEASUREMENT Rail_tiPCV1Deb_mp "PCV1: Messpunkt fuer laufende Entprellzaehler" UWORD Time_ms 1 100 0.00 655350.0 FORMAT "%8.1" ECU_ADDRESS 0x7FD054 /end MEASUREMENT
/begin MEASUREMENT Rail_tiPCV2Deb_mp "PCV2: Messpunkt fuer laufende Entprellzaehler" UWORD Time_ms 1 100 0.00 655350.0 FORMAT "%8.1" ECU_ADDRESS 0x7FD056 /end MEASUREMENT
/begin MEASUREMENT Rail_tiPCV3Deb_mp "PCV3: Messpunkt fuer laufende Entprellzaehler" UWORD Time_ms 1 100 0.00 655350.0 FORMAT "%8.1" ECU_ADDRESS 0x7FD058 /end MEASUREMENT
/begin MEASUREMENT Rail_tiPCV4Deb_mp "PCV4: Messpunkt fuer laufende Entprellzaehler" UWORD Time_ms 1 100 0.00 655350.0 FORMAT "%8.1" ECU_ADDRESS 0x7FD05A /end MEASUREMENT
/begin MEASUREMENT Rail_tiPCV5Deb_mp "PCV5: Messpunkt fuer laufende Entprellzaehler" UWORD Time_ms 1 100 0.00 655350.0 FORMAT "%8.1" ECU_ADDRESS 0x7FD05C /end MEASUREMENT
/begin MEASUREMENT Rail_tiPCVRmpDur_mp "Laufzeit der Rampe um vom aktuellen Sollwert auf den neuen PCVClose-Wert zu rampen" SWORD Time_ms 1 100 -327680.0 327670.0 FORMAT "%8.1" ECU_ADDRESS 0x80378E /end MEASUREMENT
/begin MEASUREMENT Rail_tiThresMonEna "Zeitverzögerung um Plausibilisierung des Raildrucks freizugeben" UWORD Time_ms 1 100 0.00 655350.0 FORMAT "%8.1" ECU_ADDRESS 0x7F9B5E /end MEASUREMENT
/begin MEASUREMENT Rail_tMeUnCtlType_mp "temperaturabhängige Hystereseschwelle zur Umschaltung auf Druckregelung über Zumesseinheit" SWORD Temp_Cels 1 100 -3549.940 3003.560 FORMAT "%8.3" ECU_ADDRESS 0x803750 /end MEASUREMENT
/begin MEASUREMENT Rail_tPCVCtlType_mp "temperaturabhängige Hystereseschwelle zur Umschaltung auf Druckregelung über Druckregelventil" SWORD Temp_Cels 1 100 -3549.940 3003.560 FORMAT "%8.3" ECU_ADDRESS 0x803752 /end MEASUREMENT
/begin MEASUREMENT Rtmo_ctInterrupt_u32 "Anzahl der Unterbrechungen der zu messenden Funktion innerhalb des letzten Messzyklus (keine reentranten Interrupts)" ULONG OneToOne 1 100 0.00 4294967295.00 FORMAT "%13.2" ECU_ADDRESS 0x7FFE00 /end MEASUREMENT
/begin MEASUREMENT Rtmo_ctReentrantSample_u32 "Aufrufanzahl der zu messenden Funktion innerhalb des letzten Messzyklus, wobei Funktion bereits aktiv war (reentranter Aufruf)" ULONG OneToOne 1 100 0.00 4294967295.00 FORMAT "%13.2" ECU_ADDRESS 0x7FFE0C /end MEASUREMENT
/begin MEASUREMENT Rtmo_ctSampleProc_u8 "Zähler wird nach jeder Messwertermittlung inkrementiert" UBYTE OneToOne 1 100 0.00 255.0 FORMAT "%5.1" ECU_ADDRESS 0x7FFE04 /end MEASUREMENT
/begin MEASUREMENT Rtmo_ctSample_u32 "Anzahl der Aufrufe der zu messenden Funktion innerhalb des letzten Messzyklus (keine reentranten Aufrufe)" ULONG OneToOne 1 100 0.00 4294967295.00 FORMAT "%13.2" ECU_ADDRESS 0x7FFE08 /end MEASUREMENT
/begin MEASUREMENT Rtmo_tiAbsMax_u32 "Maximale Laufzeit der zu messenden Funktion seit letztem Rücksetzen (Rtmo_swMinMaxReset_cu8)" ULONG TimeSys_us 1 100 0.00 1228361874.73 FORMAT "%13.2" ECU_ADDRESS 0x7FFDFC /end MEASUREMENT
/begin MEASUREMENT Rtmo_tiAbsMin_u32 "Minimale Laufzeit der zu messenden Funktion seit letztem Rücksetzen (Rtmo_swMinMaxReset_cu8)" ULONG TimeSys_us 1 100 0.00 1228361874.73 FORMAT "%13.2" ECU_ADDRESS 0x7FFDF8 /end MEASUREMENT
/begin MEASUREMENT Rtmo_tiAvrg_u32 "durchschnittliche Laufzeit der zu messenden Funktion innerhalb des letzten Messzyklus" ULONG TimeSys_us 1 100 0.00 1228361874.73 FORMAT "%13.2" ECU_ADDRESS 0x7FFDEC /end MEASUREMENT
/begin MEASUREMENT Rtmo_tiMax_u32 "Maximale Laufzeit der zu messenden Funktion innerhalb des letzten Messzyklus" ULONG TimeSys_us 1 100 0.00 1228361874.73 FORMAT "%13.2" ECU_ADDRESS 0x7FFDF4 /end MEASUREMENT
/begin MEASUREMENT Rtmo_tiMin_u32 "Minimale Laufzeit der zu messenden Funktion innerhalb des letzten Messzyklus" ULONG TimeSys_us 1 100 0.00 1228361874.73 FORMAT "%13.2" ECU_ADDRESS 0x7FFDF0 /end MEASUREMENT
/begin MEASUREMENT Rttp_stRttpEnable "Status vom Tuningschutz bei der Initialisierung" UBYTE OneToOne 1 100 0.00 255.0 FORMAT "%5.1" ECU_ADDRESS 0x7F9501 /end MEASUREMENT
/begin MEASUREMENT signals_stTestNLim_mp "Meßpunkt für Status Drehzahlbegrenzung von Stellertests" UBYTE OneToOne 1 100 0.00 255.0 FORMAT "%5.1" ECU_ADDRESS 0x8037BC /end MEASUREMENT
/begin MEASUREMENT signals_stTest_mp "Meßpunkt für Status Stellertest" ULONG OneToOne 1 100 0.00 4294967295.00 FORMAT "%13.2" ECU_ADDRESS 0x8037C0 /end MEASUREMENT
/begin MEASUREMENT signals_tiTstRemain_mp "Meßpunkt für verbleibende Zeit bis zur Abschaltung Stellertest über Zeitgrenze" UWORD Time_ms 1 100 0.00 655350.0 FORMAT "%8.1" ECU_ADDRESS 0x8037C4 /end MEASUREMENT
/begin MEASUREMENT SOPTst_stCyl "Endstufen die sich trotz redundanter Abschaltung aktivieren ließen" UBYTE OneToOne 1 100 0.00 255.0 FORMAT "%5.1" ECU_ADDRESS 0x7F9503 /end MEASUREMENT
/begin MEASUREMENT SrvPmp_pwrDemandEEP_mp "Limited EEPROM adjustment value of SRVPMP_PWR_DEMAND" SWORD Pwr 1 100 -308831.1 308821.7 FORMAT "%8.1" ECU_ADDRESS 0x8037C6 /end MEASUREMENT
/begin MEASUREMENT SrvPmp_pwrDes "Leistungsbedarf der Servopumpe" SWORD Pwr 1 100 -308831.1 308821.7 FORMAT "%8.1" ECU_ADDRESS 0x7F9B64 /end MEASUREMENT
/begin MEASUREMENT SrvPmp_pwrLead "Leistungsvorhalt der Servopumpe" SWORD Pwr 1 100 -308831.1 308821.7 FORMAT "%8.1" ECU_ADDRESS 0x7F9B66 /end MEASUREMENT
/begin MEASUREMENT SSpMon_stRaw_1_mp "Rohwert der Defekterkennung der Sensorversorgungsspannung 1" SWORD OneToOne 1 100 -32768.00 32767.00 FORMAT "%8.2" ECU_ADDRESS 0x8037C8 /end MEASUREMENT
/begin MEASUREMENT SSpMon_stRaw_2_mp "Rohwert der Defekterkennung der Sensorversorgungsspannung 2" SWORD OneToOne 1 100 -32768.00 32767.00 FORMAT "%8.2" ECU_ADDRESS 0x8037CA /end MEASUREMENT
/begin MEASUREMENT SSpMon_stRaw_3_mp "Rohwert der Defekterkennung der Sensorversorgungsspannung 3" SWORD OneToOne 1 100 -32768.00 32767.00 FORMAT "%8.2" ECU_ADDRESS 0x8037CC /end MEASUREMENT
/begin MEASUREMENT SSpMon_stSSpErr "Fehlerstatus der Sensorversorgungsspannungen" UWORD OneToOne 1 100 0.00 65535.00 FORMAT "%8.2" ECU_ADDRESS 0x7F9B62 /end MEASUREMENT
/begin MEASUREMENT StrtCD_stPwrStgOffRly_mp "Endstufenfehlerinformation des Starter Aus-Relais" UWORD OneToOne 1 100 0.00 65535.00 FORMAT "%8.2" ECU_ADDRESS 0x8037CE /end MEASUREMENT
/begin MEASUREMENT StrtCD_stPwrStgOnRly_mp "Endstufenfehlerinformation des Starter Ein-Relais" UWORD OneToOne 1 100 0.00 65535.00 FORMAT "%8.2" ECU_ADDRESS 0x8037D0 /end MEASUREMENT
/begin MEASUREMENT StrtCD_uPhyValOffRly "Spannung der Endstufe Klemme 50 Aus-Relais" SWORD Volt 1 100 -160156.4 160151.5 FORMAT "%8.1" ECU_ADDRESS 0x7F9B70 /end MEASUREMENT
/begin MEASUREMENT StrtCD_uPhyValOnRly "Spannung der Endstufe Klemme 50 Ein-Relais" SWORD Volt 1 100 -160156.4 160151.5 FORMAT "%8.1" ECU_ADDRESS 0x7F9B72 /end MEASUREMENT
/begin MEASUREMENT StSysCtl_ctCaSImpT50On_mp "Zähler für Nockenwellenimpulse seit T50 steigende Flanke" UWORD OneToOne 1 100 0.00 65535.00 FORMAT "%8.2" ECU_ADDRESS 0x8037EE /end MEASUREMENT
/begin MEASUREMENT StSysCtl_stEepDiagRly_mp "Relais Abschaltfolge (0: Aus-Relais/1: Ein-Relais)" UBYTE OneToOne 1 100 0.00 255.0 FORMAT "%5.1" ECU_ADDRESS 0x8037F2 /end MEASUREMENT
/begin MEASUREMENT StSysCtl_stNoCrSSigAct "Flag für kein Kurbelwellen jedoch Nockenwellensignal erkannt" UBYTE OneToOne 1 100 0.00 255.0 FORMAT "%5.1" ECU_ADDRESS 0x7F9506 /end MEASUREMENT
/begin MEASUREMENT StSysCtl_stNoCrSSig_mp "Bitcodierter Status für Erkennung kein Kurbewellensignal" UBYTE OneToOne 1 100 0.00 255.0 FORMAT "%5.1" ECU_ADDRESS 0x8037F0 /end MEASUREMENT
/begin MEASUREMENT StSysCtl_stRlyDiag_mp "Welches Relais soll diagnostiziert werden (0: Aus-Relais/1: Ein-Relais)" UBYTE OneToOne 1 100 0.00 255.0 FORMAT "%5.1" ECU_ADDRESS 0x8037F3 /end MEASUREMENT
/begin MEASUREMENT StSysCtl_stStandStillAR_mp "Motorstillstand im vorigen Nachlauf erkannt." UBYTE OneToOne 1 100 0.00 255.0 FORMAT "%5.1" ECU_ADDRESS 0x8037F4 /end MEASUREMENT
/begin MEASUREMENT StSysCtl_stStrtCncl "Startabbruch Status" UBYTE OneToOne 1 100 0.00 255.0 FORMAT "%5.1" ECU_ADDRESS 0x7F9507 /end MEASUREMENT
/begin MEASUREMENT StSysCtl_stStrtCncl_mp "Startabbruch Bedingungen Bit codiert" UWORD OneToOne 1 100 0.00 65535.00 FORMAT "%8.2" ECU_ADDRESS 0x8037F6 /end MEASUREMENT
/begin MEASUREMENT StSysCtl_stStrtCtlMode "Message zum Anzeigen von StSysCtl_swtStSysCtlMode_C" UBYTE OneToOne 1 100 0.00 255.0 FORMAT "%5.1" ECU_ADDRESS 0x7F9508 /end MEASUREMENT
/begin MEASUREMENT StSysCtl_stStrtDisengaFrm "Start Ausspur Status" UBYTE OneToOne 1 100 0.00 255.0 FORMAT "%5.1" ECU_ADDRESS 0x7F9509 /end MEASUREMENT
/begin MEASUREMENT StSysCtl_stStrtEngRlsBSG_mp "Status der Starterfreigabe von BSG/Kessy" UBYTE OneToOne 1 100 0.00 255.0 FORMAT "%5.1" ECU_ADDRESS 0x8037F1 /end MEASUREMENT
/begin MEASUREMENT StSysCtl_stStrtEngRlsMSG_mp "Status der Starterfreigabe von MSG" UBYTE OneToOne 1 100 0.00 255.0 FORMAT "%5.1" ECU_ADDRESS 0x8037F8 /end MEASUREMENT
/begin MEASUREMENT StSysCtl_stStrtRlsFrm "Starterfreigabe Status" UBYTE OneToOne 1 100 0.00 255.0 FORMAT "%5.1" ECU_ADDRESS 0x7F950A /end MEASUREMENT
/begin MEASUREMENT StSysCtl_stT15Lock_mp "K15 Sperre Status" UBYTE OneToOne 1 100 0.00 255.0 FORMAT "%5.1" ECU_ADDRESS 0x8037F9 /end MEASUREMENT
/begin MEASUREMENT StSysCtl_stT50CDOff "Status des Starter Aus-Relais" UBYTE OneToOne 1 100 0.00 255.0 FORMAT "%5.1" ECU_ADDRESS 0x7F950B /end MEASUREMENT
/begin MEASUREMENT StSysCtl_stT50CDOn "Status des Starter Ein-Relais" UBYTE OneToOne 1 100 0.00 255.0 FORMAT "%5.1" ECU_ADDRESS 0x7F950C /end MEASUREMENT
/begin MEASUREMENT StSysCtl_stTmrStrtCtl_mp "Starttimer Status" UBYTE OneToOne 1 100 0.00 255.0 FORMAT "%5.1" ECU_ADDRESS 0x8037FA /end MEASUREMENT
/begin MEASUREMENT StSys_stSpareStrt "Startart (0: normal Start/1: Notstart)" UBYTE OneToOne 1 100 0.00 255.0 FORMAT "%5.1" ECU_ADDRESS 0x7F950F /end MEASUREMENT
/begin MEASUREMENT StSys_stT50_mp "gespeichertes Klemme 50 Signal" UBYTE OneToOne 1 100 0.00 255.0 FORMAT "%5.1" ECU_ADDRESS 0x8037D4 /end MEASUREMENT
/begin MEASUREMENT StSys_trqAdj_mp "Startmomentkorrektur" SWORD Trq 1 100 -3276.800 3276.700 FORMAT "%8.3" ECU_ADDRESS 0x8037D6 /end MEASUREMENT
/begin MEASUREMENT StSys_trqStrtBas_mp "Basismoment fuer Start" SWORD Trq 1 100 -3276.800 3276.700 FORMAT "%8.3" ECU_ADDRESS 0x8037D8 /end MEASUREMENT
/begin MEASUREMENT StSys_trqValEEP_mp "Limitierter EEPROM Abgleichwert von STARTING_TRQ" SWORD Trq 1 100 -3276.800 3276.700 FORMAT "%8.3" ECU_ADDRESS 0x8037DA /end MEASUREMENT
/begin FUNCTION rail_ctlpcv_uic ""
 /begin OUT_MEASUREMENT Rail_pPCVCtlDT1_mp Rail_pPCVCtlI_mp Rail_pPCVCtlPILim_mp Rail_pPCVCtlP_mp Rail_pPCVInitI_mp Rail_pWindUp_mp /end OUT_MEASUREMENT
/end FUNCTION
/begin FUNCTION rail_ctltypeswt "Umschaltbedingungen für das 2-Reglerkonzept"
 /begin DEF_CHARACTERISTIC Rail_qMeUnCtlType_CUR Rail_qPCVCtlType_CUR Rail_tiMeUnCtlTypeDel_C Rail_tiSwtCtlTypeDel_C Rail_tMeUnCtlType_CUR Rail_tOvrRunThres_C Rail_tPCVCtlType_CUR Rail_tSwtCtlTypeHi_C Rail_tSwtCtlTypeLo_C /end DEF_CHARACTERISTIC
 /begin IN_MEASUREMENT Eng_nAvrg /end IN_MEASUREMENT
/end FUNCTION
/begin FUNCTION rail_ctltypeswt_uic ""
 /begin OUT_MEASUREMENT Rail_qMeUnCtlType_mp Rail_qPCVCtlType_mp Rail_stSwtCon_mp Rail_tMeUnCtlType_mp Rail_tPCVCtlType_mp /end OUT_MEASUREMENT
/end FUNCTION
/begin FUNCTION rail_igovcalc "" /end FUNCTION
/begin FUNCTION rail_igovcalc_uic "" /end FUNCTION
/begin FUNCTION rail_monmeun "Raildruckueberwachung für die Druckregelung ueber Zumesseinheit"
 /begin DEF_CHARACTERISTIC Rail_DebMeUn0MaxDef_C Rail_DebMeUn0MaxOk_C Rail_DebMeUn1MaxDef_C Rail_DebMeUn1MaxOk_C Rail_DebMeUn2MaxDef_C Rail_DebMeUn2MaxOk_C Rail_DebMeUn3MaxDef_C Rail_DebMeUn3MaxOk_C Rail_DebMeUn4MaxDef_C Rail_DebMeUn4MaxOk_C Rail_dvolMeUnSetMin_C Rail_pMeUnPeakMax_C Rail_pMeUnDvtMax_C Rail_qMeUnLoIdle_C Rail_stMonMeUnRls_C Rail_tMeUnLoIdle_C Rail_pMeUnDvtMax_CUR Rail_pMeUnDvtMin_CUR Rail_pMeUnPeakMin_CUR /end DEF_CHARACTERISTIC
 /begin IN_MEASUREMENT Eng_nAvrg /end IN_MEASUREMENT
/end FUNCTION
/begin FUNCTION rail_monmeun_msg "" /end FUNCTION
/begin FUNCTION rail_monmeun_uic ""
 /begin OUT_MEASUREMENT Rail_pMeUnDvtMax_mp Rail_pMeUnDvtMin_mp Rail_pMeUnPeakMin_mp Rail_stMeUnMon0_mp Rail_stMeUnMon1_mp Rail_stMeUnMon2_mp Rail_stMeUnMon3_mp Rail_stMeUnMon4_mp Rail_tiMeUn0Deb_mp Rail_tiMeUn1Deb_mp Rail_tiMeUn2Deb_mp Rail_tiMeUn3Deb_mp Rail_tiMeUn4Deb_mp /end OUT_MEASUREMENT
/end FUNCTION
/begin FUNCTION rail_monpcv "Raildruckueberwachung für die Druckregelung ueber Druckregelventil"
 /begin DEF_CHARACTERISTIC Rail_DebPCV0MaxDef_C Rail_DebPCV0MaxOk_C Rail_DebPCV1MaxDef_C Rail_DebPCV1MaxOk_C Rail_DebPCV2MaxDef_C Rail_DebPCV2MaxOk_C Rail_DebPCV3MaxDef_C Rail_DebPCV3MaxOk_C Rail_DebPCV4MaxDef_C Rail_DebPCV4MaxOk_C Rail_DebPCV5MaxDef_C Rail_DebPCV5MaxOk_C Rail_pPCVDvtMax_C Rail_pPCVSetMax_C Rail_pPCVDvtMin_C Rail_pPCVSetMin_C Rail_pAbsDvtMax_C Rail_tiThresMonEna_C Rail_qMonEnaMax_C Rail_nMonEnaMin_C Rail_nMonEnaMax_C Rail_pPCVPeakMax_C Rail_stMonPCVRls_C Rail_pNIPCVMax_MAP Rail_pNIPCVMin_MAP Rail_pPCVDvtMax_CUR Rail_pPCVPeakMin_CUR /end DEF_CHARACTERISTIC
 /begin IN_MEASUREMENT Eng_nAvrg PCVCD_iActVal /end IN_MEASUREMENT
/end FUNCTION
/begin FUNCTION rail_monpcv_msg "" /begin OUT_MEASUREMENT Rail_tiThresMonEna /end OUT_MEASUREMENT /end FUNCTION
/begin FUNCTION rail_monpcv_uic ""
 /begin OUT_MEASUREMENT Rail_pNIPCVMax_mp Rail_pNIPCVMin_mp Rail_pPCVDvtMax_mp Rail_pPCVPeakMin_mp Rail_stPCVMon0_mp Rail_stPCVMon1_mp Rail_stPCVMon2_mp Rail_stPCVMon3_mp Rail_stPCVMon4_mp Rail_stPCVMon5_mp Rail_tiPCV0Deb_mp Rail_tiPCV1Deb_mp Rail_tiPCV2Deb_mp Rail_tiPCV3Deb_mp Rail_tiPCV4Deb_mp Rail_tiPCV5Deb_mp /end OUT_MEASUREMENT
/end FUNCTION
/begin FUNCTION rail_msg "" /end FUNCTION
/begin FUNCTION rail_pgovsetup "Softwareschalter-Konfiguration der Komponente Rail"
 /begin DEF_CHARACTERISTIC Rail_swtPreCtlVal_C Rail_swtPreCtlType_C Rail_swtPressVal_C Rail_swtPressType_C Rail_swtWindUpVal_C Rail_swtWindUpType_C /end DEF_CHARACTERISTIC
/end FUNCTION
/begin FUNCTION rail_pgovsetup_msg "" /begin OUT_MEASUREMENT Rail_stCtlType Rail_swtPreCtl Rail_swtPress Rail_swtWindUp /end OUT_MEASUREMENT /end FUNCTION
/begin FUNCTION rail_pgovsetup_uic "" /end FUNCTION
/begin FUNCTION rail_prectlmeun "Vorsteuerung für die Hochdruckregelung ueber Zumesseinheit"
 /begin DEF_CHARACTERISTIC Rail_dvolLeak_MAP Rail_dvolPreCtlBas_MAP Rail_dvolPreCtlOfs_MAP Rail_dvolPreCtlPoI1_MAP Rail_dvolPreCtlPoI2_MAP Rail_facLeakAged_C Rail_stPreCtlMeUnSel_C Rail_volInjVlvCtl_C /end DEF_CHARACTERISTIC
 /begin IN_MEASUREMENT Eng_nAvrg FlSys_t InjCrv_qPoI1Des_mp InjCrv_qPoI2Des_mp InjCtl_qSetUnBal Rail_pSetPoint Rail_qPreCtlBas_mp /end IN_MEASUREMENT
/end FUNCTION
/begin FUNCTION rail_prectlmeunrmtctl_uic "" /begin DEF_CHARACTERISTIC Rail_dvolPreCtl_C Rail_swtDvolPreCtl_C /end DEF_CHARACTERISTIC /end FUNCTION
/begin FUNCTION rail_prectlmeun_uic ""
 /begin OUT_MEASUREMENT Rail_dvolInjVlvCtl_mp Rail_dvolLeak_mp Rail_dvolPreCtlBas_mp Rail_dvolPreCtlInit_mp Rail_dvolPreCtlOfs_mp Rail_dvolPreCtlPoI1_mp Rail_dvolPreCtlPoI2_mp Rail_dvolPreCtl_mp Rail_qPreCtlBas_mp /end OUT_MEASUREMENT
/end FUNCTION
/begin FUNCTION rail_prectlpcv "Vorsteuerung für die Hochdruckregelung ueber Druckregelventil"
 /begin DEF_CHARACTERISTIC Rail_dvolRedOfsLim_C Rail_pPCVCloseOfs_CUR Rail_pPCVRedOfs_CUR Rail_pPreCtl_MAP Rail_pRedOfsLim_C Rail_qRedOfsLim_C Rail_tiPCVRmpDur_CUR Rail_tiPCVRmpToOfs_C Rail_tiPCVRmpToRedOfs_C /end DEF_CHARACTERISTIC
 /begin IN_MEASUREMENT Eng_nAvrg Rail_pSetPoint /end IN_MEASUREMENT
/end FUNCTION
/begin FUNCTION rail_prectlpcvrmtctl_uic "" /begin DEF_CHARACTERISTIC Rail_pPreCtl_C Rail_swtPPreCtl_C /end DEF_CHARACTERISTIC /end FUNCTION
/begin FUNCTION rail_prectlpcv_uic ""
 /begin OUT_MEASUREMENT Rail_facPCVTiRmpVal_mp Rail_facTiRmpVal_mp Rail_pPCVClose_mp Rail_pPCVOfs_mp Rail_pPreCtl_mp Rail_stZFCDem_mp Rail_tiPCVRmpDur_mp /end OUT_MEASUREMENT
/end FUNCTION
/begin FUNCTION rail_rgn "Raildrucksollwert Regenerationswertberechnung"
 /begin DEF_CHARACTERISTIC Rail_pSetPointRgnBas1_MAP Rail_pSetPointRgnBas2_MAP Rail_pSetPointRgnBas3_MAP Rail_stRgnMsk1_C Rail_stRgnMsk2_C Rail_stRgnMsk3_C /end DEF_CHARACTERISTIC
 /begin IN_MEASUREMENT Eng_nAvrg InjCtl_qCurr /end IN_MEASUREMENT
/end FUNCTION
/begin FUNCTION rail_rgnlib "" /begin DEF_CHARACTERISTIC Rail_dtiRgnRmpUp_C Rail_dtiRgnRmpDwn_C Rail_stRgnMsk_C /end DEF_CHARACTERISTIC /end FUNCTION
/begin FUNCTION rail_rgn_msg "" /begin OUT_MEASUREMENT Rail_pSetPointRgn /end OUT_MEASUREMENT /end FUNCTION
/begin FUNCTION rail_rgn_uic "" /begin DEF_CHARACTERISTIC Rail_pSetPointRgn_Vector Rail_pSetPointRgn_Channel /end DEF_CHARACTERISTIC /end FUNCTION
/begin FUNCTION rail_setpoint "Raildruckregler Sollwertberechnung"
 /begin DEF_CHARACTERISTIC Rail_dpSetPointDec_C Rail_dpSetPointInc_MAP Rail_pSetPointBase2_MAP Rail_pSetPointBase_MAP Rail_pSetPointBattMin_CUR Rail_pSetPointInit_C Rail_pSetPointRed_C Rail_stDesBaseMsk_C Rail_stRgnDelMsk_C Rail_stSetPointSel_C /end DEF_CHARACTERISTIC
 /begin IN_MEASUREMENT BattCD_u Eng_nAvrg InjCtl_qCurr InjCtl_qSetUnBal /end IN_MEASUREMENT
 /begin OUT_MEASUREMENT Rail_RgnVal_mp /end OUT_MEASUREMENT
/end FUNCTION
/begin FUNCTION rail_setpointaddcor "Berechnung projektspezifischer Korrekturen für Raildruck-Sollwert"
 /begin DEF_CHARACTERISTIC Rail_facSetPointFTSCor_CUR Rail_pSetPointFTSCor_MAP Rail_pSetPointLimNFlTemp_C Rail_pSetPointMaxDef_C Rail_pSetPointMax_MAP Rail_pSetPointMinDef_C Rail_pSetPointMin_MAP /end DEF_CHARACTERISTIC
 /begin IN_MEASUREMENT Eng_nAvrg FTSCD_tFuel InjCtl_qCurr /end IN_MEASUREMENT
/end FUNCTION
/begin FUNCTION rail_setpointaddcorrgn "Berechnung projektspezifischer Korrekturen für Raildruck-Sollwert für den Regenerationsbetrieb" /end FUNCTION
/begin FUNCTION rail_setpointaddcorrgn_msg "" /end FUNCTION
/begin FUNCTION rail_setpointaddcorrgn_uic "" /end FUNCTION
/begin FUNCTION rail_setpointaddcor_msg ""
 /begin OUT_MEASUREMENT Rail_pSetPointAddCor Rail_pSetPointFlTempCor Rail_pSetPointLimNFlTemp Rail_pSetPointMax Rail_pSetPointMin /end OUT_MEASUREMENT
/end FUNCTION
/begin FUNCTION rail_setpointaddcor_uic "" /begin OUT_MEASUREMENT Rail_facSetPointFTSCor_mp /end OUT_MEASUREMENT /end FUNCTION
/begin FUNCTION rail_setpointenvcor "Berechnung der Korrekturen für Raildruck-Sollwert"
 /begin DEF_CHARACTERISTIC Rail_pSetPointAPSCor_MAP Rail_pSetPointATSCor_MAP Rail_pSetPointETSCor_MAP /end DEF_CHARACTERISTIC
 /begin IN_MEASUREMENT Eng_nAvrg InjCtl_qCurr /end IN_MEASUREMENT
/end FUNCTION
/begin FUNCTION rail_setpointenvcorrgn "Berechnung der Korrekturen für Raildruck-Sollwert für den Regenerationsbetrieb" /end FUNCTION
/begin FUNCTION rail_setpointenvcorrgn_msg "" /end FUNCTION
/begin FUNCTION rail_setpointenvcorrgn_uic "" /end FUNCTION
/begin FUNCTION rail_setpointenvcorslow "Gewichtungsfaktoren für die Raildruck-Sollwertkorrekturen"
 /begin DEF_CHARACTERISTIC Rail_facSetPointAPSCor_CUR Rail_facSetPointATSCor_CUR Rail_facSetPointETSCor_CUR /end DEF_CHARACTERISTIC
 /begin IN_MEASUREMENT APSCD_pVal IATSCD_tAir InjCrv_tEng /end IN_MEASUREMENT
/end FUNCTION
/begin FUNCTION rail_setpointenvcorslowrgn "Gewichtungsfaktoren für die Raildruck-Sollwertkorrekturen für den Regenerationsbetrieb" /end FUNCTION
/begin FUNCTION rail_setpointenvcorslowrgn_msg "" /end FUNCTION
/begin FUNCTION rail_setpointenvcorslowrgn_uic "" /end FUNCTION
/begin FUNCTION rail_setpointenvcorslow_msg ""
 /begin OUT_MEASUREMENT Rail_facSetPointAPSCor Rail_facSetPointATSCor Rail_facSetPointETSCor /end OUT_MEASUREMENT
/end FUNCTION
/begin FUNCTION rail_setpointenvcorslow_uic "" /end FUNCTION
/begin FUNCTION rail_setpointenvcor_msg "" /begin OUT_MEASUREMENT Rail_pSetPointEnvCor /end OUT_MEASUREMENT /end FUNCTION
/begin FUNCTION rail_setpointenvcor_uic ""
 /begin OUT_MEASUREMENT Rail_pSetPointAPSCor_mp Rail_pSetPointATSCor_mp Rail_pSetPointETSCor_mp /end OUT_MEASUREMENT
/end FUNCTION
/begin FUNCTION rail_setpointrmtctl_uic "" /begin DEF_CHARACTERISTIC Rail_pSetPoint_C Rail_swtPSetPoint_C /end DEF_CHARACTERISTIC /end FUNCTION
/begin FUNCTION rail_setpoint_msg "" /begin OUT_MEASUREMENT Rail_dpSetPointInc Rail_pSetPoint Rail_pSetPointActUnlim /end OUT_MEASUREMENT /end FUNCTION
/begin FUNCTION rail_setpoint_uic "" /begin DEF_CHARACTERISTIC Rail_pSetPoint_Vector Rail_pSetPoint_Channel /end DEF_CHARACTERISTIC
 /begin OUT_MEASUREMENT Rail_pSetPointBase_mp Rail_pSetPointBattMin_mp Rail_pSetPointCor_mp Rail_pSetPointDec_mp Rail_pSetPointDynLim_mp Rail_pSetPointFlTempLim_mp Rail_pSetPointInc_mp Rail_pSetPointLim_mp Rail_pSetPointOut_mp Rail_pSetPointZFC_mp /end OUT_MEASUREMENT
/end FUNCTION
/begin FUNCTION rail_setsubst "" /end FUNCTION
/begin FUNCTION rail_setsubst_msg "" /begin OUT_MEASUREMENT Rail_pSetPointSubst /end OUT_MEASUREMENT /end FUNCTION
/begin FUNCTION rail_setsubst_uic "" /end FUNCTION
/begin FUNCTION rail_zfclib "Funktionsbibliothek für den Eingriff der Nullmengenkallibrierung im Raildruckregler"
 /begin DEF_CHARACTERISTIC Rail_pPeakMinZFC_C Rail_pSetPointZFCMax_C Rail_pSetPointZFCMin_C Rail_rPeakMinSlpZFC_C Rail_rZFCInitDwn_CUR Rail_rZFCInitUp_CUR Rail_tiZFCDemDel_C Rail_tiZFCPT1_C /end DEF_CHARACTERISTIC
 /begin IN_MEASUREMENT ZFC_pRailSetPoint_mp /end IN_MEASUREMENT
/end FUNCTION
/begin FUNCTION rail_zfclib_uic "" /begin OUT_MEASUREMENT Rail_pZFCInit_mp Rail_stPeakMinZFC_mp /end OUT_MEASUREMENT /end FUNCTION
/begin FUNCTION rtmo "run time measurement online"
 /begin DEF_CHARACTERISTIC Rtmo_adStart_cu32 Rtmo_stSampleTime_cu8 Rtmo_swMinMaxReset_cu8 /end DEF_CHARACTERISTIC
/end FUNCTION
/begin FUNCTION rtmo_msg ""
 /begin OUT_MEASUREMENT Rtmo_ctInterrupt_u32 Rtmo_ctReentrantSample_u32 Rtmo_ctSampleProc_u8 Rtmo_ctSample_u32 Rtmo_tiAbsMax_u32 Rtmo_tiAbsMin_u32 Rtmo_tiAvrg_u32 Rtmo_tiMax_u32 Rtmo_tiMin_u32 /end OUT_MEASUREMENT
/end FUNCTION
/begin FUNCTION rttp "Tuningschutz zur Laufzeit" /end FUNCTION
/begin FUNCTION rttp_msg "" /begin OUT_MEASUREMENT Rttp_stRttpEnable /end OUT_MEASUREMENT /end FUNCTION
/begin FUNCTION rttp_uic "" /end FUNCTION
/begin FUNCTION signals "Bereitstellung von applizierbaren Signalen und ihrer Umrechnung" /begin DEF_CHARACTERISTIC Signals_PID0x1C_C /end DEF_CHARACTERISTIC /end FUNCTION
/begin FUNCTION signals_base ""
 /begin DEF_CHARACTERISTIC Signals_adFreeApplic1_C Signals_numTypFreeApplic1_C Signals_adFreeApplic2_C Signals_numTypFreeApplic2_C Signals_adFreeApplic3_C Signals_numTypFreeApplic3_C Signals_adFreeApplic4_C Signals_numTypFreeApplic4_C Sig_aDSMOffset_C Sig_aDSMScale_C Sig_aCANOffset_C Sig_aCANScale_C Sig_aDIAOffset_C Sig_aDIAScale_C Sig_Carb_dtDSMOffset_C Sig_Carb_dtDSMScale_C Sig_Carb_dtCANOffset_C Sig_Carb_dtCANScale_C Sig_Carb_dtDIAOffset_C Sig_Carb_dtDIAScale_C Sig_Carb_lDSMOffset_C Sig_Carb_lDSMScale_C Sig_Carb_lCANOffset_C Sig_Carb_lCANScale_C Sig_Carb_lDIAOffset_C Sig_Carb_lDIAScale_C Sig_Carb_mAirTimDSMOffset_C Sig_Carb_mAirTimDSMScale_C Sig_Carb_mAirTimCANOffset_C Sig_Carb_mAirTimCANScale_C Sig_Carb_mAirTimDIAOffset_C Sig_Carb_mAirTimDIAScale_C Sig_Carb_nDSMOffset_C Sig_Carb_nDSMScale_C Sig_Carb_nCANOffset_C Sig_Carb_nCANScale_C Sig_Carb_nDIAOffset_C Sig_Carb_nDIAScale_C Sig_Carb_pDSMOffset_C Sig_Carb_pDSMScale_C Sig_Carb_pCANOffset_C Sig_Carb_pCANScale_C Sig_Carb_pDIAOffset_C Sig_Carb_pDIAScale_C Sig_Carb_rDSMOffset_C Sig_Carb_rDSMScale_C Sig_Carb_rCANOffset_C Sig_Carb_rCANScale_C Sig_Carb_rDIAOffset_C Sig_Carb_rDIAScale_C Sig_Carb_tiDynDSMOffset_C Sig_Carb_tiDynDSMScale_C Sig_Carb_tiDynCANOffset_C Sig_Carb_tiDynCANScale_C Sig_Carb_tiDynDIAOffset_C Sig_Carb_tiDynDIAScale_C Sig_Carb_tiDSMOffset_C Sig_Carb_tiDSMScale_C Sig_Carb_tiCANOffset_C Sig_Carb_tiCANScale_C Sig_Carb_tiDIAOffset_C Sig_Carb_tiDIAScale_C Sig_Carb_tDSMOffset_C Sig_Carb_tDSMScale_C Sig_Carb_tCANOffset_C Sig_Carb_tCANScale_C Sig_Carb_tDIAOffset_C Sig_Carb_tDIAScale_C Sig_Carb_vDSMOffset_C Sig_Carb_vDSMScale_C Sig_Carb_vCANOffset_C Sig_Carb_vCANScale_C Sig_Carb_vDIAOffset_C Sig_Carb_vDIAScale_C Sig_CnsmpDSMOffset_C Sig_CnsmpDSMScale_C Sig_CnsmpCANOffset_C Sig_CnsmpCANScale_C Sig_CnsmpDIAOffset_C Sig_CnsmpDIAScale_C Sig_dcycDSMOffset_C Sig_dcycDSMScale_C Sig_dcycCANOffset_C Sig_dcycCANScale_C Sig_dcycDIAOffset_C Sig_dcycDIAScale_C Sig_fas1DSMOffset_C Sig_fas1DSMScale_C Sig_fas1CANOffset_C Sig_fas1CANScale_C Sig_fas1DIAOffset_C Sig_fas1DIAScale_C Sig_fas2DSMOffset_C Sig_fas2DSMScale_C Sig_fas2CANOffset_C Sig_fas2CANScale_C Sig_fas2DIAOffset_C Sig_fas2DIAScale_C Sig_fas3DSMOffset_C Sig_fas3DSMScale_C Sig_fas3CANOffset_C Sig_fas3CANScale_C Sig_fas3DIAOffset_C Sig_fas3DIAScale_C Sig_fas4DSMOffset_C Sig_fas4DSMScale_C Sig_fas4CANOffset_C Sig_fas4CANScale_C Sig_fas4DIAOffset_C Sig_fas4DIAScale_C Sig_HighByteDSMOffset_C Sig_HighByteDSMScale_C Sig_HighByteCANOffset_C Sig_HighByteCANScale_C Sig_HighByteDIAOffset_C Sig_HighByteDIAScale_C Sig_lLvlDSMOffset_C Sig_lLvlDSMScale_C Sig_lLvlCANOffset_C Sig_lLvlCANScale_C Sig_lLvlDIAOffset_C Sig_lLvlDIAScale_C Sig_lDSMOffset_C Sig_lDSMScale_C Sig_lCANOffset_C Sig_lCANScale_C Sig_lDIAOffset_C Sig_lDIAScale_C Sig_mAirCylDSMOffset_C Sig_mAirCylDSMScale_C Sig_mAirCylCANOffset_C Sig_mAirCylCANScale_C Sig_mAirCylDIAOffset_C Sig_mAirCylDIAScale_C Sig_mAirTimDSMOffset_C Sig_mAirTimDSMScale_C Sig_mAirTimCANOffset_C Sig_mAirTimCANScale_C Sig_mAirTimDIAOffset_C Sig_mAirTimDIAScale_C Sig_mAirDSMOffset_C Sig_mAirDSMScale_C Sig_mAirCANOffset_C Sig_mAirCANScale_C Sig_mAirDIAOffset_C Sig_mAirDIAScale_C Sig_mDSMOffset_C Sig_mDSMScale_C Sig_mCANOffset_C Sig_mCANScale_C Sig_mDIAOffset_C Sig_mDIAScale_C Sig_nCmpTstDSMOffset_C Sig_nCmpTstDSMScale_C Sig_nCmpTstCANOffset_C Sig_nCmpTstCANScale_C Sig_nCmpTstDIAOffset_C Sig_nCmpTstDIAScale_C Sig_NoUnitDSMOffset_C Sig_NoUnitDSMScale_C Sig_NoUnitCANOffset_C Sig_NoUnitCANScale_C Sig_NoUnitDIAOffset_C Sig_NoUnitDIAScale_C Sig_nDSMOffset_C Sig_nDSMScale_C Sig_nCANOffset_C Sig_nCANScale_C Sig_nDIAOffset_C Sig_nDIAScale_C Sig_OneToOneDSMOffset_C Sig_OneToOneDSMScale_C Sig_OneToOneCANOffset_C Sig_OneToOneCANScale_C Sig_OneToOneDIAOffset_C Sig_OneToOneDIAScale_C Sig_OnOffDSMOffset_C Sig_OnOffDSMScale_C Sig_OnOffCANOffset_C Sig_OnOffCANScale_C Sig_OnOffDIAOffset_C Sig_OnOffDIAScale_C Sig_pACDSMOffset_C Sig_pACDSMScale_C Sig_pACCANOffset_C Sig_pACCANScale_C Sig_pACDIAOffset_C Sig_pACDIAScale_C Sig_phiHResolDSMOffset_C Sig_phiHResolDSMScale_C Sig_phiHResolCANOffset_C Sig_phiHResolCANScale_C Sig_phiHResolDIAOffset_C Sig_phiHResolDIAScale_C Sig_phiDSMOffset_C Sig_phiDSMScale_C Sig_phiCANOffset_C Sig_phiCANScale_C Sig_phiDIAOffset_C Sig_phiDIAScale_C Sig_pwrDSMOffset_C Sig_pwrDSMScale_C Sig_pwrCANOffset_C Sig_pwrCANScale_C Sig_pwrDIAOffset_C Sig_pwrDIAScale_C Sig_pDSMOffset_C Sig_pDSMScale_C Sig_pCANOffset_C Sig_pCANScale_C Sig_pDIAOffset_C Sig_pDIAScale_C Sig_qdiffSysDSMOffset_C Sig_qdiffSysDSMScale_C Sig_qdiffSysCANOffset_C Sig_qdiffSysCANScale_C Sig_qdiffSysDIAOffset_C Sig_qdiffSysDIAScale_C Sig_qdiffDSMOffset_C Sig_qdiffDSMScale_C Sig_qdiffCANOffset_C Sig_qdiffCANScale_C Sig_qdiffDIAOffset_C Sig_qdiffDIAScale_C Sig_qDSMOffset_C Sig_qDSMScale_C Sig_qCANOffset_C Sig_qCANScale_C Sig_qDIAOffset_C Sig_qDIAScale_C Sig_resDSMOffset_C Sig_resDSMScale_C Sig_resCANOffset_C Sig_resCANScale_C Sig_resDIAOffset_C Sig_resDIAScale_C Sig_rDSMOffset_C Sig_rDSMScale_C Sig_rCANOffset_C Sig_rCANScale_C Sig_rDIAOffset_C Sig_rDIAScale_C Sig_strokeDSMOffset_C Sig_strokeDSMScale_C Sig_strokeCANOffset_C Sig_strokeCANScale_C Sig_strokeDIAOffset_C Sig_strokeDIAScale_C Sig_tiGlwDSMOffset_C Sig_tiGlwDSMScale_C Sig_tiGlwCANOffset_C Sig_tiGlwCANScale_C Sig_tiGlwDIAOffset_C Sig_tiGlwDIAScale_C Sig_tiDSMOffset_C Sig_tiDSMScale_C Sig_tiCANOffset_C Sig_tiCANScale_C Sig_tiDIAOffset_C Sig_tiDIAScale_C Sig_trqhighDSMOffset_C Sig_trqhighDSMScale_C Sig_trqhighCANOffset_C Sig_trqhighCANScale_C Sig_trqhighDIAOffset_C Sig_trqhighDIAScale_C Sig_trqDSMOffset_C Sig_trqDSMScale_C Sig_trqCANOffset_C Sig_trqCANScale_C Sig_trqDIAOffset_C Sig_trqDIAScale_C Sig_tDSMOffset_C Sig_tDSMScale_C Sig_tCANOffset_C Sig_tCANScale_C Sig_tDIAOffset_C Sig_tDIAScale_C Sig_uBattDSMOffset_C Sig_uBattDSMScale_C Sig_uBattCANOffset_C Sig_uBattCANScale_C Sig_uBattDIAOffset_C Sig_uBattDIAScale_C Sig_uDSMOffset_C Sig_uDSMScale_C Sig_uCANOffset_C Sig_uCANScale_C Sig_uDIAOffset_C Sig_uDIAScale_C Sig_volHighDSMOffset_C Sig_volHighDSMScale_C Sig_volHighCANOffset_C Sig_volHighCANScale_C Sig_volHighDIAOffset_C Sig_volHighDIAScale_C Sig_volDSMOffset_C Sig_volDSMScale_C Sig_volCANOffset_C Sig_volCANScale_C Sig_volDIAOffset_C Sig_volDIAScale_C Sig_vDSMOffset_C Sig_vDSMScale_C Sig_vCANOffset_C Sig_vCANScale_C Sig_vDIAOffset_C Sig_vDIAScale_C /end DEF_CHARACTERISTIC
/end FUNCTION
/begin FUNCTION signals_limits ""
 /begin DEF_CHARACTERISTIC Sig_LimLowDigital_C Sig_LimUpDigital_C Sig_LimLown_C Sig_LimUpn_C Sig_LimLowPwm_C Sig_LimUpPwm_C /end DEF_CHARACTERISTIC
/end FUNCTION
/begin FUNCTION signals_model "" /end FUNCTION
/begin FUNCTION signals_mon ""
 /begin DEF_CHARACTERISTIC signals_tiTstDemHeal_C signals_tiTstDemMax_C signals_TmrBehaviour_C signals_TstDemMaxEngN_C signals_TstDemMaxVSSCDV_C /end DEF_CHARACTERISTIC
/end FUNCTION
/begin FUNCTION signals_project ""
 /begin DEF_CHARACTERISTIC Sig_phiCrSDSMOffset_C Sig_phiCrSDSMScale_C Sig_phiCrSCANOffset_C Sig_phiCrSCANScale_C Sig_phiCrSDIAOffset_C Sig_phiCrSDIAScale_C Sig_pRailDSMOffset_C Sig_pRailDSMScale_C Sig_pRailCANOffset_C Sig_pRailCANScale_C Sig_pRailDIAOffset_C Sig_pRailDIAScale_C /end DEF_CHARACTERISTIC
/end FUNCTION
/begin FUNCTION signals_uic ""
 /begin OUT_MEASUREMENT signals_stTestNLim_mp signals_stTest_mp signals_tiTstRemain_mp /end OUT_MEASUREMENT
/end FUNCTION
/begin FUNCTION sigtst_auto ""
 /begin DEF_CHARACTERISTIC SigTst_ACEn_C SigTst_ADPEn_C SigTst_AOHtCDHt1En_C SigTst_AOHtCDHt2En_C SigTst_AltRLYExcEn_C SigTst_BPAEn_C SigTst_CtApEn_C SigTst_CtTEn_C SigTst_EGREn_C SigTst_EGRClgBypVlvEn_C SigTst_ENGMENGEn_C SigTst_ENGMGEAREn_C SigTst_Fan1En_C SigTst_Fan2En_C SigTst_FlPpCDEn_C SigTst_GLWLAMPEn_C SigTst_GLWRLYEn_C SigTst_LSUCDHt0En_C SigTst_MILLAMPEn_C SigTst_MeUnEn_C SigTst_PCVEn_C SigTst_PFltRLYHtgEn_C SigTst_PSPEn_C SigTst_SYSLAMPEn_C SigTst_StrtCDRLYOffRlyEn_C SigTst_StrtCDRLYOnRlyEn_C SigTst_TVAEn_C SigTst_VSAEn_C /end DEF_CHARACTERISTIC
/end FUNCTION
/begin FUNCTION soptst "Power-Up-Function test of disabling security pathes" /begin DEF_CHARACTERISTIC SOPTst_stShOffPathActv_C SOPTst_tiWaitOVMOff_C /end DEF_CHARACTERISTIC /end FUNCTION
/begin FUNCTION soptst_msg "" /begin OUT_MEASUREMENT SOPTst_stCyl /end OUT_MEASUREMENT /end FUNCTION
/begin FUNCTION srvpmp "Servopumpe"
 /begin DEF_CHARACTERISTIC SrvPmp_pwrAdjValDef_C SrvPmp_pwrAdjValMax_C SrvPmp_pwrAdjValMin_C SrvPmp_pwrDes_C /end DEF_CHARACTERISTIC
/end FUNCTION
/begin FUNCTION srvpmp_msg "" /begin OUT_MEASUREMENT SrvPmp_pwrDes SrvPmp_pwrLead /end OUT_MEASUREMENT /end FUNCTION
/begin FUNCTION srvpmp_uic "" /begin OUT_MEASUREMENT SrvPmp_pwrDemandEEP_mp /end OUT_MEASUREMENT /end FUNCTION
/begin FUNCTION sspmon "Versorgungsspannungsüberwachung"
 /begin DEF_CHARACTERISTIC SSpMon_DebSRCHighSplyVltgDef1_C SSpMon_DebSRCHighSplyVltgOk1_C SSpMon_DebSRCHighSplyVltgDef2_C SSpMon_DebSRCHighSplyVltgOk2_C SSpMon_DebSRCHighSplyVltgDef3_C SSpMon_DebSRCHighSplyVltgOk3_C SSpMon_DebSRCLowSplyVltgDef1_C SSpMon_DebSRCLowSplyVltgOk1_C SSpMon_DebSRCLowSplyVltgDef2_C SSpMon_DebSRCLowSplyVltgOk2_C SSpMon_DebSRCLowSplyVltgDef3_C SSpMon_DebSRCLowSplyVltgOk3_C /end DEF_CHARACTERISTIC
/end FUNCTION
/begin FUNCTION sspmon_msg "" /begin OUT_MEASUREMENT SSpMon_stSSpErr /end OUT_MEASUREMENT /end FUNCTION
/begin FUNCTION sspmon_uic "" /begin OUT_MEASUREMENT SSpMon_stRaw_1_mp SSpMon_stRaw_2_mp SSpMon_stRaw_3_mp /end OUT_MEASUREMENT /end FUNCTION
/begin FUNCTION strtcd_offrly "Starter Aus-Relais Komponententreiber"
 /begin DEF_CHARACTERISTIC StrtCD_uSRCMinOffRly_C StrtCD_uSRCMaxOffRly_C StrtCD_uLinOffRly_CUR StrtCD_stInvOutOffRly_C StrtCD_stPwrStgDiaOffRly_C StrtCD_tiNoLoadDefOfR_C StrtCD_tiNoLoadOkOfR_C StrtCD_tiShrtBatDefOfR_C StrtCD_tiShrtBatOkOfR_C StrtCD_tiShrtGndDefOfR_C StrtCD_tiShrtGndOkOfR_C StrtCD_uNoLoadMaxOffR_C StrtCD_uNoLoadMinOffR_C StrtCD_uShortBatMinOffR_C StrtCD_uShortGndMaxOffR_C /end DEF_CHARACTERISTIC
 /begin IN_MEASUREMENT StrtCD_uPhyValOffRly /end IN_MEASUREMENT
/end FUNCTION
/begin FUNCTION strtcd_offrly_msg "" /begin OUT_MEASUREMENT StrtCD_uPhyValOffRly /end OUT_MEASUREMENT /end FUNCTION
/begin FUNCTION strtcd_offrly_uic "" /begin OUT_MEASUREMENT StrtCD_stPwrStgOffRly_mp /end OUT_MEASUREMENT /end FUNCTION
/begin FUNCTION strtcd_onrly "Starter Ein-Relais Komponententreiber"
 /begin DEF_CHARACTERISTIC StrtCD_uSRCMinOnRly_C StrtCD_uSRCMaxOnRly_C StrtCD_uLinOnRly_CUR StrtCD_stInvOutOnRly_C StrtCD_stPwrStgDiaOnRly_C StrtCD_tiNoLoadDefOnR_C StrtCD_tiNoLoadOkOnR_C StrtCD_tiShrtBatDefOnR_C StrtCD_tiShrtBatOkOnR_C StrtCD_tiShrtGndDefOnR_C StrtCD_tiShrtGndOkOnR_C StrtCD_uNoLoadMaxOnR_C StrtCD_uNoLoadMinOnR_C StrtCD_uShortBatMinOnR_C StrtCD_uShortGndMaxOnR_C /end DEF_CHARACTERISTIC
 /begin IN_MEASUREMENT StrtCD_uPhyValOnRly /end IN_MEASUREMENT
/end FUNCTION
/begin FUNCTION strtcd_onrly_msg "" /begin OUT_MEASUREMENT StrtCD_uPhyValOnRly /end OUT_MEASUREMENT /end FUNCTION
/begin FUNCTION strtcd_onrly_uic "" /begin OUT_MEASUREMENT StrtCD_stPwrStgOnRly_mp /end OUT_MEASUREMENT /end FUNCTION
/begin FUNCTION stsys "Startsystem" /begin DEF_CHARACTERISTIC StSys_nEngOffHi_C StSys_nEngOffLo_C /end DEF_CHARACTERISTIC /end FUNCTION
/begin FUNCTION stsysctl_engstandstill ""
 /begin DEF_CHARACTERISTIC StSysCtl_ctCaSImpT50On_C StSysCtl_swtEnResetRelease_C StSysCtl_tiT50on_C /end DEF_CHARACTERISTIC
/end FUNCTION
/begin FUNCTION stsysctl_engstandstill_msg "" /begin OUT_MEASUREMENT StSysCtl_stNoCrSSigAct StSysCtl_stStrtRlsFrm /end OUT_MEASUREMENT /end FUNCTION
/begin FUNCTION stsysctl_engstandstill_uic ""
 /begin OUT_MEASUREMENT StSysCtl_ctCaSImpT50On_mp StSysCtl_stNoCrSSig_mp StSysCtl_stStrtEngRlsBSG_mp /end OUT_MEASUREMENT
/end FUNCTION
/begin FUNCTION stsysctl_strtctl "Startersteuerung"
 /begin DEF_CHARACTERISTIC StSysCtl_CntEepWrtAtm_C StSysCtl_nThresEngaErr_C StSysCtl_nThresEngaN_C StSysCtl_nThresEngT_CUR StSysCtl_nThresZeroN_C StSysCtl_stT50CDOff_C StSysCtl_stT50CDOn_C StSysCtl_swtEnResetDisengage_C StSysCtl_swtRlyErrIgn_C StSysCtl_swtStStrtLock_C StSysCtl_swtStSysCtlMn_C StSysCtl_swtStSysCtlMode_C StSysCtl_tiEngaErr_C StSysCtl_tiIlsNPlausDef_C StSysCtl_tiIlsNPlausOk_C StSysCtl_tiOnlyOffRly_C StSysCtl_tiRlyDiag_C StSysCtl_tiT50ROneRly1Def_C StSysCtl_tiT50ROneRly1Ok_C StSysCtl_tiT50ROneRly2Def_C StSysCtl_tiT50ROneRly2Ok_C StSysCtl_tiT50RZeroDef_C StSysCtl_tiT50RZeroOk_C StSysCtl_tiThresAddCor_C StSysCtl_tiThresEngT_CUR StSysCtl_tiThresVel_C StSysCtl_tiThresZeroN_C StSysCtl_TMaxNrm_MAP StSysCtl_vThresVel_C /end DEF_CHARACTERISTIC
 /begin IN_MEASUREMENT Eng_tEng GlwCtl_tiPreGlw /end IN_MEASUREMENT
/end FUNCTION
/begin FUNCTION stsysctl_strtctl_msg ""
 /begin OUT_MEASUREMENT StSysCtl_stStrtCncl StSysCtl_stStrtCtlMode StSysCtl_stStrtDisengaFrm StSysCtl_stT50CDOff StSysCtl_stT50CDOn StSys_stSpareStrt /end OUT_MEASUREMENT
/end FUNCTION
/begin FUNCTION stsysctl_strtctl_uic ""
 /begin OUT_MEASUREMENT StSysCtl_stEepDiagRly_mp StSysCtl_stRlyDiag_mp StSysCtl_stStandStillAR_mp StSysCtl_stStrtCncl_mp StSysCtl_stStrtEngRlsMSG_mp StSysCtl_stT15Lock_mp StSysCtl_stTmrStrtCtl_mp /end OUT_MEASUREMENT
/end FUNCTION
/begin FUNCTION stsys_addcor "Startmomentenkorrektur" /end FUNCTION
/begin FUNCTION stsys_addcor_uic "" /end FUNCTION
/begin FUNCTION stsys_strt "Startabwurf"
 /begin DEF_CHARACTERISTIC StSys_ctRevMin_C StSys_nStrtCutOut_MAP StSys_tiRlsHtg_C StSys_tiStrtCutOut_C /end DEF_CHARACTERISTIC
 /begin IN_MEASUREMENT APSCD_pVal Eng_tEng /end IN_MEASUREMENT
/end FUNCTION
/begin FUNCTION stsys_strtbas "Startbasismoment"
 /begin DEF_CHARACTERISTIC StSys_nAdjMax_C StSys_trqAdjMax_C StSys_trqAdjVal_C StSys_trqStrtAddCor_C StSys_trqStrtBas_MAP StSys_trqStrt_MAP /end DEF_CHARACTERISTIC
 /begin IN_MEASUREMENT Eng_nAvrg Eng_tEng /end IN_MEASUREMENT
/end FUNCTION
/begin FUNCTION stsys_strtbas_uic ""
 /begin OUT_MEASUREMENT StSys_stT50_mp StSys_trqAdj_mp StSys_trqStrtBas_mp StSys_trqValEEP_mp /end OUT_MEASUREMENT
/end FUNCTION
/begin COMPU_METHOD Curr "Strom" RAT_FUNC "%6.2" "[mA]" COEFFS 0 1 0 0 0 1 /end COMPU_METHOD
/begin COMPU_METHOD DtyCyc "Tastverhaeltnis" RAT_FUNC "%6.4" "[%]" COEFFS 0 100 0 0 0 1 /end COMPU_METHOD
/begin COMPU_METHOD EGTSwt "Umrechnung für EGT Rampenschalter (1 / 1000*2^14 )" RAT_FUNC "%10.9" "-" COEFFS 0 16384000 0 0 0 1 /end COMPU_METHOD
/begin COMPU_METHOD EngN "Motordrehzahl" RAT_FUNC "%6.2" "[rpm]" COEFFS 0 1 0 0 0 1 /end COMPU_METHOD
/begin COMPU_METHOD Fact "Faktor mit Auflösung 1 / 8192, hauptsächlich für einen Faktorenbereich 0...1 verwendet" RAT_FUNC "%6.5" "[-]" COEFFS 0 8192 0 0 0 1 /end COMPU_METHOD
/begin COMPU_METHOD FactHigh "Faktor mit Auflösung 1/4096, hauptsächlich für einen Faktorenbereich 0.1...10 verwendet" RAT_FUNC "%7.6" "[-]" COEFFS 0 10000 0 0 0 1 /end COMPU_METHOD
/begin COMPU_METHOD GlwCtl_Time_ms "zur Zeitumrechnung von um den Faktor 10 größeren Zeiten als Time_ms" RAT_FUNC "%6.0" "[ms]" COEFFS 0 0.01 0 0 0 1 /end COMPU_METHOD
/begin COMPU_METHOD InjMass "Einspritzmenge" RAT_FUNC "%6.4" "[mg/hub]" COEFFS 0 100 0 0 0 1 /end COMPU_METHOD
/begin COMPU_METHOD InjMassCyc "Einspritzmenge pro Zyklus (mg/Zyklus)" RAT_FUNC "%6.4" "[mg/cyc]" COEFFS 0 100 0 0 0 1 /end COMPU_METHOD
/begin COMPU_METHOD InjMassInj "Einspritzmenge pro Einspritzung (mg/Einspritzung)" RAT_FUNC "%6.4" "[mg/inj]" COEFFS 0 100 0 0 0 1 /end COMPU_METHOD
/begin COMPU_METHOD InjQntInj "Einspritzmenge der einzelnen Einspritzung" RAT_FUNC "%6.4" "mm^3/inj" COEFFS 0 100 0 0 0 1 /end COMPU_METHOD
/begin COMPU_METHOD OneToOne "eins zu eins (physikalischer Wert ist gleich dem internen Wert)" RAT_FUNC "%6.2" "[-]" COEFFS 0 1 0 0 0 1 /end COMPU_METHOD
/begin COMPU_METHOD Prc "Prozent, gleiche interne Auflösung wie Fact, aber Darstellung in Prozent (0...100%)" RAT_FUNC "%6.4" "[%]" COEFFS 0 100 0 0 0 1 /end COMPU_METHOD
/begin COMPU_METHOD PresRail_sec "Raildruckerhöhung/absenkung in hPa/s" RAT_FUNC "%6.0" "hPa/s" COEFFS 0 0.0025 0 0 0 1 /end COMPU_METHOD
/begin COMPU_METHOD Pres_hPa "Druck (angezeigt in [hPa])" RAT_FUNC "%6.2" "[hPa]" COEFFS 0 1 0 0 0 1 /end COMPU_METHOD
/begin COMPU_METHOD Pres_Rail "Raildruck in hPa" RAT_FUNC "%6.0" "[hPa]" COEFFS 0 0.01 0 0 0 1 /end COMPU_METHOD
/begin COMPU_METHOD Pwr "Leistung" RAT_FUNC "%6.2" "[W]" COEFFS 0 0.10610329539459 0 0 0 1 /end COMPU_METHOD
/begin COMPU_METHOD Qp_mm3_sec "Umrechnung für Volumenstrom" RAT_FUNC "%6.1" "mm3/s" COEFFS 0 0.1 0 0 0 1 /end COMPU_METHOD
/begin COMPU_METHOD Rmp "einheitenloser Rampengradient (für Library Ramp, etc.)" RAT_FUNC "%6.4" "[1/s]" COEFFS 0 65.536 0 0 0 1 /end COMPU_METHOD
/begin COMPU_METHOD SigDatatyp "verbale Umrechnung für die auswahl eines Datentyps eines frei applizierbaren Signals" TAB_VERB "%6.3" "" COMPU_TAB_REF SigDatatyp /end COMPU_METHOD
/begin COMPU_VTAB SigDatatyp "verbale Umrechnung für die auswahl eines Datentyps eines frei applizierbaren Signals" TAB_VERB 6 0 "SIG_SINT16" 1 "SIG_UINT16" 2 "SIG_SINT8" 3 "SIG_UINT8 or SIG_BOOL" 4 "SIG_SINT32" 5 "SIG_UINT32" /end COMPU_VTAB
/begin COMPU_METHOD SigSupLeg "verbale umrechung für unterstützte Gesetztesvorschrift (OBD) gemäß SAE J1979" TAB_VERB "%6.3" "" COMPU_TAB_REF SigSupLeg /end COMPU_METHOD
/begin COMPU_VTAB SigSupLeg "verbale umrechung für unterstützte Gesetztesvorschrift (OBD) gemäß SAE J1979" TAB_VERB 9 1 "OBDII_USA_CARB" 2 "OBD_USA_EPA" 3 "OBD_and_OBDII_USA" 4 "OBDI_USA" 5 "no_use_for_OBD" 6 "EOBD(Europe)" 7 "EOBD and OBD II" 8 "EOBD and OBD" 9 "EOBD, OBD and OBD II" /end COMPU_VTAB
/begin COMPU_METHOD Temp_Cels "Temperatur dargestellt in °C (gleiche interne Darstellung wie Temp_Kelv)" RAT_FUNC "%6.1" "[deg C]" COEFFS 0 10 2731.4 0 0 1 /end COMPU_METHOD
/begin COMPU_METHOD TimeDelay_s "Zeitkonstante T1 (in s) für PT1, DT1, etc." RAT_FUNC "%9.3" "[s]" COEFFS 0 0 1 0 0.00023283064365387 0 /end COMPU_METHOD
/begin COMPU_METHOD TimeSys_us "Zeit in [us] mit Systemzeit-Auflösung" RAT_FUNC "%6.3" "us" COEFFS 0 3.4965 0 0 0 1 /end COMPU_METHOD
/begin COMPU_METHOD Time_ms "Zeit in ms für Fehlerentprellung (DSM) und SW-Timer" RAT_FUNC "%6.1" "[ms]" COEFFS 0 0.1 0 0 0 1 /end COMPU_METHOD
/begin COMPU_METHOD Time_msUI "Zeit in ms ohne Auflösung" RAT_FUNC "%6.2" "[ms]" COEFFS 0 1 0 0 0 1 /end COMPU_METHOD
/begin COMPU_METHOD Trq "Motormoment" RAT_FUNC "%6.3" "[Nm]" COEFFS 0 10 0 0 0 1 /end COMPU_METHOD
/begin COMPU_METHOD TrqDT "zeitlich aufintegriertes Kupplungsmoment" RAT_FUNC "%6.2" "[Nm*s]" COEFFS 0 1 0 0 0 1 /end COMPU_METHOD
/begin COMPU_METHOD Vel "Fahrzeuggeschwindigkeit, gleiche interne Auflösung wie Vel_SI" RAT_FUNC "%6.4" "[km/h]" COEFFS 0 100 0 0 0 1 /end COMPU_METHOD
/begin COMPU_METHOD Volt "Spannung in V (von ADC)" RAT_FUNC "%6.2" "[mV]" COEFFS 0 0.2046 0 0 0 1 /end COMPU_METHOD
/begin COMPU_METHOD Volt_Batt "Batteriespannung" RAT_FUNC "%6.1" "[mV]" COEFFS 0 0.0492252911173131 0 0 0 1 /end COMPU_METHOD
/begin RECORD_LAYOUT Kf_Xs16_Ys16_Ws16 NO_AXIS_PTS_X 1 SWORD NO_AXIS_PTS_Y 2 SWORD AXIS_PTS_X 3 SWORD INDEX_INCR DIRECT AXIS_PTS_Y 4 SWORD INDEX_INCR DIRECT FNC_VALUES 5 SWORD COLUMN_DIR DIRECT /end RECORD_LAYOUT
/begin RECORD_LAYOUT Kl_Xs16_Ws16 NO_AXIS_PTS_X 1 SWORD AXIS_PTS_X 2 SWORD INDEX_INCR DIRECT FNC_VALUES 3 SWORD COLUMN_DIR DIRECT /end RECORD_LAYOUT
/begin RECORD_LAYOUT Kw_Ws16 FNC_VALUES 1 SWORD COLUMN_DIR DIRECT /end RECORD_LAYOUT
/begin RECORD_LAYOUT Kw_Wu16 FNC_VALUES 1 UWORD COLUMN_DIR DIRECT /end RECORD_LAYOUT
/begin RECORD_LAYOUT Kw_Wu32 FNC_VALUES 1 ULONG COLUMN_DIR DIRECT /end RECORD_LAYOUT
/begin RECORD_LAYOUT Kw_Wu8 FNC_VALUES 1 UBYTE COLUMN_DIR DIRECT /end RECORD_LAYOUT
/end MODULE
/end PROJECT
