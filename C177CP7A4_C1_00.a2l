ASAP2_VERSION 1 3
/begin PROJECT C177 "EDC16CP"
/begin HEADER "" VERSION "VCP7A3" PROJECT_NO C177 /end HEADER
/begin MODULE DIM ""
/begin MOD_COMMON "" BYTE_ORDER MSB_FIRST ALIGNMENT_BYTE 1 ALIGNMENT_WORD 2 ALIGNMENT_LONG 4 ALIGNMENT_FLOAT32_IEEE 4 /end MOD_COMMON
/begin CHARACTERISTIC ASDrf_T1CluNeg_C "ARD Führungsformer T1 Kupplung neg. Gradient" VALUE 0x1C7494 Kw_Wu32 4294.9673 TimeDelay_s 0.0000010000000 4294.9673 FORMAT "%9.4" /end CHARACTERISTIC
/begin CHARACTERISTIC ASDrf_KdCluNeg_C "ARD Führungsformer Kd=Td/T1 Kupplung neg. Gradient" VALUE 0x1C7498 Kw_Ws32 32769.0000000 Kd -32768.0000000 1.00000000000 FORMAT "%13.7" EXTENDED_LIMITS -32768.0000000 32767.9999847 /end CHARACTERISTIC
/begin CHARACTERISTIC ASDrf_T1CluPos_C "ARD Führungsformer T1 Kupplung pos. Gradient" VALUE 0x1C749C Kw_Wu32 4294.9673 TimeDelay_s 0.0000010000000 4294.9673 FORMAT "%9.4" /end CHARACTERISTIC
/begin CHARACTERISTIC ASDrf_KdCluPos_C "ARD Führungsformer Kd=Td/T1 Kupplung Ganggruppe pos. Gradient" VALUE 0x1C74A0 Kw_Ws32 32769.0000000 Kd -32768.0000000 1.00000000000 FORMAT "%13.7" EXTENDED_LIMITS -32768.0000000 32767.9999847 /end CHARACTERISTIC
/begin CHARACTERISTIC ASDrf_dtrqInrLtdLim_CUR "Kurve zur Begrenzung der zeitl. Ableitung von CoEng_trqInrLtd" CURVE 0x1C71B8 Kl_Xs16_Ws16 4000.000 dTrq -2000.000 2000.000 FORMAT "%8.3" EXTENDED_LIMITS -3276.800 3276.700
 /begin AXIS_DESCR STD_AXIS ASDrf_dtrqInrLtd_mp dTrq 7 -2000.000 2000.000 FORMAT "%8.3" EXTENDED_LIMITS -3276.800 3276.700 DEPOSIT ABSOLUTE /end AXIS_DESCR
/end CHARACTERISTIC
/begin CHARACTERISTIC ASDrf_dtrqNeg_MAP "Rampensteigung bei neg. Gradient" MAP 0x1C71D6 Kf_Xs16_Ys16_Ws16 1599.609 RmpTrqdHigh 0.00 1599.609 FORMAT "%8.3" EXTENDED_LIMITS -48000.00 47998.54
 /begin AXIS_DESCR STD_AXIS Eng_nAvrg EngN 8 40.00000 6000.000 FORMAT "%8.3" EXTENDED_LIMITS -32768.00 32767.00 DEPOSIT ABSOLUTE /end AXIS_DESCR
 /begin AXIS_DESCR STD_AXIS DrvTrn_rTransDT TransR 12 -327.6800 100.0000 FORMAT "%8.4" EXTENDED_LIMITS -327.6800 327.6700 DEPOSIT ABSOLUTE /end AXIS_DESCR
/end CHARACTERISTIC
/begin CHARACTERISTIC ASDrf_dtrqPos_MAP "Rampensteigung bei pos. Gradient" MAP 0x1C72C2 Kf_Xs16_Ys16_Ws16 1599.609 RmpTrqdHigh 0.00 1599.609 FORMAT "%8.3" EXTENDED_LIMITS -48000.00 47998.54
 /begin AXIS_DESCR STD_AXIS Eng_nAvrg EngN 8 40.00000 6000.000 FORMAT "%8.3" EXTENDED_LIMITS -32768.00 32767.00 DEPOSIT ABSOLUTE /end AXIS_DESCR
 /begin AXIS_DESCR STD_AXIS DrvTrn_rTransDT TransR 12 -327.6800 100.0000 FORMAT "%8.4" EXTENDED_LIMITS -327.6800 327.6700 DEPOSIT ABSOLUTE /end AXIS_DESCR
/end CHARACTERISTIC
/begin CHARACTERISTIC ASDrf_dtrqSteepNeg_C "Obergrenze für Initialisierung bei steilen Eingangssignalgradienten" VALUE 0x1C73AE Kw_Ws16 2000.000 dTrq -2000.000 0.00 FORMAT "%8.3" EXTENDED_LIMITS -3276.800 3276.700 /end CHARACTERISTIC
/begin CHARACTERISTIC ASDrf_dtrqSteepPos_C "Untergrenze für Initialisierung bei steilen Eingangssignalgradienten" VALUE 0x1C73B0 Kw_Ws16 2000.000 dTrq 0.00 2000.000 FORMAT "%8.3" EXTENDED_LIMITS -3276.800 3276.700 /end CHARACTERISTIC
/begin CHARACTERISTIC ASDrf_T1ExtInt_C "ARD Führungsformer T1, externer Eingriff" VALUE 0x1C74A4 Kw_Wu32 4294.9673 TimeDelay_s 0.0000010000000 4294.9673 FORMAT "%9.4" /end CHARACTERISTIC
/begin CHARACTERISTIC ASDrf_KdExtInt_C "ARD Führungsformer Kd=Td/T1, externer Eingriff" VALUE 0x1C74A8 Kw_Ws32 32769.0000000 Kd -32768.0000000 1.00000000000 FORMAT "%13.7" EXTENDED_LIMITS -32768.0000000 32767.9999847 /end CHARACTERISTIC
/begin CHARACTERISTIC ASDrf_facdtrqPos_CUR "Kennlinie für Steigungsbegrenzungsfaktor" CURVE 0x1C73B2 Kl_Xs16_Ws16 1.000000 Fact1 0.00 1.000000 FORMAT "%8.6" EXTENDED_LIMITS -256.0000 255.9922
 /begin AXIS_DESCR STD_AXIS ASDrf_stDriver OneToOne 3 1.000 4.000 FORMAT "%5.3" EXTENDED_LIMITS 0.00 255.0 DEPOSIT ABSOLUTE /end AXIS_DESCR
/end CHARACTERISTIC
/begin CHARACTERISTIC ASDrf_facKdGripPos_CUR "Kennlinie für Multiplikationsfaktor für Gripparameter bei positiver Wunschmomententendenz" CURVE 0x1C74AC Kl_Xs16_Ws16 1.000000 Fact1 0.00 1.000000 FORMAT "%8.6" EXTENDED_LIMITS -256.0000 255.9922
 /begin AXIS_DESCR STD_AXIS ASDrf_stDriver OneToOne 3 1.000 4.000 FORMAT "%5.3" EXTENDED_LIMITS 0.00 255.0 DEPOSIT ABSOLUTE /end AXIS_DESCR
/end CHARACTERISTIC
/begin CHARACTERISTIC ASDrf_T1Flt_C "Zeitkonstante PT1 Glied zur Filterung von CoEng_trqInrLtd vor der Ableitung." VALUE 0x1C73C0 Kw_Wu32 4294.9673 TimeDelay_s 0.0000010000000 4294.9673 FORMAT "%9.4" /end CHARACTERISTIC
/begin CHARACTERISTIC ASDrf_KdGripNeg_MAP "Kd bei geschlosenem Antreibsstrang und negativem Gradienten" MAP 0x1C7518 Kf_Xs16_Ys16_Ws16 1.000000 Kd_Lin_16 0.00 1.000000 FORMAT "%8.6" EXTENDED_LIMITS -1.000031 1.000000
 /begin AXIS_DESCR STD_AXIS DrvTrn_rTransDT TransR 12 0.00 100.0000 FORMAT "%8.4" EXTENDED_LIMITS -327.6800 327.6700 DEPOSIT ABSOLUTE /end AXIS_DESCR
 /begin AXIS_DESCR STD_AXIS Eng_nAvrg EngN 8 0.00 6000.000 FORMAT "%8.3" EXTENDED_LIMITS -32768.00 32767.00 DEPOSIT ABSOLUTE /end AXIS_DESCR
/end CHARACTERISTIC
/begin CHARACTERISTIC ASDrf_KdGripPos_MAP "Kd bei geschlosenem Antriebstrang und positivem Gradienten" MAP 0x1C7604 Kf_Xs16_Ys16_Ws16 1.000000 Kd_Lin_16 0.00 1.000000 FORMAT "%8.6" EXTENDED_LIMITS -1.000031 1.000000
 /begin AXIS_DESCR STD_AXIS DrvTrn_rTransDT TransR 12 0.00 100.0000 FORMAT "%8.4" EXTENDED_LIMITS -327.6800 327.6700 DEPOSIT ABSOLUTE /end AXIS_DESCR
 /begin AXIS_DESCR STD_AXIS Eng_nAvrg EngN 8 0.00 6000.000 FORMAT "%8.3" EXTENDED_LIMITS -32768.00 32767.00 DEPOSIT ABSOLUTE /end AXIS_DESCR
/end CHARACTERISTIC
/begin CHARACTERISTIC ASDrf_nTMFWRO_C "Drehzahlschwelle zum Erkennen von Ausrollen" VALUE 0x1C74BA Kw_Ws16 6000.000 EngN 0.00 6000.000 FORMAT "%8.3" EXTENDED_LIMITS -32768.00 32767.00 /end CHARACTERISTIC
/begin CHARACTERISTIC ASDrf_rAccPedFullLd_CUR "Obere Hysterseschwelle für Teillast/Volllasterkennung" CURVE 0x1C74BC Kl_Xs16_Ws16 100.0000 Prc 0.00 100.0000 FORMAT "%8.4" EXTENDED_LIMITS -327.6800 327.6700
 /begin AXIS_DESCR STD_AXIS Eng_nAvrg EngN 8 40.00000 6000.000 FORMAT "%8.3" EXTENDED_LIMITS -32768.00 32767.00 DEPOSIT ABSOLUTE /end AXIS_DESCR
/end CHARACTERISTIC
/begin CHARACTERISTIC ASDrf_rAccPedPartLd_CUR "Untere Hysterseschwelle für Teillast/Vollasterkennung" CURVE 0x1C74DE Kl_Xs16_Ws16 100.0000 Prc 0.00 100.0000 FORMAT "%8.4" EXTENDED_LIMITS -327.6800 327.6700
 /begin AXIS_DESCR STD_AXIS Eng_nAvrg EngN 8 40.00000 6000.000 FORMAT "%8.3" EXTENDED_LIMITS -32768.00 32767.00 DEPOSIT ABSOLUTE /end AXIS_DESCR
/end CHARACTERISTIC
/begin CHARACTERISTIC ASDrf_swtConvOff_C "Schalter zur Abschaltung der Kupplungsbedingung für Führungsformer und Steigungsbegrenzung" VALUE 0x1C7500 Kw_Wu8 1.000 OneToOne 0.00 1.000 FORMAT "%5.3" EXTENDED_LIMITS 0.00 255.0 /end CHARACTERISTIC
/begin CHARACTERISTIC ASDrf_swtFlt_C "Schalter zur Auswahl des Filters für CoEng_trqInrLtd (0  Filterung / >0 keine Filterung)." VALUE 0x1C73C4 Kw_Wu8 255.0 OneToOne 0.00 255.0 FORMAT "%5.1" /end CHARACTERISTIC
/begin CHARACTERISTIC ASDrf_swtGearbx_C "Schalter zur Auswahl des externen Getriebeeingriffes" VALUE 0x1C7501 Kw_Wu8 2.000 OneToOne 0.00 2.000 FORMAT "%5.3" EXTENDED_LIMITS 0.00 255.0 /end CHARACTERISTIC
/begin CHARACTERISTIC ASDrf_swtInitPS_C "Schalter zur Aktivierung/Deaktivierung der kontinuierlichen Initialisierung aufgrund Parametersatzwechsels" VALUE 0x1C73C5 Kw_Wu8 255.0 OneToOne 0.00 255.0 FORMAT "%5.1" /end CHARACTERISTIC
/begin CHARACTERISTIC ASDrf_T1GripNeg_MAP "T1 bei geschlosenem Antreibsstrang und negativem Gradienten" MAP 0x1C76F0 Kf_Xs16_Ys16_Ws16 1.499985 TimeDelay_s_Lin_16 0.00 1.499985 FORMAT "%8.6" EXTENDED_LIMITS -5.000153 5.000000
 /begin AXIS_DESCR STD_AXIS DrvTrn_rTransDT TransR 12 0.00 100.0000 FORMAT "%8.4" EXTENDED_LIMITS -327.6800 327.6700 DEPOSIT ABSOLUTE /end AXIS_DESCR
 /begin AXIS_DESCR STD_AXIS Eng_nAvrg EngN 8 0.00 6000.000 FORMAT "%8.3" EXTENDED_LIMITS -32768.00 32767.00 DEPOSIT ABSOLUTE /end AXIS_DESCR
/end CHARACTERISTIC
/begin CHARACTERISTIC ASDrf_T1GripPos_MAP "T1 bei geschlosenem Antriebstrang und positivem Gradienten" MAP 0x1C77DC Kf_Xs16_Ys16_Ws16 1.499985 TimeDelay_s_Lin_16 0.00 1.499985 FORMAT "%8.6" EXTENDED_LIMITS -5.000153 5.000000
 /begin AXIS_DESCR STD_AXIS DrvTrn_rTransDT TransR 12 0.00 100.0000 FORMAT "%8.4" EXTENDED_LIMITS -327.6800 327.6700 DEPOSIT ABSOLUTE /end AXIS_DESCR
 /begin AXIS_DESCR STD_AXIS Eng_nAvrg EngN 8 0.00 6000.000 FORMAT "%8.3" EXTENDED_LIMITS -32768.00 32767.00 DEPOSIT ABSOLUTE /end AXIS_DESCR
/end CHARACTERISTIC
/begin CHARACTERISTIC ASDrf_tiTMFWRO_C "Entprellzeit zum Erkennen von Ausrollen" VALUE 0x1C7502 Kw_Wu16 655350.0 Time_ms 0.00 655350.0 FORMAT "%8.1" /end CHARACTERISTIC
/begin CHARACTERISTIC ASDrf_T1TMFWRONeg_C "ARD Führungsformer T1 Ausrollen neg. Gradient" VALUE 0x1C7504 Kw_Wu32 4294.9673 TimeDelay_s 0.0000010000000 4294.9673 FORMAT "%9.4" /end CHARACTERISTIC
/begin CHARACTERISTIC ASDrf_KdTMFWRONeg_C "ARD Führungsformer Kd=Td/T1 Ausrollen neg. Gradient" VALUE 0x1C7508 Kw_Ws32 32769.0000000 Kd -32768.0000000 1.00000000000 FORMAT "%13.7" EXTENDED_LIMITS -32768.0000000 32767.9999847 /end CHARACTERISTIC
/begin CHARACTERISTIC ASDrf_T1TMFWROPos_C "ARD Führungsformer T1 Ausrollen pos. Gradient" VALUE 0x1C750C Kw_Wu32 4294.9673 TimeDelay_s 0.0000010000000 4294.9673 FORMAT "%9.4" /end CHARACTERISTIC
/begin CHARACTERISTIC ASDrf_KdTMFWROPos_C "ARD Führungsformer Kd=Td/T1 Ausrollen pos. Gradient" VALUE 0x1C7510 Kw_Ws32 32769.0000000 Kd -32768.0000000 1.00000000000 FORMAT "%13.7" EXTENDED_LIMITS -32768.0000000 32767.9999847 /end CHARACTERISTIC
/begin CHARACTERISTIC ASDrf_trqFltLim_C "Grenzwert der logischen Filter für CoEng_trqInrLtd vor der Ableitung" VALUE 0x1C73C6 Kw_Ws16 6553.500 Trq -3276.800 3276.700 FORMAT "%8.3" /end CHARACTERISTIC
/begin CHARACTERISTIC ASDrf_trqInr_Vector "Bypass Label, nicht ändern!" VALUE 0x1C0A3E Kw_Wu8 255.0 OneToOne 0.00 255.0 FORMAT "%5.1" /end CHARACTERISTIC
/begin CHARACTERISTIC ASDrf_trqInr_Channel "Bypass Label, nicht ändern!" VALUE 0x1C0A3F Kw_Wu8 255.0 OneToOne 0.00 255.0 FORMAT "%5.1" /end CHARACTERISTIC
/begin CHARACTERISTIC ASDrf_trqPullNeg_CUR "pos. Offset auf Verlustmoment bei neg. Lastwechsel" CURVE 0x1C73C8 Kl_Xs16_Ws16 1500.000 Trq -500.0000 1000.000 FORMAT "%8.3" EXTENDED_LIMITS -3276.800 3276.700
 /begin AXIS_DESCR STD_AXIS Eng_nAvrg EngN 12 40.00000 6000.000 FORMAT "%8.3" EXTENDED_LIMITS -32768.00 32767.00 DEPOSIT ABSOLUTE /end AXIS_DESCR
/end CHARACTERISTIC
/begin CHARACTERISTIC ASDrf_trqPullPos_CUR "pos. Offset auf Verlustmoment bei pos. Lastwechsel" CURVE 0x1C73FA Kl_Xs16_Ws16 1500.000 Trq -500.0000 1000.000 FORMAT "%8.3" EXTENDED_LIMITS -3276.800 3276.700
 /begin AXIS_DESCR STD_AXIS Eng_nAvrg EngN 12 40.00000 6000.000 FORMAT "%8.3" EXTENDED_LIMITS -32768.00 32767.00 DEPOSIT ABSOLUTE /end AXIS_DESCR
/end CHARACTERISTIC
/begin CHARACTERISTIC ASDrf_trqPushNeg_CUR "neg. Offset auf Verlustmoment bei neg. Lastwechsel" CURVE 0x1C742C Kl_Xs16_Ws16 1500.000 Trq -500.0000 1000.000 FORMAT "%8.3" EXTENDED_LIMITS -3276.800 3276.700
 /begin AXIS_DESCR STD_AXIS Eng_nAvrg EngN 12 40.00000 6000.000 FORMAT "%8.3" EXTENDED_LIMITS -32768.00 32767.00 DEPOSIT ABSOLUTE /end AXIS_DESCR
/end CHARACTERISTIC
/begin CHARACTERISTIC ASDrf_trqPushPos_CUR "neg. Offset auf Verlusmenge bei Pos. Lastwechsel" CURVE 0x1C745E Kl_Xs16_Ws16 1500.000 Trq -500.0000 1000.000 FORMAT "%8.3" EXTENDED_LIMITS -3276.800 3276.700
 /begin AXIS_DESCR STD_AXIS Eng_nAvrg EngN 12 40.00000 6000.000 FORMAT "%8.3" EXTENDED_LIMITS -32768.00 32767.00 DEPOSIT ABSOLUTE /end AXIS_DESCR
/end CHARACTERISTIC
/begin CHARACTERISTIC ASDrf_trqThresNeg_C "ARD Führungsformer Hystereseschwelle Wunschmomentgradient 'neg' alle Ganggrp." VALUE 0x1C7490 Kw_Ws16 1500.000 Trq -500.0000 1000.000 FORMAT "%8.3" EXTENDED_LIMITS -3276.800 3276.700 /end CHARACTERISTIC
/begin CHARACTERISTIC ASDrf_trqThresPos_C "ARD Führungsformer Hystereseschwelle Wunschmomentgradient 'pos' alle Ganggrp." VALUE 0x1C7492 Kw_Ws16 1500.000 Trq -500.0000 1000.000 FORMAT "%8.3" EXTENDED_LIMITS -3276.800 3276.700 /end CHARACTERISTIC
/begin CHARACTERISTIC ASDrf_trqTMFWRO_C "Drehmomentschwelle zum Erkennen von Ausrollen" VALUE 0x1C7514 Kw_Ws16 65534.00 TrqPrp -32767.00 32767.00 FORMAT "%8.2" EXTENDED_LIMITS -32768.00 32767.00 /end CHARACTERISTIC
/begin CHARACTERISTIC ASMod_rPresCritAir_C "kritisches Druckverhältnis für Frischluft" VALUE 0x1C8350 Kw_Wr32 0.00 OneToOne 0.528282000 0.528282000 FORMAT "%11.9" EXTENDED_LIMITS -1.00000000E+37 1.00000000E+37 READ_ONLY /end CHARACTERISTIC
/begin CHARACTERISTIC ASMod_facFlowCritAir_C "Wert der Durchflußfunktion bei kritischem Druckverhältnis für Frischluft" VALUE 0x1C8354 Kw_Wr32 0.00 OneToOne 0.484179000 0.484179000 FORMAT "%11.9" EXTENDED_LIMITS -1.00000000E+37 1.00000000E+37 READ_ONLY /end CHARACTERISTIC
/begin CHARACTERISTIC ASMod_rPresLinAir_C "unterer Grenzwert des Druckverhältnisses zur Linearisierung der Durchflussfunktion für Frischluft" VALUE 0x1C8358 Kw_Wr32 0.00 OneToOne 0.990000000 0.990000000 FORMAT "%11.9" EXTENDED_LIMITS -1.00000000E+37 1.00000000E+37 READ_ONLY /end CHARACTERISTIC
/begin CHARACTERISTIC ASMod_facSlpLinAir_C "Steigung der linearisierten Durchflußfunktion für Frischluft" VALUE 0x1C835C Kw_Wr32 0.00 OneToOne 9.94628000 9.94628000 FORMAT "%10.8" EXTENDED_LIMITS -1.00000000E+37 1.00000000E+37 READ_ONLY /end CHARACTERISTIC
/begin CHARACTERISTIC ASMod_arEffEGRThres_C "unterer Schwellwert des effektiven Querschnitts des Abgasrückführventils" VALUE 0x1C8484 Kw_Wr32 4.00000000 Area_float 0.00 4.00000000 FORMAT "%10.8" EXTENDED_LIMITS -1.00000000E+37 1.00000000E+37 /end CHARACTERISTIC
/begin CHARACTERISTIC ASMod_arEffEGR_CUR "effektiver Querschnitt des Abgasrückführventils als Funktion des Ventilhubes" CURVE 0x1C7FC8 Kl_Xr32_Wr32 50.0000000 Area_float 0.00 50.0000000 FORMAT "%10.7" EXTENDED_LIMITS -1.00000000E+37 1.00000000E+37
 /begin AXIS_DESCR STD_AXIS ASMod_rRelPosEGR Prc_fl 12 0.00 100.000000 FORMAT "%10.6" EXTENDED_LIMITS -1.00000000E+37 1.00000000E+37 DEPOSIT ABSOLUTE /end AXIS_DESCR
/end CHARACTERISTIC
/begin CHARACTERISTIC ASMod_arEffTVA_CUR "effektive Querschnittsfläche der Drosselklappe" CURVE 0x1C8360 Kl_Xr32_Wr32 50.0000000 Area_float 0.00 50.0000000 FORMAT "%10.7" EXTENDED_LIMITS -1.00000000E+37 1.00000000E+37
 /begin AXIS_DESCR STD_AXIS ASMod_rRelPosTVA Prc_fl 10 0.00 100.000000 FORMAT "%10.6" EXTENDED_LIMITS -1.00000000E+37 1.00000000E+37 DEPOSIT ABSOLUTE /end AXIS_DESCR
/end CHARACTERISTIC
/begin CHARACTERISTIC ASMod_ddmObsvrOffMax_C "obere Hysterese-Schwelle der zeitlichen Änderung des Luftmassenstroms für Adaption aus" VALUE 0x1C8488 Kw_Ws16 10000.00 RmpAirMassPerTimeLow -5000.000 5000.000 FORMAT "%8.3" EXTENDED_LIMITS -32768.00 32767.00 /end CHARACTERISTIC
/begin CHARACTERISTIC ASMod_ddmObsvrOffMin_C "untere Hysterese-Schwelle der zeitlichen Änderung des Luftmassenstroms für Adation aus" VALUE 0x1C848A Kw_Ws16 10000.00 RmpAirMassPerTimeLow -5000.000 5000.000 FORMAT "%8.3" EXTENDED_LIMITS -32768.00 32767.00 /end CHARACTERISTIC
/begin CHARACTERISTIC ASMod_ddmObsvrOnMax_C "obere Hysterese-Schwelle der zeitlichen Änderung des Luftmassenstroms für Adaption ein" VALUE 0x1C848C Kw_Ws16 10000.00 RmpAirMassPerTimeLow -5000.000 5000.000 FORMAT "%8.3" EXTENDED_LIMITS -32768.00 32767.00 /end CHARACTERISTIC
/begin CHARACTERISTIC ASMod_ddmObsvrOnMin_C "untere Hysterese-Schwelle der zeitlichen Änderung des Luftmassenstroms für Adaption ein" VALUE 0x1C848E Kw_Ws16 10000.00 RmpAirMassPerTimeLow -5000.000 5000.000 FORMAT "%8.3" EXTENDED_LIMITS -32768.00 32767.00 /end CHARACTERISTIC
/begin CHARACTERISTIC ASMod_tiDMEGRUpPT1_C "Zeitkonstante des PT1-Filter für positive Anderungen des rückgeführten Abgasmassenstroms" VALUE 0x1C8030 Kw_Wr32 1.00000000 Time_s_float 0.00 1.00000000 FORMAT "%10.8" EXTENDED_LIMITS -1.00000000E+37 1.00000000E+37 /end CHARACTERISTIC
/begin CHARACTERISTIC ASMod_tiDMEGRDwnPT1_C "Zeitkonstante des PT1-Filter für negative Anderungen des rückgeführten Abgasmassenstroms" VALUE 0x1C8034 Kw_Wr32 1.00000000 Time_s_float 0.00 1.00000000 FORMAT "%10.8" EXTENDED_LIMITS -1.00000000E+37 1.00000000E+37 /end CHARACTERISTIC
/begin CHARACTERISTIC ASMod_dmIndAirRef_MAP "Referenz des Gasmassenstroms als Funktion der Drehzahl und der verbrannten Kraftstoffmasse" MAP 0x1C80F0 Kf_Xs16_Ys16_Ws16 1400.000 AirMassPerTime 0.00 1400.000 FORMAT "%8.3" EXTENDED_LIMITS -3276.800 3276.700
 /begin AXIS_DESCR STD_AXIS Eng_nAvrg EngN 8 0.00 6000.000 FORMAT "%8.3" EXTENDED_LIMITS -32768.00 32767.00 DEPOSIT ABSOLUTE /end AXIS_DESCR
 /begin AXIS_DESCR STD_AXIS ASMod_qLmbdCtlCorr_mp InjMass 8 0.00 150.0000 FORMAT "%8.4" EXTENDED_LIMITS -327.6800 327.6700 DEPOSIT ABSOLUTE /end AXIS_DESCR
/end CHARACTERISTIC
/begin CHARACTERISTIC ASMod_dnObsvrOffMax_C "obere Hysterese-Schwelle der zeitlichen Änderung der Motordrehzahl für Adaption aus" VALUE 0x1C8490 Kw_Ws16 10000.00 RmpEngNLow -5000.000 5000.000 FORMAT "%8.3" EXTENDED_LIMITS -32768.00 32767.00 /end CHARACTERISTIC
/begin CHARACTERISTIC ASMod_dnObsvrOffMin_C "untere Hysterese-Schwelle der zeitlichen Änderung der Motordrehzahl für Adaption aus" VALUE 0x1C8492 Kw_Ws16 10000.00 RmpEngNLow -5000.000 5000.000 FORMAT "%8.3" EXTENDED_LIMITS -32768.00 32767.00 /end CHARACTERISTIC
/begin CHARACTERISTIC ASMod_dnObsvrOnMax_C "obere Hysterese-Schwelle der zeitlichen Änderung der Motordrehzahl für Adaption ein" VALUE 0x1C8494 Kw_Ws16 10000.00 RmpEngNLow -5000.000 5000.000 FORMAT "%8.3" EXTENDED_LIMITS -32768.00 32767.00 /end CHARACTERISTIC
/begin CHARACTERISTIC ASMod_dnObsvrOnMin_C "untere Hysterese-Schwelle der zeitlichen Änderung der Motordrehzahl für Adaption ein" VALUE 0x1C8496 Kw_Ws16 10000.00 RmpEngNLow -5000.000 5000.000 FORMAT "%8.3" EXTENDED_LIMITS -32768.00 32767.00 /end CHARACTERISTIC
/begin CHARACTERISTIC ASMod_dpObsvrOffMax_C "obere Hysterese-Schwelle der zeitlichen Änderung des Ladedrucks für Adaption aus" VALUE 0x1C8498 Kw_Ws16 4000.000 RmpPres_hPaLow -2000.000 2000.000 FORMAT "%8.3" EXTENDED_LIMITS -3276.800 3276.700 /end CHARACTERISTIC
/begin CHARACTERISTIC ASMod_dpObsvrOffMin_C "untere Hysterese-Schwelle der zeitlichen Änderung des Ladedrucks für Adaption aus" VALUE 0x1C849A Kw_Ws16 4000.000 RmpPres_hPaLow -2000.000 2000.000 FORMAT "%8.3" EXTENDED_LIMITS -3276.800 3276.700 /end CHARACTERISTIC
/begin CHARACTERISTIC ASMod_dpObsvrOnMax_C "obere Hysterese-Schwelle der zeitlichen Änderung des Ladedrucks für Adaption ein" VALUE 0x1C849C Kw_Ws16 4000.000 RmpPres_hPaLow -2000.000 2000.000 FORMAT "%8.3" EXTENDED_LIMITS -3276.800 3276.700 /end CHARACTERISTIC
/begin CHARACTERISTIC ASMod_dpObsvrOnMin_C "untere Hysterese-Schwelle der zeitlichen Änderung des Ladedrucks für Adaption ein" VALUE 0x1C849E Kw_Ws16 4000.000 RmpPres_hPaLow -2000.000 2000.000 FORMAT "%8.3" EXTENDED_LIMITS -3276.800 3276.700 /end CHARACTERISTIC
/begin CHARACTERISTIC ASMod_dqObsvrOffMax_C "obere Hysterese-Schwelle der zeitlichen Änderung der Kraftstoffmenge für Adaption aus" VALUE 0x1C84A0 Kw_Ws16 2000.000 RmpInjMassLow -1000.000 1000.000 FORMAT "%8.3" EXTENDED_LIMITS -3276.800 3276.700 /end CHARACTERISTIC
/begin CHARACTERISTIC ASMod_dqObsvrOffMin_C "untere Hysterese-Schwelle der zeitlichen Änderung der Kraftstoffmenge für Adaption aus" VALUE 0x1C84A2 Kw_Ws16 2000.000 RmpInjMassLow -1000.000 1000.000 FORMAT "%8.3" EXTENDED_LIMITS -3276.800 3276.700 /end CHARACTERISTIC
/begin CHARACTERISTIC ASMod_dqObsvrOnMax_C "obere Hysterese-Schwelle der zeitlichen Änderung der Kraftstoffmenge für Adaption ein" VALUE 0x1C84A4 Kw_Ws16 2000.000 RmpInjMassLow -1000.000 1000.000 FORMAT "%8.3" EXTENDED_LIMITS -3276.800 3276.700 /end CHARACTERISTIC
/begin CHARACTERISTIC ASMod_dqObsvrOnMin_C "untere Hysterese-Schwelle der zeitlichen Änderung der Kraftstoffmenge für Adaption ein" VALUE 0x1C84A6 Kw_Ws16 2000.000 RmpInjMassLow -1000.000 1000.000 FORMAT "%8.3" EXTENDED_LIMITS -3276.800 3276.700 /end CHARACTERISTIC
/begin CHARACTERISTIC ASMod_rPresCritEG_C "kritisches Druckverhältnis für Abgas" VALUE 0x1C8038 Kw_Wr32 0.00 OneToOne 0.533388000 0.533388000 FORMAT "%11.9" EXTENDED_LIMITS -1.00000000E+37 1.00000000E+37 READ_ONLY /end CHARACTERISTIC
/begin CHARACTERISTIC ASMod_facFlowCritEG_C "Wert der Durchflussfunktion bei kritischem Druckverhältnis für Abgas" VALUE 0x1C803C Kw_Wr32 0.00 OneToOne 0.480560000 0.480560000 FORMAT "%11.9" EXTENDED_LIMITS -1.00000000E+37 1.00000000E+37 READ_ONLY /end CHARACTERISTIC
/begin CHARACTERISTIC ASMod_rPresLinEG_C "unterer Grenzwert des Druckverhältnisses zur Linearisierung der Durchflussfunktion für Abgas" VALUE 0x1C8040 Kw_Wr32 0.00 OneToOne 0.990000000 0.990000000 FORMAT "%11.9" EXTENDED_LIMITS -1.00000000E+37 1.00000000E+37 READ_ONLY /end CHARACTERISTIC
/begin CHARACTERISTIC ASMod_facSlpLinEG_C "Steigung der linearisierten Durchflussfunktion für Abgas" VALUE 0x1C8044 Kw_Wr32 0.00 OneToOne 9.94511000 9.94511000 FORMAT "%10.8" EXTENDED_LIMITS -1.00000000E+37 1.00000000E+37 READ_ONLY /end CHARACTERISTIC
/begin CHARACTERISTIC ASMod_etaEGRClg_MAP "Wirkungsgrad des ARF-Kühlers als Funktion des Abgasmassenstroms und der Position des ARF-Kühler-Bypass" MAP 0x1C8048 Kf_Xr32_Yr32_Wr32 1.00000000 OneToOne 0.00 1.00000000 FORMAT "%10.8" EXTENDED_LIMITS -1.00000000E+37 1.00000000E+37
 /begin AXIS_DESCR STD_AXIS ASMod_dmEGRPst AirmassPerTime_float 6 -700.000000 700.000000 FORMAT "%10.6" EXTENDED_LIMITS -1.00000000E+37 1.00000000E+37 DEPOSIT ABSOLUTE /end AXIS_DESCR
 /begin AXIS_DESCR STD_AXIS ASMod_rRelPosECB Prc_fl 3 0.00 100.000000 FORMAT "%10.6" EXTENDED_LIMITS -1.00000000E+37 1.00000000E+37 DEPOSIT ABSOLUTE /end AXIS_DESCR
/end CHARACTERISTIC
/begin CHARACTERISTIC ASMod_etaTurb_CUR "Turbinenwirkungsgrad als Funktion der Position des Ladedruckstellers" CURVE 0x1C7EEC Kl_Xr32_Wr32 1.00000000 OneToOne 0.00 1.00000000 FORMAT "%10.8" EXTENDED_LIMITS -1.00000000E+37 1.00000000E+37
 /begin AXIS_DESCR STD_AXIS ASMod_rRelPosBPA Prc_fl 8 0.00 100.000000 FORMAT "%10.6" EXTENDED_LIMITS -1.00000000E+37 1.00000000E+37 DEPOSIT ABSOLUTE /end AXIS_DESCR
/end CHARACTERISTIC
/begin CHARACTERISTIC ASMod_facArEffCorMax_C "obere Begrenzung des PI-Reglers PI_ArEffCor" VALUE 0x1C84A8 Kw_Ws16 2.000000 Fact 0.00 2.000000 FORMAT "%8.6" EXTENDED_LIMITS -4.000000 3.999878 /end CHARACTERISTIC
/begin CHARACTERISTIC ASMod_facArEffCorMin_C "untere Begrenzung des PI-Reglers PI_ArEffCor" VALUE 0x1C84AA Kw_Ws16 2.000000 Fact 0.00 2.000000 FORMAT "%8.6" EXTENDED_LIMITS -4.000000 3.999878 /end CHARACTERISTIC
/begin CHARACTERISTIC ASMod_facDdTm_C "Faktor zur Berechnung der Gaslaufzeit durch den Motor" VALUE 0x1C8194 Kw_Ws16 7.000000 Fact1 1.000000 8.000000 FORMAT "%8.6" EXTENDED_LIMITS -256.0000 255.9922 /end CHARACTERISTIC
/begin CHARACTERISTIC ASMod_facDMCorTDiff_CUR "Korrekturfaktor der Temperaturerhöhung aufgrund des aktuellen Gasmassenstroms" CURVE 0x1C8196 Kl_Xs16_Ws16 2.000000 Fact 0.00 2.000000 FORMAT "%8.6" EXTENDED_LIMITS -4.000000 3.999878
 /begin AXIS_DESCR STD_AXIS ASMod_rDMIndAir_mp RatAirMass 8 -1.000000 1.000000 FORMAT "%8.6" EXTENDED_LIMITS -327.6800 327.6700 DEPOSIT ABSOLUTE /end AXIS_DESCR
/end CHARACTERISTIC
/begin CHARACTERISTIC ASMod_facDMCorTIndAir_MAP "Korrekturfaktor für die Temperatur vor Einlass aufgrund der Wandwärmeübergänge" MAP 0x1C83C8 Kf_Xs16_Ys16_Ws16 2.000000 Fact -1.000000 1.000000 FORMAT "%8.6" EXTENDED_LIMITS -4.000000 3.999878
 /begin AXIS_DESCR STD_AXIS Eng_nAvrg EngN 8 0.00 6000.000 FORMAT "%8.3" EXTENDED_LIMITS -32768.00 32767.00 DEPOSIT ABSOLUTE /end AXIS_DESCR
 /begin AXIS_DESCR STD_AXIS ASMod_dmIndAir AirMassPerTime 8 -500.0000 500.0000 FORMAT "%8.4" EXTENDED_LIMITS -3276.800 3276.700 DEPOSIT ABSOLUTE /end AXIS_DESCR
/end CHARACTERISTIC
/begin CHARACTERISTIC ASMod_facPresLsCmprPre_C "Faktor zur Berechnung des Druckabfalls vor Verdichter" VALUE 0x1C78C8 Kw_Wr32 0.300000000 FactPresLs_float 0.00 0.300000000 FORMAT "%11.9" EXTENDED_LIMITS -1.00000000E+37 1.00000000E+37 /end CHARACTERISTIC
/begin CHARACTERISTIC ASMod_facPresLsCmprPst_C "Faktor zur Berechnung des Druckabfalls nach Verdichter" VALUE 0x1C78CC Kw_Wr32 0.300000000 FactPresLs_float 0.00 0.300000000 FORMAT "%11.9" EXTENDED_LIMITS -1.00000000E+37 1.00000000E+37 /end CHARACTERISTIC
/begin CHARACTERISTIC ASMod_facPresLsEGRClg_CUR "Faktor für den Druckabfall im ARF-Kühler als Funktion der Position des ARF-Bypass-Ventils" CURVE 0x1C80C4 Kl_Xr32_Wr32 0.300000000 FactPresLs_float 0.00 0.300000000 FORMAT "%11.9" EXTENDED_LIMITS -1.00000000E+37 1.00000000E+37
 /begin AXIS_DESCR STD_AXIS ASMod_rRelPosECB Prc_fl 3 0.00 100.000000 FORMAT "%10.6" EXTENDED_LIMITS -1.00000000E+37 1.00000000E+37 DEPOSIT ABSOLUTE /end AXIS_DESCR
/end CHARACTERISTIC
/begin CHARACTERISTIC ASMod_facSOICorTDiff_CUR "Korrekturfaktor der Temperaturerhöhung aufgrund des aktuellen Spritzbeginns" CURVE 0x1C81B8 Kl_Xs16_Ws16 2.000000 Fact 0.00 2.000000 FORMAT "%8.6" EXTENDED_LIMITS -4.000000 3.999878
 /begin AXIS_DESCR STD_AXIS InjCrv_phiMI1Des AngleCrS 8 -19.99219 19.99219 FORMAT "%8.5" EXTENDED_LIMITS -768.0000 767.9766 DEPOSIT ABSOLUTE /end AXIS_DESCR
/end CHARACTERISTIC
/begin CHARACTERISTIC ASMod_facTCorVolEff_C "Korrekturfaktor zur Kompensation der Abhängigkeit des Luftaufwands von der Gastemperatur vor Einlass" VALUE 0x1C8558 Kw_Ws16 2.000000 RatAirMass 0.00 2.000000 FORMAT "%8.6" EXTENDED_LIMITS -327.6800 327.6700 /end CHARACTERISTIC
/begin CHARACTERISTIC ASMod_facTurb10_C "Koeffizient 10 zur Berechnung des Turbinendruckverhältnisses, abhängig von Abgasmassenstrom" VALUE 0x1C84F0 Kw_Wr32 1500.00000 AirmassPerTime_float 0.00 1500.00000 FORMAT "%10.5" EXTENDED_LIMITS -1.00000000E+37 1.00000000E+37 /end CHARACTERISTIC
/begin CHARACTERISTIC ASMod_facTurb11_C "Koeffizient 11 zur Berechnung des Turbinendruckverhältnisses, abhängig vom Abgasmassenstrom" VALUE 0x1C84F4 Kw_Wr32 1999.00000 AirmassPerTime_float 1.00000000 2000.00000 FORMAT "%10.5" EXTENDED_LIMITS -1.00000000E+37 1.00000000E+37 /end CHARACTERISTIC
/begin CHARACTERISTIC ASMod_facTurb20_C "Koeffizient 20 zur Berechnung des Turbinendruckverhältnisses, abhängig von der Position des Ladedruckstellers" VALUE 0x1C84F8 Kw_Wr32 100.000000 Prc_fl 0.00 100.000000 FORMAT "%10.6" EXTENDED_LIMITS -1.00000000E+37 1.00000000E+37 /end CHARACTERISTIC
/begin CHARACTERISTIC ASMod_facTurb21_C "Koeffizient 21 zur Berechnung des Turbinendruckstellers, abhängig von der Position des Ladedruckstellers" VALUE 0x1C84FC Kw_Wr32 200.000000 Prc_fl 0.00 200.000000 FORMAT "%10.6" EXTENDED_LIMITS -1.00000000E+37 1.00000000E+37 /end CHARACTERISTIC
/begin CHARACTERISTIC ASMod_facTurb30_C "Koeffizient 30 zur Berechnung des Turbinendruckverhältnisses, abhängig von der Turbinendrehzahl" VALUE 0x1C8500 Kw_Wr32 600000.000 TrbChN_float -300000.000 300000.000 FORMAT "%10.3" EXTENDED_LIMITS -1.00000000E+37 1.00000000E+37 /end CHARACTERISTIC
/begin CHARACTERISTIC ASMod_facTurb31_C "Koeffizient 31 zur Berechnung des Turbinendruckverhältnisses, abhängig von der Turbinendrehzahl" VALUE 0x1C8504 Kw_Wr32 600000.000 TrbChN_float -300000.000 300000.000 FORMAT "%10.3" EXTENDED_LIMITS -1.00000000E+37 1.00000000E+37 /end CHARACTERISTIC
/begin CHARACTERISTIC ASMod_facTurb40_C "Koeffizient 40 zur Berechnung desTurbinendruckverhältnisses" VALUE 0x1C8508 Kw_Wr32 2000000.00 OneToOne -1000000.00 1000000.00 FORMAT "%10.2" EXTENDED_LIMITS -1.00000000E+37 1.00000000E+37 /end CHARACTERISTIC
/begin CHARACTERISTIC ASMod_facTurb410_C "Koeffizient 410 zur Berechnung des Turbinendruckverhältnisses" VALUE 0x1C850C Kw_Wr32 2000000.00 OneToOne -1000000.00 1000000.00 FORMAT "%10.2" EXTENDED_LIMITS -1.00000000E+37 1.00000000E+37 /end CHARACTERISTIC
/begin CHARACTERISTIC ASMod_facTurb411_C "Koeffizient 411 zur Berechnung des Turbinendruckverhältnisses" VALUE 0x1C8510 Kw_Wr32 2000000.00 OneToOne -1000000.00 1000000.00 FORMAT "%10.2" EXTENDED_LIMITS -1.00000000E+37 1.00000000E+37 /end CHARACTERISTIC
/begin CHARACTERISTIC ASMod_facTurb412_C "Koeffizient 412 zur Berechnung des Turbinendruckverhältnisses" VALUE 0x1C8514 Kw_Wr32 2000000.00 OneToOne -1000000.00 1000000.00 FORMAT "%10.2" EXTENDED_LIMITS -1.00000000E+37 1.00000000E+37 /end CHARACTERISTIC
/begin CHARACTERISTIC ASMod_facTurb413_C "Koeffizient 413 zur Berechnung des Turbinendruckverhältnisses" VALUE 0x1C8518 Kw_Wr32 2000000.00 OneToOne -1000000.00 1000000.00 FORMAT "%10.2" EXTENDED_LIMITS -1.00000000E+37 1.00000000E+37 /end CHARACTERISTIC
/begin CHARACTERISTIC ASMod_facTurb41_C "Koeffizient 41 zur Berechnung des Turbinendruckverhältnisses" VALUE 0x1C851C Kw_Wr32 2000000.00 OneToOne -1000000.00 1000000.00 FORMAT "%10.2" EXTENDED_LIMITS -1.00000000E+37 1.00000000E+37 /end CHARACTERISTIC
/begin CHARACTERISTIC ASMod_facTurb42_C "Koeffizient 42 zur Berechnung des Turbinendruckverhältnisses" VALUE 0x1C8520 Kw_Wr32 2000000.00 OneToOne -1000000.00 1000000.00 FORMAT "%10.2" EXTENDED_LIMITS -1.00000000E+37 1.00000000E+37 /end CHARACTERISTIC
/begin CHARACTERISTIC ASMod_facTurb43_C "Koeffizient 43 zur Berechnung des Turbinendruckverhältnisses" VALUE 0x1C8524 Kw_Wr32 2000000.00 OneToOne -1000000.00 1000000.00 FORMAT "%10.2" EXTENDED_LIMITS -1.00000000E+37 1.00000000E+37 /end CHARACTERISTIC
/begin CHARACTERISTIC ASMod_facTurb44_C "Koeffizient 44 zur Berechnung des Turbinendruckverhältnisses" VALUE 0x1C8528 Kw_Wr32 2000000.00 OneToOne -1000000.00 1000000.00 FORMAT "%10.2" EXTENDED_LIMITS -1.00000000E+37 1.00000000E+37 /end CHARACTERISTIC
/begin CHARACTERISTIC ASMod_facTurb45_C "Koeffizient 45 zur Berechnung des Turbinendruckverhältnisses" VALUE 0x1C852C Kw_Wr32 2000000.00 OneToOne -1000000.00 1000000.00 FORMAT "%10.2" EXTENDED_LIMITS -1.00000000E+37 1.00000000E+37 /end CHARACTERISTIC
/begin CHARACTERISTIC ASMod_facTurb46_C "Koeffizient 46 zur Berechnung des Turbinendruckverhältnisses" VALUE 0x1C8530 Kw_Wr32 2000000.00 OneToOne -1000000.00 1000000.00 FORMAT "%10.2" EXTENDED_LIMITS -1.00000000E+37 1.00000000E+37 /end CHARACTERISTIC
/begin CHARACTERISTIC ASMod_facTurb47_C "Koeffizient 47 zur Berechnung des Turbinendruckverhältnisses" VALUE 0x1C8534 Kw_Wr32 2000000.00 OneToOne -1000000.00 1000000.00 FORMAT "%10.2" EXTENDED_LIMITS -1.00000000E+37 1.00000000E+37 /end CHARACTERISTIC
/begin CHARACTERISTIC ASMod_facTurb48_C "Koeffizient 48 zur Berechnung des Turbinendruckverhältnisses" VALUE 0x1C8538 Kw_Wr32 2000000.00 OneToOne -1000000.00 1000000.00 FORMAT "%10.2" EXTENDED_LIMITS -1.00000000E+37 1.00000000E+37 /end CHARACTERISTIC
/begin CHARACTERISTIC ASMod_facTurb49_C "Koeffizient 49 zur Berechnung des Turbinendruckverhältnisses" VALUE 0x1C853C Kw_Wr32 2000000.00 OneToOne -1000000.00 1000000.00 FORMAT "%10.2" EXTENDED_LIMITS -1.00000000E+37 1.00000000E+37 /end CHARACTERISTIC
/begin CHARACTERISTIC ASMod_facVolEffCorMax_C "obere Begrenzung des PI-Reglers PI_VolEffCor" VALUE 0x1C84AC Kw_Ws16 2.000000 Fact 0.00 2.000000 FORMAT "%8.6" EXTENDED_LIMITS -4.000000 3.999878 /end CHARACTERISTIC
/begin CHARACTERISTIC ASMod_facVolEffCorMin_C "untere Begrenzung des PI-Reglers PI_VolEffCor" VALUE 0x1C84AE Kw_Ws16 2.000000 Fact 0.00 2.000000 FORMAT "%8.6" EXTENDED_LIMITS -4.000000 3.999878 /end CHARACTERISTIC
/begin CHARACTERISTIC ASMod_facVolEff_MAP "Luftaufwand des Motors als Funktion von Drehzahl und aktueller Einspritzmenge" MAP 0x1C855A Kf_Xs16_Ys16_Ws16 1.000000 RatAirMass 0.00 1.000000 FORMAT "%8.6" EXTENDED_LIMITS -327.6800 327.6700
 /begin AXIS_DESCR STD_AXIS Eng_nAvrg EngN 10 0.00 6000.000 FORMAT "%8.3" EXTENDED_LIMITS -32768.00 32767.00 DEPOSIT ABSOLUTE /end AXIS_DESCR
 /begin AXIS_DESCR STD_AXIS InjCtl_qCurr InjMass 10 0.00 327.6700 FORMAT "%8.4" EXTENDED_LIMITS -327.6800 327.6700 DEPOSIT ABSOLUTE /end AXIS_DESCR
/end CHARACTERISTIC
/begin CHARACTERISTIC ASMod_facVSACorVolEff_MAP "Korrekturfaktor für Luftaufwand als Funktion von Drehzahl und relativer Drallklappenposition" MAP 0x1C864E Kf_Xs16_Ys16_Ws16 2.000000 RatAirMass 0.00 2.000000 FORMAT "%8.6" EXTENDED_LIMITS -327.6800 327.6700
 /begin AXIS_DESCR STD_AXIS Eng_nAvrg EngN 10 0.00 6000.000 FORMAT "%8.3" EXTENDED_LIMITS -32768.00 32767.00 DEPOSIT ABSOLUTE /end AXIS_DESCR
 /begin AXIS_DESCR STD_AXIS ASMod_rRelPosVSA Prc 10 0.00 100.0000 FORMAT "%8.4" EXTENDED_LIMITS -327.6800 327.6700 DEPOSIT ABSOLUTE /end AXIS_DESCR
/end CHARACTERISTIC
/begin CHARACTERISTIC ASMod_tiTIndAirUpPT1_C "Zeitkonstante der PT1-Filterung bei positiver Temperaturänderung des Gasmassenstroms in den Motor" VALUE 0x1C846C Kw_Wr32 0.500000000 Time_s_float 0.00 0.500000000 FORMAT "%11.9" EXTENDED_LIMITS -1.00000000E+37 1.00000000E+37 /end CHARACTERISTIC
/begin CHARACTERISTIC ASMod_tiTIndAirDwnPT1_C "Zeitkonstante der PT1-Filterung bei negativer Temperaturänderung des Gasmassenstroms in den Motor" VALUE 0x1C8470 Kw_Wr32 0.500000000 Time_s_float 0.00 0.500000000 FORMAT "%11.9" EXTENDED_LIMITS -1.00000000E+37 1.00000000E+37 /end CHARACTERISTIC
/begin CHARACTERISTIC ASMod_mIndVolMin_C "unterer Grenzwert für die Gasmasse im Einlassvolumen" VALUE 0x1C83B8 Kw_Wr32 149.500000 Airmass_float 0.500000000 150.000000 FORMAT "%10.6" EXTENDED_LIMITS -1.00000000E+37 1.00000000E+37 /end CHARACTERISTIC
/begin CHARACTERISTIC ASMod_mIntMnfMin_C "unterer Grenzwert für die Gasmasse im Einlasskrümmer" VALUE 0x1C8474 Kw_Wr32 10.0000000 Airmass_float 0.00 10.0000000 FORMAT "%10.7" EXTENDED_LIMITS -1.00000000E+37 1.00000000E+37 /end CHARACTERISTIC
/begin CHARACTERISTIC ASMod_mO2IntMnfMin_C "unterer Grenzwert für Sauerstoffmasse im Einlasskrümmer" VALUE 0x1C8478 Kw_Wr32 3.00000000 Airmass_float 0.00 3.00000000 FORMAT "%10.8" EXTENDED_LIMITS -1.00000000E+37 1.00000000E+37 /end CHARACTERISTIC
/begin CHARACTERISTIC ASMod_nObsvrOffMax_C "obere Hysterese-Schwelle der Drehzahl für Adaption aus" VALUE 0x1C84B0 Kw_Ws16 6000.000 EngN 0.00 6000.000 FORMAT "%8.3" EXTENDED_LIMITS -32768.00 32767.00 /end CHARACTERISTIC
/begin CHARACTERISTIC ASMod_nObsvrOffMin_C "untere Hysterese-Schwelle der Drehzahl für Adaption aus" VALUE 0x1C84B2 Kw_Ws16 6000.000 EngN 0.00 6000.000 FORMAT "%8.3" EXTENDED_LIMITS -32768.00 32767.00 /end CHARACTERISTIC
/begin CHARACTERISTIC ASMod_nObsvrOnMax_C "obere Hysterese-Schwelle der Drehzahl für Adaption ein" VALUE 0x1C84B4 Kw_Ws16 6000.000 EngN 0.00 6000.000 FORMAT "%8.3" EXTENDED_LIMITS -32768.00 32767.00 /end CHARACTERISTIC
/begin CHARACTERISTIC ASMod_nObsvrOnMin_C "untere Hysterese-Schwelle der Drehzahl für Adaption ein" VALUE 0x1C84B6 Kw_Ws16 6000.000 EngN 0.00 6000.000 FORMAT "%8.3" EXTENDED_LIMITS -32768.00 32767.00 /end CHARACTERISTIC
/begin CHARACTERISTIC ASMod_nTrbChRed_MAP "Verdichterkennfeld als Funktion des reduzierten Luftmassenstroms und des Verdichterdruckverhältnisses" MAP 0x1C78D0 Kf_Xr32_Yr32_Wr32 300000.000 TrbChN_float 0.00 300000.000 FORMAT "%10.3" EXTENDED_LIMITS -1.00000000E+37 1.00000000E+37
 /begin AXIS_DESCR STD_AXIS ASMod_rPresCmpr_mp OneToOne 16 0.00 4.00000000 FORMAT "%10.8" EXTENDED_LIMITS -1.00000000E+37 1.00000000E+37 DEPOSIT ABSOLUTE /end AXIS_DESCR
 /begin AXIS_DESCR STD_AXIS ASMod_dmAirPerTimeRed_mp AirmassPerTime_float 16 0.00 1400.00000 FORMAT "%10.5" EXTENDED_LIMITS -1.00000000E+37 1.00000000E+37 DEPOSIT ABSOLUTE /end AXIS_DESCR
/end CHARACTERISTIC
/begin CHARACTERISTIC ASMod_ObsvrArEffKi_C "I-Verstärkung des PI-Reglers PI_ArEffCor" VALUE 0x1C84B8 Kw_Wu32 0.999999997475 Ki_Pres_hPa2Fact 0.00 0.999999997475 FORMAT "%13.11" EXTENDED_LIMITS 0.00 122.070312472 /end CHARACTERISTIC
/begin CHARACTERISTIC ASMod_ObsvrArEffKp_C "P-Verstärkung des PI-Reglers PI_ArEffCor" VALUE 0x1C84BC Kw_Wu32 1.00000000000 Kp_Pres_hPa2Fact 0.00 1.00000000000 FORMAT "%13.11" EXTENDED_LIMITS 0.00 7.99999999814 /end CHARACTERISTIC
/begin CHARACTERISTIC ASMod_ObsvrVolEffKi_C "I-Verstärkung des PI-Reglers PI_VolEffCor" VALUE 0x1C84C0 Kw_Wu32 0.999999997475 Ki_Pres_hPa2Fact 0.00 0.999999997475 FORMAT "%13.11" EXTENDED_LIMITS 0.00 122.070312472 /end CHARACTERISTIC
/begin CHARACTERISTIC ASMod_ObsvrVolEffKp_C "P-Verstärkung des PI-Reglers PI_VolEffCor" VALUE 0x1C84C4 Kw_Wu32 1.00000000000 Kp_Pres_hPa2Fact 0.00 1.00000000000 FORMAT "%13.11" EXTENDED_LIMITS 0.00 7.99999999814 /end CHARACTERISTIC
/begin CHARACTERISTIC ASMod_pCmprPreRef_C "Referenz des Atmosphärendrucks" VALUE 0x1C7D60 Kw_Wr32 4000.00000 Pres_hPa_float 0.00 4000.00000 FORMAT "%10.5" EXTENDED_LIMITS -1.00000000E+37 1.00000000E+37 /end CHARACTERISTIC
/begin CHARACTERISTIC ASMod_pDiffEGPipe_CUR "Druckabfall nach Turbine ohne Druckabfall durch Abgasnachbehandlung" CURVE 0x1C7F34 Kl_Xr32_Wr32 1000.00000 Pres_hPa_float 0.00 1000.00000 FORMAT "%10.5" EXTENDED_LIMITS -1.00000000E+37 1.00000000E+37
 /begin AXIS_DESCR STD_AXIS ASMod_dmEGPipeRed_mp AirmassPerTimeRed_float 8 0.00 50000.0000 FORMAT "%10.4" EXTENDED_LIMITS -1.00000000E+37 1.00000000E+37 DEPOSIT ABSOLUTE /end AXIS_DESCR
/end CHARACTERISTIC
/begin CHARACTERISTIC ASMod_phiSOIRef_MAP "Referenz des Spritzbeginns der MI1 als Funktion der Dehzahl und der verbrannten Kraftstoffmenge" MAP 0x1C81DA Kf_Xs16_Ys16_Ws16 60.00000 AngleCrS -19.99219 40.00781 FORMAT "%8.5" EXTENDED_LIMITS -768.0000 767.9766
 /begin AXIS_DESCR STD_AXIS Eng_nAvrg EngN 8 0.00 6000.000 FORMAT "%8.3" EXTENDED_LIMITS -32768.00 32767.00 DEPOSIT ABSOLUTE /end AXIS_DESCR
 /begin AXIS_DESCR STD_AXIS ASMod_qLmbdCtlCorr_mp InjMass 8 0.00 150.0000 FORMAT "%8.4" EXTENDED_LIMITS -327.6800 327.6700 DEPOSIT ABSOLUTE /end AXIS_DESCR
/end CHARACTERISTIC
/begin CHARACTERISTIC ASMod_pIntMnfMin_C "unterer Grenzwert für Druck im Einlasskrümmer" VALUE 0x1C847C Kw_Wr32 1000.00000 Pres_hPa_float 0.00 1000.00000 FORMAT "%10.5" EXTENDED_LIMITS -1.00000000E+37 1.00000000E+37 /end CHARACTERISTIC
/begin CHARACTERISTIC ASMod_pTurbMax_C "obere Begrenzung des Drucks vor Turbine" VALUE 0x1C8540 Kw_Wr32 6000.00000 Pres_hPa_float 0.00 6000.00000 FORMAT "%10.5" EXTENDED_LIMITS -1.00000000E+37 1.00000000E+37 /end CHARACTERISTIC
/begin CHARACTERISTIC ASMod_pTurbMin_C "untere Begrenzung des Drucks vor Turbine" VALUE 0x1C8544 Kw_Wr32 4000.00000 Pres_hPa_float 0.00 4000.00000 FORMAT "%10.5" EXTENDED_LIMITS -1.00000000E+37 1.00000000E+37 /end CHARACTERISTIC
/begin CHARACTERISTIC ASMod_pTurbPstRef_C "Referenz des Drucks nach Turbine" VALUE 0x1C8548 Kw_Wr32 6000.00000 Pres_hPa_float 0.00 6000.00000 FORMAT "%10.5" EXTENDED_LIMITS -1.00000000E+37 1.00000000E+37 /end CHARACTERISTIC
/begin CHARACTERISTIC ASMod_qObsvrOffMax_C "obere Hysterese-Schwelle der Menge für Adaption aus" VALUE 0x1C84C8 Kw_Ws16 100.0000 InjMass 0.00 100.0000 FORMAT "%8.4" EXTENDED_LIMITS -327.6800 327.6700 /end CHARACTERISTIC
/begin CHARACTERISTIC ASMod_qObsvrOffMin_C "untere Hysterese-Schwelle der Menge für Adaption aus" VALUE 0x1C84CA Kw_Ws16 100.0000 InjMass 0.00 100.0000 FORMAT "%8.4" EXTENDED_LIMITS -327.6800 327.6700 /end CHARACTERISTIC
/begin CHARACTERISTIC ASMod_qObsvrOnMax_C "obere Hysterese-Schwelle der Menge für Adaption ein" VALUE 0x1C84CC Kw_Ws16 100.0000 InjMass 0.00 100.0000 FORMAT "%8.4" EXTENDED_LIMITS -327.6800 327.6700 /end CHARACTERISTIC
/begin CHARACTERISTIC ASMod_qObsvrOnMin_C "untere Hysterese-Schwelle der Menge für Adaption ein" VALUE 0x1C84CE Kw_Ws16 100.0000 InjMass 0.00 100.0000 FORMAT "%8.4" EXTENDED_LIMITS -327.6800 327.6700 /end CHARACTERISTIC
/begin CHARACTERISTIC ASMod_rBPALin_CUR "Linearisierungskennlinie für den Ladedrucksteller" CURVE 0x1C7E38 Kl_Xs16_Ws16 100.0000 Prc 0.00 100.0000 FORMAT "%8.4" EXTENDED_LIMITS -327.6800 327.6700
 /begin AXIS_DESCR STD_AXIS BPASCD_rRelPos Prc 8 0.00 100.0000 FORMAT "%8.4" EXTENDED_LIMITS -327.6800 327.6700 DEPOSIT ABSOLUTE /end AXIS_DESCR
/end CHARACTERISTIC
/begin CHARACTERISTIC ASMod_rEGRLin_CUR "Linearisierungskennlinie für den ARF-Ventilsteller" CURVE 0x1C7E5A Kl_Xs16_Ws16 100.0000 Prc 0.00 100.0000 FORMAT "%8.4" EXTENDED_LIMITS -327.6800 327.6700
 /begin AXIS_DESCR STD_AXIS EGRSCD_rRelPos DtyCyc 8 0.00 100.0000 FORMAT "%8.4" EXTENDED_LIMITS -327.6800 327.6700 DEPOSIT ABSOLUTE /end AXIS_DESCR
/end CHARACTERISTIC
/begin CHARACTERISTIC ASMod_tiRelPosBPAUpPT1_C "Zeitkonstante der PT1-Filterung bei positiver Positionsänderung des Ladedruckstellers" VALUE 0x1C7E7C Kw_Wr32 1.00000000 Time_s_float 0.00 1.00000000 FORMAT "%10.8" EXTENDED_LIMITS -1.00000000E+37 1.00000000E+37 /end CHARACTERISTIC
/begin CHARACTERISTIC ASMod_tiRelPosBPADwnPT1_C "Zeitkonstante der PT1-Filterung bei negativer Positionsänderung des Ladedruckstellers" VALUE 0x1C7E80 Kw_Wr32 1.00000000 Time_s_float 0.00 1.00000000 FORMAT "%10.8" EXTENDED_LIMITS -1.00000000E+37 1.00000000E+37 /end CHARACTERISTIC
/begin CHARACTERISTIC ASMod_tiRelPosECBUpPT1_C "Zeitkonstante der PT1-Filterung bei positiver Positionsänderung des Stellers für den ARF-Kühler-Bypass" VALUE 0x1C7E84 Kw_Wr32 1.00000000 Time_s_float 0.00 1.00000000 FORMAT "%10.8" EXTENDED_LIMITS -1.00000000E+37 1.00000000E+37 /end CHARACTERISTIC
/begin CHARACTERISTIC ASMod_tiRelPosECBDwnPT1_C "Zeitkonstante der PT1-Filterung bei negativer Positionsänderung des Stellers für den ARF-Kühler-Bypass" VALUE 0x1C7E88 Kw_Wr32 1.00000000 Time_s_float 0.00 1.00000000 FORMAT "%10.8" EXTENDED_LIMITS -1.00000000E+37 1.00000000E+37 /end CHARACTERISTIC
/begin CHARACTERISTIC ASMod_tiRelPosEGRUpPT1_C "Zeitkonstante der PT1-Filterung bei positiver Positionsänderung des ARF-Ventils" VALUE 0x1C7E8C Kw_Wr32 1.00000000 Time_s_float 0.00 1.00000000 FORMAT "%10.8" EXTENDED_LIMITS -1.00000000E+37 1.00000000E+37 /end CHARACTERISTIC
/begin CHARACTERISTIC ASMod_tiRelPosEGRDwnPT1_C "Zeitkonstante der PT1-Filterung bei negativer Positionsänderung des ARF-Ventils" VALUE 0x1C7E90 Kw_Wr32 1.00000000 Time_s_float 0.00 1.00000000 FORMAT "%10.8" EXTENDED_LIMITS -1.00000000E+37 1.00000000E+37 /end CHARACTERISTIC
/begin CHARACTERISTIC ASMod_tiRelPosTVAUpPT1_C "Zeitkonstante der PT1-Filterung bei positiver Positionsänderung des Regelklappenstellers" VALUE 0x1C7E94 Kw_Wr32 1.00000000 Time_s_float 0.00 1.00000000 FORMAT "%10.8" EXTENDED_LIMITS -1.00000000E+37 1.00000000E+37 /end CHARACTERISTIC
/begin CHARACTERISTIC ASMod_tiRelPosTVADwnPT1_C "Zeitkonstante der PT1-Filterung bei negativer Positionsänderung des Regelklappenstellers" VALUE 0x1C7E98 Kw_Wr32 1.00000000 Time_s_float 0.00 1.00000000 FORMAT "%10.8" EXTENDED_LIMITS -1.00000000E+37 1.00000000E+37 /end CHARACTERISTIC
/begin CHARACTERISTIC ASMod_tiRelPosVSAUpPT1_C "Zeitkonstante der PT1-Filterung bei positiver Positionsänderung des Drallklappenstellers" VALUE 0x1C7E9C Kw_Wr32 1.00000000 Time_s_float 0.00 1.00000000 FORMAT "%10.8" EXTENDED_LIMITS -1.00000000E+37 1.00000000E+37 /end CHARACTERISTIC
/begin CHARACTERISTIC ASMod_tiRelPosVSADwnPT1_C "Zeitkonstante der PT1-Filterung bei negativer Positionsänderung des Drallklappenstellers" VALUE 0x1C7EA0 Kw_Wr32 1.00000000 Time_s_float 0.00 1.00000000 FORMAT "%10.8" EXTENDED_LIMITS -1.00000000E+37 1.00000000E+37 /end CHARACTERISTIC
/begin CHARACTERISTIC ASMod_rHysThresBPA_C "Hystereseschwelle für den Ladedrucksteller" VALUE 0x1C7EA4 Kw_Wr32 100.000000 OneToOne 0.00 100.000000 FORMAT "%10.6" EXTENDED_LIMITS -1.00000000E+37 1.00000000E+37 /end CHARACTERISTIC
/begin CHARACTERISTIC ASMod_rRelPosThresMax_C "obere relative Position des Abgasrückführventils zur Erkennung Ventil geschlossen" VALUE 0x1C84D0 Kw_Wr32 100.000000 Prc_fl 0.00 100.000000 FORMAT "%10.6" EXTENDED_LIMITS -1.00000000E+37 1.00000000E+37 /end CHARACTERISTIC
/begin CHARACTERISTIC ASMod_rRelPosThresMin_C "untere relative Position des Abgasrückführventils zur Erkennung Ventil geschlossen" VALUE 0x1C84D4 Kw_Wr32 100.000000 Prc_fl 0.00 100.000000 FORMAT "%10.6" EXTENDED_LIMITS -1.00000000E+37 1.00000000E+37 /end CHARACTERISTIC
/begin CHARACTERISTIC ASMod_rTDiffTurbAdbt_CUR "relative Temperaturänderung in der Turbine bei adiabater Zustandsänderung" CURVE 0x1C7F7C Kl_Xr32_Wr32 2.00000000 OneToOne 0.00 2.00000000 FORMAT "%10.8" EXTENDED_LIMITS -1.00000000E+37 1.00000000E+37
 /begin AXIS_DESCR STD_AXIS ASMod_rPresEGPipe_mp OneToOne 8 1.00000000 5.00000000 FORMAT "%10.8" EXTENDED_LIMITS -1.00000000E+37 1.00000000E+37 DEPOSIT ABSOLUTE /end AXIS_DESCR
/end CHARACTERISTIC
/begin CHARACTERISTIC ASMod_rTVALin_CUR "Linearisierungskennlinie für den Regelklappensteller" CURVE 0x1C7EA8 Kl_Xs16_Ws16 100.0000 Prc 0.00 100.0000 FORMAT "%8.4" EXTENDED_LIMITS -327.6800 327.6700
 /begin AXIS_DESCR STD_AXIS AirCtl_rTVA Prc 8 0.00 100.0000 FORMAT "%8.4" EXTENDED_LIMITS -327.6800 327.6700 DEPOSIT ABSOLUTE /end AXIS_DESCR
/end CHARACTERISTIC
/begin CHARACTERISTIC ASMod_rVSALin_CUR "Linearisierungskennlinie für den Drallklappensteller" CURVE 0x1C7ECA Kl_Xs16_Ws16 100.0000 Prc 0.00 100.0000 FORMAT "%8.4" EXTENDED_LIMITS -327.6800 327.6700
 /begin AXIS_DESCR STD_AXIS IndSys_rVSA DtyCyc 8 0.00 100.0000 FORMAT "%8.4" EXTENDED_LIMITS -327.6800 327.6700 DEPOSIT ABSOLUTE /end AXIS_DESCR
/end CHARACTERISTIC
/begin CHARACTERISTIC ASMod_swtClrFacArEff_C "SW-Schalter zur Initialisierung des Korrekturfaktors des effektiven Querschnitts des Abgasrückführventils" VALUE 0x1C84D8 Kw_Wu8 1.000 OneToOne 0.00 1.000 FORMAT "%5.3" EXTENDED_LIMITS 0.00 255.0 /end CHARACTERISTIC
/begin CHARACTERISTIC ASMod_swtClrFacVolEff_C "SW-Schalter zur Initialisierung des Korrekturfaktors des Luftwands" VALUE 0x1C84D9 Kw_Wu8 1.000 OneToOne 0.00 1.000 FORMAT "%5.3" EXTENDED_LIMITS 0.00 255.0 /end CHARACTERISTIC
/begin CHARACTERISTIC ASMod_swtOnObsvrPIndVol_C "SW-Schalter zur Aktivierung der Beobachterfunktion" VALUE 0x1C84DA Kw_Wu8 1.000 OneToOne 0.00 1.000 FORMAT "%5.3" EXTENDED_LIMITS 0.00 255.0 /end CHARACTERISTIC
/begin CHARACTERISTIC ASMod_swtTempAirMod_C "Umschalter für Umgebungstemperaturmodell" VALUE 0x1C7D64 Kw_Ws16 1.000000 OneToOne 0.00 1.000000 FORMAT "%8.6" EXTENDED_LIMITS -32768.00 32767.00 /end CHARACTERISTIC
/begin CHARACTERISTIC ASMod_tAirCorr_MAP "Korrekturwert als Funktion von Ansauglufttemperatur [K]" MAP 0x1C7D66 Kf_Xs16_Ys16_Ws16 250.0000 Temp_Cels -50.14000 199.8600 FORMAT "%8.4" EXTENDED_LIMITS -3549.940 3003.560
 /begin AXIS_DESCR STD_AXIS IATSCD_tAir Temp_Cels 8 -50.14000 199.8600 FORMAT "%8.4" EXTENDED_LIMITS -3549.940 3003.560 DEPOSIT ABSOLUTE /end AXIS_DESCR
 /begin AXIS_DESCR STD_AXIS BPSCD_pLin Pres_hPa 8 0.00 3500.000 FORMAT "%8.3" EXTENDED_LIMITS -32768.00 32767.00 DEPOSIT ABSOLUTE /end AXIS_DESCR
/end CHARACTERISTIC
/begin CHARACTERISTIC ASMod_tClntMod_CUR "Wassertemperatureinfluss im Umgebungstemperaturmodell" CURVE 0x1C7E0A Kl_Xs16_Ws16 250.0000 Temp_Cels -50.14000 199.8600 FORMAT "%8.4" EXTENDED_LIMITS -3549.940 3003.560
 /begin AXIS_DESCR STD_AXIS ASMod_tClntPT1_mp Temp_Cels 8 -50.14000 149.8600 FORMAT "%8.4" EXTENDED_LIMITS -3549.940 3003.560 DEPOSIT ABSOLUTE /end AXIS_DESCR
/end CHARACTERISTIC
/begin CHARACTERISTIC ASMod_tCmprPreRef_C "Referenz des Umgebungstemperatur" VALUE 0x1C7E2C Kw_Wr32 250.000000 TempC_float -50.0000000 200.000000 FORMAT "%10.6" EXTENDED_LIMITS -1.00000000E+37 1.00000000E+37 /end CHARACTERISTIC
/begin CHARACTERISTIC ASMod_tDiffEng_MAP "Grundkennfeld der Temperaturerhöhung als Funktion der Drehzahl und der verbrannten Kraftstoffmenge" MAP 0x1C827E Kf_Xs16_Ys16_Ws16 1200.000 TempDiff_Kelv -600.0000 600.0000 FORMAT "%8.4" EXTENDED_LIMITS -3276.800 3276.700
 /begin AXIS_DESCR STD_AXIS Eng_nAvrg EngN 8 0.00 6000.000 FORMAT "%8.3" EXTENDED_LIMITS -32768.00 32767.00 DEPOSIT ABSOLUTE /end AXIS_DESCR
 /begin AXIS_DESCR STD_AXIS ASMod_qBurned_mp InjMass 8 0.00 150.0000 FORMAT "%8.4" EXTENDED_LIMITS -327.6800 327.6700 DEPOSIT ABSOLUTE /end AXIS_DESCR
/end CHARACTERISTIC
/begin CHARACTERISTIC ASMod_tEGRPstMin_C "untere Begrenzung der Temperatur des rückgeführten Abgases" VALUE 0x1C80E4 Kw_Wr32 350.000000 TempC_float -50.0000000 300.000000 FORMAT "%10.6" EXTENDED_LIMITS -1.00000000E+37 1.00000000E+37 /end CHARACTERISTIC
/begin CHARACTERISTIC ASMod_tiTEGRPstUpPT1_C "Zeitkonstante des PT1-Filter für positive Temperaturänderungen des rückgeführten Abgases" VALUE 0x1C80E8 Kw_Wr32 1.00000000 Time_s_float 0.00 1.00000000 FORMAT "%10.8" EXTENDED_LIMITS -1.00000000E+37 1.00000000E+37 /end CHARACTERISTIC
/begin CHARACTERISTIC ASMod_tiTEGRPstDwnPT1_C "Zeitkonstante des PT1-Filter für negative Temperaturänderungen des rückgeführten Abgases" VALUE 0x1C80EC Kw_Wr32 1.00000000 Time_s_float 0.00 1.00000000 FORMAT "%10.8" EXTENDED_LIMITS -1.00000000E+37 1.00000000E+37 /end CHARACTERISTIC
/begin CHARACTERISTIC ASMod_tEngCorTDiff_CUR "Korrektur der Temperaturerhöhung aufgrund der Motortemperatur" CURVE 0x1C8322 Kl_Xs16_Ws16 1200.000 Temp_Kelv -600.0000 600.0000 FORMAT "%8.4" EXTENDED_LIMITS -3276.800 3276.700
 /begin AXIS_DESCR STD_AXIS ASMod_tEngCorTDiff_mp TempDiff_Kelv 8 -20.00000 120.0000 FORMAT "%8.4" EXTENDED_LIMITS -3276.800 3276.700 DEPOSIT ABSOLUTE /end AXIS_DESCR
/end CHARACTERISTIC
/begin CHARACTERISTIC ASMod_tEngRef_C "Referenz der Motoretemperatur" VALUE 0x1C8344 Kw_Ws16 250.0000 Temp_Cels -50.04000 199.9600 FORMAT "%8.4" EXTENDED_LIMITS -3549.940 3003.560 /end CHARACTERISTIC
/begin CHARACTERISTIC ASMod_tiDDMAirPerTimePT1_C "Zeitkonstante des PT1-Filters für die zeitliche Änderung des Luftmassenstroms" VALUE 0x1C84DC Kw_Wu32 1.9994505 TimeDelay_s 0.0010000001 2.0004505 FORMAT "%9.7" EXTENDED_LIMITS 0.0000010000000 4294.9673 /end CHARACTERISTIC
/begin CHARACTERISTIC ASMod_tiDelObsvrPIndVol_C "Verzögerungszeit zur Aktivierung der PI-Regler" VALUE 0x1C84E0 Kw_Wu16 2.000000 Time_s 0.00 2.000000 FORMAT "%8.6" EXTENDED_LIMITS 0.00 655.3500 /end CHARACTERISTIC
/begin CHARACTERISTIC ASMod_tiDMAirUpPT1_C "Zeitkonstante der PT1-Filterung bei negativer Änderung des Gasmassenstroms in den Motor" VALUE 0x1C83BC Kw_Wr32 0.500000000 Time_s_float 0.00 0.500000000 FORMAT "%11.9" EXTENDED_LIMITS -1.00000000E+37 1.00000000E+37 /end CHARACTERISTIC
/begin CHARACTERISTIC ASMod_tiDMAirDwnPT1_C "Zeitkonstante der PT1-Filterung bei positiver Änderung des Gasmassenstroms in den Motor" VALUE 0x1C83C0 Kw_Wr32 0.500000000 Time_s_float 0.00 0.500000000 FORMAT "%11.9" EXTENDED_LIMITS -1.00000000E+37 1.00000000E+37 /end CHARACTERISTIC
/begin CHARACTERISTIC ASMod_tiDNAvrgPT1_C "Zeitkonstante des PT1-Filters für die zeitliche Änderung der Motordrehzahl" VALUE 0x1C84E4 Kw_Wu32 1.9994505 TimeDelay_s 0.0010000001 2.0004505 FORMAT "%9.7" EXTENDED_LIMITS 0.0000010000000 4294.9673 /end CHARACTERISTIC
/begin CHARACTERISTIC ASMod_tiDPIntValPT1_C "Zeitkonstante des PT1-Filters für die zeitliche Änderung des Ladedrucks" VALUE 0x1C84E8 Kw_Wu32 1.9994505 TimeDelay_s 0.0010000001 2.0004505 FORMAT "%9.7" EXTENDED_LIMITS 0.0000010000000 4294.9673 /end CHARACTERISTIC
/begin CHARACTERISTIC ASMod_tiDQLmbdCtlPT1_C "Zeitkonstante des PT1-Filters für die zeitliche Änderung der Kraftstoffmenge" VALUE 0x1C84EC Kw_Wu32 1.9994505 TimeDelay_s 0.0010000001 2.0004505 FORMAT "%9.7" EXTENDED_LIMITS 0.0000010000000 4294.9673 /end CHARACTERISTIC
/begin CHARACTERISTIC ASMod_tIndAirRef_MAP "Referenz der Gastemperatur vor Einlass als Funktion von Drehzahl und aktueller Einspritzmenge" MAP 0x1C8742 Kf_Xs16_Ys16_Ws16 150.0000 Temp_Cels -50.04000 99.96000 FORMAT "%8.4" EXTENDED_LIMITS -3549.940 3003.560
 /begin AXIS_DESCR STD_AXIS Eng_nAvrg EngN 10 0.00 6000.000 FORMAT "%8.3" EXTENDED_LIMITS -32768.00 32767.00 DEPOSIT ABSOLUTE /end AXIS_DESCR
 /begin AXIS_DESCR STD_AXIS InjCtl_qCurr InjMass 10 0.00 327.6700 FORMAT "%8.4" EXTENDED_LIMITS -327.6800 327.6700 DEPOSIT ABSOLUTE /end AXIS_DESCR
/end CHARACTERISTIC
/begin CHARACTERISTIC ASMod_tiTempAirPT1_C "PT1 Filterzeitkonstante für Lufttemperatur Ansaugtrakt" VALUE 0x1C7E30 Kw_Wu32 4294.9673 TimeDelay_s 0.0000010000000 4294.9673 FORMAT "%9.4" /end CHARACTERISTIC
/begin CHARACTERISTIC ASMod_tiTempClntPT1_C "PT1 Filterzeitkonstante für Wassertemperatur" VALUE 0x1C7E34 Kw_Wu32 4294.9673 TimeDelay_s 0.0000010000000 4294.9673 FORMAT "%9.4" /end CHARACTERISTIC
/begin CHARACTERISTIC ASMod_tiTExhMnfPstUpPT1_C "Zeitkonstante des PT1-Filters für positive Abgastemperaturänderungen" VALUE 0x1C8348 Kw_Wr32 1.00000000 Time_s_float 0.00 1.00000000 FORMAT "%10.8" EXTENDED_LIMITS -1.00000000E+37 1.00000000E+37 /end CHARACTERISTIC
/begin CHARACTERISTIC ASMod_tiTExhMnfPstDwnPT1_C "Zeitkonstante des PT1-Filters für negative Abgastemperaturänderungen" VALUE 0x1C834C Kw_Wr32 1.00000000 Time_s_float 0.00 1.00000000 FORMAT "%10.8" EXTENDED_LIMITS -1.00000000E+37 1.00000000E+37 /end CHARACTERISTIC
/begin CHARACTERISTIC ASMod_tiPTurbPreUpPT1_C "Zeitkonstante des PT1-Filters für positive Druckänderungen" VALUE 0x1C854C Kw_Wr32 1.00000000 Time_s_float 0.00 1.00000000 FORMAT "%10.8" EXTENDED_LIMITS -1.00000000E+37 1.00000000E+37 /end CHARACTERISTIC
/begin CHARACTERISTIC ASMod_tiPTurbPreDwnPT1_C "Zeitkonstante des PT1-Filters für negative Druckänderungen" VALUE 0x1C8550 Kw_Wr32 1.00000000 Time_s_float 0.00 1.00000000 FORMAT "%10.8" EXTENDED_LIMITS -1.00000000E+37 1.00000000E+37 /end CHARACTERISTIC
/begin CHARACTERISTIC ASMod_tTurbPreRef_C "Referenz der Abgastemperatur vor Turbine" VALUE 0x1C8554 Kw_Wr32 1050.00000 TempC_float -50.0000000 1000.00000 FORMAT "%10.5" EXTENDED_LIMITS -1.00000000E+37 1.00000000E+37 /end CHARACTERISTIC
/begin CHARACTERISTIC ASMod_tTurbPstMin_C "Schwelle für minimale Abgastemperatur" VALUE 0x1C7FC4 Kw_Wr32 550.000000 TempC_float -50.0000000 500.000000 FORMAT "%10.6" EXTENDED_LIMITS -1.00000000E+37 1.00000000E+37 /end CHARACTERISTIC
/begin CHARACTERISTIC ASMod_volEng_C "Hubvolumen des Motors" VALUE 0x1C8836 Kw_Ws16 20.00000 Vol 0.00 20.00000 FORMAT "%8.5" EXTENDED_LIMITS -327.6800 327.6700 /end CHARACTERISTIC
/begin CHARACTERISTIC ASMod_volIndVol_C "Einlaßvolumen (effektives Volumen zwischen Turbolader und Mischstelle)" VALUE 0x1C83C4 Kw_Wr32 50.0000000 Vol_float 0.00 50.0000000 FORMAT "%10.7" EXTENDED_LIMITS -1.00000000E+37 1.00000000E+37 /end CHARACTERISTIC
/begin CHARACTERISTIC ASMod_volIntMnf_C "Volumen des Einlasskrümmers" VALUE 0x1C8480 Kw_Wr32 5.00000000 Vol_float 0.00 5.00000000 FORMAT "%10.8" EXTENDED_LIMITS -1.00000000E+37 1.00000000E+37 /end CHARACTERISTIC
/begin CHARACTERISTIC BasAdj_K2SigBlkVal0_MAP "Testeranzeige für Meßwertausgabe ohne Grundeinstellung  (Diagnose)" MAP 0x1C8838 Kf_Xs16_Ys16_Ws16 32766.00 OneToOne 0.00 32766.00 FORMAT "%8.2" EXTENDED_LIMITS -32768.00 32767.00
 /begin AXIS_DESCR STD_AXIS BasAdj_DispMode_mp OneToOne 5 0.00 4.000 FORMAT "%5.3" EXTENDED_LIMITS 0.00 255.0 DEPOSIT ABSOLUTE /end AXIS_DESCR
 /begin AXIS_DESCR STD_AXIS BasAdj_ActRout_mp OneToOne 10 0.00 11.00 FORMAT "%5.2" EXTENDED_LIMITS 0.00 255.0 DEPOSIT ABSOLUTE /end AXIS_DESCR
/end CHARACTERISTIC
/begin CHARACTERISTIC BasAdj_K2SigBlkVal1_MAP "Testeranzeige bei Meßwertausgabe mit Grundeinstellung für das Tastverhältnis 1  (Diagnose)" MAP 0x1C88BE Kf_Xs16_Ys16_Ws16 32766.00 OneToOne 0.00 32766.00 FORMAT "%8.2" EXTENDED_LIMITS -32768.00 32767.00
 /begin AXIS_DESCR STD_AXIS BasAdj_DispMode_mp OneToOne 5 0.00 4.000 FORMAT "%5.3" EXTENDED_LIMITS 0.00 255.0 DEPOSIT ABSOLUTE /end AXIS_DESCR
 /begin AXIS_DESCR STD_AXIS BasAdj_ActRout_mp OneToOne 10 0.00 11.00 FORMAT "%5.2" EXTENDED_LIMITS 0.00 255.0 DEPOSIT ABSOLUTE /end AXIS_DESCR
/end CHARACTERISTIC
/begin CHARACTERISTIC BasAdj_K2SigBlkVal2_MAP "Testeranzeige bei Meßwertausgabe mit Grundeinstellung für das Tastverhältnis 2  (Diagnose)" MAP 0x1C8944 Kf_Xs16_Ys16_Ws16 32766.00 OneToOne 0.00 32766.00 FORMAT "%8.2" EXTENDED_LIMITS -32768.00 32767.00
 /begin AXIS_DESCR STD_AXIS BasAdj_DispMode_mp OneToOne 5 0.00 4.000 FORMAT "%5.3" EXTENDED_LIMITS 0.00 255.0 DEPOSIT ABSOLUTE /end AXIS_DESCR
 /begin AXIS_DESCR STD_AXIS BasAdj_ActRout_mp OneToOne 10 0.00 11.00 FORMAT "%5.2" EXTENDED_LIMITS 0.00 255.0 DEPOSIT ABSOLUTE /end AXIS_DESCR
/end CHARACTERISTIC
/begin CHARACTERISTIC BasAdj_nMax_C "Drehzahlschwelle zum Ausführen der Grundeinstellung  (Diagnose)" VALUE 0x1C89CA Kw_Ws16 32767.00 EngN 0.00 32767.00 FORMAT "%8.2" EXTENDED_LIMITS -32768.00 32767.00 /end CHARACTERISTIC
/begin CHARACTERISTIC BasAdj_phiInjSetPoint_C "erster [0] und zweiter [1] Sollwert der Spritzbeginnregelung bei Grundeinstellung  (Diagnose)" VAL_BLK 0x1C89CC Kwb_Ws16 1535.977 AngleCrS -768.0000 767.9766 FORMAT "%8.4" NUMBER 2 /end CHARACTERISTIC
/begin CHARACTERISTIC BasAdj_qMax_C "Mengenschwelle zum Ausführen der Grundeinstellung  (Diagnose)" VALUE 0x1C89D0 Kw_Ws16 327.6700 InjMass 0.00 327.6700 FORMAT "%8.4" EXTENDED_LIMITS -327.6800 327.6700 /end CHARACTERISTIC
/begin CHARACTERISTIC BasAdj_rAirCtlEGR_C "erster [0] und zweiter [1] Sollwert des EGR-Ventils bei EGR Grundeinstellung  (Diagnose)" VAL_BLK 0x1C89D2 Kwb_Ws16 655.3500 Prc -327.6800 327.6700 FORMAT "%8.4" NUMBER 2 /end CHARACTERISTIC
/begin CHARACTERISTIC BasAdj_rAirCtlTVA_C "erster [0] und zweiter [1] Sollwert der Drosselklappe bei EGR Grundeinstellung  (Diagnose)" VAL_BLK 0x1C89D6 Kwb_Ws16 655.3500 Prc -327.6800 327.6700 FORMAT "%8.4" NUMBER 2 /end CHARACTERISTIC
/begin CHARACTERISTIC BasAdj_rPCRBiT_C "Erster [0] und zweiter [1] Sollwert des PCR-Stellglieds bei BiT Grundeinstellung  (Diagnose)" VAL_BLK 0x1C89DA Kwb_Ws16 655.3500 Prc -327.6800 327.6700 FORMAT "%8.4" NUMBER 2 /end CHARACTERISTIC
/begin CHARACTERISTIC BasAdj_rPCR_C "erster [0] und zweiter [1] Sollwert des PCR-Stellglieds bei PCR Grundeinstellung  (Diagnose)" VAL_BLK 0x1C89DE Kwb_Ws16 655.3500 Prc -327.6800 327.6700 FORMAT "%8.4" NUMBER 2 /end CHARACTERISTIC
/begin CHARACTERISTIC BasAdj_rVSA_C "Sollwert des VSA-Stellglieds bei VSA Grundeinstellung  (Diagnose)" VAL_BLK 0x1C89E2 Kwb_Ws16 655.3500 Prc -327.6800 327.6700 FORMAT "%8.4" NUMBER 2 /end CHARACTERISTIC
/begin CHARACTERISTIC BasAdj_stCmpTstNum_C "Testroutine Nummer für Kompressionstest" VALUE 0x1C89E6 Kw_Wu8 255.0 OneToOne 0.00 255.0 FORMAT "%5.1" /end CHARACTERISTIC
/begin CHARACTERISTIC BasAdj_stKickDownlrnNum_C "Testroutinenummer für den Kick-Down lernen" VALUE 0x1C89E7 Kw_Wu8 255.0 OneToOne 0.00 255.0 FORMAT "%5.1" /end CHARACTERISTIC
/begin CHARACTERISTIC BasAdj_stPSP_C "Tastverhaeltnis fuer die Elektrische Vorfoerderpumpe bei PSP Grundeinstellung  (Diagnose)" VAL_BLK 0x1C89E8 Kwb_Wu8 255.0 OneToOne 0.00 255.0 FORMAT "%5.1" NUMBER 2 /end CHARACTERISTIC
/begin CHARACTERISTIC BasAdj_tiEnd_C "Maximalzeit des Grundeinstellungstest  (Diagnose)" VALUE 0x1C89EA Kw_Wu16 655350.0 Time_ms 0.00 655350.0 FORMAT "%8.1" /end CHARACTERISTIC
/begin CHARACTERISTIC BasAdj_tiRoutDemMax_C "Zeit in der der Tester eine neue Anforderung senden muß, um nicht ins Timeout zu gelangen" VALUE 0x1C89EC Kw_Wu16 655350.0 Time_ms 0.00 655350.0 FORMAT "%8.1" /end CHARACTERISTIC
/begin CHARACTERISTIC BattCD_uSRCMin_C "SRC-Min der Batteriespannung" VALUE 0x1C8A30 Kw_Ws16 20782.00 Volt_Batt 0.00 20782.00 FORMAT "%8.2" EXTENDED_LIMITS -665674.1 665653.8 /end CHARACTERISTIC
/begin CHARACTERISTIC BattCD_uSRCMax_C "SRC-Max der Batteriespannung" VALUE 0x1C8A32 Kw_Ws16 20782.00 Volt_Batt 0.00 20782.00 FORMAT "%8.2" EXTENDED_LIMITS -665674.1 665653.8 /end CHARACTERISTIC
/begin CHARACTERISTIC BattCD_uLin_CUR "Linearisierungskennlinie" CURVE 0x1C8A34 Kl_Xs16_Ws16 28603.18 Volt_Batt 0.00 28603.18 FORMAT "%8.2" EXTENDED_LIMITS -665674.1 665653.8
 /begin AXIS_DESCR STD_AXIS BattCD_uRaw Volt_Batt 5 0.00 28603.18 FORMAT "%8.2" EXTENDED_LIMITS -665674.1 665653.8 DEPOSIT ABSOLUTE /end AXIS_DESCR
/end CHARACTERISTIC
/begin CHARACTERISTIC BattCD_duRmpSlpUp_C "Rampe Zunahme Batteriespannung negative Steigung" VALUE 0x1C8A4C Kw_Wu32 1331348144.36 RmpVoltBatt 0.00 1331348144.36 FORMAT "%13.2" /end CHARACTERISTIC
/begin CHARACTERISTIC BattCD_duRmpSlpDwn_C "Rampe Zunahme Batteriespannung positive Steigung" VALUE 0x1C8A50 Kw_Wu32 1331348144.36 RmpVoltBatt 0.00 1331348144.36 FORMAT "%13.2" /end CHARACTERISTIC
/begin CHARACTERISTIC BattCD_tiDebSRCHighDef_C "Entprellzeit für Erkennung des SRC-High-Fehlers der Batteriespannung" VALUE 0x1C8A54 Kw_Wu16 655350.0 Time_ms 0.00 655350.0 FORMAT "%8.1" /end CHARACTERISTIC
/begin CHARACTERISTIC BattCD_tiDebSRCHighOk_C "Entprellzeit für Heilung des SRC-High-Fehlers der Batteriespannung" VALUE 0x1C8A56 Kw_Wu16 655350.0 Time_ms 0.00 655350.0 FORMAT "%8.1" /end CHARACTERISTIC
/begin CHARACTERISTIC BattCD_tiDebSRCLowDef_C "Entprellzeit für Erkennung des SRC-Low-Fehlers der Batteriespannung" VALUE 0x1C8A58 Kw_Wu16 655350.0 Time_ms 0.00 655350.0 FORMAT "%8.1" /end CHARACTERISTIC
/begin CHARACTERISTIC BattCD_tiDebSRCLowOk_C "Entprellzeit für Heilung des SRC-Low-Fehlers der Batteriespannung" VALUE 0x1C8A5A Kw_Wu16 655350.0 Time_ms 0.00 655350.0 FORMAT "%8.1" /end CHARACTERISTIC
/begin CHARACTERISTIC BattCD_stSensIDWord_C "Kennung Batteriespannungserfassung" VALUE 0x1C8A5C Kw_Wu16 65535.00 OneToOne 0.00 65535.00 FORMAT "%8.2" /end CHARACTERISTIC
/begin CHARACTERISTIC BattCD_uDfl_C "Vorgabewert Batteriespannung" VALUE 0x1C8A5E Kw_Ws16 28603.18 Volt_Batt 0.00 28603.18 FORMAT "%8.2" EXTENDED_LIMITS -665674.1 665653.8 /end CHARACTERISTIC
/begin CHARACTERISTIC BattCD_vLim_C "Geschwindigkeitsgrenze zum Ausblenden von BattCD-SRC-High-Fehler" VALUE 0x1C8A60 Kw_Ws16 250.0000 Vel 0.00 250.0000 FORMAT "%8.4" EXTENDED_LIMITS -327.6800 327.6700 /end CHARACTERISTIC
/begin CHARACTERISTIC Batt_facCor_CUR "Kennlinie für Batteriespannungskorrektur" CURVE 0x1C8A1E Kl_Xs16_Ws16 1.600098 Fact 0.1999512 1.800049 FORMAT "%8.6" EXTENDED_LIMITS -4.000000 3.999878
 /begin AXIS_DESCR STD_AXIS BattCD_u Volt_Batt 4 0.00 20010.04 FORMAT "%8.2" EXTENDED_LIMITS -665674.1 665653.8 DEPOSIT ABSOLUTE /end AXIS_DESCR
/end CHARACTERISTIC
/begin CHARACTERISTIC BPACD_DebExcTempDef_C "Fehlerentprellzeit für Übertemperatur" VALUE 0x1C8A7A Kw_Wu16 655350.0 Time_ms 0.00 655350.0 FORMAT "%8.1" /end CHARACTERISTIC
/begin CHARACTERISTIC BPACD_DebExcTempOk_C "Heilungsentprellzeit für Übertemperatur" VALUE 0x1C8A7C Kw_Wu16 655350.0 Time_ms 0.00 655350.0 FORMAT "%8.1" /end CHARACTERISTIC
/begin CHARACTERISTIC BPACD_DebNoLoadDef_C "Fehlerentprellzeit für Lastabfall" VALUE 0x1C8A7E Kw_Wu16 655350.0 Time_ms 0.00 655350.0 FORMAT "%8.1" /end CHARACTERISTIC
/begin CHARACTERISTIC BPACD_DebNoLoadOk_C "Heilungsentprellzeit für Lastabfall" VALUE 0x1C8A80 Kw_Wu16 655350.0 Time_ms 0.00 655350.0 FORMAT "%8.1" /end CHARACTERISTIC
/begin CHARACTERISTIC BPACD_DebShortCircBatDef_C "Fehlerentprellzeitzeit für Kurzschluß nach Batteriespannung" VALUE 0x1C8A82 Kw_Wu16 655350.0 Time_ms 0.00 655350.0 FORMAT "%8.1" /end CHARACTERISTIC
/begin CHARACTERISTIC BPACD_DebShortCircBatOk_C "Heilungsentprellzeit für Kurzschluß nach Batteriespannung" VALUE 0x1C8A84 Kw_Wu16 655350.0 Time_ms 0.00 655350.0 FORMAT "%8.1" /end CHARACTERISTIC
/begin CHARACTERISTIC BPACD_DebShortCircGndDef_C "Fehlerentprellzeit für Kurzschluß nach Masse" VALUE 0x1C8A86 Kw_Wu16 655350.0 Time_ms 0.00 655350.0 FORMAT "%8.1" /end CHARACTERISTIC
/begin CHARACTERISTIC BPACD_DebShortCircGndOk_C "Heilungsentprellzeit für Kurzschluß nach Masse" VALUE 0x1C8A88 Kw_Wu16 655350.0 Time_ms 0.00 655350.0 FORMAT "%8.1" /end CHARACTERISTIC
/begin CHARACTERISTIC BPACD_stInvOut_C "Invertierungsparameter für das Signal der Ladedruckstellerendstufe" VALUE 0x1C8A8A Kw_Wu8 1.000 OneToOne 0.00 1.000 FORMAT "%5.3" EXTENDED_LIMITS 0.00 255.0 /end CHARACTERISTIC
/begin CHARACTERISTIC BPACD_tiPer_C "Periodendauer Ladedrucksteller." VALUE 0x1C8A8C Kw_Ws16 6553.500 Period -3276.800 3276.700 FORMAT "%8.3" /end CHARACTERISTIC
/begin CHARACTERISTIC BPACD_rCnv_CUR "Kennlinie zur konvertierung von Öffnungsgrad in Tastverhältnis" CURVE 0x1C8A8E Kl_Xs16_Ws16 100.0000 DtyCyc 0.00 100.0000 FORMAT "%8.4" EXTENDED_LIMITS -327.6800 327.6700
 /begin AXIS_DESCR STD_AXIS BPA_rBPA Prc 2 0.00 100.0000 FORMAT "%8.4" EXTENDED_LIMITS -327.6800 327.6700 DEPOSIT ABSOLUTE /end AXIS_DESCR
/end CHARACTERISTIC
/begin CHARACTERISTIC BPACD_rErrDflVal_C "Ausgabetastverhältnis im Fehlerfall" VALUE 0x1C8A98 Kw_Ws16 0.00 DtyCyc 0.00 0.00 FORMAT "%8.2" EXTENDED_LIMITS -327.6800 327.6700 /end CHARACTERISTIC
/begin CHARACTERISTIC BPACD_rOutMax_C "Maximal auszugebendes Tastverhältnis" VALUE 0x1C8A9A Kw_Ws16 100.0000 DtyCyc 0.00 100.0000 FORMAT "%8.4" EXTENDED_LIMITS -327.6800 327.6700 /end CHARACTERISTIC
/begin CHARACTERISTIC BPACD_rOutMin_C "Minimal auszugebendes Tastverhältnis" VALUE 0x1C8A9C Kw_Ws16 100.0000 DtyCyc 0.00 100.0000 FORMAT "%8.4" EXTENDED_LIMITS -327.6800 327.6700 /end CHARACTERISTIC
/begin CHARACTERISTIC BPACD_rTst_C "Tastverhältnis, dass im Fehlerfall zyklisch ausgegeben wird" VALUE 0x1C8A9E Kw_Ws16 100.0000 DtyCyc 0.00 100.0000 FORMAT "%8.4" EXTENDED_LIMITS -327.6800 327.6700 /end CHARACTERISTIC
/begin CHARACTERISTIC BPACD_stPwrStgActv_C "Aktivierung der Abschaltbedingungen der Endstufe" VALUE 0x1C8AA0 Kw_Wu8 1.000 OneToOne 0.00 1.000 FORMAT "%5.3" EXTENDED_LIMITS 0.00 255.0 /end CHARACTERISTIC
/begin CHARACTERISTIC BPACD_stPwrStgDia_C "Aktivierung der Abschaltbedingungen der Endstufediagnose" VALUE 0x1C8AA1 Kw_Wu8 1.000 OneToOne 0.00 1.000 FORMAT "%5.3" EXTENDED_LIMITS 0.00 255.0 /end CHARACTERISTIC
/begin CHARACTERISTIC BPACD_swtBattCor_C "Schalter Batteriespannungskorrektur (0 = AUS, 1 = EIN)" VALUE 0x1C8AA2 Kw_Wu8 1.000 OneToOne 0.00 1.000 FORMAT "%5.3" EXTENDED_LIMITS 0.00 255.0 /end CHARACTERISTIC
/begin CHARACTERISTIC BPACD_swtEActrOn_C "Schalter zur Auswahl des elektrischen Ladedruckstellers über CAN (0 = AUS, 1 = EIN)" VALUE 0x1C8AA3 Kw_Wu8 1.000 OneToOne 0.00 1.000 FORMAT "%5.3" EXTENDED_LIMITS 0.00 255.0 /end CHARACTERISTIC
/begin CHARACTERISTIC BPACD_tiBtwTst_C "Zeitabstand, in dem im Fehlerfall die Endstufe getestet wird" VALUE 0x1C8AA4 Kw_Wu16 29980.00 Time_ms 20.00000 30000.00 FORMAT "%8.2" EXTENDED_LIMITS 0.00 655350.0 /end CHARACTERISTIC
/begin CHARACTERISTIC BPASCD_DebRngErrDef_C "Defekterkennungszeit Tastverhältnis im undefinierten Bereich" VALUE 0x1C8AA6 Kw_Wu16 655350.0 Time_ms 0.00 655350.0 FORMAT "%8.1" /end CHARACTERISTIC
/begin CHARACTERISTIC BPASCD_DebRngErrOk_C "Heilzeit Tastverhältnis im undefinierten Bereich" VALUE 0x1C8AA8 Kw_Wu16 655350.0 Time_ms 0.00 655350.0 FORMAT "%8.1" /end CHARACTERISTIC
/begin CHARACTERISTIC BPASCD_DebMaxPeriodDef_C "Defekterkennungszeit Periodendauer zu hoch (SRC)" VALUE 0x1C8AAA Kw_Wu16 655350.0 Time_ms 0.00 655350.0 FORMAT "%8.1" /end CHARACTERISTIC
/begin CHARACTERISTIC BPASCD_DebMaxPeriodOk_C "Heilzeit Periodendauer zu hoch (SRC)" VALUE 0x1C8AAC Kw_Wu16 655350.0 Time_ms 0.00 655350.0 FORMAT "%8.1" /end CHARACTERISTIC
/begin CHARACTERISTIC BPASCD_DebMaxDef_C "Defekterkennungszeit Tastverhältnis zu hoch (SRC)" VALUE 0x1C8AAE Kw_Wu16 655350.0 Time_ms 0.00 655350.0 FORMAT "%8.1" /end CHARACTERISTIC
/begin CHARACTERISTIC BPASCD_DebMaxOk_C "Heilzeit Tastverhältnis zu niedrig (SRC)" VALUE 0x1C8AB0 Kw_Wu16 655350.0 Time_ms 0.00 655350.0 FORMAT "%8.1" /end CHARACTERISTIC
/begin CHARACTERISTIC BPASCD_DebMinPeriodDef_C "Defekterkennungszeit Periodendauer zu niedrig" VALUE 0x1C8AB2 Kw_Wu16 655350.0 Time_ms 0.00 655350.0 FORMAT "%8.1" /end CHARACTERISTIC
/begin CHARACTERISTIC BPASCD_DebMinPeriodOk_C "Heilzeit Periodendauer zu niedrig" VALUE 0x1C8AB4 Kw_Wu16 655350.0 Time_ms 0.00 655350.0 FORMAT "%8.1" /end CHARACTERISTIC
/begin CHARACTERISTIC BPASCD_DebMinDef_C "Defekterkennungszeit Tastverhältnis zu niedrig (SRC)" VALUE 0x1C8AB6 Kw_Wu16 655350.0 Time_ms 0.00 655350.0 FORMAT "%8.1" /end CHARACTERISTIC
/begin CHARACTERISTIC BPASCD_DebMinOk_C "Heilzeit Tastverhältnis zu niedrig (SRC)" VALUE 0x1C8AB8 Kw_Wu16 655350.0 Time_ms 0.00 655350.0 FORMAT "%8.1" /end CHARACTERISTIC
/begin CHARACTERISTIC BPASCD_stPwmInInv_C "PWM-Invertierungsstatus" VALUE 0x1C8ABA Kw_Wu8 1.000 OneToOne 0.00 1.000 FORMAT "%5.3" EXTENDED_LIMITS 0.00 255.0 /end CHARACTERISTIC
/begin CHARACTERISTIC BPASCD_tiPwmInMinPer_C "Mindestperiodendauer des PWM-Eingangssignals" VALUE 0x1C8ABC Kw_Ws16 6553.500 Period -3276.800 3276.700 FORMAT "%8.3" /end CHARACTERISTIC
/begin CHARACTERISTIC BPASCD_tiPwmInMaxPer_C "Maximale Periodendauer des PWM_Eingangssignals" VALUE 0x1C8ABE Kw_Ws16 6553.500 Period -3276.800 3276.700 FORMAT "%8.3" /end CHARACTERISTIC
/begin CHARACTERISTIC BPASCD_dcycPwmInMin_C "Mindesttastverhältnis des PWM-Eingangssignals" VALUE 0x1C8AC0 Kw_Ws16 100.0000 DtyCyc 0.00 100.0000 FORMAT "%8.4" EXTENDED_LIMITS -327.6800 327.6700 /end CHARACTERISTIC
/begin CHARACTERISTIC BPASCD_dcycPwmInMax_C "Maximales Tastverhältnis des PWM-Eingangssignals" VALUE 0x1C8AC2 Kw_Ws16 100.0000 DtyCyc 0.00 100.0000 FORMAT "%8.4" EXTENDED_LIMITS -327.6800 327.6700 /end CHARACTERISTIC
/begin CHARACTERISTIC BPASCD_rLinDcyc_CUR "Linearisierungskennlinie Ladedruckstellerrückmeldung" CURVE 0x1C8AC4 Kl_Xs16_Ws16 100.0000 Prc 0.00 100.0000 FORMAT "%8.4" EXTENDED_LIMITS -327.6800 327.6700
 /begin AXIS_DESCR STD_AXIS BPASCD_dcycIn DtyCyc 2 0.00 100.0000 FORMAT "%8.4" EXTENDED_LIMITS -327.6800 327.6700 DEPOSIT ABSOLUTE /end AXIS_DESCR
/end CHARACTERISTIC
/begin CHARACTERISTIC BPA_DebErrLrnLMSDef_C "Fehlerentprellzeit für unterer mechanischer Anschlag nicht gelernt" VALUE 0x1C8A64 Kw_Wu16 655350.0 Time_ms 0.00 655350.0 FORMAT "%8.1" /end CHARACTERISTIC
/begin CHARACTERISTIC BPA_DebErrLrnLMSOk_C "Heilzeit für unterer mechanischer Anschlag nicht gelernt" VALUE 0x1C8A66 Kw_Wu16 655350.0 Time_ms 0.00 655350.0 FORMAT "%8.1" /end CHARACTERISTIC
/begin CHARACTERISTIC BPA_DebErrLrnUMSDef_C "Fehlerentprellzeit für oberer mechanischer Anschlag nicht gelernt" VALUE 0x1C8A68 Kw_Wu16 655350.0 Time_ms 0.00 655350.0 FORMAT "%8.1" /end CHARACTERISTIC
/begin CHARACTERISTIC BPA_DebErrLrnUMSOk_C "Heilzeit für oberer mechanischer Anschlag nicht gelernt" VALUE 0x1C8A6A Kw_Wu16 655350.0 Time_ms 0.00 655350.0 FORMAT "%8.1" /end CHARACTERISTIC
/begin CHARACTERISTIC BPA_DebErrPWMDef_C "Fehlerentprellzeit für Signalfehler am Drallsteller PWM-Eingang" VALUE 0x1C8A6C Kw_Wu16 655350.0 Time_ms 0.00 655350.0 FORMAT "%8.1" /end CHARACTERISTIC
/begin CHARACTERISTIC BPA_DebErrPWMOk_C "Heilungsentprellzeit für Signalfehler am Drallsteller PWM-Eingang" VALUE 0x1C8A6E Kw_Wu16 655350.0 Time_ms 0.00 655350.0 FORMAT "%8.1" /end CHARACTERISTIC
/begin CHARACTERISTIC BPA_DebExcSensTempDef_C "Fehlerentprellzeit für Bauteiltemperatur überschritten" VALUE 0x1C8A70 Kw_Wu16 655350.0 Time_ms 0.00 655350.0 FORMAT "%8.1" /end CHARACTERISTIC
/begin CHARACTERISTIC BPA_DebExcSensTempOk_C "Heilzeit für Bauteiltemperatur überschritten" VALUE 0x1C8A72 Kw_Wu16 655350.0 Time_ms 0.00 655350.0 FORMAT "%8.1" /end CHARACTERISTIC
/begin CHARACTERISTIC BPA_nThres_C "Drehzahlschwelle zum verifizieren des unteren mechanischen Anschlags." VALUE 0x1C8A74 Kw_Ws16 6000.000 EngN 0.00 6000.000 FORMAT "%8.3" EXTENDED_LIMITS -32768.00 32767.00 /end CHARACTERISTIC
/begin CHARACTERISTIC BPA_rBPA_Vector "Bypass-Label für BPA_rBPA" VALUE 0x1C0A40 Kw_Wu8 255.0 OneToOne 0.00 255.0 FORMAT "%5.1" /end CHARACTERISTIC
/begin CHARACTERISTIC BPA_rBPA_Channel "Bypass-Label für BPA_rBPA" VALUE 0x1C0A41 Kw_Wu8 255.0 OneToOne 0.00 255.0 FORMAT "%5.1" /end CHARACTERISTIC
/begin CHARACTERISTIC BPA_swtLrnLMSLrnDef_C "Unteren mechanischen Anschlag nach Lern-Defekt verifizieren" VALUE 0x1C8A76 Kw_Wu8 1.000 OneToOne 0.00 1.000 FORMAT "%5.3" EXTENDED_LIMITS 0.00 255.0 /end CHARACTERISTIC
/begin CHARACTERISTIC BPA_swtLrnLMSPWMDef_C "Unteren mechanischen Anschlag nach PWM-Defekt verifizieren." VALUE 0x1C8A77 Kw_Wu8 1.000 OneToOne 0.00 1.000 FORMAT "%5.3" EXTENDED_LIMITS 0.00 255.0 /end CHARACTERISTIC
/begin CHARACTERISTIC BPA_swtLrnLMS_C "Unteren mechanischen Anschlag lernen." VALUE 0x1C8A78 Kw_Wu8 1.000 OneToOne 0.00 1.000 FORMAT "%5.3" EXTENDED_LIMITS 0.00 255.0 /end CHARACTERISTIC
/begin CHARACTERISTIC BPSCD_uSRCMin_C "SRC-Min-Wert für Ladedruck." VALUE 0x1C8AD0 Kw_Ws16 5000.000 Volt 0.00 5000.000 FORMAT "%8.3" EXTENDED_LIMITS -160156.4 160151.5 /end CHARACTERISTIC
/begin CHARACTERISTIC BPSCD_uSRCMax_C "SRC-Max-Wert für Ladedruck." VALUE 0x1C8AD2 Kw_Ws16 5000.000 Volt 0.00 5000.000 FORMAT "%8.3" EXTENDED_LIMITS -160156.4 160151.5 /end CHARACTERISTIC
/begin CHARACTERISTIC BPSCD_pLin_CUR "Linearisierungskennlinie" CURVE 0x1C8AD4 Kl_Xs16_Ws16 5000.000 Pres_hPa 0.00 5000.000 FORMAT "%8.3" EXTENDED_LIMITS -32768.00 32767.00
 /begin AXIS_DESCR STD_AXIS BPSCD_uRawVal Volt 25 0.00 5000.000 FORMAT "%8.3" EXTENDED_LIMITS -160156.4 160151.5 DEPOSIT ABSOLUTE /end AXIS_DESCR
/end CHARACTERISTIC
/begin CHARACTERISTIC BPSCD_ctAvgMx_C "Anzahl der Berechnungszyklen für die Absolute APS-BPS Differenz" VALUE 0x1C8B3A Kw_Wu16 249.0000 OneToOne 1.000000 250.0000 FORMAT "%8.4" EXTENDED_LIMITS 0.00 65535.00 /end CHARACTERISTIC
/begin CHARACTERISTIC BPSCD_DebSigDef_C "Defektentprellzeit fuer CAN Signal defekt" VALUE 0x1C8B3C Kw_Wu16 655350.0 Time_ms 0.00 655350.0 FORMAT "%8.1" /end CHARACTERISTIC
/begin CHARACTERISTIC BPSCD_DebSigOK_C "Heilungsentprellzeit fuer CAN Signal defekt" VALUE 0x1C8B3E Kw_Wu16 655350.0 Time_ms 0.00 655350.0 FORMAT "%8.1" /end CHARACTERISTIC
/begin CHARACTERISTIC BPSCD_DebSRCHighDef_C "Fehlerentprellzeit fuer SRC-High Fehler" VALUE 0x1C8B40 Kw_Wu16 655350.0 Time_ms 0.00 655350.0 FORMAT "%8.1" /end CHARACTERISTIC
/begin CHARACTERISTIC BPSCD_DebSRCHighOK_C "Heilungsentprellzeit fuer SRC-High Fehler" VALUE 0x1C8B42 Kw_Wu16 655350.0 Time_ms 0.00 655350.0 FORMAT "%8.1" /end CHARACTERISTIC
/begin CHARACTERISTIC BPSCD_DebSRCLowDef_C "Fehlerentprellzeit fuer SRC-Low Fehler" VALUE 0x1C8B44 Kw_Wu16 655350.0 Time_ms 0.00 655350.0 FORMAT "%8.1" /end CHARACTERISTIC
/begin CHARACTERISTIC BPSCD_DebSRCLowOK_C "Heilungsentprellzeit fuer SRC-Low Fehler" VALUE 0x1C8B46 Kw_Wu16 655350.0 Time_ms 0.00 655350.0 FORMAT "%8.1" /end CHARACTERISTIC
/begin CHARACTERISTIC BPSCD_nLim_C "Obere Grenze Motordrehzahl." VALUE 0x1C8B48 Kw_Ws16 6000.000 EngN 0.00 6000.000 FORMAT "%8.3" EXTENDED_LIMITS -32768.00 32767.00 /end CHARACTERISTIC
/begin CHARACTERISTIC BPSCD_numSSp_C "Wahlschalter für Sensorversorgungsschaltermonitor für Ladedruckfühler" VALUE 0x1C8B4A Kw_Wu8 2.000 OneToOne 1.000 3.000 FORMAT "%5.3" EXTENDED_LIMITS 0.00 255.0 /end CHARACTERISTIC
/begin CHARACTERISTIC BPSCD_pAdjMax_C "oberer Grenzwert für Ladedruckkorrektur mit dem Lade-Atmosphärendruckabgleichwert" VALUE 0x1C8B4C Kw_Ws16 3000.000 Pres_hPa 0.00 3000.000 FORMAT "%8.3" EXTENDED_LIMITS -32768.00 32767.00 /end CHARACTERISTIC
/begin CHARACTERISTIC BPSCD_tiPT1_C "Verzugszeit. (für PT1 Filter )" VALUE 0x1C8B50 Kw_Wu32 4294.9673 TimeDelay_s 0.0000010000000 4294.9673 FORMAT "%9.4" /end CHARACTERISTIC
/begin CHARACTERISTIC BPSCD_pDiffLim_C "Grenzwert für absolute Differenz zwischen LD und AD" VALUE 0x1C8B54 Kw_Ws16 3500.000 Pres_hPa 0.00 3500.000 FORMAT "%8.3" EXTENDED_LIMITS -32768.00 32767.00 /end CHARACTERISTIC
/begin CHARACTERISTIC BPSCD_tiLPFilt_C "Low-Pass-Filter Zeitkonstante für LDF-Erfassung" VALUE 0x1C0B50 Kw_Wu32 0.099997239 TimeDelay_s 0.0000020000000 0.099999239 FORMAT "%10.8" EXTENDED_LIMITS 0.0000010000000 4294.9673 /end CHARACTERISTIC
/begin CHARACTERISTIC BPSCD_dpRmpSlpUp_C "Rampensteigung bei Heilung/Vorgabewert für LDF" VALUE 0x1C8B58 Kw_Wu32 65535999.9847 RmpPres_hPa 0.00 65535999.9847 FORMAT "%13.4" /end CHARACTERISTIC
/begin CHARACTERISTIC BPSCD_dpRmpSlpDwn_C "Rampensteigung bei Heilung/Vorgabewert für LDF" VALUE 0x1C8B5C Kw_Wu32 65535999.9847 RmpPres_hPa 0.00 65535999.9847 FORMAT "%13.4" /end CHARACTERISTIC
/begin CHARACTERISTIC BPSCD_swtCorrOn_C "Schalter zur Aktivierung der Ladedruckkorrektur mit dem Lade-Atmosphärendruckabgleichwert" VALUE 0x1C8B60 Kw_Wu8 1.000 OneToOne 0.00 1.000 FORMAT "%5.3" EXTENDED_LIMITS 0.00 255.0 /end CHARACTERISTIC
/begin CHARACTERISTIC BPSCD_swtSigVal_C "Schalter ob Signal ueber CAN/ADC" VALUE 0x1C8B61 Kw_Wu8 1.000 OneToOne 0.00 1.000 FORMAT "%5.3" EXTENDED_LIMITS 0.00 255.0 /end CHARACTERISTIC
/begin CHARACTERISTIC BPSCD_tiAvgDly_C "Verzögerung des Berechnungsstarts der  Absoluten  APS-BPS Differenz" VALUE 0x1C8B62 Kw_Wu16 100000.0 Time_ms 0.00 100000.0 FORMAT "%8.1" EXTENDED_LIMITS 0.00 655350.0 /end CHARACTERISTIC
/begin CHARACTERISTIC BPSCD_stSensIDWord_C "Geberkennwort LDF" VALUE 0x1C8B64 Kw_Wu16 65535.00 OneToOne 0.00 65535.00 FORMAT "%8.2" /end CHARACTERISTIC
/begin CHARACTERISTIC BPSCD_pDfl_C "Ladedruck Vorgabewert" VALUE 0x1C8B66 Kw_Ws16 65535.00 Pres_hPa -32768.00 32767.00 FORMAT "%8.2" /end CHARACTERISTIC
/begin CHARACTERISTIC BrkCD_DebdynPlaDef_C "Zählergrenze für endgültig defekt bei dynamischer Bremsenplausibilität" VALUE 0x1C8B68 Kw_Wu16 65535.00 OneToOne 0.00 65535.00 FORMAT "%8.2" /end CHARACTERISTIC
/begin CHARACTERISTIC BrkCD_DebdynPlaOk_C "Zählerschwelle für endgültig ok (nicht verwendet)" VALUE 0x1C8B6A Kw_Wu16 65535.00 OneToOne 0.00 65535.00 FORMAT "%8.2" /end CHARACTERISTIC
/begin CHARACTERISTIC BrkCD_DebSRCHighDef_C "Fehlerentprellungszeit fuer SRC-High Bremskontakt" VALUE 0x1C8B6C Kw_Wu16 655350.0 Time_ms 0.00 655350.0 FORMAT "%8.1" /end CHARACTERISTIC
/begin CHARACTERISTIC BrkCD_DebSRCHighOk_C "Heilungsentprellzeit fuer SRC-High Bremskontakt" VALUE 0x1C8B6E Kw_Wu16 655350.0 Time_ms 0.00 655350.0 FORMAT "%8.1" /end CHARACTERISTIC
/begin CHARACTERISTIC BrkCD_DebSRCLowDef_C "Fehlerentprellungszeit fuer SRC-Low Bremskontakt" VALUE 0x1C8B70 Kw_Wu16 655350.0 Time_ms 0.00 655350.0 FORMAT "%8.1" /end CHARACTERISTIC
/begin CHARACTERISTIC BrkCD_DebSRCLowOk_C "Heilungsentprellzeit fuer SRC-Low Bremskontakt" VALUE 0x1C8B72 Kw_Wu16 655350.0 Time_ms 0.00 655350.0 FORMAT "%8.1" /end CHARACTERISTIC
/begin CHARACTERISTIC BrkCD_uMnSwtSRCMin_C "SRC Minimum (Bremskontakt)" VALUE 0x1C8B74 Kw_Ws16 5200.391 Volt 0.00 5200.391 FORMAT "%8.3" EXTENDED_LIMITS -160156.4 160151.5 /end CHARACTERISTIC
/begin CHARACTERISTIC BrkCD_uMnSwtSRCMax_C "SRC Maximum (Bremskontakt)" VALUE 0x1C8B76 Kw_Ws16 5200.391 Volt 0.00 5200.391 FORMAT "%8.3" EXTENDED_LIMITS -160156.4 160151.5 /end CHARACTERISTIC
/begin CHARACTERISTIC BrkCD_uMnSwtLin_CUR "Linearisierungskennlinie des Bremskontaktes" CURVE 0x1C8B78 Kl_Xs16_Ws16 5200.391 Volt 0.00 5200.391 FORMAT "%8.3" EXTENDED_LIMITS -160156.4 160151.5
 /begin AXIS_DESCR STD_AXIS BrkCD_uMnSwtRawVal Volt 3 0.00 5200.391 FORMAT "%8.3" EXTENDED_LIMITS -160156.4 160151.5 DEPOSIT ABSOLUTE /end AXIS_DESCR
/end CHARACTERISTIC
/begin CHARACTERISTIC BrkCD_tiMnSwtDebNeg_C "Entprellzeit Bremskontakt - abfallende Flanke" VALUE 0x1C8B86 Kw_Wu16 655350.0 TimeDeb 0.00 655350.0 FORMAT "%8.1" /end CHARACTERISTIC
/begin CHARACTERISTIC BrkCD_tiMnSwtDebPos_C "Entprellzeit Bremskontakt - aufsteigende Flanke" VALUE 0x1C8B88 Kw_Wu16 655350.0 TimeDeb 0.00 655350.0 FORMAT "%8.1" /end CHARACTERISTIC
/begin CHARACTERISTIC BrkCD_numStepDef_C "Schrittweite des Zählers bei Defekterkennung" VALUE 0x1C8B8A Kw_Wu8 3.000 OneToOne 0.00 3.000 FORMAT "%5.3" EXTENDED_LIMITS 0.00 255.0 /end CHARACTERISTIC
/begin CHARACTERISTIC BrkCD_numStepOK_C "Schrittweise des Zählers bei der Heilungserkennung (nicht verwendet)" VALUE 0x1C8B8B Kw_Wu8 3.000 OneToOne 0.00 3.000 FORMAT "%5.3" EXTENDED_LIMITS 0.00 255.0 /end CHARACTERISTIC
/begin CHARACTERISTIC BrkCD_tiRedSwtDebNeg_C "Entprellzeit redundanter Bremskontakt - abfallende Flanke" VALUE 0x1C8B8C Kw_Wu16 655350.0 TimeDeb 0.00 655350.0 FORMAT "%8.1" /end CHARACTERISTIC
/begin CHARACTERISTIC BrkCD_tiRedSwtDebPos_C "Entprellzeit redundanter Bremskontakt - aufsteigende Flanke" VALUE 0x1C8B8E Kw_Wu16 655350.0 TimeDeb 0.00 655350.0 FORMAT "%8.1" /end CHARACTERISTIC
/begin CHARACTERISTIC BrkCD_dtRmpSlpUp_C "Aufwärts-Schritt für Rampe Bremskontakt" VALUE 0x1C8B90 Kw_Wu32 320312805.400 RmpVolt 0.00 320312805.400 FORMAT "%13.3" /end CHARACTERISTIC
/begin CHARACTERISTIC BrkCD_dtRmpSlpDwn_C "Abwärts-Schritt für Rampe Bremskontakt" VALUE 0x1C8B94 Kw_Wu32 320312805.400 RmpVolt 0.00 320312805.400 FORMAT "%13.3" /end CHARACTERISTIC
/begin CHARACTERISTIC BrkCD_stBrk_Invalid_C "Bremskontaktschalter Vorgabewert bei Sensordefekt" VALUE 0x1C8B98 Kw_Wu8 3.000 OneToOne 0.00 3.000 FORMAT "%5.3" EXTENDED_LIMITS 0.00 255.0 /end CHARACTERISTIC
/begin CHARACTERISTIC BrkCD_stDflVal_C "Redundanter Bremskontakt-Vorgabewert" VALUE 0x1C1626 Kw_Wu8 3.000 OneToOne 0.00 3.000 FORMAT "%5.3" EXTENDED_LIMITS 0.00 255.0 /end CHARACTERISTIC
/begin CHARACTERISTIC BrkCD_stMnSwtInvIn_C "Signal Bremskontakt invertiert" VALUE 0x1C8B99 Kw_Wu8 1.000 OneToOne 0.00 1.000 FORMAT "%5.3" EXTENDED_LIMITS 0.00 255.0 /end CHARACTERISTIC
/begin CHARACTERISTIC BrkCD_stRedSwtInvIn_C "Signal redundanter Bremskontakt invertiert" VALUE 0x1C1627 Kw_Wu8 1.000 OneToOne 0.00 1.000 FORMAT "%5.3" EXTENDED_LIMITS 0.00 255.0 /end CHARACTERISTIC
/begin CHARACTERISTIC BrkCD_swtRedSwtPresent_C "Schalter redundanter Bremskontakt vorhanden" VALUE 0x1C8B9A Kw_Wu8 1.000 OneToOne 0.00 1.000 FORMAT "%5.3" EXTENDED_LIMITS 0.00 255.0 /end CHARACTERISTIC
/begin CHARACTERISTIC BrkCD_swtSigVal_C "Schalterwert, Signal von HW DIO/CAN (1=CAN, 0=DIO)" VALUE 0x1C1628 Kw_Wu8 3.000 OneToOne 0.00 3.000 FORMAT "%5.3" EXTENDED_LIMITS 0.00 255.0 /end CHARACTERISTIC
/begin CHARACTERISTIC BrkCD_tiBREdyn_C "Zeit für die ein unplausibles Signal anliegen muß, um den Ereigniszähler hochzuzählen" VALUE 0x1C8B9C Kw_Wu32 1500.00000000 Time_ms 500.000000000 2000.00000000 FORMAT "%13.8" EXTENDED_LIMITS 0.00 42949672950.0 /end CHARACTERISTIC
/begin CHARACTERISTIC BrkCD_tiBREiO_C "Zeit für die plausible Bremssignale anliegen müssen um Fehler wieder zu heilen." VALUE 0x1C8BA0 Kw_Wu32 1500.00000000 Time_ms 500.000000000 2000.00000000 FORMAT "%13.8" EXTENDED_LIMITS 0.00 42949672950.0 /end CHARACTERISTIC
/begin CHARACTERISTIC BrkCD_stSensIDWord_C "Geberkennwort Bremskontakt" VALUE 0x1C8BA4 Kw_Wu16 65535.00 OneToOne 0.00 65535.00 FORMAT "%8.2" /end CHARACTERISTIC
/begin CHARACTERISTIC BrkCD_uDfl_C "Bremskontakt Spannungsvorgabewert bei Fehler" VALUE 0x1C8BA6 Kw_Ws16 5200.391 Volt 0.00 5200.391 FORMAT "%8.3" EXTENDED_LIMITS -160156.4 160151.5 /end CHARACTERISTIC
/begin CHARACTERISTIC BrkCD_uMnSwtA2DThres_C "Analogsignalschwelle zur Erkennung log. EIN" VALUE 0x1C8BA8 Kw_Ws16 5000.000 Volt 0.00 5000.000 FORMAT "%8.3" EXTENDED_LIMITS -160156.4 160151.5 /end CHARACTERISTIC
/begin CHARACTERISTIC BypEtk_dNsyncStimuli64_C "Bypass, nicht ändern. Anzahl der winkelsynchron übertragenen Acht-Byte-Größen von ASCET zur ECU." VALUE 0x1C8BAC Kw_Wu8 255.0 OneToOne 0.00 255.0 FORMAT "%5.1" /end CHARACTERISTIC
/begin CHARACTERISTIC BypEtk_dNsyncStimuli32_C "Bypass, nicht ändern. Anzahl der winkelsynchron übertragenen Vier-Byte-Größen von ASCET zur ECU." VALUE 0x1C8BAD Kw_Wu8 255.0 OneToOne 0.00 255.0 FORMAT "%5.1" /end CHARACTERISTIC
/begin CHARACTERISTIC BypEtk_dNsyncStimuli16_C "Bypass, nicht ändern. Anzahl der winkelsynchron übertragenen Zwei-Byte-Größen von ASCET zur ECU." VALUE 0x1C8BAE Kw_Wu8 255.0 OneToOne 0.00 255.0 FORMAT "%5.1" /end CHARACTERISTIC
/begin CHARACTERISTIC BypEtk_dNsyncStimuli8_C "Bypass, nicht ändern. Anzahl der winkelsynchron übertragenen Ein-Byte-Größen von ASCET zur ECU." VALUE 0x1C8BAF Kw_Wu8 255.0 OneToOne 0.00 255.0 FORMAT "%5.1" /end CHARACTERISTIC
/begin CHARACTERISTIC BypEtk_stAscet_C "Status ASCET ETK Bypass (0: deaktiviert; 1: ETK-Bypass starten, wenn Wert vorher 0; 2: sofort starten)" VALUE 0x1C8BB0 Kw_Wu8 2.000 OneToOne 0.00 2.000 FORMAT "%5.3" EXTENDED_LIMITS 0.00 255.0 /end CHARACTERISTIC
/begin CHARACTERISTIC BypEtk_dTsyncStimuli64_C "Bypass, nicht ändern. Anzahl der zeitsynchron übertragenen Acht-Byte-Größen von ASCET zur ECU." VALUE 0x1C8BB1 Kw_Wu8 255.0 OneToOne 0.00 255.0 FORMAT "%5.1" /end CHARACTERISTIC
/begin CHARACTERISTIC BypEtk_dTsyncStimuli32_C "Bypass, nicht ändern. Anzahl der zeitsynchron übertragenen Vier-Byte-Größen von ASCET zur ECU." VALUE 0x1C8BB2 Kw_Wu8 255.0 OneToOne 0.00 255.0 FORMAT "%5.1" /end CHARACTERISTIC
/begin CHARACTERISTIC BypEtk_dTsyncStimuli16_C "Bypass, nicht ändern. Anzahl der zeitsynchron übertragenen Zwei-Byte-Größen von ASCET zur ECU." VALUE 0x1C8BB3 Kw_Wu8 255.0 OneToOne 0.00 255.0 FORMAT "%5.1" /end CHARACTERISTIC
/begin CHARACTERISTIC BypEtk_dTsyncStimuli8_C "Bypass, nicht ändern. Anzahl der zeitsynchron übertragenen Ein-Byte-Größen von ASCET zur ECU." VALUE 0x1C8BB4 Kw_Wu8 255.0 OneToOne 0.00 255.0 FORMAT "%5.1" /end CHARACTERISTIC
/begin CHARACTERISTIC BypInt_adFunc_C "Feld von Funktionszeigern auf interne Bypass Funktionen" VAL_BLK 0x1C8BB8 Kwb_Wu32 4294967295.00 OneToOne 0.00 4294967295.00 FORMAT "%13.2" NUMBER 11 /end CHARACTERISTIC
/begin CHARACTERISTIC BypInt_stAscet_C "Status interner ASCET Bypass (0: deaktiviert; 1: internen Bypass starten, wenn Wert vorher 0; 2: sofort starten)" VALUE 0x1C8BE4 Kw_Wu8 2.000 OneToOne 0.00 2.000 FORMAT "%5.3" EXTENDED_LIMITS 0.00 255.0 /end CHARACTERISTIC
/begin CHARACTERISTIC Carb9_CIDTable_C "CARB 9 Calibration ID" ASCII 0x1C0B54 Ktx 255.0 defaultAscii 0.00 255.0 NUMBER 16 /end CHARACTERISTIC
/begin CHARACTERISTIC Carb_Mode1VisPID_CUR "OBD Mode 1 PID-Anzeige Maske" VAL_BLK 0x1C0B68 Kwb_Wu32 4294967295.00 OneToOne 0.00 4294967295.00 FORMAT "%13.2" NUMBER 4 /end CHARACTERISTIC
/begin CHARACTERISTIC Carb_Mode3SwtDia_C "Anzeigen der Fehler nur für Carb Mode 3(0) oder für Carb Mode 3 und 7 (1)" VALUE 0x1C0B78 Kw_Wu8 255.0 OneToOne 0.00 255.0 FORMAT "%5.1" /end CHARACTERISTIC
/begin CHARACTERISTIC Carb_Mode4RefVal_C "Ist Carb_Mode4SigNum_C größer als dieser Referenzwert erfolgt kein Reset" VALUE 0x1C0B7C Kw_Ws32 4294967295.00 OneToOne -2147483648.00 2147483647.00 FORMAT "%13.2" /end CHARACTERISTIC
/begin CHARACTERISTIC Carb_Mode4SigNum_C "Vergleiche Carb_Mode4SigNum_C mit dem Referenzwert Carb_Mode4RefVal_C" VALUE 0x1C0B80 Kw_Wu16 65535.00 OneToOne 0.00 65535.00 FORMAT "%8.2" /end CHARACTERISTIC
/begin CHARACTERISTIC Carb_Mode6TstComp_CUR "Komponente des Carb Mode 6 Subtests" VAL_BLK 0x1C0B82 Kwb_Wu8 255.0 OneToOne 0.00 255.0 FORMAT "%5.1" NUMBER 10 /end CHARACTERISTIC
/begin CHARACTERISTIC Carb_Mode6TstNum_CUR "Test Nummer des Carb Mode 6 Subtests" VAL_BLK 0x1C0B8C Kwb_Wu8 254.0 OneToOne 1.000 255.0 FORMAT "%5.1" EXTENDED_LIMITS 0.00 255.0 NUMBER 10 /end CHARACTERISTIC
/begin CHARACTERISTIC Carb_Mode6TstRefMax_CUR "Maximaler Referenzwert des Carb Mode 6 Subtest" VAL_BLK 0x1C0B96 Kwb_Wu16 65534.00 OneToOne 1.000000 65535.00 FORMAT "%8.2" EXTENDED_LIMITS 0.00 65535.00 NUMBER 10 /end CHARACTERISTIC
/begin CHARACTERISTIC Carb_Mode6TstRefMin_CUR "Minimaler Referenzwert des Carb Mode 6 Subtest" VAL_BLK 0x1C0BAA Kwb_Wu16 65534.00 OneToOne 1.000000 65535.00 FORMAT "%8.2" EXTENDED_LIMITS 0.00 65535.00 NUMBER 10 /end CHARACTERISTIC
/begin CHARACTERISTIC Carb_Mode6TstTestId_CUR "Test Identifier für OBD über CAN" VAL_BLK 0x1C0BBE Kwb_Wu8 255.0 OneToOne 0.00 255.0 FORMAT "%5.1" NUMBER 10 /end CHARACTERISTIC
/begin CHARACTERISTIC Carb_Mode6TstUnitId_CUR "Einheits und Skalierungs Identifier der Datenbytes" VAL_BLK 0x1C0BC8 Kwb_Wu8 255.0 OneToOne 0.00 255.0 FORMAT "%5.1" NUMBER 10 /end CHARACTERISTIC
/begin CHARACTERISTIC Carb_Mode6TstVal_CUR "Testwert des Carb Mode 6 Subtests" VAL_BLK 0x1C0BD2 Kwb_Wu16 65534.00 OneToOne 1.000000 65535.00 FORMAT "%8.2" EXTENDED_LIMITS 0.00 65535.00 NUMBER 10 /end CHARACTERISTIC
/begin CHARACTERISTIC Carb_Mode9PID0_C "Support-Status des Infotype 0x00. Liefert alle ünterstützten Infotypes ( immer 0 für supported)" VALUE 0x1C0BE6 Kw_Wu8 255.0 OneToOne 0.00 255.0 FORMAT "%5.1" /end CHARACTERISTIC
/begin CHARACTERISTIC Carb_Mode9PID1_C "Support-Status des Infotype 0x01 (1 für supported, 0 für nicht supported)" VALUE 0x1C0BE7 Kw_Wu8 255.0 OneToOne 0.00 255.0 FORMAT "%5.1" /end CHARACTERISTIC
/begin CHARACTERISTIC Carb_Mode9PID2_C "Support-Status des Infotype 0x02 ""Vehicle Identification"" ( 2 für supported, 0 für nicht supported)" VALUE 0x1C0BE8 Kw_Wu8 255.0 OneToOne 0.00 255.0 FORMAT "%5.1" /end CHARACTERISTIC
/begin CHARACTERISTIC Carb_Mode9PID3_C "Support-Status des Infotype 0x03 ( 3 für supported, 0 für nicht supported)" VALUE 0x1C0BE9 Kw_Wu8 255.0 OneToOne 0.00 255.0 FORMAT "%5.1" /end CHARACTERISTIC
/begin CHARACTERISTIC Carb_Mode9PID4_C "Support-Status des Infotype 0x04 ""Calibration Identification"" ( 4 für supported, 0 für nicht supported)" VALUE 0x1C0BEA Kw_Wu8 255.0 OneToOne 0.00 255.0 FORMAT "%5.1" /end CHARACTERISTIC
/begin CHARACTERISTIC Carb_Mode9PID5_C "Support-Status des Infotype 0x05 ( 5 für supported, 0 für nicht supported)" VALUE 0x1C0BEB Kw_Wu8 255.0 OneToOne 0.00 255.0 FORMAT "%5.1" /end CHARACTERISTIC
/begin CHARACTERISTIC Carb_Mode9PID6_C "Support-Status des Infotype 0x06 ""Calibration Verification Number"" ( 6 für supported, 0 für nicht supported)" VALUE 0x1C0BEC Kw_Wu8 6.000 OneToOne 0.00 6.000 FORMAT "%5.3" EXTENDED_LIMITS 0.00 255.0 /end CHARACTERISTIC
/begin CHARACTERISTIC Carb_stAppl_C "Applikationsschalter zwischen ISO9141(0) und KWP2000-4(1)" VALUE 0x1C0BED Kw_Wu8 1.000 OneToOne 0.00 1.000 FORMAT "%5.3" EXTENDED_LIMITS 0.00 255.0 /end CHARACTERISTIC
/begin CHARACTERISTIC CaSCD_ctEdgOfs_C "Anzahl von Nockenwellenflanken mit erkannter CaS/CrS Verdrehung" VALUE 0x1C8BE8 Kw_Wu8 255.0 default 0.00 255.0 FORMAT "%5.1" /end CHARACTERISTIC
/begin CHARACTERISTIC CaSCD_ctErrSync_C "maximale Anzahl von Störungen auf dem Phasengebersystem während einer Nockenwellenumdrehung" VALUE 0x1C8BE9 Kw_Wu8 255.0 default 0.00 255.0 FORMAT "%5.1" /end CHARACTERISTIC
/begin CHARACTERISTIC CaSCD_ctShftSync_C "Anzahl falscher Nockenwellenflanken bis neue Positionssuche" VALUE 0x1C8BEA Kw_Wu8 255.0 default 0.00 255.0 FORMAT "%5.1" /end CHARACTERISTIC
/begin CHARACTERISTIC CaSCD_dSegSeries_C "Segmentfolge der Phasengebersegmente" VAL_BLK 0x1C0BEE Kwb_Wu8 31.00 OneToOne 0.00 31.00 FORMAT "%5.2" EXTENDED_LIMITS 0.00 255.0 NUMBER 16 /end CHARACTERISTIC
/begin CHARACTERISTIC CaSCD_facPlausHigh_CUR "Obere Grenze der Plausibilitätsprüfung des Phasengebersignals" CURVE 0x1C8BEC Kl_Xs16_Ws16 19.00000 Fact1 1.000000 20.00000 FORMAT "%8.5" EXTENDED_LIMITS -256.0000 255.9922
 /begin AXIS_DESCR STD_AXIS CaSCD_tiPeriodRev Period_ms 12 0.00 3276.700 FORMAT "%8.3" EXTENDED_LIMITS -3276.800 3276.700 DEPOSIT ABSOLUTE /end AXIS_DESCR
/end CHARACTERISTIC
/begin CHARACTERISTIC CaSCD_facPlausLow_CUR "Untere Grenze der Plausibilitätsprüfung des Phasengebersignals" CURVE 0x1C8C1E Kl_Xs16_Ws16 1.000000 Fact1 0.00 1.000000 FORMAT "%8.6" EXTENDED_LIMITS -256.0000 255.9922
 /begin AXIS_DESCR STD_AXIS CaSCD_tiPeriodRevHold Period_ms 12 0.00 3276.700 FORMAT "%8.3" EXTENDED_LIMITS -3276.800 3276.700 DEPOSIT ABSOLUTE /end AXIS_DESCR
/end CHARACTERISTIC
/begin CHARACTERISTIC CaSCD_nMinSpeed_C "Kleinster Wert für Phasengeberraddrehzahl" VALUE 0x1C0BFE Kw_Ws16 5960.000 EngN 40.00000 6000.000 FORMAT "%8.3" EXTENDED_LIMITS -32768.00 32767.00 /end CHARACTERISTIC
/begin CHARACTERISTIC CaSCD_phiSegLenTolc_C "Toleranz für jede Segmentlänge" VAL_BLK 0x1C0C00 Kwb_Ws16 360.0000 AngleCaS 0.00 360.0000 FORMAT "%8.4" EXTENDED_LIMITS -384.0000 383.9883 NUMBER 16 /end CHARACTERISTIC
/begin CHARACTERISTIC CaSCD_phiSegLen_C "Länge der Phasensegmete" VAL_BLK 0x1C0C20 Kwb_Ws16 360.0000 AngleCaS 0.00 360.0000 FORMAT "%8.4" EXTENDED_LIMITS -384.0000 383.9883 NUMBER 16 /end CHARACTERISTIC
/begin CHARACTERISTIC CaSCD_phiSegOfs_C "Winkel zwischen physikalischer Nulllage und Beginn Referenztabelle" VALUE 0x1C0C40 Kw_Ws16 360.0000 AngleCaS 0.00 360.0000 FORMAT "%8.4" EXTENDED_LIMITS -384.0000 383.9883 /end CHARACTERISTIC
/begin CHARACTERISTIC CaSCD_phiSpeedCalcTolc_C "Toleranzwinkel für Segmenterkennung bei der Berechnung der Phasengeberdrehzahl" VALUE 0x1C0C42 Kw_Ws16 360.0000 AngleCaS 0.00 360.0000 FORMAT "%8.4" EXTENDED_LIMITS -384.0000 383.9883 /end CHARACTERISTIC
/begin CHARACTERISTIC CaSCD_phiSpeedSegLen_C "Winkel einer Segmentlänge zur Berechnung der Phasengeberraddrehzahl" VALUE 0x1C0C44 Kw_Ws16 360.0000 AngleCaS 0.00 360.0000 FORMAT "%8.4" EXTENDED_LIMITS -384.0000 383.9883 /end CHARACTERISTIC
/begin CHARACTERISTIC CaSCD_phiSpeedSegOfs_C "Winkel zwischen phys. Nullposition und dem Beginn der Segmente zur Phasenraddrehzahlberechnung" VALUE 0x1C0C46 Kw_Ws16 360.0000 AngleCaS 0.00 360.0000 FORMAT "%8.4" EXTENDED_LIMITS -384.0000 383.9883 /end CHARACTERISTIC
/begin CHARACTERISTIC CaSCD_stCalc_C "Abschalten von unterschiedlichen Funktionen des Phasensystems" VALUE 0x1C0C48 Kw_Wu8 255.0 OneToOne 0.00 255.0 FORMAT "%5.1" /end CHARACTERISTIC
/begin CHARACTERISTIC CaSCD_stEdgeTrig_C "Triggerbedingung für die Phasenflankenerfassung" VALUE 0x1C0C49 Kw_Wu8 2.000 OneToOne 1.000 3.000 FORMAT "%5.3" EXTENDED_LIMITS 0.00 255.0 /end CHARACTERISTIC
/begin CHARACTERISTIC CaSCD_stPinState_C "Signalpegel zur Auswertung der Phasensegmente verwenden" VALUE 0x1C0C4A Kw_Wu8 1.000 OneToOne 0.00 1.000 FORMAT "%5.3" EXTENDED_LIMITS 0.00 255.0 /end CHARACTERISTIC
/begin CHARACTERISTIC CaSCD_stTPO_C "True Power On Funktion des Phasengebersensors" VALUE 0x1C0C4B Kw_Wu8 1.000 OneToOne 0.00 1.000 FORMAT "%5.3" EXTENDED_LIMITS 0.00 255.0 /end CHARACTERISTIC
/begin CHARACTERISTIC CaSCD_tiPeriodRev1Max_C "Max. Zeit der vorletzten Periode einer Phasengeberradumdrehung" VALUE 0x1C0C4C Kw_Ws16 3276.700 Period_ms 0.00 3276.700 FORMAT "%8.3" EXTENDED_LIMITS -3276.800 3276.700 /end CHARACTERISTIC
/begin CHARACTERISTIC CaSCD_tiPeriodRev2Max_C "Max. Zeit der letzten Periode einer Phasengeberradumdrehung" VALUE 0x1C0C4E Kw_Ws16 3276.700 Period_ms 0.00 3276.700 FORMAT "%8.3" EXTENDED_LIMITS -3276.800 3276.700 /end CHARACTERISTIC
/begin CHARACTERISTIC CaSCD_tiTimOutOfs_C "Offset zur Berechnung des Timeout-Wertes der Plausibilitätsprüfung" VALUE 0x1C0C50 Kw_Ws16 3276.700 Period_ms 0.00 3276.700 FORMAT "%8.3" EXTENDED_LIMITS -3276.800 3276.700 /end CHARACTERISTIC
/begin CHARACTERISTIC Clg_dtMinDynTst_C "Minimaler Anstieg der Wassertemperatur zur Aktivierung des dynamischen Plausibilitätstests" VALUE 0x1C8C50 Kw_Ws16 6553.500 TempDiff_Kelv -3276.800 3276.700 FORMAT "%8.3" /end CHARACTERISTIC
/begin CHARACTERISTIC Clg_nMinEnaDynTst_C "Minimale Drehzahl zur Aktivierung des dynamischen Plausibilitätstests" VALUE 0x1C8C52 Kw_Ws16 65535.00 EngN -32768.00 32767.00 FORMAT "%8.2" /end CHARACTERISTIC
/begin CHARACTERISTIC Clg_qMinEnaDynTst_C "Minimale Einspritzmenge zur Aktivierung des dynamischen Plausibilitätstests" VALUE 0x1C8C54 Kw_Ws16 655.3500 InjMass -327.6800 327.6700 FORMAT "%8.4" /end CHARACTERISTIC
/begin CHARACTERISTIC Clg_stCtl_C "Bitcodierter Schalter für das Modul:Kühlung" VALUE 0x1C8C56 Kw_Wu8 255.0 OneToOne 0.00 255.0 FORMAT "%5.1" /end CHARACTERISTIC
/begin CHARACTERISTIC Clg_tiInitTmr_C "Zeitspanne nach Motorstatrt bis die Wassertemperatur erfasst wird" VALUE 0x1C8C58 Kw_Ws16 655.3500 Time_s -327.6800 327.6700 FORMAT "%8.4" /end CHARACTERISTIC
/begin CHARACTERISTIC Clg_tiMaxDynTst_CUR "Kennlinie der maximal zulässigen Testzeit des dynamischen Plausibilitätstest" CURVE 0x1C8C5A Kl_Xs16_Ws16 167769.6 Time_DynTst -83886.08 83883.52 FORMAT "%8.2"
 /begin AXIS_DESCR STD_AXIS Clg_tClntStrtVal_mp Temp_Cels 10 -3549.940 3003.560 FORMAT "%8.3" DEPOSIT ABSOLUTE /end AXIS_DESCR
/end CHARACTERISTIC
/begin CHARACTERISTIC Clg_tMinClntDynTst_C "Minimale Wassertemperatur zur Aktivierung des dynamischen Plausibilitätstest" VALUE 0x1C8C84 Kw_Ws16 6553.500 Temp_Cels -3549.940 3003.560 FORMAT "%8.3" /end CHARACTERISTIC
/begin CHARACTERISTIC CmbChb_nAvrgThrHi_C "maximale Drehzahl fuer Ueberwachung" VALUE 0x1C8C86 Kw_Ws16 6000.000 EngN 0.00 6000.000 FORMAT "%8.3" EXTENDED_LIMITS -32768.00 32767.00 /end CHARACTERISTIC
/begin CHARACTERISTIC CmbChb_nAvrgThrLo_C "minimale Drehzahl fuer Ueberwachung" VALUE 0x1C8C88 Kw_Ws16 6000.000 EngN 0.00 6000.000 FORMAT "%8.3" EXTENDED_LIMITS -32768.00 32767.00 /end CHARACTERISTIC
/begin CHARACTERISTIC CmbChb_qRawThrHi_C "maximale Menge fuer Ueberwachung" VALUE 0x1C8C8A Kw_Ws16 655.3500 InjMass -327.6800 327.6700 FORMAT "%8.4" /end CHARACTERISTIC
/begin CHARACTERISTIC CmbChb_qRawThrLo_C "minimale Menge fuer Ueberwachung" VALUE 0x1C8C8C Kw_Ws16 655.3500 InjMass -327.6800 327.6700 FORMAT "%8.4" /end CHARACTERISTIC
/begin CHARACTERISTIC CmbChb_tClntThrLo_C "minimale Wassertemperatur fuer Ueberwachung" VALUE 0x1C8C8E Kw_Ws16 3003.700 Temp_Cels -0.1400000 3003.560 FORMAT "%8.3" EXTENDED_LIMITS -3549.940 3003.560 /end CHARACTERISTIC
/begin CHARACTERISTIC CmbChb_vThrHi_C "maximale Geschwindigkeit fuer Ueberwachung" VALUE 0x1C8C90 Kw_Ws16 327.6700 Vel 0.00 327.6700 FORMAT "%8.4" EXTENDED_LIMITS -327.6800 327.6700 /end CHARACTERISTIC
/begin CHARACTERISTIC CmbChb_tiDebClutchChng_C "Entprellzeit für die Zustandsänderung des Kupplungssignals" VALUE 0x1C8C92 Kw_Wu16 655350.0 Time_ms 0.00 655350.0 FORMAT "%8.1" /end CHARACTERISTIC
/begin CHARACTERISTIC CmbChb_tiDlyStr_C "Startausblendezeit" VALUE 0x1C8C94 Kw_Wu16 655350.0 Time_ms 0.00 655350.0 FORMAT "%8.1" /end CHARACTERISTIC
/begin CHARACTERISTIC CmbChb_ctEngRevPerBlk_C "Blockgroesse (UpM) f. Ausbl./Test/Ausw.verz." VALUE 0x1C8C96 Kw_Wu16 65535.00 OneToOne 0.00 65535.00 FORMAT "%8.2" /end CHARACTERISTIC
/begin CHARACTERISTIC CmbChb_ctSegTDC1_C "Offset für internen Segmentzähler in Aussetzererkennung" VALUE 0x1C8C98 Kw_Wu16 0.00 OneToOne 0.00 0.00 FORMAT "%8.2" EXTENDED_LIMITS 0.00 65535.00 /end CHARACTERISTIC
/begin CHARACTERISTIC CmbChb_numBlk_C "Blockanzahl fuer Test" VALUE 0x1C8C9A Kw_Wu16 65535.00 OneToOne 0.00 65535.00 FORMAT "%8.2" /end CHARACTERISTIC
/begin CHARACTERISTIC CmbChb_dnSegMin_C "Prozentuelle Komponente des durchschnittlichen minimalen Drehzahlanstieges" VALUE 0x1C8C9C Kw_Ws16 655.3500 Prc -327.6800 327.6700 FORMAT "%8.4" /end CHARACTERISTIC
/begin CHARACTERISTIC CmbChb_ctMisfireMax_C "maximale Anzahl von Aussetzern pro Test" VALUE 0x1C8C9E Kw_Wu16 65535.00 OneToOne 0.00 65535.00 FORMAT "%8.2" /end CHARACTERISTIC
/begin CHARACTERISTIC CmbChb_swtMonClutchVal_C "DS-Wert für SW-Schalter CmbChb_swtMonClutch, De/Aktivierung Überwachung Zündaussetzererkennung" VALUE 0x1C8CA0 Kw_Wu8 3.000 OneToOne 0.00 3.000 FORMAT "%5.3" EXTENDED_LIMITS 0.00 255.0 /end CHARACTERISTIC
/begin CHARACTERISTIC CmbChb_swtMonClutchType_C "Typ SW-Schalter CmbChb_swtMonClutch (1: EEPROM, 2: DS-Wert CrCCD_swtMonClutchVal_C)" VALUE 0x1C8CA1 Kw_Wu8 1.000 OneToOne 1.000 2.000 FORMAT "%5.3" EXTENDED_LIMITS 0.00 255.0 /end CHARACTERISTIC
/begin CHARACTERISTIC BasAdj_EGRnSetpoint_C "Leerlaufsolldrehzahl bei EGR Grundeinstellung  (Diagnose)" VALUE 0x1C89EE Kw_Ws16 65535.00 EngN -32768.00 32767.00 FORMAT "%8.2" /end CHARACTERISTIC
/begin CHARACTERISTIC BasAdj_EGRtime_C "Zeit nach der bei EGR-Grundeinstellung zwischen den beiden Tastverhältnissen umgeschalten wird  (Diagnose)" VALUE 0x1C89F0 Kw_Wu16 655350.0 Time_ms 0.00 655350.0 FORMAT "%8.1" /end CHARACTERISTIC
/begin CHARACTERISTIC BasAdj_EGRBits_C "Maske für BasAdj_st bei EGR Grundeinstellung  (Diagnose)" VALUE 0x1C89F2 Kw_Wu16 65535.00 OneToOne 0.00 65535.00 FORMAT "%8.2" READ_ONLY /end CHARACTERISTIC
/begin CHARACTERISTIC BasAdj_InjSetPointnSetpoint_C "Leerlaufsolldrehzahl bei Spritzbeginn - Grundeinstellung (Diagnose)" VALUE 0x1C89F4 Kw_Ws16 65535.00 EngN -32768.00 32767.00 FORMAT "%8.2" /end CHARACTERISTIC
/begin CHARACTERISTIC BasAdj_InjSetPointtime_C "Zeit nach der bei Spritzbeginn-Grundeinstellung zwischen den beiden Tastverhältnissen umgeschalten wird  (Diagnose)" VALUE 0x1C89F6 Kw_Wu16 655350.0 Time_ms 0.00 655350.0 FORMAT "%8.1" /end CHARACTERISTIC
/begin CHARACTERISTIC BasAdj_InjSetPointBits_C "Maske für BasAdj_st bei Spritzbeginn-Grundeinstellung  (Diagnose)" VALUE 0x1C89F8 Kw_Wu16 65535.00 OneToOne 0.00 65535.00 FORMAT "%8.2" READ_ONLY /end CHARACTERISTIC
/begin CHARACTERISTIC BasAdj_PCRBiTnSetpoint_C "Leerlaufsolldrehzahl bei BiT-Grundeinstellung  (Diagnose)" VALUE 0x1C89FA Kw_Ws16 65535.00 EngN -32768.00 32767.00 FORMAT "%8.2" /end CHARACTERISTIC
/begin CHARACTERISTIC BasAdj_PCRBiTtime_C "Zeit nach der bei BiT-Grundeinstellung zwischen den beiden Tastverhältnissen umgeschalten wird  (Diagnose)" VALUE 0x1C89FC Kw_Wu16 655350.0 Time_ms 0.00 655350.0 FORMAT "%8.1" /end CHARACTERISTIC
/begin CHARACTERISTIC BasAdj_PCRBiTBits_C "Maske für BasAdj_st bei BiT-Grundeinstellung  (Diagnose)" VALUE 0x1C89FE Kw_Wu16 65535.00 OneToOne 0.00 65535.00 FORMAT "%8.2" READ_ONLY /end CHARACTERISTIC
/begin CHARACTERISTIC BasAdj_PCRnSetpoint_C "Leerlaufsolldrehzahl bei PCR-Grundeinstellung  (Diagnose)" VALUE 0x1C8A00 Kw_Ws16 65535.00 EngN -32768.00 32767.00 FORMAT "%8.2" /end CHARACTERISTIC
/begin CHARACTERISTIC BasAdj_PCRtime_C "Zeit nach der bei PCR-Grundeinstellung zwischen den beiden Tastverhältnissen umgeschalten wird  (Diagnose)" VALUE 0x1C8A02 Kw_Wu16 655350.0 Time_ms 0.00 655350.0 FORMAT "%8.1" /end CHARACTERISTIC
/begin CHARACTERISTIC BasAdj_PCRBits_C "Maske für BasAdj_st bei PCR-Grundeinstellung  (Diagnose)" VALUE 0x1C8A04 Kw_Wu16 65535.00 OneToOne 0.00 65535.00 FORMAT "%8.2" READ_ONLY /end CHARACTERISTIC
/begin CHARACTERISTIC BasAdj_PSPnSetpoint_C "Leerlaufsolldrehzahl bei PSP-Grundeinstellung  (Diagnose)" VALUE 0x1C8A06 Kw_Ws16 65535.00 EngN -32768.00 32767.00 FORMAT "%8.2" /end CHARACTERISTIC
/begin CHARACTERISTIC BasAdj_PSPtime_C "Zeit nach der bei PSP-Grundeinstellung zwischen den beiden Tastverhältnissen umgeschalten wird  (Diagnose)" VALUE 0x1C8A08 Kw_Wu16 655350.0 Time_ms 0.00 655350.0 FORMAT "%8.1" /end CHARACTERISTIC
/begin CHARACTERISTIC BasAdj_PSPBits_C "Maske für BasAdj_st bei PSP-Grundeinstellung  (Diagnose)" VALUE 0x1C8A0A Kw_Wu16 65535.00 OneToOne 0.00 65535.00 FORMAT "%8.2" READ_ONLY /end CHARACTERISTIC
/begin CHARACTERISTIC BasAdj_VSA1nSetpoint_C "Leerlaufsolldrehzahl bei VSA 1-Grundeinstellung  (Diagnose)" VALUE 0x1C8A0C Kw_Ws16 65535.00 EngN -32768.00 32767.00 FORMAT "%8.2" /end CHARACTERISTIC
/begin CHARACTERISTIC BasAdj_VSA1time_C "Zeit nach der bei VSA 1-Grundeinstellung zwischen den beiden Tastverhältnissen umgeschalten wird  (Diagnose)" VALUE 0x1C8A0E Kw_Wu16 655350.0 Time_ms 0.00 655350.0 FORMAT "%8.1" /end CHARACTERISTIC
/begin CHARACTERISTIC BasAdj_VSA1Bits_C "Maske für BasAdj_st bei VSA 1-Grundeinstellung  (Diagnose)" VALUE 0x1C8A10 Kw_Wu16 65535.00 OneToOne 0.00 65535.00 FORMAT "%8.2" READ_ONLY /end CHARACTERISTIC
/begin CHARACTERISTIC BasAdj_VSA2nSetpoint_C "Leerlaufsolldrehzahl bei VSA 2-Grundeinstellung  (Diagnose)" VALUE 0x1C8A12 Kw_Ws16 65535.00 EngN -32768.00 32767.00 FORMAT "%8.2" /end CHARACTERISTIC
/begin CHARACTERISTIC BasAdj_VSA2time_C "Zeit nach der bei VSA 2 - Grundeinstellung zwischen den beiden Tastverhältnissen umgeschalten wird  (Diagnose)" VALUE 0x1C8A14 Kw_Wu16 655350.0 Time_ms 0.00 655350.0 FORMAT "%8.1" /end CHARACTERISTIC
/begin CHARACTERISTIC BasAdj_VSA2Bits_C "Maske für BasAdj_st bei VSA 2-Grundeinstellung  (Diagnose)" VALUE 0x1C8A16 Kw_Wu16 65535.00 OneToOne 0.00 65535.00 FORMAT "%8.2" READ_ONLY /end CHARACTERISTIC
/begin CHARACTERISTIC BasAdj_VSAMSnSetpoint_C "Leerlaufsolldrehzahl bei VSA M/S - Grundeinstellung  (Diagnose)" VALUE 0x1C8A18 Kw_Ws16 65535.00 EngN -32768.00 32767.00 FORMAT "%8.2" /end CHARACTERISTIC
/begin CHARACTERISTIC BasAdj_VSAMStime_C "Zeit nach der bei VSA M/S - Grundeinstellung zwischen den beiden Tastverhältnissen umgeschalten wird  (Diagnose)" VALUE 0x1C8A1A Kw_Wu16 655350.0 Time_ms 0.00 655350.0 FORMAT "%8.1" /end CHARACTERISTIC
/begin CHARACTERISTIC BasAdj_VSAMSBits_C "Maske für BasAdj_st bei VSA M/S -Grundeinstellung  (Diagnose)" VALUE 0x1C8A1C Kw_Wu16 65535.00 OneToOne 0.00 65535.00 FORMAT "%8.2" READ_ONLY /end CHARACTERISTIC
/begin MEASUREMENT ASDrf_dtrqInrLtd_mp "zeitliche Ableitung von CoEng_trqInrLtd" SWORD dTrq 1 100 -3276.800 3276.700 FORMAT "%8.3" ECU_ADDRESS 0x80209C /end MEASUREMENT
/begin MEASUREMENT ASDrf_dtrqLim_mp "durch ASDrf_dtrqInrLtdLim_CUR begrenzte zeitliche Ableitung von CoEng_trqInrLtd" SLONG dTrq 1 100 -214748364.800 214748364.700 FORMAT "%13.3" ECU_ADDRESS 0x8020A0 /end MEASUREMENT
/begin MEASUREMENT ASDrf_KdCurr_mp "Aktueller Parameter Kd des ARD-FF (ASDrf)" SLONG Kd 1 100 -32768.0000000 32767.9999847 FORMAT "%13.7" ECU_ADDRESS 0x8020A4 /end MEASUREMENT
/begin MEASUREMENT ASDrf_stBitFrame "Status von Parameterauswahl" UBYTE OneToOne 1 100 0.00 255.0 FORMAT "%5.1" ECU_ADDRESS 0x7F930C /end MEASUREMENT
/begin MEASUREMENT ASDrf_stDriver "Satus vom Gaspedal (Vollast, Teillast, Kick down)" UBYTE OneToOne 1 100 0.00 255.0 FORMAT "%5.1" ECU_ADDRESS 0x7F930D /end MEASUREMENT
/begin MEASUREMENT ASDrf_stExtInt "Erkennung von externem Momenteneingriff" UBYTE OneToOne 1 100 0.00 255.0 FORMAT "%5.1" ECU_ADDRESS 0x7F930E /end MEASUREMENT
/begin MEASUREMENT ASDrf_stGrip "Status Kraftschluß bzw.  Wandlerkupplung geregelt" UBYTE OneToOne 1 100 0.00 255.0 FORMAT "%5.1" ECU_ADDRESS 0x7F930F /end MEASUREMENT
/begin MEASUREMENT ASDrf_stInitSteepIn_mp "Indikator für Initialisierung aufgrund großer Eingangsgradienten" UBYTE OneToOne 1 100 0.00 255.0 FORMAT "%5.1" ECU_ADDRESS 0x8020A8 /end MEASUREMENT
/begin MEASUREMENT ASDrf_stPosNeg "pos/neg Mengentendenz" UBYTE OneToOne 1 100 0.00 255.0 FORMAT "%5.1" ECU_ADDRESS 0x7F9310 /end MEASUREMENT
/begin MEASUREMENT ASDrf_stSlpLim_mp "Steigungsbegrenzung aktiv" UBYTE OneToOne 1 100 0.00 255.0 FORMAT "%5.1" ECU_ADDRESS 0x8020A9 /end MEASUREMENT
/begin MEASUREMENT ASDrf_stTMFWRO "Statusleiste für Ausrollerkennung" UBYTE OneToOne 1 100 0.00 255.0 FORMAT "%5.1" ECU_ADDRESS 0x7F9311 /end MEASUREMENT
/begin MEASUREMENT ASDrf_T1Curr_mp "Aktueller Parameter T1 des ARD-FF (ASDrf)" ULONG TimeDelay_s 1 100 0.0000010000000 4294.9673 FORMAT "%9.4" ECU_ADDRESS 0x8020AC /end MEASUREMENT
/begin MEASUREMENT ASDrf_trqCompoffset_mp "Offset für Schleppfehlerkorrektur" SLONG Trq 1 100 -214748364.800 214748364.700 FORMAT "%13.3" ECU_ADDRESS 0x8020B0 /end MEASUREMENT
/begin MEASUREMENT ASDrf_trqInit_mp "berechneter Initialisierungswert für PT1 Zustandsvariable" SWORD Trq 1 100 -3276.800 3276.700 FORMAT "%8.3" ECU_ADDRESS 0x8020B4 /end MEASUREMENT
/begin MEASUREMENT ASDrf_trqInr "ARD Führungsformer Momentausgang (inneres Moment)" SWORD Trq 1 100 -3276.800 3276.700 FORMAT "%8.3" ECU_ADDRESS 0x7F95B4 /end MEASUREMENT
/begin MEASUREMENT ASDrf_trqInrLtdFlt_mp "Gefiltertes Eingangssignal CoEng_trqInrLtd" SWORD Trq 1 100 -3276.800 3276.700 FORMAT "%8.3" ECU_ADDRESS 0x8020B6 /end MEASUREMENT
/begin MEASUREMENT ASDrf_trqInrUnLim_mp "Ausgang des PDT1-Glieds, vor der Steigungsbegrenzung des Führungsformers." SWORD Trq 1 100 -3276.800 3276.700 FORMAT "%8.3" ECU_ADDRESS 0x8020B8 /end MEASUREMENT
/begin MEASUREMENT ASDrf_trqLimPull_mp "Zuggrenze" SWORD Trq 1 100 -3276.800 3276.700 FORMAT "%8.3" ECU_ADDRESS 0x8020BA /end MEASUREMENT
/begin MEASUREMENT ASDrf_trqLimPush_mp "Schubgrenze" SWORD Trq 1 100 -3276.800 3276.700 FORMAT "%8.3" ECU_ADDRESS 0x8020BC /end MEASUREMENT
/begin MEASUREMENT ASDrf_trqLoss_mp "Reibmoment inc. Nebenaggregate" SWORD Trq 1 100 -3276.800 3276.700 FORMAT "%8.3" ECU_ADDRESS 0x8020BE /end MEASUREMENT
/begin MEASUREMENT ASDrf_trqPT1In_mp "aktueller PT1 Eingangswert" SLONG Trq 1 100 -214748364.800 214748364.700 FORMAT "%13.3" ECU_ADDRESS 0x8020C0 /end MEASUREMENT
/begin MEASUREMENT ASDrf_trqPT1Out_mp "aktueller PT1 Ausgangswert" SWORD Trq 1 100 -3276.800 3276.700 FORMAT "%8.3" ECU_ADDRESS 0x8020C4 /end MEASUREMENT
/begin MEASUREMENT ASDrf_trqPT1P_mp "Ausgang P-Anteil in PT1 gefiltertem Signal" SWORD Trq 1 100 -3276.800 3276.700 FORMAT "%8.3" ECU_ADDRESS 0x8020C6 /end MEASUREMENT
/begin MEASUREMENT ASDrf_trqP_mp "Ausgang ASDrf P-Anteil" SWORD Trq 1 100 -3276.800 3276.700 FORMAT "%8.3" ECU_ADDRESS 0x8020C8 /end MEASUREMENT
/begin MEASUREMENT ASMod_arEffEGR "effektiver Querschnitt des Abgasrückführventils" FLOAT32_IEEE Area_float 1 100 0.00 50.0000000 FORMAT "%10.7" ECU_ADDRESS 0x7F9BD4 /end MEASUREMENT
/begin MEASUREMENT ASMod_arEffTVA_mp "effektive Querschnittsfläche der Drosselklappe" FLOAT32_IEEE Area_float 1 100 0.00 50.0000000 FORMAT "%10.7" ECU_ADDRESS 0x802148 /end MEASUREMENT
/begin MEASUREMENT ASMod_ddmAirPerTime_mp "zeitliche Änderung des Luftmassenstroms" SWORD RmpAirMassPerTimeLow 1 100 -32768.00 32767.00 FORMAT "%8.2" ECU_ADDRESS 0x802190 /end MEASUREMENT
/begin MEASUREMENT ASMod_dmAirPerTimeCorr "dynamisch korrigierter Frischluftmassenstrom vor Mischstelle" FLOAT32_IEEE AirmassPerTime_float 1 100 0.00 1400.00000 FORMAT "%10.5" ECU_ADDRESS 0x7F9BD8 /end MEASUREMENT
/begin MEASUREMENT ASMod_dmAirPerTimeCorrRaw_mp "Rohwert des dynamisch korrigierten Frischluftmassenstrom vor Mischstelle" FLOAT32_IEEE AirmassPerTime_float 1 100 0.00 1400.00000 FORMAT "%10.5" ECU_ADDRESS 0x80214C /end MEASUREMENT
/begin MEASUREMENT ASMod_dmAirPerTimeRed_mp "reduzierter HFM Luftmassenstrom" FLOAT32_IEEE AirmassPerTime_float 1 100 0.00 1400.00000 FORMAT "%10.5" ECU_ADDRESS 0x8020CC /end MEASUREMENT
/begin MEASUREMENT ASMod_dmEGPipeRed_mp "reduzierter Abgasmassenstrom" FLOAT32_IEEE AirmassPerTimeRed_float 1 100 0.00 50000.0000 FORMAT "%10.4" ECU_ADDRESS 0x8020F0 /end MEASUREMENT
/begin MEASUREMENT ASMod_dmEGRIndAir_mp "Massenstrom des rückgeführten Abgases in den Motor" FLOAT32_IEEE AirmassPerTime_float 1 100 0.00 720.000000 FORMAT "%10.6" ECU_ADDRESS 0x802158 /end MEASUREMENT
/begin MEASUREMENT ASMod_dmEGRIntMnf_mp "zeitliche Änderung der rückgeführten Abgasmasse im Einlasskrümmer" FLOAT32_IEEE AirmassPerTime_float 1 100 -180.000000 180.000000 FORMAT "%10.6" ECU_ADDRESS 0x80215C /end MEASUREMENT
/begin MEASUREMENT ASMod_dmEGRPst "rückgeführter Abgasmassenstrom nach ARF-Kühler" FLOAT32_IEEE AirmassPerTime_float 1 100 -700.000000 700.000000 FORMAT "%10.6" ECU_ADDRESS 0x7F9BDC /end MEASUREMENT
/begin MEASUREMENT ASMod_dmEGRPstRaw_mp "ungefilterter rückgeführter Abgasmassenstrom nach ARF-Kühler" FLOAT32_IEEE AirmassPerTime_float 1 100 -700.000000 700.000000 FORMAT "%10.6" ECU_ADDRESS 0x802108 /end MEASUREMENT
/begin MEASUREMENT ASMod_dmEG_mp "Abgasmassenstrom nach Verbrennung" SWORD AirMassPerTime 1 100 -3276.800 3276.700 FORMAT "%8.3" ECU_ADDRESS 0x802116 /end MEASUREMENT
/begin MEASUREMENT ASMod_dmExhMnfPre "Abgasmassenstrom am Eintritt des Abgaskrümmers" SWORD AirMassPerTime 1 100 -3276.800 3276.700 FORMAT "%8.3" ECU_ADDRESS 0x7F95B6 /end MEASUREMENT
/begin MEASUREMENT ASMod_dmExhMnfPst "Abgasmassenstrom am Austritt des Abgaskrümmers" SWORD AirMassPerTime 1 100 0.00 1400.000 FORMAT "%8.3" ECU_ADDRESS 0x7F95B8 /end MEASUREMENT
/begin MEASUREMENT ASMod_dmExhMnfPstRed_mp "reduzierter Abgasmassenstrom am Austritt des Abgaskrümmers" FLOAT32_IEEE AirmassPerTime_float 1 100 0.00 1500.00000 FORMAT "%10.5" ECU_ADDRESS 0x8021BC /end MEASUREMENT
/begin MEASUREMENT ASMod_dmFlBurned_mp "Massenstrom des verbrannten Kraftstoffs" SWORD InjMassPerTime 1 100 -327.6800 327.6700 FORMAT "%8.4" ECU_ADDRESS 0x802118 /end MEASUREMENT
/begin MEASUREMENT ASMod_dmFlPerTime_mp "eingespritzter Kraftstoffmassenstrom" SWORD InjMassPerTime 1 100 -327.6800 327.6700 FORMAT "%8.4" ECU_ADDRESS 0x80211A /end MEASUREMENT
/begin MEASUREMENT ASMod_dmIndAir "Gasmassenstrom in den Motor" SWORD AirMassPerTime 1 100 -3276.800 3276.700 FORMAT "%8.3" ECU_ADDRESS 0x7F95BA /end MEASUREMENT
/begin MEASUREMENT ASMod_dmIndAirRaw_mp "ungefilterter Gasmassenstrom in den Motor ohne Temperaturkorrektur" FLOAT32_IEEE AirmassPerTime_float 1 100 0.00 1400.00000 FORMAT "%10.5" ECU_ADDRESS 0x802160 /end MEASUREMENT
/begin MEASUREMENT ASMod_dmIndAirRef "Referenz des Gasmassenstroms in den Motor während geschlossener Abgasrückführung" SWORD AirMassPerTime 1 100 -3276.800 3276.700 FORMAT "%8.3" ECU_ADDRESS 0x7F95BC /end MEASUREMENT
/begin MEASUREMENT ASMod_dmIndAirRef_mp "Referenz des Gasmassenstroms in den Motor" SWORD AirMassPerTime 1 100 -3276.800 3276.700 FORMAT "%8.3" ECU_ADDRESS 0x80211C /end MEASUREMENT
/begin MEASUREMENT ASMod_dmIndVol_mp "zeitliche Änderung der Gasmasse im Ansaugvolumen" FLOAT32_IEEE AirmassPerTime_float 1 100 -360.000000 360.000000 FORMAT "%10.6" ECU_ADDRESS 0x802150 /end MEASUREMENT
/begin MEASUREMENT ASMod_dmIntMnf_mp "zeitliche Änderung der Gasmasse im Einlasskrümmer" FLOAT32_IEEE AirmassPerTime_float 1 100 -360.000000 360.000000 FORMAT "%10.6" ECU_ADDRESS 0x802164 /end MEASUREMENT
/begin MEASUREMENT ASMod_dmO2EG_mp "Sauerstoffmassenstrom nach Verbrennung" SWORD O2MassPerTime 1 100 -327.6800 327.6700 FORMAT "%8.4" ECU_ADDRESS 0x80211E /end MEASUREMENT
/begin MEASUREMENT ASMod_dmO2IndAir "Sauerstoffmassenstrom in den Motor" SWORD O2MassPerTime 1 100 -327.6800 327.6700 FORMAT "%8.4" ECU_ADDRESS 0x7F95BE /end MEASUREMENT
/begin MEASUREMENT ASMod_dmO2IntMnf_mp "zeitliche Änderung der Sauerstoffmasse im Einlasskrümmer" FLOAT32_IEEE AirmassPerTime_float 1 100 -80.0000000 80.0000000 FORMAT "%10.7" ECU_ADDRESS 0x802168 /end MEASUREMENT
/begin MEASUREMENT ASMod_dnAvrg_mp "zeitliche Änderung der Motordrehzahl" SWORD RmpEngNLow 1 100 -32768.00 32767.00 FORMAT "%8.2" ECU_ADDRESS 0x802192 /end MEASUREMENT
/begin MEASUREMENT ASMod_dpIntVal_mp "zeitliche Änderung des Ladedrucks" SWORD RmpPres_hPaLow 1 100 -3276.800 3276.700 FORMAT "%8.3" ECU_ADDRESS 0x802194 /end MEASUREMENT
/begin MEASUREMENT ASMod_dqLmbdCtl_mp "zeitliche Änderung der Kraftstoffmenge" SWORD RmpInjMassLow 1 100 -3276.800 3276.700 FORMAT "%8.3" ECU_ADDRESS 0x802196 /end MEASUREMENT
/begin MEASUREMENT ASMod_dvolIndAirRef "Referenz des Gasvolumenstroms in den Motor" SWORD AirVolPerTime 1 100 -3276.800 3276.700 FORMAT "%8.3" ECU_ADDRESS 0x7F95C0 /end MEASUREMENT
/begin MEASUREMENT ASMod_etaTurb_mp "Turbinenwirkungsgrad als Funktion der Position des Ladedruckstellers" FLOAT32_IEEE OneToOne 1 100 0.00 1.00000000 FORMAT "%10.8" ECU_ADDRESS 0x8020F4 /end MEASUREMENT
/begin MEASUREMENT ASMod_facArEffCorOutI_mp "I-Anteil des PI-Reglers zur Korrektur des effektiven Querschnitts des Abgasrückführventils" SLONG Fact 1 100 -262144.000000 262143.999878 FORMAT "%13.6" ECU_ADDRESS 0x802198 /end MEASUREMENT
/begin MEASUREMENT ASMod_facArEffCorOutP_mp "P-Anteil des PI-Reglers zur Korrektur des effektiven Querschnitts des Abgasrückführventils" SWORD Fact 1 100 -4.000000 3.999878 FORMAT "%8.6" ECU_ADDRESS 0x80219C /end MEASUREMENT
/begin MEASUREMENT ASMod_facArEffCorOut_mp "Ausgang des PI-Reglers zur Korrektur des effektiven Querschnitts des Abgasrückführventils" SWORD Fact 1 100 -4.000000 3.999878 FORMAT "%8.6" ECU_ADDRESS 0x80219E /end MEASUREMENT
/begin MEASUREMENT ASMod_facArEffEGRCor "Korrekturfaktor für den effektiven Querschnitt des Abgasrückführventils" FLOAT32_IEEE OneToOne 1 100 0.00 4.00000000 FORMAT "%10.8" ECU_ADDRESS 0x7F9BE4 /end MEASUREMENT
/begin MEASUREMENT ASMod_facDMCorTDiff_mp "Korrekturfaktor der Temperaturerhöhung aufgrund des aktuellen Gasmassenstroms" SWORD Fact 1 100 -4.000000 3.999878 FORMAT "%8.6" ECU_ADDRESS 0x802120 /end MEASUREMENT
/begin MEASUREMENT ASMod_facDMCorTIndAir_mp "Korrekturfaktor für Temperatur vor Einlass aufgrund der Wandwärmeübergänge" SWORD Fact 1 100 -4.000000 3.999878 FORMAT "%8.6" ECU_ADDRESS 0x80218C /end MEASUREMENT
/begin MEASUREMENT ASMod_facSOICorTDiff_mp "Korrekturfaktor der Temperaturerhöhung aufgrund des aktuellen Spritzbeginns" SWORD Fact 1 100 -4.000000 3.999878 FORMAT "%8.6" ECU_ADDRESS 0x802122 /end MEASUREMENT
/begin MEASUREMENT ASMod_facTCorDMIndAir_mp "Korrekturfaktor für den Luftaufwand aufgrund Differenz zwischen Referenz und aktueller Temperatur vor Einlass" FLOAT32_IEEE OneToOne 1 100 0.00 2.00000000 FORMAT "%10.8" ECU_ADDRESS 0x80216C /end MEASUREMENT
/begin MEASUREMENT ASMod_facTIndAirCor_mp "Korrekturfaktor für Luftaufwand" SWORD RatAirMass 1 100 -327.6800 327.6700 FORMAT "%8.4" ECU_ADDRESS 0x8021CA /end MEASUREMENT
/begin MEASUREMENT ASMod_facVolEffCor "Korrekturfaktor für effektiven Luftaufwand" FLOAT32_IEEE OneToOne 1 100 0.00 4.00000000 FORMAT "%10.8" ECU_ADDRESS 0x7F9BE8 /end MEASUREMENT
/begin MEASUREMENT ASMod_facVolEffCorOutI_mp "I-Anteil des PI-Reglers zur Korrektur des Luftaufwands" SLONG Fact 1 100 -262144.000000 262143.999878 FORMAT "%13.6" ECU_ADDRESS 0x8021A0 /end MEASUREMENT
/begin MEASUREMENT ASMod_facVolEffCorOutP_mp "P-Anteil des PI-Reglers zur Korrektur des Luftwaufwands" SWORD Fact 1 100 -4.000000 3.999878 FORMAT "%8.6" ECU_ADDRESS 0x8021A4 /end MEASUREMENT
/begin MEASUREMENT ASMod_facVolEffCorOut_mp "Ausgang des PI-Reglers der Korrektur des Luftaufwands" SWORD Fact 1 100 -4.000000 3.999878 FORMAT "%8.6" ECU_ADDRESS 0x8021A6 /end MEASUREMENT
/begin MEASUREMENT ASMod_facVolEff_mp "Luftaufwand aus Grundkennfeld" SWORD RatAirMass 1 100 -327.6800 327.6700 FORMAT "%8.4" ECU_ADDRESS 0x8021CC /end MEASUREMENT
/begin MEASUREMENT ASMod_facVSACorVolEff_mp "Korrekturfaktor für Luftaufwand aufgrund aktueller Drallklappenposition" SWORD RatAirMass 1 100 -327.6800 327.6700 FORMAT "%8.4" ECU_ADDRESS 0x8021CE /end MEASUREMENT
/begin MEASUREMENT ASMod_mAirIntMnf_mp "Masse der Frischluft im Einlasskrümmer" FLOAT32_IEEE Airmass_float 1 100 0.00 20.0000000 FORMAT "%10.7" ECU_ADDRESS 0x802170 /end MEASUREMENT
/begin MEASUREMENT ASMod_mAirPerCylCorr "dynamisch korrigierte Luftmasse pro Zylinder vor Mischstelle" SWORD AirMassPerCyl 1 100 0.00 700.0000 FORMAT "%8.4" ECU_ADDRESS 0x7F95C2 /end MEASUREMENT
/begin MEASUREMENT ASMod_mEGRIntMnf_mp "Masse des rückgeführten Abgases im Einlasskrümmer" FLOAT32_IEEE Airmass_float 1 100 0.00 10.0000000 FORMAT "%10.7" ECU_ADDRESS 0x802174 /end MEASUREMENT
/begin MEASUREMENT ASMod_mIndVol "Gasmasse im Einlassvolumen" FLOAT32_IEEE Airmass_float 1 100 0.00 150.000000 FORMAT "%10.6" ECU_ADDRESS 0x7F9BEC /end MEASUREMENT
/begin MEASUREMENT ASMod_mIntMnf_mp "Gasmasse im Einlasskrümmer" FLOAT32_IEEE Airmass_float 1 100 0.00 20.0000000 FORMAT "%10.7" ECU_ADDRESS 0x802178 /end MEASUREMENT
/begin MEASUREMENT ASMod_mO2IntMnf_mp "Sauerstoffmasse im Einlasskrümmer" FLOAT32_IEEE Airmass_float 1 100 0.00 5.00000000 FORMAT "%10.8" ECU_ADDRESS 0x80217C /end MEASUREMENT
/begin MEASUREMENT ASMod_nTrbCh "aktuelle Turboladerdrehzahl" FLOAT32_IEEE TrbChN_float 1 100 0.00 300000.000 FORMAT "%10.3" ECU_ADDRESS 0x7F9BF0 /end MEASUREMENT
/begin MEASUREMENT ASMod_nTrbChRed_mp "reduzierte Turboladerdrehzahl" FLOAT32_IEEE TrbChN_float 1 100 0.00 300000.000 FORMAT "%10.3" ECU_ADDRESS 0x8020D0 /end MEASUREMENT
/begin MEASUREMENT ASMod_nTurbRed_mp "reduzierte Turboladerdrehzahl" FLOAT32_IEEE TrbChN_float 1 100 0.00 300000.000 FORMAT "%10.3" ECU_ADDRESS 0x8021C0 /end MEASUREMENT
/begin MEASUREMENT ASMod_pCmprPre_mp "Druck vor Verdichter" FLOAT32_IEEE Pres_hPa_float 1 100 0.00 4000.00000 FORMAT "%10.5" ECU_ADDRESS 0x8020D4 /end MEASUREMENT
/begin MEASUREMENT ASMod_pCmprPst_mp "Druck nach Verdichter" FLOAT32_IEEE Pres_hPa_float 1 100 0.00 4000.00000 FORMAT "%10.5" ECU_ADDRESS 0x8020D8 /end MEASUREMENT
/begin MEASUREMENT ASMod_pDiffEGPipe_mp "Druckabfall nach Turbine ohne Abgasnachbehandlung" FLOAT32_IEEE Pres_hPa_float 1 100 0.00 1000.00000 FORMAT "%10.5" ECU_ADDRESS 0x8020F8 /end MEASUREMENT
/begin MEASUREMENT ASMod_pDiffEGT "Druckabfall in der Abgasleitung durch Abgasnachbehandlung" FLOAT32_IEEE Pres_hPa_float 1 100 -1000.00000 1000.00000 FORMAT "%10.5" ECU_ADDRESS 0x7F9BF4 /end MEASUREMENT
/begin MEASUREMENT ASMod_pEGRPst "Druck des rückgeführten Abgases nach ARF-Kühler" FLOAT32_IEEE Pres_hPa_float 1 100 0.00 6000.00000 FORMAT "%10.5" ECU_ADDRESS 0x7F9BF8 /end MEASUREMENT
/begin MEASUREMENT ASMod_phiSOIRef_mp "Referenz des Spritzbeginns der MI1" SWORD AngleCrS 1 100 -768.0000 767.9766 FORMAT "%8.4" ECU_ADDRESS 0x802124 /end MEASUREMENT
/begin MEASUREMENT ASMod_pIndVol "Druck im Einlassvolumen" FLOAT32_IEEE Pres_hPa_float 1 100 0.00 4000.00000 FORMAT "%10.5" ECU_ADDRESS 0x7F9BFC /end MEASUREMENT
/begin MEASUREMENT ASMod_pIndVolDvt_mp "Abweichung zwischem berechnetem und gemessenem Ladedruck" SWORD Pres_hPa 1 100 -32768.00 32767.00 FORMAT "%8.2" ECU_ADDRESS 0x8021A8 /end MEASUREMENT
/begin MEASUREMENT ASMod_pIntMnf "Druck im Einlasskrümmer" FLOAT32_IEEE Pres_hPa_float 1 100 0.00 4000.00000 FORMAT "%10.5" ECU_ADDRESS 0x7F9C00 /end MEASUREMENT
/begin MEASUREMENT ASMod_pLsEGRClg_mp "Druckverlust des Abgasmassenstroms im ARF-Kühler" FLOAT32_IEEE Pres_hPa_float 1 100 0.00 1000.00000 FORMAT "%10.5" ECU_ADDRESS 0x80210C /end MEASUREMENT
/begin MEASUREMENT ASMod_pTurbPre "Druck vor Turbine" FLOAT32_IEEE Pres_hPa_float 1 100 0.00 4000.00000 FORMAT "%10.5" ECU_ADDRESS 0x7F9C04 /end MEASUREMENT
/begin MEASUREMENT ASMod_pTurbPst "Druck nach Turbine" FLOAT32_IEEE Pres_hPa_float 1 100 0.00 4000.00000 FORMAT "%10.5" ECU_ADDRESS 0x7F9C08 /end MEASUREMENT
/begin MEASUREMENT ASMod_qBurned_mp "Menge des verbrannten Kraftstoffes" SWORD InjMass 1 100 -327.6800 327.6700 FORMAT "%8.4" ECU_ADDRESS 0x802126 /end MEASUREMENT
/begin MEASUREMENT ASMod_qCor "Korrekturmenge für Mengensignal" SWORD InjMass 1 100 -327.6800 327.6700 FORMAT "%8.4" ECU_ADDRESS 0x7F95C4 /end MEASUREMENT
/begin MEASUREMENT ASMod_qLmbdCtlCorr_mp "korrigierte Lambdakontrollmenge" SWORD InjMass 1 100 -327.6800 327.6700 FORMAT "%8.4" ECU_ADDRESS 0x802128 /end MEASUREMENT
/begin MEASUREMENT ASMod_rDMIndAir_mp "relative Abweichung von der Referenz des Gasmassenstroms" SWORD RatAirMass 1 100 -327.6800 327.6700 FORMAT "%8.4" ECU_ADDRESS 0x80212A /end MEASUREMENT
/begin MEASUREMENT ASMod_rEGR "Abgasrückführrate in den Motor" FLOAT32_IEEE OneToOne 1 100 0.00 1.00000000 FORMAT "%10.8" ECU_ADDRESS 0x7F9C0C /end MEASUREMENT
/begin MEASUREMENT ASMod_rFlBurned_mp "Verhältnis der verbrannten zur eingespritzten Kraftstoffmasse" SWORD RatFuelMass 1 100 -327.6800 327.6700 FORMAT "%8.4" ECU_ADDRESS 0x80212C /end MEASUREMENT
/begin MEASUREMENT ASMod_rLmbdRecEG "schnelles reziprokes Lambda-Signal nach Verbrennung" SWORD lambdaRecVal 1 100 -32.76800 32.76700 FORMAT "%8.5" ECU_ADDRESS 0x7F95C6 /end MEASUREMENT
/begin MEASUREMENT ASMod_rLmbdRecExhMnfPst "reziprokes Lambdasignal am Ausgang des Abgaskrümmers" SWORD lambdaRecVal 1 100 0.00 2.000000 FORMAT "%8.6" ECU_ADDRESS 0x7F95C8 /end MEASUREMENT
/begin MEASUREMENT ASMod_rLmbdRecIndAir_mp "reziprokes Lambdasignal des Gasmassenstroms in den Motor" FLOAT32_IEEE OneToOne 1 100 0.00 2.00000000 FORMAT "%10.8" ECU_ADDRESS 0x802180 /end MEASUREMENT
/begin MEASUREMENT ASMod_rO2EG_mp "Sauerstoffmassenanteil des Abgases nach Verbrennung" SWORD O2 1 100 -0.3276800 0.3276700 FORMAT "%9.7" ECU_ADDRESS 0x80212E /end MEASUREMENT
/begin MEASUREMENT ASMod_rO2ExhMnfPre "Sauerstoffmassenanteil des Abgases am Eintritt des Abgaskrümmers" SWORD O2 1 100 -0.3276800 0.3276700 FORMAT "%9.7" ECU_ADDRESS 0x7F95CA /end MEASUREMENT
/begin MEASUREMENT ASMod_rO2ExhMnfPst_mp "Sauerstoffmassenanteil des Abgases am Austritt des Abgaskrümmers" FLOAT32_IEEE OneToOne 1 100 0.00 0.250000000 FORMAT "%11.9" ECU_ADDRESS 0x80213C /end MEASUREMENT
/begin MEASUREMENT ASMod_rO2IndAir "Sauerstoffmassenanteil des Massenstroms in den Motor" FLOAT32_IEEE OneToOne 1 100 0.00 0.250000000 FORMAT "%11.9" ECU_ADDRESS 0x7F9C10 /end MEASUREMENT
/begin MEASUREMENT ASMod_rPresCmpr_mp "Druckverhältnis am Verdichter" FLOAT32_IEEE OneToOne 1 100 0.00 4.00000000 FORMAT "%10.8" ECU_ADDRESS 0x8020DC /end MEASUREMENT
/begin MEASUREMENT ASMod_rPresEGPipe_mp "Druckverhältnis an der Turbine aus Modul EGPipe" FLOAT32_IEEE OneToOne 1 100 0.00 2.00000000 FORMAT "%10.8" ECU_ADDRESS 0x8020FC /end MEASUREMENT
/begin MEASUREMENT ASMod_rPresTurb_mp "Druckverhältnis an der Turbine" FLOAT32_IEEE OneToOne 1 100 0.00 5.00000000 FORMAT "%10.8" ECU_ADDRESS 0x8021C4 /end MEASUREMENT
/begin MEASUREMENT ASMod_rRelPosBPA "relative Position des Ladedruckstellers" FLOAT32_IEEE Prc_fl 1 100 0.00 100.000000 FORMAT "%10.6" ECU_ADDRESS 0x7F9C14 /end MEASUREMENT
/begin MEASUREMENT ASMod_rRelPosECB "relative Position des ARF-Kühler-Bypass-Ventils" FLOAT32_IEEE Prc_fl 1 100 0.00 100.000000 FORMAT "%10.6" ECU_ADDRESS 0x7F9C18 /end MEASUREMENT
/begin MEASUREMENT ASMod_rRelPosEGR "relative Position des Abgasrückführventils" FLOAT32_IEEE Prc_fl 1 100 0.00 100.000000 FORMAT "%10.6" ECU_ADDRESS 0x7F9C1C /end MEASUREMENT
/begin MEASUREMENT ASMod_rRelPosTVA "relative Position des Regelklappenstellers" FLOAT32_IEEE Prc_fl 1 100 0.00 100.000000 FORMAT "%10.6" ECU_ADDRESS 0x7F9C20 /end MEASUREMENT
/begin MEASUREMENT ASMod_rRelPosVSA "relative Position der Drallklappe" SWORD Prc 1 100 -327.6800 327.6700 FORMAT "%8.4" ECU_ADDRESS 0x7F95CC /end MEASUREMENT
/begin MEASUREMENT ASMod_rTDiffTurbAdbt_mp "relative Temperaturänderung in der Turbine bei adiabater Zustandsänderung" FLOAT32_IEEE OneToOne 1 100 0.00 2.00000000 FORMAT "%10.8" ECU_ADDRESS 0x802100 /end MEASUREMENT
/begin MEASUREMENT ASMod_stArEffEGRAdaptDel_mp "verzögerter Freigabestatus für Korrektur des effektiven Querschnitts des Abgasrückführventils" UBYTE OneToOne 1 100 0.00 255.0 FORMAT "%5.1" ECU_ADDRESS 0x8021AA /end MEASUREMENT
/begin MEASUREMENT ASMod_stArEffEGRAdapt_mp "Freigabestatus für Korrektur des effektiven Querschnitts des Abgasrückführventils" UBYTE OneToOne 1 100 0.00 255.0 FORMAT "%5.1" ECU_ADDRESS 0x8021AB /end MEASUREMENT
/begin MEASUREMENT ASMod_stCheckRlsDDM_mp "Freigabestatus abhängig von der zeitlichen Änderung des Luftmassenstroms" SWORD OneToOne 1 100 -32768.00 32767.00 FORMAT "%8.2" ECU_ADDRESS 0x8021AC /end MEASUREMENT
/begin MEASUREMENT ASMod_stCheckRlsDN_mp "Freigabestatus abhängig von der zeitlichen Änderung der Motordrehzahl" SWORD OneToOne 1 100 -32768.00 32767.00 FORMAT "%8.2" ECU_ADDRESS 0x8021AE /end MEASUREMENT
/begin MEASUREMENT ASMod_stCheckRlsDP_mp "Freigabestatus abhängig von der zeitlichen Änderung des Ladedrucks" SWORD OneToOne 1 100 -32768.00 32767.00 FORMAT "%8.2" ECU_ADDRESS 0x8021B0 /end MEASUREMENT
/begin MEASUREMENT ASMod_stCheckRlsDQ_mp "Freigabestatus abhängig von der zeitlichen Ableitung der Kraftstoffmenge" SWORD OneToOne 1 100 -32768.00 32767.00 FORMAT "%8.2" ECU_ADDRESS 0x8021B2 /end MEASUREMENT
/begin MEASUREMENT ASMod_stCheckRlsN_mp "Freigabestatus abhängig von der Motordrehzahl" SWORD OneToOne 1 100 -32768.00 32767.00 FORMAT "%8.2" ECU_ADDRESS 0x8021B4 /end MEASUREMENT
/begin MEASUREMENT ASMod_stCheckRlsQ_mp "Freigabestatus abhängig von der Kraftstoffmenge" SWORD OneToOne 1 100 -32768.00 32767.00 FORMAT "%8.2" ECU_ADDRESS 0x8021B6 /end MEASUREMENT
/begin MEASUREMENT ASMod_stFlDirEGR_mp "Status der Strömungsrichtung des rückgeführten Abgasmassenstroms" UBYTE OneToOne 1 100 0.00 255.0 FORMAT "%5.1" ECU_ADDRESS 0x80218E /end MEASUREMENT
/begin MEASUREMENT ASMod_stNaNCo_mp "Status der Erkennung auf NaN und Inf im Modul Koordinator" UBYTE OneToOne 1 100 0.00 255.0 FORMAT "%5.1" ECU_ADDRESS 0x8020EC /end MEASUREMENT
/begin MEASUREMENT ASMod_stNaNEGR_mp "Status der Erkennung auf NaN und Inf im Modul Abgasrückführung" UBYTE OneToOne 1 100 0.00 255.0 FORMAT "%5.1" ECU_ADDRESS 0x802114 /end MEASUREMENT
/begin MEASUREMENT ASMod_stNaNExhMnf_mp "Status der Erkennung auf NaN und Inf im Modul Abgaskrümmer" UBYTE OneToOne 1 100 0.00 255.0 FORMAT "%5.1" ECU_ADDRESS 0x802144 /end MEASUREMENT
/begin MEASUREMENT ASMod_stNaNIndVol_mp "Status der Erkennung auf NaN und Inf im Modul Einlassvolumen" UBYTE OneToOne 1 100 0.00 255.0 FORMAT "%5.1" ECU_ADDRESS 0x802154 /end MEASUREMENT
/begin MEASUREMENT ASMod_stNaNIntMnf_mp "Status der Erkennung auf NaN und Inf im Modul Einlasskrümmer" UBYTE OneToOne 1 100 0.00 255.0 FORMAT "%5.1" ECU_ADDRESS 0x80218F /end MEASUREMENT
/begin MEASUREMENT ASMod_stNaNTurb_mp "Status der Erkennung auf NaN und Inf im Modul Turbine" UBYTE OneToOne 1 100 0.00 255.0 FORMAT "%5.1" ECU_ADDRESS 0x8021C8 /end MEASUREMENT
/begin MEASUREMENT ASMod_stVolEffAdaptDel_mp "verzögerter Freigabestatus für die Korrektur des Luftaufwands" UBYTE OneToOne 1 100 0.00 255.0 FORMAT "%5.1" ECU_ADDRESS 0x8021B8 /end MEASUREMENT
/begin MEASUREMENT ASMod_stVolEffAdapt_mp "Freigabestatus für die Korrektur des Luftwands" UBYTE OneToOne 1 100 0.00 255.0 FORMAT "%5.1" ECU_ADDRESS 0x8021B9 /end MEASUREMENT
/begin MEASUREMENT ASMod_tAirCorrPT1_mp "Gefilterte druckkorrigierte Ansauglufttemperatur" SWORD Temp_Cels 1 100 -3549.940 3003.560 FORMAT "%8.3" ECU_ADDRESS 0x8020E4 /end MEASUREMENT
/begin MEASUREMENT ASMod_tAirCorr_mp "Druckkorrigierte Ansauglufttemperatur" SWORD Temp_Cels 1 100 -3549.940 3003.560 FORMAT "%8.3" ECU_ADDRESS 0x8020E6 /end MEASUREMENT
/begin MEASUREMENT ASMod_tAir_mp "Lufttemperatur aus IndSys_tAirFld" FLOAT32_IEEE TempC_float 1 100 -274.000000 300.000000 FORMAT "%10.6" ECU_ADDRESS 0x8020E0 /end MEASUREMENT
/begin MEASUREMENT ASMod_tClntModCur_mp "Wassertemperatureinfluss im Umgebungstemperaturmodell" SWORD Temp_Cels 1 100 -3549.940 3003.560 FORMAT "%8.3" ECU_ADDRESS 0x8020E8 /end MEASUREMENT
/begin MEASUREMENT ASMod_tClntPT1_mp "Gefilterte Wassertemperatur" SWORD Temp_Cels 1 100 -3549.940 3003.560 FORMAT "%8.3" ECU_ADDRESS 0x8020EA /end MEASUREMENT
/begin MEASUREMENT ASMod_tDiffEGRClg_mp "Temperaturabsenkung des Abgases im ARF-Kühler" FLOAT32_IEEE TempK_float 1 100 0.00 800.000000 FORMAT "%10.6" ECU_ADDRESS 0x802110 /end MEASUREMENT
/begin MEASUREMENT ASMod_tDiffEG_mp "Temperaturerhöhung des Gasmassenstroms durch Verbrennung" SWORD TempDiff_Kelv 1 100 -3276.800 3276.700 FORMAT "%8.3" ECU_ADDRESS 0x802130 /end MEASUREMENT
/begin MEASUREMENT ASMod_tDiffEng_mp "Temperaturerhöhung des Gasmassenstroms aus dem Grundkennfeld" SWORD TempDiff_Kelv 1 100 -3276.800 3276.700 FORMAT "%8.3" ECU_ADDRESS 0x802132 /end MEASUREMENT
/begin MEASUREMENT ASMod_tEGRPst "Temperatur des rückgeführten Abgases nach ARF-Kühler" FLOAT32_IEEE TempC_float 1 100 -50.0000000 1000.00000 FORMAT "%10.5" ECU_ADDRESS 0x7F9C24 /end MEASUREMENT
/begin MEASUREMENT ASMod_tEG_mp "Temperatur des Abgases nach Verbrennung" SWORD Temp_Cels 1 100 -3549.940 3003.560 FORMAT "%8.3" ECU_ADDRESS 0x802134 /end MEASUREMENT
/begin MEASUREMENT ASMod_tEngCorTDiff_mp "Korrektur der Temperaturerhöhung aufgrund der Motortemperatur" SWORD TempDiff_Kelv 1 100 -3276.800 3276.700 FORMAT "%8.3" ECU_ADDRESS 0x802136 /end MEASUREMENT
/begin MEASUREMENT ASMod_tExhMnfPre "Abgastemperatur am Eintritt des Abgaskrümmers" SWORD Temp_Cels 1 100 -3549.940 3003.560 FORMAT "%8.3" ECU_ADDRESS 0x7F95CE /end MEASUREMENT
/begin MEASUREMENT ASMod_tExhMnfPst "Abgastemperatur am Austritt des Abgaskrümmers" FLOAT32_IEEE TempC_float 1 100 0.00 1000.00000 FORMAT "%10.5" ECU_ADDRESS 0x7F9C28 /end MEASUREMENT
/begin MEASUREMENT ASMod_tExhMnfPstRaw_mp "ungefilterte Abgastemperatur am Austritt des Abgaskrümmers" FLOAT32_IEEE TempC_float 1 100 0.00 1000.00000 FORMAT "%10.5" ECU_ADDRESS 0x802140 /end MEASUREMENT
/begin MEASUREMENT ASMod_tiDdTm_mp "Gaslaufzeit durch den Motor" SWORD TimeDeb 1 100 -327680.0 327670.0 FORMAT "%8.1" ECU_ADDRESS 0x802138 /end MEASUREMENT
/begin MEASUREMENT ASMod_tIndAir "Temperatur des Gasmassenstroms in den Motor" SWORD Temp_Cels 1 100 -3549.940 3003.560 FORMAT "%8.3" ECU_ADDRESS 0x7F95D0 /end MEASUREMENT
/begin MEASUREMENT ASMod_tIndAirRaw_mp "ungefilterte Temperatur des Gasmassenstrom in den Motor" FLOAT32_IEEE TempC_float 1 100 -50.0000000 500.000000 FORMAT "%10.6" ECU_ADDRESS 0x802184 /end MEASUREMENT
/begin MEASUREMENT ASMod_tIndAirRef "Referenz der Gastemperatur vor Einlass" SWORD Temp_Cels 1 100 -3549.940 3003.560 FORMAT "%8.3" ECU_ADDRESS 0x7F95D2 /end MEASUREMENT
/begin MEASUREMENT ASMod_tIntMnf_mp "Temperatur der Gasmasse im Einlasskrümmer" FLOAT32_IEEE TempC_float 1 100 -50.0000000 500.000000 FORMAT "%10.6" ECU_ADDRESS 0x802188 /end MEASUREMENT
/begin MEASUREMENT ASMod_tTurbPst_mp "Abgastemperatur nach Turbine" FLOAT32_IEEE TempC_float 1 100 -50.0000000 500.000000 FORMAT "%10.6" ECU_ADDRESS 0x802104 /end MEASUREMENT
/begin MEASUREMENT BasAdj_ActRout_mp "vom Tester vorgegebene Grundeinstellungsnummer (Diagnose)" UBYTE OneToOne 1 100 0.00 255.0 FORMAT "%5.1" ECU_ADDRESS 0x8021D0 /end MEASUREMENT
/begin MEASUREMENT BasAdj_DispMode_mp "Dummy Wert für die x Eingangsgröße in den Kennfeldern BasAdj_K2SigBlkVal x _MAP in basadj.kgs  (Diagnose)" UBYTE OneToOne 1 100 0.00 255.0 FORMAT "%5.1" ECU_ADDRESS 0x8021D1 /end MEASUREMENT
/begin MEASUREMENT BasAdj_lastRout_mp "Nummer der zuletzt aufgerufenen Grundeinstellung  (Diagnose)" UBYTE OneToOne 1 100 0.00 255.0 FORMAT "%5.1" ECU_ADDRESS 0x8021D2 /end MEASUREMENT
/begin MEASUREMENT BasAdj_nSetPointDia "Leerlaufsolldrehzahl bei Grundeinstellung  (Diagnose)" SWORD EngN 1 100 -32768.00 32767.00 FORMAT "%8.2" ECU_ADDRESS 0x7F9638 /end MEASUREMENT
/begin MEASUREMENT BasAdj_phiInjSetPoint "Sollwert der Spritzbeginnregelung bei Grundeinstellung  (Diagnose)" SWORD AngleCrS 1 100 -768.0000 767.9766 FORMAT "%8.4" ECU_ADDRESS 0x7F963A /end MEASUREMENT
/begin MEASUREMENT BasAdj_rAirCtlEGR "Sollwert des EGR-Ventils bei EGR Grundeinstellung  (Diagnose)" SWORD Prc 1 100 -327.6800 327.6700 FORMAT "%8.4" ECU_ADDRESS 0x7F963C /end MEASUREMENT
/begin MEASUREMENT BasAdj_rAirCtlTVA "Sollwert der Drosselklappe bei EGR Grundeinstellung  (Diagnose)" SWORD Prc 1 100 -327.6800 327.6700 FORMAT "%8.4" ECU_ADDRESS 0x7F963E /end MEASUREMENT
/begin MEASUREMENT BasAdj_rPCR "Sollwert des PCR-Stellglieds bei PCR Grundeinstellung  (Diagnose)" SWORD Prc 1 100 -327.6800 327.6700 FORMAT "%8.4" ECU_ADDRESS 0x7F9640 /end MEASUREMENT
/begin MEASUREMENT BasAdj_rPCRBiT1 "Vorgabewert fuer den 1. Ladedrucksteller bei BiT Grundeinstellung  (Diagnose)" SWORD Prc 1 100 -327.6800 327.6700 FORMAT "%8.4" ECU_ADDRESS 0x7F9642 /end MEASUREMENT
/begin MEASUREMENT BasAdj_rPCRBiT2 "Vorgabewert fuer den 2. Ladedrucksteller bei BiT Grundeinstellung  (Diagnose)" SWORD Prc 1 100 -327.6800 327.6700 FORMAT "%8.4" ECU_ADDRESS 0x7F9644 /end MEASUREMENT
/begin MEASUREMENT BasAdj_rVSA1 "Vorgabewert fuer den 1. Drallsteller bei VSA1 Grundeinstellung  (Diagnose)" SWORD DtyCyc 1 100 -327.6800 327.6700 FORMAT "%8.4" ECU_ADDRESS 0x7F9646 /end MEASUREMENT
/begin MEASUREMENT BasAdj_rVSA2 "Vorgabewert fuer den 2. Drallsteller bei VSA2 Grundeinstellung  (Diagnose)" SWORD DtyCyc 1 100 -327.6800 327.6700 FORMAT "%8.4" ECU_ADDRESS 0x7F9648 /end MEASUREMENT
/begin MEASUREMENT BasAdj_st "Status Grundeinstellungstest für Diagnose" UWORD OneToOne 1 100 0.00 65535.00 FORMAT "%8.2" ECU_ADDRESS 0x7F964A /end MEASUREMENT
/begin MEASUREMENT BasAdj_stActRout_mp "Status des aktuellen Grundeinstellungtests  (Diagnose)" UBYTE OneToOne 1 100 0.00 255.0 FORMAT "%5.1" ECU_ADDRESS 0x8021D3 /end MEASUREMENT
/begin MEASUREMENT BasAdj_stPSP "Vorgabewert fuer die Elektrische Vorfoerderpumpe bei PSP Grundeinstellung  (Diagnose)" UBYTE OneToOne 1 100 0.00 255.0 FORMAT "%5.1" ECU_ADDRESS 0x7F932F /end MEASUREMENT
/begin MEASUREMENT BasAdj_stRoutDem_mp "Zeigt die Kommunikation mit dem Tester (Anforderung vom Tester)    (Diagnose)" UBYTE OneToOne 1 100 0.00 255.0 FORMAT "%5.1" ECU_ADDRESS 0x8021D4 /end MEASUREMENT
/begin MEASUREMENT BattCD_u "Batteriespannung" SWORD Volt_Batt 1 100 -665674.1 665653.8 FORMAT "%8.1" ECU_ADDRESS 0x7F964C /end MEASUREMENT
/begin MEASUREMENT BattCD_uLin_mp "Rohwert Batterspannung über ADC" SWORD Volt_Batt 1 100 -665674.1 665653.8 FORMAT "%8.1" ECU_ADDRESS 0x8021D6 /end MEASUREMENT
/begin MEASUREMENT BattCD_uRaw "Rohwert ADC-Signalspannung für Batteriespannung" SWORD Volt_Batt 1 100 -665674.1 665653.8 FORMAT "%8.1" ECU_ADDRESS 0x7F9650 /end MEASUREMENT
/begin MEASUREMENT Batt_facCor "Faktor für Batteriespannungskorrektur" SWORD Fact 1 100 -4.000000 3.999878 FORMAT "%8.6" ECU_ADDRESS 0x7F9652 /end MEASUREMENT
/begin MEASUREMENT BdInt_nMax "Schutzdrehzahl für Karosserie und Innenraum" SWORD EngN 1 100 -32768.00 32767.00 FORMAT "%8.2" ECU_ADDRESS 0x7F9654 /end MEASUREMENT
/begin MEASUREMENT BdInt_nMin "Anforderung Leerlaufdrehzahl durch Karosserie & Innenraum" SWORD EngN 1 100 -32768.00 32767.00 FORMAT "%8.2" ECU_ADDRESS 0x7F9656 /end MEASUREMENT
/begin MEASUREMENT BdInt_pwrDes "Leistungsanforderung Wunsch Karosserie & Innenraum" SWORD Pwr 1 100 -308831.1 308821.7 FORMAT "%8.1" ECU_ADDRESS 0x7F9658 /end MEASUREMENT
/begin MEASUREMENT BdInt_pwrLead "Leistungsanforderung Vorhalt Karosserie & Innenraum" SWORD Pwr 1 100 -308831.1 308821.7 FORMAT "%8.1" ECU_ADDRESS 0x7F965A /end MEASUREMENT
/begin MEASUREMENT BPACD_rCnv_mp "Tastverhältnis basierend auf dem Ausgang des Ladedrucksreglers" SWORD DtyCyc 1 100 -327.6800 327.6700 FORMAT "%8.4" ECU_ADDRESS 0x8021DC /end MEASUREMENT
/begin MEASUREMENT BPACD_rOut "Tastverhältnis zür Endstufenansteuerung" SWORD DtyCyc 1 100 -327.6800 327.6700 FORMAT "%8.4" ECU_ADDRESS 0x7F961A /end MEASUREMENT
/begin MEASUREMENT BPACD_rOut2 "Tastverhältnis 2 zur Endstufenansteuerung" SWORD DtyCyc 1 100 -327.6800 327.6700 FORMAT "%8.4" ECU_ADDRESS 0x7F961C /end MEASUREMENT
/begin MEASUREMENT BPASCD_dcycIn "Tastverhältnis der Drallklappenrückmeldeleitung" SWORD DtyCyc 1 100 -327.6800 327.6700 FORMAT "%8.4" ECU_ADDRESS 0x7F961E /end MEASUREMENT
/begin MEASUREMENT BPASCD_rRelPos "Relative Position des Ladedruckstellers nach der Fehlerbehandlung" SWORD Prc 1 100 -327.6800 327.6700 FORMAT "%8.4" ECU_ADDRESS 0x7F9620 /end MEASUREMENT
/begin MEASUREMENT BPASCD_st "Status der Ladedruckstellerrückmeldung" UBYTE OneToOne 1 100 0.00 255.0 FORMAT "%5.1" ECU_ADDRESS 0x7F932A /end MEASUREMENT
/begin MEASUREMENT BPASCD_stErr_mp "Fehlerdaten der Ladedruckstellerrückmeldung" UBYTE OneToOne 1 100 0.00 255.0 FORMAT "%5.1" ECU_ADDRESS 0x8021DE /end MEASUREMENT
/begin MEASUREMENT BPASCD_tiActPer_mp "Periodendauer der Ladedruckstellerrückmeldung" UWORD Period_ms 1 100 0.00 6553.500 FORMAT "%8.3" ECU_ADDRESS 0x8021E0 /end MEASUREMENT
/begin MEASUREMENT BPA_rBPA "Stellgröße für Ladedrucksteller (Stellerkoordinatorausgang)" SWORD Prc 1 100 -327.6800 327.6700 FORMAT "%8.4" ECU_ADDRESS 0x7F9622 /end MEASUREMENT
/begin MEASUREMENT BPA_rBPAByp_mp "Bypass-Label, Kopie von BPA_rBPA" SWORD Prc 1 100 -327.6800 327.6700 FORMAT "%8.4" ECU_ADDRESS 0x8021D8 /end MEASUREMENT
/begin MEASUREMENT BPA_stBPA "Stellerkoordinatorstatus" UBYTE OneToOne 1 100 0.00 255.0 FORMAT "%5.1" ECU_ADDRESS 0x7F932B /end MEASUREMENT
/begin MEASUREMENT BPA_stErrHdl1_mp "Status der Fehlerreaktion im Steller in Abhängigkeit der Anzahl nach Anlernfehler" UBYTE OneToOne 1 100 0.00 255.0 FORMAT "%5.1" ECU_ADDRESS 0x8021DA /end MEASUREMENT
/begin MEASUREMENT BPA_stErrHdl2_mp "Status der Fehlerreaktion im Steller in Abhängigkeit der Anzahl nach PWM Defekt" UBYTE OneToOne 1 100 0.00 255.0 FORMAT "%5.1" ECU_ADDRESS 0x8021DB /end MEASUREMENT
/begin MEASUREMENT BPSCD_ctAvg "Durchschnittliche Absolute APS-BPS Differenz für den Plausibilitäts Test" UWORD OneToOne 1 100 0.00 65535.00 FORMAT "%8.2" ECU_ADDRESS 0x7F9624 /end MEASUREMENT
/begin MEASUREMENT BPSCD_pAvgDiff "Berechnungswert der Absoluten APS-BPS Differenz" SWORD Pres_hPa 1 100 -32768.00 32767.00 FORMAT "%8.2" ECU_ADDRESS 0x7F9626 /end MEASUREMENT
/begin MEASUREMENT BPSCD_pDiffLim_mp "Maximal erlaubte durchschnittliche absolute APS-BPS Differenz. Kopie von BPSCD_pDiffLim_C für signals" SWORD Pres_hPa 1 100 -32768.00 32767.00 FORMAT "%8.2" ECU_ADDRESS 0x8021E2 /end MEASUREMENT
/begin MEASUREMENT BPSCD_pDiff_mp "Absolute APS-BPS Differenz des aktuellen Berechnungszyklus" SWORD OneToOne 1 100 -32768.00 32767.00 FORMAT "%8.2" ECU_ADDRESS 0x8021E4 /end MEASUREMENT
/begin MEASUREMENT BPSCD_pFltVal "gefilterter Wert des Ladedrucks" SWORD Pres_hPa 1 100 -32768.00 32767.00 FORMAT "%8.2" ECU_ADDRESS 0x7F9628 /end MEASUREMENT
/begin MEASUREMENT BPSCD_pIntVal "aktueller Ladedruck" SWORD Pres_hPa 1 100 -32768.00 32767.00 FORMAT "%8.2" ECU_ADDRESS 0x7F962A /end MEASUREMENT
/begin MEASUREMENT BPSCD_pLastPhyVal "Ladedruck im letzten Zyklus" SWORD Pres_hPa 1 100 -32768.00 32767.00 FORMAT "%8.2" ECU_ADDRESS 0x7F962C /end MEASUREMENT
/begin MEASUREMENT BPSCD_pLin "Mittelere Ladedruck-Wert (liniarisiert)" SWORD Pres_hPa 1 100 -32768.00 32767.00 FORMAT "%8.2" ECU_ADDRESS 0x7F962E /end MEASUREMENT
/begin MEASUREMENT BPSCD_pOutVal "Ladedruckwert" SWORD Pres_hPa 1 100 -32768.00 32767.00 FORMAT "%8.2" ECU_ADDRESS 0x7F9630 /end MEASUREMENT
/begin MEASUREMENT BPSCD_pPhyVal "Ladedruck in diesem Zyklus" SWORD Pres_hPa 1 100 -32768.00 32767.00 FORMAT "%8.2" ECU_ADDRESS 0x7F9632 /end MEASUREMENT
/begin MEASUREMENT BPSCD_stErr "Fehlererkennung (falls einer auftritt) des Ladedrucksensors in einem Zyklus" UBYTE OneToOne 1 100 0.00 255.0 FORMAT "%5.1" ECU_ADDRESS 0x7F932C /end MEASUREMENT
/begin MEASUREMENT BPSCD_stPlausCalc_mp "Status der APS-BPS Plausibilitäts-Berechnung" UBYTE OneToOne 1 100 0.00 255.0 FORMAT "%5.1" ECU_ADDRESS 0x8021E6 /end MEASUREMENT
/begin MEASUREMENT BPSCD_stPlausErr "Plausibilitaetsfehler Status ( zwischen BPSCD und APSCD )" UBYTE OneToOne 1 100 0.00 255.0 FORMAT "%5.1" ECU_ADDRESS 0x7F932D /end MEASUREMENT
/begin MEASUREMENT BPSCD_stTransStage "Status der transtion stage des Ladedrucksensors" UWORD OneToOne 1 100 0.00 65535.00 FORMAT "%8.2" ECU_ADDRESS 0x7F9634 /end MEASUREMENT
/begin MEASUREMENT BPSCD_swtSig "Wert ob Signal ueber CAN/ADC kommt" UBYTE OneToOne 1 100 0.00 255.0 FORMAT "%5.1" ECU_ADDRESS 0x7F932E /end MEASUREMENT
/begin MEASUREMENT BPSCD_uRawVal "Spannungsrohwert des Ladedrucksensors" SWORD Volt 1 100 -160156.4 160151.5 FORMAT "%8.1" ECU_ADDRESS 0x7F9636 /end MEASUREMENT
/begin MEASUREMENT BrkCD_ctBREPLAU_mp "Entprellzaehler fuer dynamische Plausibilitätsprüfung Bremse" UWORD OneToOne 1 100 0.00 65535.00 FORMAT "%8.2" ECU_ADDRESS 0x8021E8 /end MEASUREMENT
/begin MEASUREMENT BrkCD_stDebDyn_mp "Fehlerzustand der dynamischen Bremsenplausibilität" UBYTE OneToOne 1 100 0.00 255.0 FORMAT "%5.1" ECU_ADDRESS 0x8021EA /end MEASUREMENT
/begin MEASUREMENT BrkCD_stMnSwtDebVal "Digitalsignal Bremskontakt entprellt" UBYTE OneToOne 1 100 0.00 255.0 FORMAT "%5.1" ECU_ADDRESS 0x7F9330 /end MEASUREMENT
/begin MEASUREMENT BrkCD_stMnSwtLogVal_mp "Digitalsignal redundanter Bremskontakt nicht entprellt" UBYTE OneToOne 1 100 0.00 255.0 FORMAT "%5.1" ECU_ADDRESS 0x8021EB /end MEASUREMENT
/begin MEASUREMENT BrkCD_stMnSwtRawVal "Rohwert Bremskontakt nicht entprellt" UBYTE OneToOne 1 100 0.00 255.0 FORMAT "%5.1" ECU_ADDRESS 0x7F9331 /end MEASUREMENT
/begin MEASUREMENT BrkCD_stPressed "Meldung Bremse betätigt" UBYTE OneToOne 1 100 0.00 255.0 FORMAT "%5.1" ECU_ADDRESS 0x7F9332 /end MEASUREMENT
/begin MEASUREMENT BrkCD_stRedSwtDebVal "Digitalsignal redundanter Bremskontakt entprellt" UBYTE OneToOne 1 100 0.00 255.0 FORMAT "%5.1" ECU_ADDRESS 0x7F9333 /end MEASUREMENT
/begin MEASUREMENT BrkCD_stRedSwtLogVal_mp "Digitalsignal redundanter Bremskontakt nicht entprellt" UBYTE OneToOne 1 100 0.00 255.0 FORMAT "%5.1" ECU_ADDRESS 0x8021EC /end MEASUREMENT
/begin MEASUREMENT BrkCD_stRedSwtPresent "Redundanter Bremskontakt Aktivinformation" UBYTE OneToOne 1 100 0.00 255.0 FORMAT "%5.1" ECU_ADDRESS 0x7F9334 /end MEASUREMENT
/begin MEASUREMENT BrkCD_stRedSwtRawVal "Rohwert redundanter Bremskontakt nicht entprellt" UBYTE OneToOne 1 100 0.00 255.0 FORMAT "%5.1" ECU_ADDRESS 0x7F9335 /end MEASUREMENT
/begin MEASUREMENT BrkCD_stRun_mp "Laufzeitmesspunkt" UWORD OneToOne 1 100 0.00 65535.00 FORMAT "%8.2" ECU_ADDRESS 0x8021EE /end MEASUREMENT
/begin MEASUREMENT BrkCD_swtSig "Signalquelle Schalter - DIO/CAN" UBYTE OneToOne 1 100 0.00 255.0 FORMAT "%5.1" ECU_ADDRESS 0x7F9336 /end MEASUREMENT
/begin MEASUREMENT BrkCD_uMnSwtLinVal "Linearisierter Analogwert des Bremskontaktes" SWORD Volt 1 100 -160156.4 160151.5 FORMAT "%8.1" ECU_ADDRESS 0x7F965C /end MEASUREMENT
/begin MEASUREMENT BrkCD_uMnSwtNrmVal_mp "Mit Batteriespannungsfaktor korrigierter Spannungswert des Hauptbremsschalters" SWORD Volt 1 100 -160156.4 160151.5 FORMAT "%8.1" ECU_ADDRESS 0x8021F0 /end MEASUREMENT
/begin MEASUREMENT BrkCD_uMnSwtRawVal "Analogwert des Bremskontaktes" SWORD Volt 1 100 -160156.4 160151.5 FORMAT "%8.1" ECU_ADDRESS 0x7F965E /end MEASUREMENT
/begin MEASUREMENT BrkCD_uMnSwtTrnsVal_mp "Spannung des Hauptbremsschalters nach Transstage und PT1-Filter" SWORD Volt 1 100 -160156.4 160151.5 FORMAT "%8.1" ECU_ADDRESS 0x8021F2 /end MEASUREMENT
/begin MEASUREMENT BypEtk_ctStepDelayNsync_u8 "ETK Bypass Schritt drehzahlsynchron" UBYTE OneToOne 1 100 0.00 255.0 FORMAT "%5.1" ECU_ADDRESS 0x800832 /end MEASUREMENT
/begin MEASUREMENT BypEtk_ctStepDelayTsync_u8 "ETK Bypass Schritt zeitsynchron" UBYTE OneToOne 1 100 0.00 255.0 FORMAT "%5.1" ECU_ADDRESS 0x800833 /end MEASUREMENT
/begin MEASUREMENT BypEtk_stEcu_u8 "Status ETK-Bypass in SG (0: inaktiv im SG; 1: aktiv im SG; 2: wartet auf Kommunikation)" UBYTE OneToOne 1 100 0.00 255.0 FORMAT "%5.1" ECU_ADDRESS 0x800831 /end MEASUREMENT
/begin MEASUREMENT BypInt_stEcu_u8 "Status interner Bypass in SG (0: inaktiv im SG; 1: aktiv im SG; 2: wartet auf Kommunikation)" UBYTE OneToOne 1 100 0.00 255.0 FORMAT "%5.1" ECU_ADDRESS 0x80083D /end MEASUREMENT
/begin MEASUREMENT CaSCD_ctEdgCaSRev_mp "Anzahl sämtlicher Phasensignale während einer Nockenwellenumdrehung" UBYTE OneToOne 1 100 0.00 255.0 FORMAT "%5.1" ECU_ADDRESS 0x8021F4 /end MEASUREMENT
/begin MEASUREMENT CaSCD_ctEdgOfs_mp "Zähler erkannter Nockenwellenflanken mit Verdrehung" UBYTE OneToOne 1 100 0.00 255.0 FORMAT "%5.1" ECU_ADDRESS 0x8021F5 /end MEASUREMENT
/begin MEASUREMENT CaSCD_ctEdgOrd_mp "Zähler erkannter Nockenwellenflanken in korrekter Reihenfolge" UBYTE OneToOne 1 100 0.00 255.0 FORMAT "%5.1" ECU_ADDRESS 0x8021F6 /end MEASUREMENT
/begin MEASUREMENT CaSCD_ctErrEdg_mp "Anzahl erkannter Störungen auf einer Nockenwellenumdrehung" UBYTE OneToOne 1 100 0.00 255.0 FORMAT "%5.1" ECU_ADDRESS 0x8021F7 /end MEASUREMENT
/begin MEASUREMENT CaSCD_ctPhRevEdges_mp "Zähler der Phasengeberflanken über einer Phasengeberradumdrehung" UBYTE OneToOne 1 100 0.00 255.0 FORMAT "%5.1" ECU_ADDRESS 0x8021F8 /end MEASUREMENT
/begin MEASUREMENT CaSCD_ctPhRev_mp "Umdrehungszähler des Phasengeberrades" UBYTE OneToOne 1 100 0.00 255.0 FORMAT "%5.1" ECU_ADDRESS 0x8021F9 /end MEASUREMENT
/begin MEASUREMENT CaSCD_ctSegEdg_mp "Anzahl erkannter SEG Flanken" UBYTE OneToOne 1 100 0.00 255.0 FORMAT "%5.1" ECU_ADDRESS 0x8021FA /end MEASUREMENT
/begin MEASUREMENT CaSCD_ctShftPos_mp "Zähler verschobene Nockenwellenflanken" UBYTE OneToOne 1 100 0.00 255.0 FORMAT "%5.1" ECU_ADDRESS 0x8021FB /end MEASUREMENT
/begin MEASUREMENT CaSCD_ctSyncEdg_mp "Anzahl erkannter SYNC Flanken" UBYTE OneToOne 1 100 0.00 255.0 FORMAT "%5.1" ECU_ADDRESS 0x8021FC /end MEASUREMENT
/begin MEASUREMENT CaSCD_nPeriod "Phasengeberraddrehzahl basierent auf einer konstanten Phasengebersegmentlänge" SWORD EngN 1 100 -32768.00 32767.00 FORMAT "%8.2" ECU_ADDRESS 0x7F9672 /end MEASUREMENT
/begin MEASUREMENT CaSCD_nSeg "Die aktuelle Nockenwellensegmentdrehzahl im BackUp-Modus" SWORD EngN 1 100 -32768.00 32767.00 FORMAT "%8.2" ECU_ADDRESS 0x7F9674 /end MEASUREMENT
/begin MEASUREMENT CaSCD_numFrstInt_mp "Interruptart bei Start der Verifikation CaS/CrS" UBYTE OneToOne 1 100 0.00 255.0 FORMAT "%5.1" ECU_ADDRESS 0x8021FD /end MEASUREMENT
/begin MEASUREMENT CaSCD_numFrstTDC_mp "Zylinderzählerstand bei Start der Verifikation CaS/CrS" UBYTE OneToOne 1 100 0.00 255.0 FORMAT "%5.1" ECU_ADDRESS 0x8021FE /end MEASUREMENT
/begin MEASUREMENT CaSCD_phiCurr_mp "Aktuelle Winkelposition des Phasengebers" SWORD AngleCrS 1 100 -768.0000 767.9766 FORMAT "%8.4" ECU_ADDRESS 0x802200 /end MEASUREMENT
/begin MEASUREMENT CaSCD_phiLstEdge_mp "Position der letzten Phasengeberflanke" SWORD AngleCrS 1 100 -768.0000 767.9766 FORMAT "%8.4" ECU_ADDRESS 0x802202 /end MEASUREMENT
/begin MEASUREMENT CaSCD_phiLstFEdge_mp "Winke fuer fallende Nockenwellenflanke" SWORD AngleCrS 1 100 -768.0000 767.9766 FORMAT "%8.4" ECU_ADDRESS 0x802204 /end MEASUREMENT
/begin MEASUREMENT CaSCD_phiLstREdge_mp "Winkel der steigenden Nockenwellenflanke" SWORD AngleCrS 1 100 -768.0000 767.9766 FORMAT "%8.4" ECU_ADDRESS 0x802206 /end MEASUREMENT
/begin MEASUREMENT CaSCD_stPhaseErr_mp "Fehlerstatus des Phasensystems" UWORD OneToOne 1 100 0.00 65535.00 FORMAT "%8.2" ECU_ADDRESS 0x802208 /end MEASUREMENT
/begin MEASUREMENT CaSCD_stPhaseSig_mp "Status des Phasengebersignals (Signalgüte)" UWORD OneToOne 1 100 0.00 65535.00 FORMAT "%8.2" ECU_ADDRESS 0x80220A /end MEASUREMENT
/begin MEASUREMENT CaSCD_stPhaseSync_mp "Status der Phasengebersynchronisation (Signalformerkennung)" UWORD OneToOne 1 100 0.00 65535.00 FORMAT "%8.2" ECU_ADDRESS 0x80220C /end MEASUREMENT
/begin MEASUREMENT CaSCD_stSegCylEdg_mp "Status erkannter SEG Flanken" UWORD OneToOne 1 100 0.00 65535.00 FORMAT "%8.2" ECU_ADDRESS 0x80220E /end MEASUREMENT
/begin MEASUREMENT CaSCD_stSyncCylEdg_mp "Status erkannter SYNC Flanken" UWORD OneToOne 1 100 0.00 65535.00 FORMAT "%8.2" ECU_ADDRESS 0x802210 /end MEASUREMENT
/begin MEASUREMENT CaSCD_tiPeriodRev "Periodendauer einer Umdrehung des Phasengeberrades" SWORD Period_ms 1 100 -3276.800 3276.700 FORMAT "%8.3" ECU_ADDRESS 0x7F9676 /end MEASUREMENT
/begin MEASUREMENT CaSCD_tiPeriodRevHold "Vorletzte Periodendauer einer Umdrehung des Phasengeberrades" SWORD Period_ms 1 100 -3276.800 3276.700 FORMAT "%8.3" ECU_ADDRESS 0x7F9678 /end MEASUREMENT
/begin MEASUREMENT CaSCD_tiSeg "aktuelle Segmentzeit der Nockenwelle im Backup Mode" ULONG Per_Dur 1 100 0.00 4294967295.00 FORMAT "%13.2" ECU_ADDRESS 0x7F9C38 /end MEASUREMENT
/begin MEASUREMENT CaSCD_tiSigTimOut_mp "Timeoutwert des Phasengebersignals" SWORD Period_ms 1 100 -3276.800 3276.700 FORMAT "%8.3" ECU_ADDRESS 0x802212 /end MEASUREMENT
/begin MEASUREMENT CatSys_st "Regenerationsstatus des Katalysatorsystems" UBYTE OneToOne 1 100 0.00 255.0 FORMAT "%5.1" ECU_ADDRESS 0x7F933C /end MEASUREMENT
/begin MEASUREMENT CatSys_tCat "Katalysatortemperatur" SWORD Temp_Cels 1 100 -3549.940 3003.560 FORMAT "%8.3" ECU_ADDRESS 0x7F967A /end MEASUREMENT
/begin MEASUREMENT Clg_dtDynTst "Ansteig der Wassertemperatur seit start" SWORD TempDiff_Kelv 1 100 -3276.800 3276.700 FORMAT "%8.3" ECU_ADDRESS 0x7F967C /end MEASUREMENT
/begin MEASUREMENT Clg_dtDynTstCARB "Anstieg der Kühlmitteltemperatur beim letzten Test" SWORD TempDiff_Kelv 1 100 -3276.800 3276.700 FORMAT "%8.3" ECU_ADDRESS 0x7F967E /end MEASUREMENT
/begin MEASUREMENT Clg_dtMinDynTstCARB "Kopie von Clg_dtMinDynTst_C für Tester" SWORD TempDiff_Kelv 1 100 -3276.800 3276.700 FORMAT "%8.3" ECU_ADDRESS 0x7F9680 /end MEASUREMENT
/begin MEASUREMENT Clg_tClntStrtVal_mp "Wassertemperatur zu Beginn des dynamischen Plausibilitätstests" SWORD Temp_Cels 1 100 -3549.940 3003.560 FORMAT "%8.3" ECU_ADDRESS 0x802214 /end MEASUREMENT
/begin MEASUREMENT Clg_tEndDynTst "CTSCD_tClnt am Ende des Tests" SWORD Temp_Cels 1 100 -3549.940 3003.560 FORMAT "%8.3" ECU_ADDRESS 0x7F9682 /end MEASUREMENT
/begin MEASUREMENT Clg_tEndDynTstCARB "Kühlmitteltemperatur am Ende des letzten Tests" SWORD Temp_Cels 1 100 -3549.940 3003.560 FORMAT "%8.3" ECU_ADDRESS 0x7F9684 /end MEASUREMENT
/begin MEASUREMENT Clg_tiDynTst "Abgelaufene Zeit, seit der der dynamische plausibilitätstest aktiv ist" UWORD Time_DynTst 1 100 0.00 167769.6 FORMAT "%8.1" ECU_ADDRESS 0x7F9688 /end MEASUREMENT
/begin MEASUREMENT Clg_tiDynTstCARB "Dauer des letzten Tests" UWORD Time_DynTst 1 100 0.00 167769.6 FORMAT "%8.1" ECU_ADDRESS 0x7F968A /end MEASUREMENT
/begin MEASUREMENT Clg_tiMaxDynTst "Maximal zulässige Testzeit des dynamischen Plausibilitätstest" UWORD Time_DynTst 1 100 0.00 167769.6 FORMAT "%8.1" ECU_ADDRESS 0x7F968C /end MEASUREMENT
/begin MEASUREMENT Clg_tiMaxDynTstCARB "Maximale Testzeit beim letzten Test" UWORD Time_DynTst 1 100 0.00 167769.6 FORMAT "%8.1" ECU_ADDRESS 0x7F968E /end MEASUREMENT
/begin MEASUREMENT Clg_tMinClntDynTstCARB "Kopie von Clg_tMinClntDynTst_C für Tester" SWORD Temp_Cels 1 100 -3549.940 3003.560 FORMAT "%8.3" ECU_ADDRESS 0x7F9686 /end MEASUREMENT
/begin MEASUREMENT CmbChb_ctMifBuf1_mp "Meßpunkt für die Erkennung der Fehlzündungen der einzelnen Zylinder, Puffer1" UWORD OneToOne 1 100 0.00 65535.00 FORMAT "%8.2" ARRAY_SIZE 7 ECU_ADDRESS 0x802216 /end MEASUREMENT
/begin MEASUREMENT CmbChb_ctMifBuf2_mp "Meßpunkt für die Erkennung der Fehlzündungen der einzelnen Zylinder, Puffer2" UWORD OneToOne 1 100 0.00 65535.00 FORMAT "%8.2" ARRAY_SIZE 7 ECU_ADDRESS 0x802224 /end MEASUREMENT
/begin MEASUREMENT CmbChb_ctMifMem_mp "Meßpunkt für die Erkennung der Fehlzündungen der einzelnen Zylinder, Logging Speicher" UWORD OneToOne 1 100 0.00 65535.00 FORMAT "%8.2" ARRAY_SIZE 7 ECU_ADDRESS 0x802232 /end MEASUREMENT
/begin MEASUREMENT CmbChb_st "Status der Fehlzündungserkennung" UBYTE OneToOne 1 100 0.00 255.0 FORMAT "%5.1" ECU_ADDRESS 0x7F933D /end MEASUREMENT
/begin MEASUREMENT CmbChb_swtMonClutch "SW-Schalter Aktivierung/Deaktivierung Überwachung Zündaussetzererkennung" UBYTE OneToOne 1 100 0.00 3.000 FORMAT "%5.3" ECU_ADDRESS 0x7F933E /end MEASUREMENT
/begin FUNCTION asdrf_governor "ARD-Regelalgoithmus, Führungsformer"
 /begin DEF_CHARACTERISTIC ASDrf_dtrqInrLtdLim_CUR ASDrf_dtrqNeg_MAP ASDrf_dtrqPos_MAP ASDrf_dtrqSteepNeg_C ASDrf_dtrqSteepPos_C ASDrf_facdtrqPos_CUR ASDrf_T1Flt_C ASDrf_swtFlt_C ASDrf_swtInitPS_C ASDrf_trqFltLim_C ASDrf_trqPullNeg_CUR ASDrf_trqPullPos_CUR ASDrf_trqPushNeg_CUR ASDrf_trqPushPos_CUR ASDrf_trqThresNeg_C ASDrf_trqThresPos_C /end DEF_CHARACTERISTIC
 /begin IN_MEASUREMENT ASDrf_dtrqInrLtd_mp ASDrf_stDriver DrvTrn_rTransDT Eng_nAvrg /end IN_MEASUREMENT
/end FUNCTION
/begin FUNCTION asdrf_governor_msg "" /begin OUT_MEASUREMENT ASDrf_stPosNeg ASDrf_trqInr /end OUT_MEASUREMENT /end FUNCTION
/begin FUNCTION asdrf_governor_uic "" /begin DEF_CHARACTERISTIC ASDrf_trqInr_Vector ASDrf_trqInr_Channel /end DEF_CHARACTERISTIC
 /begin OUT_MEASUREMENT ASDrf_dtrqInrLtd_mp ASDrf_dtrqLim_mp ASDrf_KdCurr_mp ASDrf_stInitSteepIn_mp ASDrf_stSlpLim_mp ASDrf_T1Curr_mp ASDrf_trqCompoffset_mp ASDrf_trqInit_mp ASDrf_trqInrLtdFlt_mp ASDrf_trqInrUnLim_mp ASDrf_trqLimPull_mp ASDrf_trqLimPush_mp ASDrf_trqLoss_mp ASDrf_trqPT1In_mp ASDrf_trqPT1Out_mp ASDrf_trqPT1P_mp ASDrf_trqP_mp /end OUT_MEASUREMENT
/end FUNCTION
/begin FUNCTION asdrf_selectparameter "Parametersatzauswahl ARD Führungsformer"
 /begin DEF_CHARACTERISTIC ASDrf_T1CluNeg_C ASDrf_KdCluNeg_C ASDrf_T1CluPos_C ASDrf_KdCluPos_C ASDrf_T1ExtInt_C ASDrf_KdExtInt_C ASDrf_facKdGripPos_CUR ASDrf_nTMFWRO_C ASDrf_rAccPedFullLd_CUR ASDrf_rAccPedPartLd_CUR ASDrf_swtConvOff_C ASDrf_swtGearbx_C ASDrf_tiTMFWRO_C ASDrf_T1TMFWRONeg_C ASDrf_KdTMFWRONeg_C ASDrf_T1TMFWROPos_C ASDrf_KdTMFWROPos_C ASDrf_trqTMFWRO_C /end DEF_CHARACTERISTIC
 /begin IN_MEASUREMENT ASDrf_stDriver Eng_nAvrg /end IN_MEASUREMENT
/end FUNCTION
/begin FUNCTION asdrf_selectparameter_msg ""
 /begin OUT_MEASUREMENT ASDrf_stBitFrame ASDrf_stDriver ASDrf_stExtInt ASDrf_stGrip ASDrf_stTMFWRO /end OUT_MEASUREMENT
/end FUNCTION
/begin FUNCTION asdrf_selectparameter_uic "" /end FUNCTION
/begin FUNCTION asdrf_selectparameter_var ""
 /begin DEF_CHARACTERISTIC ASDrf_KdGripNeg_MAP ASDrf_KdGripPos_MAP ASDrf_T1GripNeg_MAP ASDrf_T1GripPos_MAP /end DEF_CHARACTERISTIC
 /begin IN_MEASUREMENT DrvTrn_rTransDT Eng_nAvrg /end IN_MEASUREMENT
/end FUNCTION
/begin FUNCTION asmod_cmpr "Verdichter"
 /begin DEF_CHARACTERISTIC ASMod_facPresLsCmprPre_C ASMod_facPresLsCmprPst_C ASMod_nTrbChRed_MAP ASMod_pCmprPreRef_C ASMod_swtTempAirMod_C ASMod_tAirCorr_MAP ASMod_tClntMod_CUR ASMod_tCmprPreRef_C ASMod_tiTempAirPT1_C ASMod_tiTempClntPT1_C /end DEF_CHARACTERISTIC
 /begin IN_MEASUREMENT ASMod_tClntPT1_mp BPSCD_pLin IATSCD_tAir /end IN_MEASUREMENT
 /begin OUT_MEASUREMENT ASMod_dmAirPerTimeRed_mp ASMod_nTrbChRed_mp ASMod_pCmprPre_mp ASMod_pCmprPst_mp ASMod_rPresCmpr_mp ASMod_tAir_mp /end OUT_MEASUREMENT
/end FUNCTION
/begin FUNCTION asmod_cmpr_msg "" /begin OUT_MEASUREMENT ASMod_nTrbCh /end OUT_MEASUREMENT /end FUNCTION
/begin FUNCTION asmod_cmpr_uic ""
 /begin OUT_MEASUREMENT ASMod_tAirCorrPT1_mp ASMod_tAirCorr_mp ASMod_tClntModCur_mp ASMod_tClntPT1_mp /end OUT_MEASUREMENT
/end FUNCTION
/begin FUNCTION asmod_co "interface coordinator"
 /begin DEF_CHARACTERISTIC ASMod_rBPALin_CUR ASMod_rEGRLin_CUR ASMod_tiRelPosBPAUpPT1_C ASMod_tiRelPosBPADwnPT1_C ASMod_tiRelPosECBUpPT1_C ASMod_tiRelPosECBDwnPT1_C ASMod_tiRelPosEGRUpPT1_C ASMod_tiRelPosEGRDwnPT1_C ASMod_tiRelPosTVAUpPT1_C ASMod_tiRelPosTVADwnPT1_C ASMod_tiRelPosVSAUpPT1_C ASMod_tiRelPosVSADwnPT1_C ASMod_rHysThresBPA_C ASMod_rTVALin_CUR ASMod_rVSALin_CUR /end DEF_CHARACTERISTIC
 /begin IN_MEASUREMENT AirCtl_rTVA BPASCD_rRelPos EGRSCD_rRelPos IndSys_rVSA /end IN_MEASUREMENT
/end FUNCTION
/begin FUNCTION asmod_co_msg ""
 /begin OUT_MEASUREMENT ASMod_pDiffEGT ASMod_qCor ASMod_rRelPosBPA ASMod_rRelPosECB ASMod_rRelPosEGR ASMod_rRelPosTVA ASMod_rRelPosVSA /end OUT_MEASUREMENT
/end FUNCTION
/begin FUNCTION asmod_co_uic "" /begin OUT_MEASUREMENT ASMod_stNaNCo_mp /end OUT_MEASUREMENT /end FUNCTION
/begin FUNCTION asmod_egpipe "Abgasleitung"
 /begin DEF_CHARACTERISTIC ASMod_etaTurb_CUR ASMod_pDiffEGPipe_CUR ASMod_rTDiffTurbAdbt_CUR ASMod_tTurbPstMin_C /end DEF_CHARACTERISTIC
 /begin IN_MEASUREMENT ASMod_rRelPosBPA /end IN_MEASUREMENT
 /begin OUT_MEASUREMENT ASMod_dmEGPipeRed_mp ASMod_etaTurb_mp ASMod_pDiffEGPipe_mp ASMod_rPresEGPipe_mp ASMod_rTDiffTurbAdbt_mp ASMod_tTurbPst_mp /end OUT_MEASUREMENT
/end FUNCTION
/begin FUNCTION asmod_egpipe_msg "" /begin OUT_MEASUREMENT ASMod_pTurbPst /end OUT_MEASUREMENT /end FUNCTION
/begin FUNCTION asmod_egpipe_uic "" /end FUNCTION
/begin FUNCTION asmod_egr "Abgasrückführung"
 /begin DEF_CHARACTERISTIC ASMod_arEffEGR_CUR ASMod_tiDMEGRUpPT1_C ASMod_tiDMEGRDwnPT1_C ASMod_rPresCritEG_C ASMod_facFlowCritEG_C ASMod_rPresLinEG_C ASMod_facSlpLinEG_C ASMod_etaEGRClg_MAP ASMod_facPresLsEGRClg_CUR ASMod_tEGRPstMin_C ASMod_tiTEGRPstUpPT1_C ASMod_tiTEGRPstDwnPT1_C /end DEF_CHARACTERISTIC
 /begin IN_MEASUREMENT ASMod_dmEGRPst ASMod_rRelPosECB ASMod_rRelPosEGR /end IN_MEASUREMENT
 /begin OUT_MEASUREMENT ASMod_dmEGRPstRaw_mp ASMod_pLsEGRClg_mp ASMod_tDiffEGRClg_mp /end OUT_MEASUREMENT
/end FUNCTION
/begin FUNCTION asmod_egr_msg "" /begin OUT_MEASUREMENT ASMod_arEffEGR ASMod_dmEGRPst ASMod_pEGRPst ASMod_tEGRPst /end OUT_MEASUREMENT /end FUNCTION
/begin FUNCTION asmod_egr_uic "" /begin OUT_MEASUREMENT ASMod_stNaNEGR_mp /end OUT_MEASUREMENT /end FUNCTION
/begin FUNCTION asmod_eng "Motor"
 /begin DEF_CHARACTERISTIC ASMod_dmIndAirRef_MAP ASMod_facDdTm_C ASMod_facDMCorTDiff_CUR ASMod_facSOICorTDiff_CUR ASMod_phiSOIRef_MAP ASMod_tDiffEng_MAP ASMod_tEngCorTDiff_CUR ASMod_tEngRef_C /end DEF_CHARACTERISTIC
 /begin IN_MEASUREMENT ASMod_qBurned_mp ASMod_qLmbdCtlCorr_mp ASMod_rDMIndAir_mp ASMod_tEngCorTDiff_mp Eng_nAvrg InjCrv_phiMI1Des /end IN_MEASUREMENT
/end FUNCTION
/begin FUNCTION asmod_eng_msg ""
 /begin OUT_MEASUREMENT ASMod_dmExhMnfPre ASMod_rLmbdRecEG ASMod_rO2ExhMnfPre ASMod_tExhMnfPre /end OUT_MEASUREMENT
/end FUNCTION
/begin FUNCTION asmod_eng_uic ""
 /begin OUT_MEASUREMENT ASMod_dmEG_mp ASMod_dmFlBurned_mp ASMod_dmFlPerTime_mp ASMod_dmIndAirRef_mp ASMod_dmO2EG_mp ASMod_facDMCorTDiff_mp ASMod_facSOICorTDiff_mp ASMod_phiSOIRef_mp ASMod_qBurned_mp ASMod_qLmbdCtlCorr_mp ASMod_rDMIndAir_mp ASMod_rFlBurned_mp ASMod_rO2EG_mp ASMod_tDiffEG_mp ASMod_tDiffEng_mp ASMod_tEG_mp ASMod_tEngCorTDiff_mp ASMod_tiDdTm_mp /end OUT_MEASUREMENT
/end FUNCTION
/begin FUNCTION asmod_exhmnf "Abgaskrümmer" /begin DEF_CHARACTERISTIC ASMod_tiTExhMnfPstUpPT1_C ASMod_tiTExhMnfPstDwnPT1_C /end DEF_CHARACTERISTIC /begin OUT_MEASUREMENT ASMod_rO2ExhMnfPst_mp ASMod_tExhMnfPstRaw_mp /end OUT_MEASUREMENT /end FUNCTION
/begin FUNCTION asmod_exhmnf_msg "" /begin OUT_MEASUREMENT ASMod_dmExhMnfPst ASMod_rLmbdRecExhMnfPst ASMod_tExhMnfPst /end OUT_MEASUREMENT /end FUNCTION
/begin FUNCTION asmod_exhmnf_uic "" /begin OUT_MEASUREMENT ASMod_stNaNExhMnf_mp /end OUT_MEASUREMENT /end FUNCTION
/begin FUNCTION asmod_indvol "Modell des Einlaßvolumens"
 /begin DEF_CHARACTERISTIC ASMod_rPresCritAir_C ASMod_facFlowCritAir_C ASMod_rPresLinAir_C ASMod_facSlpLinAir_C ASMod_arEffTVA_CUR ASMod_mIndVolMin_C ASMod_tiDMAirUpPT1_C ASMod_tiDMAirDwnPT1_C ASMod_volIndVol_C /end DEF_CHARACTERISTIC
 /begin IN_MEASUREMENT ASMod_rRelPosTVA /end IN_MEASUREMENT
 /begin OUT_MEASUREMENT ASMod_arEffTVA_mp ASMod_dmAirPerTimeCorrRaw_mp ASMod_dmIndVol_mp /end OUT_MEASUREMENT
/end FUNCTION
/begin FUNCTION asmod_indvol_msg ""
 /begin OUT_MEASUREMENT ASMod_dmAirPerTimeCorr ASMod_mAirPerCylCorr ASMod_mIndVol ASMod_pIndVol /end OUT_MEASUREMENT
/end FUNCTION
/begin FUNCTION asmod_indvol_uic "" /begin OUT_MEASUREMENT ASMod_stNaNIndVol_mp /end OUT_MEASUREMENT /end FUNCTION
/begin FUNCTION asmod_intmnf "Einlasskrümmer"
 /begin DEF_CHARACTERISTIC ASMod_facDMCorTIndAir_MAP ASMod_tiTIndAirUpPT1_C ASMod_tiTIndAirDwnPT1_C ASMod_mIntMnfMin_C ASMod_mO2IntMnfMin_C ASMod_pIntMnfMin_C ASMod_volIntMnf_C /end DEF_CHARACTERISTIC
 /begin IN_MEASUREMENT ASMod_dmIndAir Eng_nAvrg /end IN_MEASUREMENT
 /begin OUT_MEASUREMENT ASMod_dmEGRIndAir_mp ASMod_dmEGRIntMnf_mp ASMod_dmIndAirRaw_mp ASMod_dmIntMnf_mp ASMod_dmO2IntMnf_mp ASMod_facTCorDMIndAir_mp ASMod_mAirIntMnf_mp ASMod_mEGRIntMnf_mp ASMod_mIntMnf_mp ASMod_mO2IntMnf_mp ASMod_rLmbdRecIndAir_mp ASMod_tIndAirRaw_mp ASMod_tIntMnf_mp /end OUT_MEASUREMENT
/end FUNCTION
/begin FUNCTION asmod_intmnf_msg ""
 /begin OUT_MEASUREMENT ASMod_dmIndAir ASMod_dmO2IndAir ASMod_pIntMnf ASMod_rEGR ASMod_rO2IndAir ASMod_tIndAir /end OUT_MEASUREMENT
/end FUNCTION
/begin FUNCTION asmod_intmnf_uic ""
 /begin OUT_MEASUREMENT ASMod_facDMCorTIndAir_mp ASMod_stFlDirEGR_mp ASMod_stNaNIntMnf_mp /end OUT_MEASUREMENT
/end FUNCTION
/begin FUNCTION asmod_lib "" /end FUNCTION
/begin FUNCTION asmod_obsvrpindvol "Beobachter für Ladedruck"
 /begin DEF_CHARACTERISTIC ASMod_arEffEGRThres_C ASMod_ddmObsvrOffMax_C ASMod_ddmObsvrOffMin_C ASMod_ddmObsvrOnMax_C ASMod_ddmObsvrOnMin_C ASMod_dnObsvrOffMax_C ASMod_dnObsvrOffMin_C ASMod_dnObsvrOnMax_C ASMod_dnObsvrOnMin_C ASMod_dpObsvrOffMax_C ASMod_dpObsvrOffMin_C ASMod_dpObsvrOnMax_C ASMod_dpObsvrOnMin_C ASMod_dqObsvrOffMax_C ASMod_dqObsvrOffMin_C ASMod_dqObsvrOnMax_C ASMod_dqObsvrOnMin_C ASMod_facArEffCorMax_C ASMod_facArEffCorMin_C ASMod_facVolEffCorMax_C ASMod_facVolEffCorMin_C ASMod_nObsvrOffMax_C ASMod_nObsvrOffMin_C ASMod_nObsvrOnMax_C ASMod_nObsvrOnMin_C ASMod_ObsvrArEffKi_C ASMod_ObsvrArEffKp_C ASMod_ObsvrVolEffKi_C ASMod_ObsvrVolEffKp_C ASMod_qObsvrOffMax_C ASMod_qObsvrOffMin_C ASMod_qObsvrOnMax_C ASMod_qObsvrOnMin_C ASMod_rRelPosThresMax_C ASMod_rRelPosThresMin_C ASMod_swtClrFacArEff_C ASMod_swtClrFacVolEff_C ASMod_swtOnObsvrPIndVol_C ASMod_tiDDMAirPerTimePT1_C ASMod_tiDelObsvrPIndVol_C ASMod_tiDNAvrgPT1_C ASMod_tiDPIntValPT1_C ASMod_tiDQLmbdCtlPT1_C /end DEF_CHARACTERISTIC
/end FUNCTION
/begin FUNCTION asmod_obsvrpindvol_msg "" /begin OUT_MEASUREMENT ASMod_facArEffEGRCor ASMod_facVolEffCor /end OUT_MEASUREMENT /end FUNCTION
/begin FUNCTION asmod_obsvrpindvol_uic ""
 /begin OUT_MEASUREMENT ASMod_ddmAirPerTime_mp ASMod_dnAvrg_mp ASMod_dpIntVal_mp ASMod_dqLmbdCtl_mp ASMod_facArEffCorOutI_mp ASMod_facArEffCorOutP_mp ASMod_facArEffCorOut_mp ASMod_facVolEffCorOutI_mp ASMod_facVolEffCorOutP_mp ASMod_facVolEffCorOut_mp ASMod_pIndVolDvt_mp ASMod_stArEffEGRAdaptDel_mp ASMod_stArEffEGRAdapt_mp ASMod_stCheckRlsDDM_mp ASMod_stCheckRlsDN_mp ASMod_stCheckRlsDP_mp ASMod_stCheckRlsDQ_mp ASMod_stCheckRlsN_mp ASMod_stCheckRlsQ_mp ASMod_stVolEffAdaptDel_mp ASMod_stVolEffAdapt_mp /end OUT_MEASUREMENT
/end FUNCTION
/begin FUNCTION asmod_turb "Turbine"
 /begin DEF_CHARACTERISTIC ASMod_facTurb10_C ASMod_facTurb11_C ASMod_facTurb20_C ASMod_facTurb21_C ASMod_facTurb30_C ASMod_facTurb31_C ASMod_facTurb40_C ASMod_facTurb410_C ASMod_facTurb411_C ASMod_facTurb412_C ASMod_facTurb413_C ASMod_facTurb41_C ASMod_facTurb42_C ASMod_facTurb43_C ASMod_facTurb44_C ASMod_facTurb45_C ASMod_facTurb46_C ASMod_facTurb47_C ASMod_facTurb48_C ASMod_facTurb49_C ASMod_pTurbMax_C ASMod_pTurbMin_C ASMod_pTurbPstRef_C ASMod_tiPTurbPreUpPT1_C ASMod_tiPTurbPreDwnPT1_C ASMod_tTurbPreRef_C /end DEF_CHARACTERISTIC
 /begin OUT_MEASUREMENT ASMod_dmExhMnfPstRed_mp ASMod_nTurbRed_mp ASMod_rPresTurb_mp /end OUT_MEASUREMENT
/end FUNCTION
/begin FUNCTION asmod_turb_msg "" /begin OUT_MEASUREMENT ASMod_pTurbPre /end OUT_MEASUREMENT /end FUNCTION
/begin FUNCTION asmod_turb_uic "" /begin OUT_MEASUREMENT ASMod_stNaNTurb_mp /end OUT_MEASUREMENT /end FUNCTION
/begin FUNCTION asmod_var "" /end FUNCTION
/begin FUNCTION asmod_voleff "Luftaufwand"
 /begin DEF_CHARACTERISTIC ASMod_facTCorVolEff_C ASMod_facVolEff_MAP ASMod_facVSACorVolEff_MAP ASMod_tIndAirRef_MAP ASMod_volEng_C /end DEF_CHARACTERISTIC
 /begin IN_MEASUREMENT ASMod_rRelPosVSA Eng_nAvrg InjCtl_qCurr /end IN_MEASUREMENT
/end FUNCTION
/begin FUNCTION asmod_voleff_msg "" /begin OUT_MEASUREMENT ASMod_dmIndAirRef ASMod_dvolIndAirRef ASMod_tIndAirRef /end OUT_MEASUREMENT /end FUNCTION
/begin FUNCTION asmod_voleff_uic ""
 /begin OUT_MEASUREMENT ASMod_facTIndAirCor_mp ASMod_facVolEff_mp ASMod_facVSACorVolEff_mp /end OUT_MEASUREMENT
/end FUNCTION
/begin FUNCTION basadj "Grundeinstellungstest bei externer Diagnoseanforderung"
 /begin DEF_CHARACTERISTIC BasAdj_K2SigBlkVal0_MAP BasAdj_K2SigBlkVal1_MAP BasAdj_K2SigBlkVal2_MAP BasAdj_nMax_C BasAdj_phiInjSetPoint_C BasAdj_qMax_C BasAdj_rAirCtlEGR_C BasAdj_rAirCtlTVA_C BasAdj_rPCRBiT_C BasAdj_rPCR_C BasAdj_rVSA_C BasAdj_stCmpTstNum_C BasAdj_stKickDownlrnNum_C BasAdj_stPSP_C BasAdj_tiEnd_C BasAdj_tiRoutDemMax_C BasAdj_EGRnSetpoint_C BasAdj_EGRtime_C BasAdj_EGRBits_C BasAdj_InjSetPointnSetpoint_C BasAdj_InjSetPointtime_C BasAdj_InjSetPointBits_C BasAdj_PCRBiTnSetpoint_C BasAdj_PCRBiTtime_C BasAdj_PCRBiTBits_C BasAdj_PCRnSetpoint_C BasAdj_PCRtime_C BasAdj_PCRBits_C BasAdj_PSPnSetpoint_C BasAdj_PSPtime_C BasAdj_PSPBits_C BasAdj_VSA1nSetpoint_C BasAdj_VSA1time_C BasAdj_VSA1Bits_C BasAdj_VSA2nSetpoint_C BasAdj_VSA2time_C BasAdj_VSA2Bits_C BasAdj_VSAMSnSetpoint_C BasAdj_VSAMStime_C BasAdj_VSAMSBits_C /end DEF_CHARACTERISTIC
 /begin IN_MEASUREMENT BasAdj_ActRout_mp BasAdj_DispMode_mp /end IN_MEASUREMENT
/end FUNCTION
/begin FUNCTION basadj_msg ""
 /begin OUT_MEASUREMENT BasAdj_nSetPointDia BasAdj_phiInjSetPoint BasAdj_rAirCtlEGR BasAdj_rAirCtlTVA BasAdj_rPCR BasAdj_rPCRBiT1 BasAdj_rPCRBiT2 BasAdj_rVSA1 BasAdj_rVSA2 BasAdj_st BasAdj_stPSP /end OUT_MEASUREMENT
/end FUNCTION
/begin FUNCTION basadj_uic ""
 /begin OUT_MEASUREMENT BasAdj_ActRout_mp BasAdj_DispMode_mp BasAdj_lastRout_mp BasAdj_stActRout_mp BasAdj_stRoutDem_mp /end OUT_MEASUREMENT
/end FUNCTION
/begin FUNCTION battcd "Komponententreiber Batteriespannung"
 /begin DEF_CHARACTERISTIC BattCD_uSRCMin_C BattCD_uSRCMax_C BattCD_uLin_CUR BattCD_duRmpSlpUp_C BattCD_duRmpSlpDwn_C BattCD_tiDebSRCHighDef_C BattCD_tiDebSRCHighOk_C BattCD_tiDebSRCLowDef_C BattCD_tiDebSRCLowOk_C BattCD_stSensIDWord_C BattCD_uDfl_C BattCD_vLim_C /end DEF_CHARACTERISTIC
 /begin IN_MEASUREMENT BattCD_uRaw /end IN_MEASUREMENT
/end FUNCTION
/begin FUNCTION battcd_msg "" /begin OUT_MEASUREMENT BattCD_u BattCD_uRaw /end OUT_MEASUREMENT /end FUNCTION
/begin FUNCTION battcd_uic "" /begin OUT_MEASUREMENT BattCD_uLin_mp /end OUT_MEASUREMENT /end FUNCTION
/begin FUNCTION batt_corfac "" /begin DEF_CHARACTERISTIC Batt_facCor_CUR /end DEF_CHARACTERISTIC /begin IN_MEASUREMENT BattCD_u /end IN_MEASUREMENT /end FUNCTION
/begin FUNCTION batt_corfac_msg "" /begin OUT_MEASUREMENT Batt_facCor /end OUT_MEASUREMENT /end FUNCTION
/begin FUNCTION bdint "Karosserie und Innenraum" /end FUNCTION
/begin FUNCTION bdint_msg "" /begin OUT_MEASUREMENT BdInt_nMax BdInt_nMin BdInt_pwrDes BdInt_pwrLead /end OUT_MEASUREMENT /end FUNCTION
/begin FUNCTION bpacd "Komponententreiber des Ladedruckstellers"
 /begin DEF_CHARACTERISTIC BPACD_DebExcTempDef_C BPACD_DebExcTempOk_C BPACD_DebNoLoadDef_C BPACD_DebNoLoadOk_C BPACD_DebShortCircBatDef_C BPACD_DebShortCircBatOk_C BPACD_DebShortCircGndDef_C BPACD_DebShortCircGndOk_C BPACD_stInvOut_C BPACD_tiPer_C BPACD_rCnv_CUR BPACD_rErrDflVal_C BPACD_rOutMax_C BPACD_rOutMin_C BPACD_rTst_C BPACD_stPwrStgActv_C BPACD_stPwrStgDia_C BPACD_swtBattCor_C BPACD_swtEActrOn_C BPACD_tiBtwTst_C /end DEF_CHARACTERISTIC
 /begin IN_MEASUREMENT BPA_rBPA /end IN_MEASUREMENT
/end FUNCTION
/begin FUNCTION bpacd_msg "" /begin OUT_MEASUREMENT BPACD_rOut BPACD_rOut2 /end OUT_MEASUREMENT /end FUNCTION
/begin FUNCTION bpacd_uic "" /begin OUT_MEASUREMENT BPACD_rCnv_mp /end OUT_MEASUREMENT /end FUNCTION
/begin FUNCTION bpascd "Komponententreiber für den Ladedrucksteller Sensor"
 /begin DEF_CHARACTERISTIC BPASCD_DebRngErrDef_C BPASCD_DebRngErrOk_C BPASCD_DebMaxPeriodDef_C BPASCD_DebMaxPeriodOk_C BPASCD_DebMaxDef_C BPASCD_DebMaxOk_C BPASCD_DebMinPeriodDef_C BPASCD_DebMinPeriodOk_C BPASCD_DebMinDef_C BPASCD_DebMinOk_C BPASCD_stPwmInInv_C BPASCD_tiPwmInMinPer_C BPASCD_tiPwmInMaxPer_C BPASCD_dcycPwmInMin_C BPASCD_dcycPwmInMax_C BPASCD_rLinDcyc_CUR /end DEF_CHARACTERISTIC
 /begin IN_MEASUREMENT BPASCD_dcycIn /end IN_MEASUREMENT
/end FUNCTION
/begin FUNCTION bpascd_msg "" /begin OUT_MEASUREMENT BPASCD_dcycIn BPASCD_rRelPos BPASCD_st /end OUT_MEASUREMENT /end FUNCTION
/begin FUNCTION bpascd_uic "" /begin OUT_MEASUREMENT BPASCD_stErr_mp BPASCD_tiActPer_mp /end OUT_MEASUREMENT /end FUNCTION
/begin FUNCTION bpa_co "Stellerkoordinator für Ladedrucksteller"
 /begin DEF_CHARACTERISTIC BPA_DebErrLrnLMSDef_C BPA_DebErrLrnLMSOk_C BPA_DebErrLrnUMSDef_C BPA_DebErrLrnUMSOk_C BPA_DebErrPWMDef_C BPA_DebErrPWMOk_C BPA_DebExcSensTempDef_C BPA_DebExcSensTempOk_C BPA_nThres_C BPA_swtLrnLMSLrnDef_C BPA_swtLrnLMSPWMDef_C BPA_swtLrnLMS_C /end DEF_CHARACTERISTIC
/end FUNCTION
/begin FUNCTION bpa_co_msg "" /begin OUT_MEASUREMENT BPA_rBPA BPA_stBPA /end OUT_MEASUREMENT /end FUNCTION
/begin FUNCTION bpa_co_uic "" /begin DEF_CHARACTERISTIC BPA_rBPA_Vector BPA_rBPA_Channel /end DEF_CHARACTERISTIC /begin OUT_MEASUREMENT BPA_rBPAByp_mp BPA_stErrHdl1_mp BPA_stErrHdl2_mp /end OUT_MEASUREMENT /end FUNCTION
/begin FUNCTION bpscd "Komponententreiber des Ladedruckfühlers"
 /begin DEF_CHARACTERISTIC BPSCD_uSRCMin_C BPSCD_uSRCMax_C BPSCD_pLin_CUR BPSCD_ctAvgMx_C BPSCD_DebSigDef_C BPSCD_DebSigOK_C BPSCD_DebSRCHighDef_C BPSCD_DebSRCHighOK_C BPSCD_DebSRCLowDef_C BPSCD_DebSRCLowOK_C BPSCD_nLim_C BPSCD_numSSp_C BPSCD_pAdjMax_C BPSCD_tiPT1_C BPSCD_pDiffLim_C BPSCD_dpRmpSlpUp_C BPSCD_dpRmpSlpDwn_C BPSCD_swtCorrOn_C BPSCD_swtSigVal_C BPSCD_tiAvgDly_C BPSCD_stSensIDWord_C BPSCD_pDfl_C /end DEF_CHARACTERISTIC
 /begin IN_MEASUREMENT BPSCD_uRawVal /end IN_MEASUREMENT
/end FUNCTION
/begin FUNCTION bpscd_filtconst "" /begin DEF_CHARACTERISTIC BPSCD_tiLPFilt_C /end DEF_CHARACTERISTIC /end FUNCTION
/begin FUNCTION bpscd_msg ""
 /begin OUT_MEASUREMENT BPSCD_ctAvg BPSCD_pAvgDiff BPSCD_pFltVal BPSCD_pIntVal BPSCD_pLastPhyVal BPSCD_pLin BPSCD_pOutVal BPSCD_pPhyVal BPSCD_stErr BPSCD_stPlausErr BPSCD_stTransStage BPSCD_swtSig BPSCD_uRawVal /end OUT_MEASUREMENT
/end FUNCTION
/begin FUNCTION bpscd_uic "" /begin OUT_MEASUREMENT BPSCD_pDiffLim_mp BPSCD_pDiff_mp BPSCD_stPlausCalc_mp /end OUT_MEASUREMENT /end FUNCTION
/begin FUNCTION brkcd "Komponententreiber zur Erfassung aller Bremssignale"
 /begin DEF_CHARACTERISTIC BrkCD_DebdynPlaDef_C BrkCD_DebdynPlaOk_C BrkCD_DebSRCHighDef_C BrkCD_DebSRCHighOk_C BrkCD_DebSRCLowDef_C BrkCD_DebSRCLowOk_C BrkCD_uMnSwtSRCMin_C BrkCD_uMnSwtSRCMax_C BrkCD_uMnSwtLin_CUR BrkCD_tiMnSwtDebNeg_C BrkCD_tiMnSwtDebPos_C BrkCD_numStepDef_C BrkCD_numStepOK_C BrkCD_tiRedSwtDebNeg_C BrkCD_tiRedSwtDebPos_C BrkCD_dtRmpSlpUp_C BrkCD_dtRmpSlpDwn_C BrkCD_stBrk_Invalid_C BrkCD_stMnSwtInvIn_C BrkCD_swtRedSwtPresent_C BrkCD_tiBREdyn_C BrkCD_tiBREiO_C BrkCD_stSensIDWord_C BrkCD_uDfl_C BrkCD_uMnSwtA2DThres_C /end DEF_CHARACTERISTIC
 /begin IN_MEASUREMENT BrkCD_uMnSwtRawVal /end IN_MEASUREMENT
/end FUNCTION
/begin FUNCTION brkcd_chkd "" /begin DEF_CHARACTERISTIC BrkCD_stDflVal_C BrkCD_stRedSwtInvIn_C BrkCD_swtSigVal_C /end DEF_CHARACTERISTIC /end FUNCTION
/begin FUNCTION brkcd_msg ""
 /begin OUT_MEASUREMENT BrkCD_stMnSwtDebVal BrkCD_stMnSwtRawVal BrkCD_stPressed BrkCD_stRedSwtDebVal BrkCD_stRedSwtPresent BrkCD_stRedSwtRawVal BrkCD_swtSig BrkCD_uMnSwtLinVal BrkCD_uMnSwtRawVal /end OUT_MEASUREMENT
/end FUNCTION
/begin FUNCTION brkcd_uic ""
 /begin OUT_MEASUREMENT BrkCD_ctBREPLAU_mp BrkCD_stDebDyn_mp BrkCD_stMnSwtLogVal_mp BrkCD_stRedSwtLogVal_mp BrkCD_stRun_mp BrkCD_uMnSwtNrmVal_mp BrkCD_uMnSwtTrnsVal_mp /end OUT_MEASUREMENT
/end FUNCTION
/begin FUNCTION bypetk ""
 /begin DEF_CHARACTERISTIC BypEtk_dNsyncStimuli64_C BypEtk_dNsyncStimuli32_C BypEtk_dNsyncStimuli16_C BypEtk_dNsyncStimuli8_C BypEtk_stAscet_C BypEtk_dTsyncStimuli64_C BypEtk_dTsyncStimuli32_C BypEtk_dTsyncStimuli16_C BypEtk_dTsyncStimuli8_C /end DEF_CHARACTERISTIC
/end FUNCTION
/begin FUNCTION bypetk_msg ""
 /begin OUT_MEASUREMENT BypEtk_ctStepDelayNsync_u8 BypEtk_ctStepDelayTsync_u8 BypEtk_stEcu_u8 /end OUT_MEASUREMENT
/end FUNCTION
/begin FUNCTION bypint "" /begin DEF_CHARACTERISTIC BypInt_adFunc_C BypInt_stAscet_C /end DEF_CHARACTERISTIC /end FUNCTION
/begin FUNCTION bypint_msg "" /begin OUT_MEASUREMENT BypInt_stEcu_u8 /end OUT_MEASUREMENT /end FUNCTION
/begin FUNCTION carb "CARB Einstellungen"
 /begin DEF_CHARACTERISTIC Carb9_CIDTable_C Carb_Mode1VisPID_CUR Carb_Mode3SwtDia_C Carb_Mode4RefVal_C Carb_Mode4SigNum_C Carb_Mode6TstComp_CUR Carb_Mode6TstNum_CUR Carb_Mode6TstRefMax_CUR Carb_Mode6TstRefMin_CUR Carb_Mode6TstTestId_CUR Carb_Mode6TstUnitId_CUR Carb_Mode6TstVal_CUR Carb_Mode9PID0_C Carb_Mode9PID1_C Carb_Mode9PID2_C Carb_Mode9PID3_C Carb_Mode9PID4_C Carb_Mode9PID5_C Carb_Mode9PID6_C Carb_stAppl_C /end DEF_CHARACTERISTIC
/end FUNCTION
/begin FUNCTION cascd "Komponententreiber Nockenwelle"
 /begin DEF_CHARACTERISTIC CaSCD_ctEdgOfs_C CaSCD_ctErrSync_C CaSCD_ctShftSync_C CaSCD_dSegSeries_C CaSCD_facPlausHigh_CUR CaSCD_facPlausLow_CUR CaSCD_nMinSpeed_C CaSCD_phiSegLenTolc_C CaSCD_phiSegLen_C CaSCD_phiSegOfs_C CaSCD_phiSpeedCalcTolc_C CaSCD_phiSpeedSegLen_C CaSCD_phiSpeedSegOfs_C CaSCD_stCalc_C CaSCD_stEdgeTrig_C CaSCD_stPinState_C CaSCD_stTPO_C CaSCD_tiPeriodRev1Max_C CaSCD_tiPeriodRev2Max_C CaSCD_tiTimOutOfs_C /end DEF_CHARACTERISTIC
 /begin IN_MEASUREMENT CaSCD_tiPeriodRev CaSCD_tiPeriodRevHold /end IN_MEASUREMENT
/end FUNCTION
/begin FUNCTION cascd_backup "" /end FUNCTION
/begin FUNCTION cascd_msg ""
 /begin OUT_MEASUREMENT CaSCD_nPeriod CaSCD_nSeg CaSCD_tiPeriodRev CaSCD_tiPeriodRevHold CaSCD_tiSeg /end OUT_MEASUREMENT
/end FUNCTION
/begin FUNCTION cascd_uic ""
 /begin OUT_MEASUREMENT CaSCD_ctEdgCaSRev_mp CaSCD_ctEdgOfs_mp CaSCD_ctEdgOrd_mp CaSCD_ctErrEdg_mp CaSCD_ctPhRevEdges_mp CaSCD_ctPhRev_mp CaSCD_ctSegEdg_mp CaSCD_ctShftPos_mp CaSCD_ctSyncEdg_mp CaSCD_numFrstInt_mp CaSCD_numFrstTDC_mp CaSCD_phiCurr_mp CaSCD_phiLstEdge_mp CaSCD_phiLstFEdge_mp CaSCD_phiLstREdge_mp CaSCD_stPhaseErr_mp CaSCD_stPhaseSig_mp CaSCD_stPhaseSync_mp CaSCD_stSegCylEdg_mp CaSCD_stSyncCylEdg_mp CaSCD_tiSigTimOut_mp /end OUT_MEASUREMENT
/end FUNCTION
/begin FUNCTION catsys_msg "" /begin OUT_MEASUREMENT CatSys_st CatSys_tCat /end OUT_MEASUREMENT /end FUNCTION
/begin FUNCTION clg "Kühlung"
 /begin DEF_CHARACTERISTIC Clg_dtMinDynTst_C Clg_nMinEnaDynTst_C Clg_qMinEnaDynTst_C Clg_stCtl_C Clg_tiInitTmr_C Clg_tiMaxDynTst_CUR Clg_tMinClntDynTst_C /end DEF_CHARACTERISTIC
 /begin IN_MEASUREMENT Clg_tClntStrtVal_mp /end IN_MEASUREMENT
/end FUNCTION
/begin FUNCTION clg_msg ""
 /begin OUT_MEASUREMENT Clg_dtDynTst Clg_dtDynTstCARB Clg_dtMinDynTstCARB Clg_tEndDynTst Clg_tEndDynTstCARB Clg_tiDynTst Clg_tiDynTstCARB Clg_tiMaxDynTst Clg_tiMaxDynTstCARB Clg_tMinClntDynTstCARB /end OUT_MEASUREMENT
/end FUNCTION
/begin FUNCTION clg_uic "" /begin OUT_MEASUREMENT Clg_tClntStrtVal_mp /end OUT_MEASUREMENT /end FUNCTION
/begin FUNCTION cmbchb_misfire "Brennräume Fehlzündungserkennung"
 /begin DEF_CHARACTERISTIC CmbChb_nAvrgThrHi_C CmbChb_nAvrgThrLo_C CmbChb_qRawThrHi_C CmbChb_qRawThrLo_C CmbChb_tClntThrLo_C CmbChb_vThrHi_C CmbChb_tiDebClutchChng_C CmbChb_tiDlyStr_C CmbChb_ctEngRevPerBlk_C CmbChb_ctSegTDC1_C CmbChb_numBlk_C CmbChb_dnSegMin_C CmbChb_ctMisfireMax_C CmbChb_swtMonClutchVal_C CmbChb_swtMonClutchType_C /end DEF_CHARACTERISTIC
 /begin OUT_MEASUREMENT CmbChb_ctMifBuf1_mp CmbChb_ctMifBuf2_mp CmbChb_ctMifMem_mp /end OUT_MEASUREMENT
/end FUNCTION
/begin FUNCTION cmbchb_misfire_msg "" /begin OUT_MEASUREMENT CmbChb_st CmbChb_swtMonClutch /end OUT_MEASUREMENT /end FUNCTION
/begin COMPU_METHOD AirMassPerCyl "Luftmasse pro Zylinder" RAT_FUNC "%6.3" "[mg/Hub Luft]" COEFFS 0 10 0 0 0 1 /end COMPU_METHOD
/begin COMPU_METHOD AirMassPerTime "Luftmasse pro Zeit" RAT_FUNC "%6.3" "[Kg/h Luft]" COEFFS 0 10 0 0 0 1 /end COMPU_METHOD
/begin COMPU_METHOD AirmassPerTimeRed_float "Umrechnungsformel für reduzierte Luftmassenstrom" RAT_FUNC "%6.2" "[kg/h*K^-0.5]" COEFFS 0 1 0 0 0 1 /end COMPU_METHOD
/begin COMPU_METHOD AirmassPerTime_float "Umrechnungsformel für Luftmasse pro Zeit" RAT_FUNC "%6.2" "[kg/h]" COEFFS 0 1 0 0 0 1 /end COMPU_METHOD
/begin COMPU_METHOD Airmass_float "Umrechnungsformel für Luftmasse" RAT_FUNC "%6.2" "[g]" COEFFS 0 1 0 0 0 1 /end COMPU_METHOD
/begin COMPU_METHOD AirVolPerTime "Umrechnungsformel für Luftvolumenstrom" RAT_FUNC "%6.3" "m^3/h" COEFFS 0 10 0 0 0 1 /end COMPU_METHOD
/begin COMPU_METHOD AngleCaS "Winkel Nockenwelle" RAT_FUNC "%6.4" "[deg CaS]" COEFFS 0 85.3333333333334 0 0 0 1 /end COMPU_METHOD
/begin COMPU_METHOD AngleCrS "Winkel Kurbelwelle" RAT_FUNC "%6.4" "[deg CrS]" COEFFS 0 42.6666666666667 0 0 0 1 /end COMPU_METHOD
/begin COMPU_METHOD Area_float "Flaeche für Fliesspunktvariable" RAT_FUNC "%6.2" "[cm^2]" COEFFS 0 1 0 0 0 1 /end COMPU_METHOD
/begin COMPU_METHOD CoeffA "Koeffizient A in der Parabel dTrq = A * Trq^2 + Trq" RAT_FUNC "%6.4" "1/(s*Nm)" COEFFS 0 204.8 0 0 0 1 /end COMPU_METHOD
/begin COMPU_METHOD Curr_A "Umrechnung für Strom in Ampere" RAT_FUNC "%6.4" "A" COEFFS 0 100 0 0 0 1 /end COMPU_METHOD
/begin COMPU_METHOD dTrq "Umrtechnungsformel dTrq/dTime" RAT_FUNC "%6.3" "Nm/s" COEFFS 0 10 0 0 0 1 /end COMPU_METHOD
/begin COMPU_METHOD DtyCyc "Tastverhaeltnis" RAT_FUNC "%6.4" "[%]" COEFFS 0 100 0 0 0 1 /end COMPU_METHOD
/begin COMPU_METHOD EngN "Motordrehzahl" RAT_FUNC "%6.2" "[rpm]" COEFFS 0 1 0 0 0 1 /end COMPU_METHOD
/begin COMPU_METHOD Fact "Faktor mit Auflösung 1 / 8192, hauptsächlich für einen Faktorenbereich 0...1 verwendet" RAT_FUNC "%6.5" "[-]" COEFFS 0 8192 0 0 0 1 /end COMPU_METHOD
/begin COMPU_METHOD Fact1 "Faktor mit Auflösung 0,01 (100 mal höherer Bereich als Fact)" RAT_FUNC "%6.4" "[-]" COEFFS 0 128 0 0 0 1 /end COMPU_METHOD
/begin COMPU_METHOD FactPresLs_float "Faktor zur Berechnung des Druckabfalls für Fliesspunktvariable" RAT_FUNC "%6.2" "[(hpa/(kg/h))^2/K]" COEFFS 0 1 0 0 0 1 /end COMPU_METHOD
/begin COMPU_METHOD InjMass "Einspritzmenge" RAT_FUNC "%6.4" "[mg/hub]" COEFFS 0 100 0 0 0 1 /end COMPU_METHOD
/begin COMPU_METHOD InjMassPerTime "Kraftstoffmassenstrom" RAT_FUNC "%6.4" "[kg/h]" COEFFS 0 100 0 0 0 1 /end COMPU_METHOD
/begin COMPU_METHOD Kd "Differentialverstärkung Kd (gleiche Einheit/Umrechnungsformel an Ein- und Ausgang)" RAT_FUNC "%7.6" "[1/1]" COEFFS 0 65536 0 0 0 1 /end COMPU_METHOD
/begin COMPU_METHOD Kd_Lin_16 "Kd Verstärkung von linearen Kennlinien/-feldern" RAT_FUNC "%7.6" "1/1" COEFFS 0 32767 0 0 0 1 /end COMPU_METHOD
/begin COMPU_METHOD Ki_Pres_hPa2Fact "Umrechnung Druck in hPa zu Faktor fuer I-Anteil" RAT_FUNC "%10.9" "[1/(hPa*s)]" COEFFS 0 35184372.088832 0 0 0 1 /end COMPU_METHOD
/begin COMPU_METHOD Kp_Pres_hPa2Fact "Umrechnung Druck in hPa zu Faktor fuer P-Anteil" RAT_FUNC "%11.10" "[1/hPa]" COEFFS 0 536870912 0 0 0 1 /end COMPU_METHOD
/begin COMPU_METHOD lambdaRecVal "Reziproker Lambda Wert" RAT_FUNC "%6.5" "[-]" COEFFS 0 1000 0 0 0 1 /end COMPU_METHOD
/begin COMPU_METHOD O2 "Sauerstoffkonzentration" RAT_FUNC "%8.7" "[-]" COEFFS 0 100000 0 0 0 1 /end COMPU_METHOD
/begin COMPU_METHOD O2MassPerTime "Sauerstoffmassenstrom" RAT_FUNC "%6.4" "[kg/h]" COEFFS 0 100 0 0 0 1 /end COMPU_METHOD
/begin COMPU_METHOD OneToOne "eins zu eins (physikalischer Wert ist gleich dem internen Wert)" RAT_FUNC "%6.2" "[-]" COEFFS 0 1 0 0 0 1 /end COMPU_METHOD
/begin COMPU_METHOD Period "Periodendauer" RAT_FUNC "%6.3" "[ms]" COEFFS 0 10 0 0 0 1 /end COMPU_METHOD
/begin COMPU_METHOD Period_ms "Periodendauer in ms" RAT_FUNC "%6.3" "[ms]" COEFFS 0 10 0 0 0 1 /end COMPU_METHOD
/begin COMPU_METHOD Per_Dur "Periodendauer Segmentzeit" RAT_FUNC "%6.2" "[usec]" COEFFS 0 1 0 0 0 1 /end COMPU_METHOD
/begin COMPU_METHOD Prc "Prozent, gleiche interne Auflösung wie Fact, aber Darstellung in Prozent (0...100%)" RAT_FUNC "%6.4" "[%]" COEFFS 0 100 0 0 0 1 /end COMPU_METHOD
/begin COMPU_METHOD Prc_fl "Float Umrechnung für Percent" RAT_FUNC "%6.2" "[%]" COEFFS 0 1 0 0 0 1 /end COMPU_METHOD
/begin COMPU_METHOD Pres_hPa "Druck (angezeigt in [hPa])" RAT_FUNC "%6.2" "[hPa]" COEFFS 0 1 0 0 0 1 /end COMPU_METHOD
/begin COMPU_METHOD Pres_hPa_float "Druck (angezeigt in [hPa])" RAT_FUNC "%6.2" "[hPa]" COEFFS 0 1 0 0 0 1 /end COMPU_METHOD
/begin COMPU_METHOD Pwr "Leistung" RAT_FUNC "%6.2" "[W]" COEFFS 0 0.10610329539459 0 0 0 1 /end COMPU_METHOD
/begin COMPU_METHOD RatAirMass "Luftmassenverhältnis" RAT_FUNC "%6.4" "[-]" COEFFS 0 100 0 0 0 1 /end COMPU_METHOD
/begin COMPU_METHOD RatFuelMass "Kraftstoffmassenverhältnis" RAT_FUNC "%6.4" "[-]" COEFFS 0 100 0 0 0 1 /end COMPU_METHOD
/begin COMPU_METHOD RmpAirMassPerTimeLow "Luftmasse Rampensteigung" RAT_FUNC "%6.2" "[(kg/h)/s]" COEFFS 0 1 0 0 0 1 /end COMPU_METHOD
/begin COMPU_METHOD RmpEngNLow "Motordrehzahl Rampensteigung" RAT_FUNC "%6.2" "[rpm/s]" COEFFS 0 1 0 0 0 1 /end COMPU_METHOD
/begin COMPU_METHOD RmpInjMassLow "Einspritzmenge Rampensteigung" RAT_FUNC "%6.3" "[(mg/stroke)/s]" COEFFS 0 10 0 0 0 1 /end COMPU_METHOD
/begin COMPU_METHOD RmpPres_hPa "Rampengradient für Druck angezeigt in [hPa/s]" RAT_FUNC "%6.4" "[hPa/s]" COEFFS 0 65.536 0 0 0 1 /end COMPU_METHOD
/begin COMPU_METHOD RmpPres_hPaLow "Druck Rampensteigung" RAT_FUNC "%6.3" "[hPa/s]" COEFFS 0 10 0 0 0 1 /end COMPU_METHOD
/begin COMPU_METHOD RmpTrqdHigh "Rampengradient für Momente mit großen Steigungen" RAT_FUNC "%6.2" "[Nm/s]" COEFFS 0 0.682666666666667 0 0 0 1 /end COMPU_METHOD
/begin COMPU_METHOD RmpVolt "ADC Spannungsrampengradient" RAT_FUNC "%6.4" "[mV/s]" COEFFS 0 13.4086656 0 0 0 1 /end COMPU_METHOD
/begin COMPU_METHOD RmpVoltBatt "Rampengradient für Batteriespannung" RAT_FUNC "%6.3" "[mV/s]" COEFFS 0 3.22602867866423 0 0 0 1 /end COMPU_METHOD
/begin COMPU_METHOD TempC_float "Temperatur in Celsius für Fliesspunktvariable" RAT_FUNC "%6.1" "[deg C]" COEFFS 0 1 273.14 0 0 1 /end COMPU_METHOD
/begin COMPU_METHOD TempDiff_Kelv "Offsettemperatur dargestellt in [K]" RAT_FUNC "%6.3" "[ deg C ]" COEFFS 0 10 0 0 0 1 /end COMPU_METHOD
/begin COMPU_METHOD TempK_float "Umwandlungsformel für Temperatur in Kelvin" RAT_FUNC "%6.2" "[K]" COEFFS 0 1 0 0 0 1 /end COMPU_METHOD
/begin COMPU_METHOD Temp_Cels "Temperatur dargestellt in °C (gleiche interne Darstellung wie Temp_Kelv)" RAT_FUNC "%6.1" "[deg C]" COEFFS 0 10 2731.4 0 0 1 /end COMPU_METHOD
/begin COMPU_METHOD Temp_Kelv "Temperatur dargestellt in Kelvin" RAT_FUNC "%6.3" "[ deg C ]" COEFFS 0 10 0 0 0 1 /end COMPU_METHOD
/begin COMPU_METHOD TimeDeb "Entprellzeit in Millisekunden für Libraryfunktion Debounce" RAT_FUNC "%6.1" "[ms]" COEFFS 0 0.1 0 0 0 1 /end COMPU_METHOD
/begin COMPU_METHOD TimeDelay_s "Zeitkonstante T1 (in s) für PT1, DT1, etc." RAT_FUNC "%9.3" "[s]" COEFFS 0 0 1 0 0.00023283064365387 0 /end COMPU_METHOD
/begin COMPU_METHOD TimeDelay_s_Lin_16 "Zeitkonstante T1 (in s) für PT1, DT1, etc. für SINT16, kein Kehrwert" RAT_FUNC "%6.5" "s" COEFFS 0 6553.4 0 0 0 1 /end COMPU_METHOD
/begin COMPU_METHOD Time_DynTst "Zeitumrechung für dynamischen test mit geringerer Auflösung, damit es für KL Ausgang passt" RAT_FUNC "%6.2" "[s]" COEFFS 0 0.390625 0 0 0 1 /end COMPU_METHOD
/begin COMPU_METHOD Time_ms "Zeit in ms für Fehlerentprellung (DSM) und SW-Timer" RAT_FUNC "%6.1" "[ms]" COEFFS 0 0.1 0 0 0 1 /end COMPU_METHOD
/begin COMPU_METHOD Time_s "Zeit in s für Fehlerentprellung (DSM) und SW-Timer" RAT_FUNC "%6.4" "[s]" COEFFS 0 100 0 0 0 1 /end COMPU_METHOD
/begin COMPU_METHOD Time_s_float "Umrechnungsformel für PT1 Zeitkonstanten" RAT_FUNC "%6.2" "[s]" COEFFS 0 1 0 0 0 1 /end COMPU_METHOD
/begin COMPU_METHOD TransR "Übersetzungsverhältnis (Getriebe etc.)" RAT_FUNC "%6.4" "[-]" COEFFS 0 100 0 0 0 1 /end COMPU_METHOD
/begin COMPU_METHOD TrbChN_float "Turboladerdrehzahl für Fliesspunktvariable" RAT_FUNC "%6.2" "[rpm]" COEFFS 0 1 0 0 0 1 /end COMPU_METHOD
/begin COMPU_METHOD Trq "Motormoment" RAT_FUNC "%6.3" "[Nm]" COEFFS 0 10 0 0 0 1 /end COMPU_METHOD
/begin COMPU_METHOD TrqPrp "Vortriebsmoment" RAT_FUNC "%6.2" "[Nm]" COEFFS 0 1 0 0 0 1 /end COMPU_METHOD
/begin COMPU_METHOD Vel "Fahrzeuggeschwindigkeit, gleiche interne Auflösung wie Vel_SI" RAT_FUNC "%6.4" "[km/h]" COEFFS 0 100 0 0 0 1 /end COMPU_METHOD
/begin COMPU_METHOD Vol "Volumen" RAT_FUNC "%6.4" "[l]" COEFFS 0 100 0 0 0 1 /end COMPU_METHOD
/begin COMPU_METHOD Volt "Spannung in V (von ADC)" RAT_FUNC "%6.2" "[mV]" COEFFS 0 0.2046 0 0 0 1 /end COMPU_METHOD
/begin COMPU_METHOD Volt_Batt "Batteriespannung" RAT_FUNC "%6.1" "[mV]" COEFFS 0 0.0492252911173131 0 0 0 1 /end COMPU_METHOD
/begin COMPU_METHOD Vol_float "Umrechnungsformel für Luftvolumen" RAT_FUNC "%6.2" "[l]" COEFFS 0 1 0 0 0 1 /end COMPU_METHOD
/begin COMPU_METHOD default "" RAT_FUNC "%6.2" "" COEFFS 0 1 0 0 0 1 /end COMPU_METHOD
/begin COMPU_METHOD defaultAscii "" RAT_FUNC "%6.2" "" COEFFS 0 1 0 0 0 1 /end COMPU_METHOD
/begin RECORD_LAYOUT Kf_Xr32_Yr32_Wr32 NO_AXIS_PTS_X 1 ULONG NO_AXIS_PTS_Y 2 ULONG AXIS_PTS_X 3 FLOAT32_IEEE INDEX_INCR DIRECT AXIS_PTS_Y 4 FLOAT32_IEEE INDEX_INCR DIRECT FNC_VALUES 5 FLOAT32_IEEE COLUMN_DIR DIRECT /end RECORD_LAYOUT
/begin RECORD_LAYOUT Kf_Xs16_Ys16_Ws16 NO_AXIS_PTS_X 1 SWORD NO_AXIS_PTS_Y 2 SWORD AXIS_PTS_X 3 SWORD INDEX_INCR DIRECT AXIS_PTS_Y 4 SWORD INDEX_INCR DIRECT FNC_VALUES 5 SWORD COLUMN_DIR DIRECT /end RECORD_LAYOUT
/begin RECORD_LAYOUT Kl_Xr32_Wr32 NO_AXIS_PTS_X 1 ULONG AXIS_PTS_X 2 FLOAT32_IEEE INDEX_INCR DIRECT FNC_VALUES 3 FLOAT32_IEEE COLUMN_DIR DIRECT /end RECORD_LAYOUT
/begin RECORD_LAYOUT Kl_Xs16_Ws16 NO_AXIS_PTS_X 1 SWORD AXIS_PTS_X 2 SWORD INDEX_INCR DIRECT FNC_VALUES 3 SWORD COLUMN_DIR DIRECT /end RECORD_LAYOUT
/begin RECORD_LAYOUT Ktx FNC_VALUES 1 UBYTE COLUMN_DIR DIRECT /end RECORD_LAYOUT
/begin RECORD_LAYOUT Kwb_Ws16 FNC_VALUES 1 SWORD COLUMN_DIR DIRECT /end RECORD_LAYOUT
/begin RECORD_LAYOUT Kwb_Wu16 FNC_VALUES 1 UWORD COLUMN_DIR DIRECT /end RECORD_LAYOUT
/begin RECORD_LAYOUT Kwb_Wu32 FNC_VALUES 1 ULONG COLUMN_DIR DIRECT /end RECORD_LAYOUT
/begin RECORD_LAYOUT Kwb_Wu8 FNC_VALUES 1 UBYTE COLUMN_DIR DIRECT /end RECORD_LAYOUT
/begin RECORD_LAYOUT Kw_Wr32 FNC_VALUES 1 FLOAT32_IEEE COLUMN_DIR DIRECT /end RECORD_LAYOUT
/begin RECORD_LAYOUT Kw_Ws16 FNC_VALUES 1 SWORD COLUMN_DIR DIRECT /end RECORD_LAYOUT
/begin RECORD_LAYOUT Kw_Ws32 FNC_VALUES 1 SLONG COLUMN_DIR DIRECT /end RECORD_LAYOUT
/begin RECORD_LAYOUT Kw_Wu16 FNC_VALUES 1 UWORD COLUMN_DIR DIRECT /end RECORD_LAYOUT
/begin RECORD_LAYOUT Kw_Wu32 FNC_VALUES 1 ULONG COLUMN_DIR DIRECT /end RECORD_LAYOUT
/begin RECORD_LAYOUT Kw_Wu8 FNC_VALUES 1 UBYTE COLUMN_DIR DIRECT /end RECORD_LAYOUT
/end MODULE
/end PROJECT
