ASAP2_VERSION 1 3
/begin PROJECT C177 "EDC16CP"
/begin HEADER "" VERSION "VCP7A3" PROJECT_NO C177 /end HEADER
/begin MODULE DIM ""
/begin MOD_COMMON "" BYTE_ORDER MSB_FIRST ALIGNMENT_BYTE 1 ALIGNMENT_WORD 2 ALIGNMENT_LONG 4 ALIGNMENT_FLOAT32_IEEE 4 /end MOD_COMMON
/begin CHARACTERISTIC Chiste_stEnaTst_C "Schalter zum Testen des Befehlstests" VALUE 0x1E9DBC Kw_Wu8 255.0 OneToOne 0.00 255.0 FORMAT "%5.1" /end CHARACTERISTIC
/begin CHARACTERISTIC K2RDI_DiaNum_C "Diagnosenummer" ASCII 0x1C1232 Ktx 255.0 defaultAscii 0.00 255.0 NUMBER 5 /end CHARACTERISTIC
/begin CHARACTERISTIC K2RDI_SWPartNum_C "VW/Audi Softwareteilnummer" ASCII 0x1C1238 Ktx 255.0 defaultAscii 0.00 255.0 NUMBER 7 /end CHARACTERISTIC
/begin CHARACTERISTIC StSys_nFreezeTrqRmp_C "Rampenbegrenzungsdrehzahl" VALUE 0x1E795C Kw_Ws16 65535.00 EngN -32768.00 32767.00 FORMAT "%8.2" /end CHARACTERISTIC
/begin CHARACTERISTIC StSys_nReleaseTrqRmp_C "Rampenfreigabedrehzahl" VALUE 0x1E795E Kw_Ws16 65535.00 EngN -32768.00 32767.00 FORMAT "%8.2" /end CHARACTERISTIC
/begin CHARACTERISTIC StSys_nThrestEng_CUR "Zweimassenschwungrad Kennlinie für Drehzahlschwelle" CURVE 0x1E7980 Kl_Xs16_Ws16 5960.000 EngN 40.00000 6000.000 FORMAT "%8.3" EXTENDED_LIMITS -32768.00 32767.00
 /begin AXIS_DESCR STD_AXIS Eng_tEng Temp_Cels 5 -50.14000 149.8600 FORMAT "%8.4" EXTENDED_LIMITS -3549.940 3003.560 DEPOSIT ABSOLUTE /end AXIS_DESCR
/end CHARACTERISTIC
/begin CHARACTERISTIC StSys_nThresTMFW_C "Drehzahlschwelle für Zweimassenschwungrad" VALUE 0x1E7996 Kw_Ws16 5960.000 EngN 40.00000 6000.000 FORMAT "%8.3" EXTENDED_LIMITS -32768.00 32767.00 /end CHARACTERISTIC
/begin CHARACTERISTIC StSys_numAvrgRun_C "Anzahl der Durchläufe für die Erkennung des Batteriespannungsgradienten" VALUE 0x1E7998 Kw_Wu8 9.000 OneToOne 1.000 10.00 FORMAT "%5.2" EXTENDED_LIMITS 0.00 255.0 /end CHARACTERISTIC
/begin CHARACTERISTIC StSys_nUpLiThrestEng_CUR "Zweimassenschwungrad Kennlinie für obere Drehzahlschwelle" CURVE 0x1E799A Kl_Xs16_Ws16 5960.000 EngN 40.00000 6000.000 FORMAT "%8.3" EXTENDED_LIMITS -32768.00 32767.00
 /begin AXIS_DESCR STD_AXIS Eng_tEng Temp_Cels 5 -50.14000 149.8600 FORMAT "%8.4" EXTENDED_LIMITS -3549.940 3003.560 DEPOSIT ABSOLUTE /end AXIS_DESCR
/end CHARACTERISTIC
/begin CHARACTERISTIC StSys_tFuelHi_C "Schwelle über der die Kraftstofftemeperatur für heiß erkannt wird" VALUE 0x1E7960 Kw_Ws16 3053.700 Temp_Cels -50.14000 3003.560 FORMAT "%8.3" EXTENDED_LIMITS -3549.940 3003.560 /end CHARACTERISTIC
/begin CHARACTERISTIC StSys_tFuelLo_C "Schwelle unter der die Kraftstofftemeperatur für kalt erkannt wird" VALUE 0x1E7962 Kw_Ws16 3053.700 Temp_Cels -50.14000 3003.560 FORMAT "%8.3" EXTENDED_LIMITS -3549.940 3003.560 /end CHARACTERISTIC
/begin CHARACTERISTIC StSys_tiDelnUpLiThres_C "Wartezeit für das Erreichen der oberen Drehzahlschwelle" VALUE 0x1E79B0 Kw_Wu16 20000.00 Time_ms 0.00 20000.00 FORMAT "%8.2" EXTENDED_LIMITS 0.00 655350.0 /end CHARACTERISTIC
/begin CHARACTERISTIC StSys_tiDelTMFW_C "Wartezeit für Zweimassenschwungrad" VALUE 0x1E79B2 Kw_Wu16 20000.00 Time_ms 0.00 20000.00 FORMAT "%8.2" EXTENDED_LIMITS 0.00 655350.0 /end CHARACTERISTIC
/begin CHARACTERISTIC StSys_tiEngTempValid_C "Verzögerungszeit bis Motortemperatur gueltig" VALUE 0x1E7964 Kw_Wu16 655350.0 Time_ms 0.00 655350.0 FORMAT "%8.1" /end CHARACTERISTIC
/begin CHARACTERISTIC StSys_tiShutOff_MAP "Zeit der Startmomentverzögerung" MAP 0x1E79B4 Kf_Xs16_Ys16_Ws16 10000.00 Time_ms 0.00 10000.00 FORMAT "%8.2" EXTENDED_LIMITS -327680.0 327670.0
 /begin AXIS_DESCR STD_AXIS Eng_tEng Temp_Cels 10 -50.14000 149.8600 FORMAT "%8.4" EXTENDED_LIMITS -3549.940 3003.560 DEPOSIT ABSOLUTE /end AXIS_DESCR
 /begin AXIS_DESCR STD_AXIS GlwCtl_tiPreGlw GlwCtl_Time_ms 4 0.00 335500.0 FORMAT "%8.1" EXTENDED_LIMITS 0.00 6553500. DEPOSIT ABSOLUTE /end AXIS_DESCR
/end CHARACTERISTIC
/begin CHARACTERISTIC StSys_dtrqColdInc_C "Momentinkrement fuer kalten Motor" VALUE 0x1E7968 Kw_Wu32 6553594.99817 RmpTrq 5.00030517578 6553599.99847 FORMAT "%13.5" EXTENDED_LIMITS 0.00 6553599.99847 /end CHARACTERISTIC
/begin CHARACTERISTIC StSys_tiColdRmpLck_C "Rampensperrzeit fur kalten Motor" VALUE 0x1E796C Kw_Wu16 655350.0 Time_ms 0.00 655350.0 FORMAT "%8.1" /end CHARACTERISTIC
/begin CHARACTERISTIC StSys_trqColdLim_C "Grenzmoment fuer kalten Motor" VALUE 0x1E796E Kw_Ws16 3276.700 Trq 0.00 3276.700 FORMAT "%8.3" EXTENDED_LIMITS -3276.800 3276.700 /end CHARACTERISTIC
/begin CHARACTERISTIC StSys_dtrqHotInc_C "Momentinkrement fuer heißen Motor" VALUE 0x1E7970 Kw_Wu32 6553594.99817 RmpTrq 5.00030517578 6553599.99847 FORMAT "%13.5" EXTENDED_LIMITS 0.00 6553599.99847 /end CHARACTERISTIC
/begin CHARACTERISTIC StSys_tiHotRmpLck_C "Rampensperrzeit fur heißen Motor" VALUE 0x1E7974 Kw_Wu16 655350.0 Time_ms 0.00 655350.0 FORMAT "%8.1" /end CHARACTERISTIC
/begin CHARACTERISTIC StSys_trqHotLim_C "Grenzmoment fuer heißen Motor" VALUE 0x1E7976 Kw_Ws16 3276.700 Trq 0.00 3276.700 FORMAT "%8.3" EXTENDED_LIMITS -3276.800 3276.700 /end CHARACTERISTIC
/begin CHARACTERISTIC StSys_dtrqWarmInc_C "Momentinkrement fuer warmen Motor" VALUE 0x1E7978 Kw_Wu32 6553594.99817 RmpTrq 5.00030517578 6553599.99847 FORMAT "%13.5" EXTENDED_LIMITS 0.00 6553599.99847 /end CHARACTERISTIC
/begin CHARACTERISTIC StSys_tiWarmRmpLck_C "Rampensperrzeit fur warmen Motor" VALUE 0x1E797C Kw_Wu16 655350.0 Time_ms 0.00 655350.0 FORMAT "%8.1" /end CHARACTERISTIC
/begin CHARACTERISTIC StSys_trqWarmLim_C "Grenzmoment fuer warmen Motor" VALUE 0x1E797E Kw_Ws16 3276.700 Trq 0.00 3276.700 FORMAT "%8.3" EXTENDED_LIMITS -3276.800 3276.700 /end CHARACTERISTIC
/begin CHARACTERISTIC StSys_uAltTMFW_C "Batteriespannungsänderung für Zweimassenschwungrad" VALUE 0x1E7A24 Kw_Ws16 20782.00 Volt_Batt_PerSec_20ms 0.00 20782.00 FORMAT "%8.2" EXTENDED_LIMITS -332837.0 332826.9 /end CHARACTERISTIC
/begin CHARACTERISTIC StSys_uThresTMFW_C "Batteriespannungsschwelle für Zweimassenschwungrad" VALUE 0x1E7A26 Kw_Ws16 20782.00 Volt_Batt 0.00 20782.00 FORMAT "%8.2" EXTENDED_LIMITS -665674.1 665653.8 /end CHARACTERISTIC
/begin CHARACTERISTIC SvLpCD_dGradFillCrv_C "Faktor für die Konvertierung der Füllstandszeit in die Einzelfüllstandsdifferenz" VALUE 0x1E80A0 Kw_Ws16 64.00000 RatVolLength1 -32.00000 32.00000 FORMAT "%8.5" EXTENDED_LIMITS -256.0000 255.9922 /end CHARACTERISTIC
/begin CHARACTERISTIC SvLpCD_tiEngNPT1_C "Zeitkonstante für das PT1-Filter für die Motordrehzahl" VALUE 0x1E80A4 Kw_Wu32 4294.9673 TimeDelay_s 0.0000010000000 4294.9673 FORMAT "%9.4" /end CHARACTERISTIC
/begin CHARACTERISTIC SvLpCD_lFillLvl_CUR "Kennlinie für die Berechnung der Füllstände von der Füllstandszeit" CURVE 0x1E80A8 Kl_Xs16_Ws16 65.53400 Length1_mm 0.00 65.53400 FORMAT "%8.5" EXTENDED_LIMITS -65.53600 65.53400
 /begin AXIS_DESCR STD_AXIS FrmMng_tiTOSFillLvl1 Time_RtmLowRes 13 100.0000 1123.000 FORMAT "%8.3" EXTENDED_LIMITS 0.00 6553.500 DEPOSIT ABSOLUTE /end AXIS_DESCR
/end CHARACTERISTIC
/begin CHARACTERISTIC SvLpCD_lOilWarn_MAP "Ölwarnschwellen - Kompensationskennfeld" MAP 0x1E80DE Kf_Xs16_Ys16_Ws16 65.53400 Length1_mm 0.00 65.53400 FORMAT "%8.5" EXTENDED_LIMITS -65.53600 65.53400
 /begin AXIS_DESCR STD_AXIS SvLpCD_nAvrgFlt EngN 13 0.00 6000.000 FORMAT "%8.3" EXTENDED_LIMITS -32768.00 32767.00 DEPOSIT ABSOLUTE /end AXIS_DESCR
 /begin AXIS_DESCR STD_AXIS OTSCD_tEngOilWIV Temp_Cels 13 -40.04000 149.9600 FORMAT "%8.4" EXTENDED_LIMITS -3549.940 3003.560 DEPOSIT ABSOLUTE /end AXIS_DESCR
/end CHARACTERISTIC
/begin CHARACTERISTIC SvLpCD_nEngMax_C "Maximalgrenzwert der Motordrehzahl für die Berechnung der Summe der Einzelfüllstandsdifferenzen" VALUE 0x1E8268 Kw_Ws16 4000.000 EngN 0.00 4000.000 FORMAT "%8.3" EXTENDED_LIMITS -32768.00 32767.00 /end CHARACTERISTIC
/begin CHARACTERISTIC SvLpCD_nEngMin_C "Minimalgrenzwert der Motordrehzahl für die Berechnung der Summe der Einzelfüllstandsdifferenzen" VALUE 0x1E826A Kw_Ws16 4000.000 EngN 0.00 4000.000 FORMAT "%8.3" EXTENDED_LIMITS -32768.00 32767.00 /end CHARACTERISTIC
/begin CHARACTERISTIC SvLpCD_tiFillLvlMax_C "Maximalgrenzwert für die Füllstandszeit" VALUE 0x1E826C Kw_Wu16 6553.500 Time_RtmLowRes 0.00 6553.500 FORMAT "%8.3" /end CHARACTERISTIC
/begin CHARACTERISTIC SvLpCD_tiFillLvlMin_C "Minimalgrenzwert für die Füllstandszeit" VALUE 0x1E826E Kw_Wu16 6553.500 Time_RtmLowRes 0.00 6553.500 FORMAT "%8.3" /end CHARACTERISTIC
/begin CHARACTERISTIC SvLpCD_tOilMax_C "Maximalgrenzwert der Öltemperatur für die Berechnung der Summe der Einzelfüllstandsdifferenzen" VALUE 0x1E8270 Kw_Ws16 190.0000 Temp_Cels -40.04000 149.9600 FORMAT "%8.4" EXTENDED_LIMITS -3549.940 3003.560 /end CHARACTERISTIC
/begin CHARACTERISTIC SvLpCD_tOilMin_C "Minimalgrenzwert der Öltemperatur für die Berechnung der Summe der Einzelfüllstandsdifferenzen" VALUE 0x1E8272 Kw_Ws16 190.0000 Temp_Cels -40.04000 149.9600 FORMAT "%8.4" EXTENDED_LIMITS -3549.940 3003.560 /end CHARACTERISTIC
/begin CHARACTERISTIC SvLp_dOilLoad_MAP "Öltemp.- und Drehzahlabhängige Berechnung für WIV2" MAP 0x1E7B8C Kf_Xs16_Ys16_Ws16 65400.00 OneToOne -32700.00 32700.00 FORMAT "%8.2" EXTENDED_LIMITS -32768.00 32767.00
 /begin AXIS_DESCR STD_AXIS Eng_nAvrg EngN 8 0.00 6500.000 FORMAT "%8.3" EXTENDED_LIMITS -32768.00 32767.00 DEPOSIT ABSOLUTE /end AXIS_DESCR
 /begin AXIS_DESCR STD_AXIS OTSCD_tEngOil Temp_Cels 8 -53.14000 226.8600 FORMAT "%8.4" EXTENDED_LIMITS -3549.940 3003.560 DEPOSIT ABSOLUTE /end AXIS_DESCR
/end CHARACTERISTIC
/begin CHARACTERISTIC SvLp_dSootLoadWIV2_Vector "Konfigurationslabel für Bypass message" VALUE 0x1C0B46 Kw_Wu8 255.0 OneToOne 0.00 255.0 FORMAT "%5.1" /end CHARACTERISTIC
/begin CHARACTERISTIC SvLp_dSootLoadWIV2_Channel "Konfigurationslabel für Bypass message" VALUE 0x1C0B47 Kw_Wu8 255.0 OneToOne 0.00 255.0 FORMAT "%5.1" /end CHARACTERISTIC
/begin CHARACTERISTIC SvLp_dSootLoad_Vector "Konfigurationslabel für Bypass message" VALUE 0x1C0B48 Kw_Wu8 255.0 OneToOne 0.00 255.0 FORMAT "%5.1" /end CHARACTERISTIC
/begin CHARACTERISTIC SvLp_dSootLoad_Channel "Konfigurationslabel für Bypass message" VALUE 0x1C0B49 Kw_Wu8 255.0 OneToOne 0.00 255.0 FORMAT "%5.1" /end CHARACTERISTIC
/begin CHARACTERISTIC SvLp_dSootLoad_MAP "Drehzahl- und Einspritzmengenabhängige Berechnung für WIV2" MAP 0x1E7C30 Kf_Xs16_Ys16_Ws16 65400.00 OneToOne -32700.00 32700.00 FORMAT "%8.2" EXTENDED_LIMITS -32768.00 32767.00
 /begin AXIS_DESCR STD_AXIS Eng_nAvrg EngN 8 0.00 6500.000 FORMAT "%8.3" EXTENDED_LIMITS -32768.00 32767.00 DEPOSIT ABSOLUTE /end AXIS_DESCR
 /begin AXIS_DESCR STD_AXIS InjCtl_qSetUnBal InjMass 8 0.00 60.00000 FORMAT "%8.5" EXTENDED_LIMITS -327.6800 327.6700 DEPOSIT ABSOLUTE /end AXIS_DESCR
/end CHARACTERISTIC
/begin CHARACTERISTIC SvLp_facQI_MAP "Kennfeld für die Guetefaktorberechnung" MAP 0x1E7CD4 Kf_Xs16_Ys16_Ws16 3.000000 Fact1 0.00 3.000000 FORMAT "%8.6" EXTENDED_LIMITS -256.0000 255.9922
 /begin AXIS_DESCR STD_AXIS SvLpCD_nAvrgFlt EngN 9 0.00 6000.000 FORMAT "%8.3" EXTENDED_LIMITS -32768.00 32767.00 DEPOSIT ABSOLUTE /end AXIS_DESCR
 /begin AXIS_DESCR STD_AXIS SvLp_aTrnvrsFlt_mp TrnvrsAcc 5 -1.270000 1.270000 FORMAT "%8.6" EXTENDED_LIMITS -327.6800 327.6700 DEPOSIT ABSOLUTE /end AXIS_DESCR
/end CHARACTERISTIC
/begin CHARACTERISTIC SvLp_facSoot_C "Referenzfaktor für das Rußäquivalent" VALUE 0x1E7D4E Kw_Wu8 25.50 Fact_WearSoot 0.00 25.50 FORMAT "%5.2" /end CHARACTERISTIC
/begin CHARACTERISTIC SvLp_facWear_C "Referenzfaktor für das Verschleißäquivalent" VALUE 0x1E7D4F Kw_Wu8 25.50 Fact_WearSoot 0.00 25.50 FORMAT "%5.2" /end CHARACTERISTIC
/begin CHARACTERISTIC SvLp_lEquCalc_C "Normalisierungsfaktor für die Ruß- / Verschleißäquivalentberechnung" VALUE 0x1E7D50 Kw_Wu8 127500. Dist1 0.00 127500. FORMAT "%5.0" /end CHARACTERISTIC
/begin CHARACTERISTIC SvLp_lOilLoad_MAP "Öltemp.- und Drehzahlabhängige Berechnung" MAP 0x1E7D52 Kf_Xs16_Ys16_Ws16 32767.00 Length 0.00 32767.00 FORMAT "%8.2" EXTENDED_LIMITS -32768.00 32767.00
 /begin AXIS_DESCR STD_AXIS Eng_nAvrg EngN 8 0.00 6500.000 FORMAT "%8.3" EXTENDED_LIMITS -32768.00 32767.00 DEPOSIT ABSOLUTE /end AXIS_DESCR
 /begin AXIS_DESCR STD_AXIS OTSCD_tEngOilWIV Temp_Cels 8 -53.14000 226.8600 FORMAT "%8.4" EXTENDED_LIMITS -3549.940 3003.560 DEPOSIT ABSOLUTE /end AXIS_DESCR
/end CHARACTERISTIC
/begin CHARACTERISTIC SvLp_lSootLoad_MAP "Drehzahl- und Einspritzmengenabhängige Berechnung" MAP 0x1E7DF6 Kf_Xs16_Ys16_Ws16 32767.00 Length 0.00 32767.00 FORMAT "%8.2" EXTENDED_LIMITS -32768.00 32767.00
 /begin AXIS_DESCR STD_AXIS Eng_nAvrg EngN 8 0.00 6500.000 FORMAT "%8.3" EXTENDED_LIMITS -32768.00 32767.00 DEPOSIT ABSOLUTE /end AXIS_DESCR
 /begin AXIS_DESCR STD_AXIS InjCtl_qSetUnBal InjMass 8 0.00 60.00000 FORMAT "%8.5" EXTENDED_LIMITS -327.6800 327.6700 DEPOSIT ABSOLUTE /end AXIS_DESCR
/end CHARACTERISTIC
/begin CHARACTERISTIC SvLp_lSotLdRgn1_MAP "Kennfeld für Russeintrag bei Regeneration 1[m]" MAP 0x1E7E9A Kf_Xs16_Ys16_Ws16 32767.00 Length 0.00 32767.00 FORMAT "%8.2" EXTENDED_LIMITS -32768.00 32767.00
 /begin AXIS_DESCR STD_AXIS Eng_nAvrg EngN 8 0.00 6500.000 FORMAT "%8.3" EXTENDED_LIMITS -32768.00 32767.00 DEPOSIT ABSOLUTE /end AXIS_DESCR
 /begin AXIS_DESCR STD_AXIS InjCrv_qTot InjMassCyc 8 0.00 60.00000 FORMAT "%8.5" EXTENDED_LIMITS -327.6800 327.6700 DEPOSIT ABSOLUTE /end AXIS_DESCR
/end CHARACTERISTIC
/begin CHARACTERISTIC SvLp_lSotLdRgn2_MAP "Kennfeld für Russeintrag bei Regeneration 2 [m]" MAP 0x1E7F3E Kf_Xs16_Ys16_Ws16 32767.00 Length 0.00 32767.00 FORMAT "%8.2" EXTENDED_LIMITS -32768.00 32767.00
 /begin AXIS_DESCR STD_AXIS Eng_nAvrg EngN 8 0.00 6500.000 FORMAT "%8.3" EXTENDED_LIMITS -32768.00 32767.00 DEPOSIT ABSOLUTE /end AXIS_DESCR
 /begin AXIS_DESCR STD_AXIS InjCrv_qTot InjMassCyc 8 0.00 60.00000 FORMAT "%8.5" EXTENDED_LIMITS -327.6800 327.6700 DEPOSIT ABSOLUTE /end AXIS_DESCR
/end CHARACTERISTIC
/begin CHARACTERISTIC SvLp_lSotLdRgn3_MAP "Kennfeld für Russeintrag bei Regeneration 3 [m]" MAP 0x1E7FE2 Kf_Xs16_Ys16_Ws16 32767.00 Length 0.00 32767.00 FORMAT "%8.2" EXTENDED_LIMITS -32768.00 32767.00
 /begin AXIS_DESCR STD_AXIS Eng_nAvrg EngN 8 0.00 6500.000 FORMAT "%8.3" EXTENDED_LIMITS -32768.00 32767.00 DEPOSIT ABSOLUTE /end AXIS_DESCR
 /begin AXIS_DESCR STD_AXIS InjCrv_qTot InjMassCyc 8 0.00 60.00000 FORMAT "%8.5" EXTENDED_LIMITS -327.6800 327.6700 DEPOSIT ABSOLUTE /end AXIS_DESCR
/end CHARACTERISTIC
/begin CHARACTERISTIC SvLp_stSotLdRgnMsk1_C "Maske für Umschaltung des Russeintragskennfeldes bei Regeneration 1[]" VALUE 0x1E8088 Kw_Wu32 1.00000000000 OneToOne 0.00 1.00000000000 FORMAT "%13.11" EXTENDED_LIMITS 0.00 4294967295.00 /end CHARACTERISTIC
/begin CHARACTERISTIC SvLp_stSotLdRgnMsk2_C "Maske für Umschaltung des Russeintragskennfeldes bei Regeneration 2 []" VALUE 0x1E808C Kw_Wu32 1.00000000000 OneToOne 0.00 1.00000000000 FORMAT "%13.11" EXTENDED_LIMITS 0.00 4294967295.00 /end CHARACTERISTIC
/begin CHARACTERISTIC SvLp_stSotLdRgnMsk3_C "Maske für Umschaltung des Russeintragskennfeldes bei Regeneration 3 []" VALUE 0x1E8090 Kw_Wu32 1.00000000000 OneToOne 0.00 1.00000000000 FORMAT "%13.11" EXTENDED_LIMITS 0.00 4294967295.00 /end CHARACTERISTIC
/begin CHARACTERISTIC SvLp_swtPresentVal_C "Schalterstellung, ob SI berechnet wird" VALUE 0x1E8094 Kw_Wu8 1.000 OneToOne 0.00 1.000 FORMAT "%5.3" EXTENDED_LIMITS 0.00 255.0 /end CHARACTERISTIC
/begin CHARACTERISTIC SvLp_swtPresentType_C "Schaltertype" VALUE 0x1E8095 Kw_Wu8 1.000 OneToOne 1.000 2.000 FORMAT "%5.3" EXTENDED_LIMITS 0.00 255.0 /end CHARACTERISTIC
/begin CHARACTERISTIC SvLp_tiPlausWIV_C "Zeit während der Kurzzeitmittelwert und Ölstandszahler auf 0 gesetzt werden" VALUE 0x1E8096 Kw_Wu16 655350.0 Time_ms 0.00 655350.0 FORMAT "%8.1" /end CHARACTERISTIC
/begin CHARACTERISTIC SvLp_tiShTiMeanVal_C "Zeitraum über den der Kurzzeitmittelwert berechnet wird" VALUE 0x1E8098 Kw_Wu16 655350.0 Time_ms 0.00 655350.0 FORMAT "%8.1" /end CHARACTERISTIC
/begin CHARACTERISTIC SvLp_tiTrnvrsAccPT1_C "Zeitkonstante für PT1 Filter (Querbeschleunigung)" VALUE 0x1E809C Kw_Wu32 4294.9673 TimeDelay_s 0.0000010000000 4294.9673 FORMAT "%9.4" /end CHARACTERISTIC
/begin CHARACTERISTIC T15CD_uSRCMin_C "Untere Grenze des SRC der Klemme 15" VALUE 0x1E8274 Kw_Ws16 20782.00 Volt_Batt 0.00 20782.00 FORMAT "%8.2" EXTENDED_LIMITS -665674.1 665653.8 /end CHARACTERISTIC
/begin CHARACTERISTIC T15CD_uSRCMax_C "Obere Grenze des SRC der Klemme 15" VALUE 0x1E8276 Kw_Ws16 20782.00 Volt_Batt 0.00 20782.00 FORMAT "%8.2" EXTENDED_LIMITS -665674.1 665653.8 /end CHARACTERISTIC
/begin CHARACTERISTIC T15CD_uLin_CUR "Kennlinie für Linearisierung des Rohwerts der Klemme 15" CURVE 0x1E8278 Kl_Xs16_Ws16 5200.579 Volt_Batt 0.00 5200.579 FORMAT "%8.3" EXTENDED_LIMITS -665674.1 665653.8
 /begin AXIS_DESCR STD_AXIS T15CD_uRawVal Volt_Batt 5 -665674.1 665653.8 FORMAT "%8.1" DEPOSIT ABSOLUTE /end AXIS_DESCR
/end CHARACTERISTIC
/begin CHARACTERISTIC T15CD_uCutOffHysXLow_C "Untere Hysteresegrenze für Klemme 15 Spannungsüberwachung" VALUE 0x1E828E Kw_Ws16 5200.579 Volt_Batt 0.00 5200.579 FORMAT "%8.3" EXTENDED_LIMITS -665674.1 665653.8 /end CHARACTERISTIC
/begin CHARACTERISTIC T15CD_uCutOffHysXHigh_C "Obere Hysteresegrenze für Klemme 15 Spannungsüberwachung" VALUE 0x1E8290 Kw_Ws16 5200.579 Volt_Batt 0.00 5200.579 FORMAT "%8.3" EXTENDED_LIMITS -665674.1 665653.8 /end CHARACTERISTIC
/begin CHARACTERISTIC T15CD_stCutOffHysYLow_C "Unterer Ausgangswert der Hysterese der Klemme 15 Spannungsüberwachung" VALUE 0x1E8292 Kw_Ws16 1.000000 OneToOne 0.00 1.000000 FORMAT "%8.6" EXTENDED_LIMITS -32768.00 32767.00 /end CHARACTERISTIC
/begin CHARACTERISTIC T15CD_stCutOffHysYHigh_C "Oberer Ausgangswert der Hysterese der Klemme 15 Spannungsüberwachung" VALUE 0x1E8294 Kw_Ws16 1.000000 OneToOne 0.00 1.000000 FORMAT "%8.6" EXTENDED_LIMITS -32768.00 32767.00 /end CHARACTERISTIC
/begin CHARACTERISTIC T15CD_DebNplDef_C "Fehlerentprellzeit für Plausibilitätsfehler" VALUE 0x1E8296 Kw_Wu16 655350.0 Time_ms 0.00 655350.0 FORMAT "%8.1" /end CHARACTERISTIC
/begin CHARACTERISTIC T15CD_DebNplOk_C "Heilungsentprellzeit für Plausibilitätsfehler" VALUE 0x1E8298 Kw_Wu16 655350.0 Time_ms 0.00 655350.0 FORMAT "%8.1" /end CHARACTERISTIC
/begin CHARACTERISTIC T15CD_tiDebNeg_C "Filterzeitkonstante der Klemme 15 für fallende Flanken" VALUE 0x1E829A Kw_Wu16 655350.0 TimeDeb 0.00 655350.0 FORMAT "%8.1" /end CHARACTERISTIC
/begin CHARACTERISTIC T15CD_tiDebPos_C "Filterzeitkonstante der Klemme 15 für steigende Flanken" VALUE 0x1E829C Kw_Wu16 655350.0 TimeDeb 0.00 655350.0 FORMAT "%8.1" /end CHARACTERISTIC
/begin CHARACTERISTIC T15CD_DebSRCHighDef_C "Fehlerentprellzeit für SRC-High Fehler" VALUE 0x1E829E Kw_Wu16 655350.0 Time_ms 0.00 655350.0 FORMAT "%8.1" /end CHARACTERISTIC
/begin CHARACTERISTIC T15CD_DebSRCHighOk_C "Heilungsentprellzeit für SRC-High Fehler" VALUE 0x1E82A0 Kw_Wu16 655350.0 Time_ms 0.00 655350.0 FORMAT "%8.1" /end CHARACTERISTIC
/begin CHARACTERISTIC T15CD_DebSRCLowDef_C "Fehlerentprellzeit für SRC-Low Fehler" VALUE 0x1E82A2 Kw_Wu16 655350.0 Time_ms 0.00 655350.0 FORMAT "%8.1" /end CHARACTERISTIC
/begin CHARACTERISTIC T15CD_DebSRCLowOk_C "Heilungsentprellzeit für SRC-Low Fehler" VALUE 0x1E82A4 Kw_Wu16 655350.0 Time_ms 0.00 655350.0 FORMAT "%8.1" /end CHARACTERISTIC
/begin CHARACTERISTIC T15CD_dtRmpSlpUp_C "Aufwärts-Rampenschrittweite für Klemme 15 Analogwerterfassung" VALUE 0x1E82A8 Kw_Wu32 1331348143.43 RmpVoltBatt 0.929935936354 1331348144.36 FORMAT "%13.2" EXTENDED_LIMITS 0.00 1331348144.36 /end CHARACTERISTIC
/begin CHARACTERISTIC T15CD_dtRmpSlpDwn_C "Abwärts-Rampenschrittweite für Klemme 15 Analogwerterfassung" VALUE 0x1E82AC Kw_Wu32 1331348143.43 RmpVoltBatt 0.929935936354 1331348144.36 FORMAT "%13.2" EXTENDED_LIMITS 0.00 1331348144.36 /end CHARACTERISTIC
/begin CHARACTERISTIC T15CD_stCutOffPreset_C "Initialisierungswert für die Message der CAN/Suspendmode-Überwachungsabschaltung" VALUE 0x1E82B0 Kw_Wu8 1.000 OneToOne 0.00 1.000 FORMAT "%5.3" EXTENDED_LIMITS 0.00 255.0 /end CHARACTERISTIC
/begin CHARACTERISTIC T15CD_stInvIn_C "Invertierungsparameter für Klemme 15 Eingangssignal" VALUE 0x1E82B1 Kw_Wu8 1.000 OneToOne 0.00 1.000 FORMAT "%5.3" EXTENDED_LIMITS 0.00 255.0 /end CHARACTERISTIC
/begin CHARACTERISTIC T15CD_tiucoPT1_C "Zeitkonstante für PT1-Filterung der linearisierten Klemme 15" VALUE 0x1E82B4 Kw_Wu32 4294.9673 TimeDelay_s 0.0000010000000 4294.9673 FORMAT "%9.4" /end CHARACTERISTIC
/begin CHARACTERISTIC T15CD_stSensIDWord_C "Geberkennwort für Analogauswertung der Klemme 15" VALUE 0x1E82B8 Kw_Wu16 65535.00 OneToOne 0.00 65535.00 FORMAT "%8.2" /end CHARACTERISTIC
/begin CHARACTERISTIC T15CD_uDfl_C "Vorgabewert für Analogwert der Klemme 15" VALUE 0x1E82BA Kw_Ws16 5200.579 Volt_Batt 0.00 5200.579 FORMAT "%8.3" EXTENDED_LIMITS -665674.1 665653.8 /end CHARACTERISTIC
/begin CHARACTERISTIC T15CD_uA2DThres_C "Schwellwert für Umwandlung des analogen in digitalen Klemme 15-Wert" VALUE 0x1E82BC Kw_Ws16 5200.579 Volt_Batt 0.00 5200.579 FORMAT "%8.3" EXTENDED_LIMITS -665674.1 665653.8 /end CHARACTERISTIC
/begin CHARACTERISTIC T15CD_uCutOffPreset_C "Initialisierungswert für die PT1-Filterung der linearisierten Klemme 15" VALUE 0x1E82BE Kw_Ws16 5200.579 Volt_Batt 0.00 5200.579 FORMAT "%8.3" EXTENDED_LIMITS -665674.1 665653.8 /end CHARACTERISTIC
/begin CHARACTERISTIC T50CD_tiDigInDebNeg_C "Entprellzeit für negative Flanken" VALUE 0x1E82C0 Kw_Wu16 655350.0 TimeDeb 0.00 655350.0 FORMAT "%8.1" /end CHARACTERISTIC
/begin CHARACTERISTIC T50CD_tiDigInDebPos_C "Entprellzeit für positive Flanken" VALUE 0x1E82C2 Kw_Wu16 655350.0 TimeDeb 0.00 655350.0 FORMAT "%8.1" /end CHARACTERISTIC
/begin CHARACTERISTIC T50CD_tiRxDigInDebNeg_C "Entprellzeit der neg. Flanke der Anlasserückmeldeleitung" VALUE 0x1E82C8 Kw_Wu16 655350.0 TimeDeb 0.00 655350.0 FORMAT "%8.1" /end CHARACTERISTIC
/begin CHARACTERISTIC T50CD_tiRxDigInDebPos_C "Entprellzeit der pos. Flanke der Anlasserrückmeldeleitung" VALUE 0x1E82CA Kw_Wu16 655350.0 TimeDeb 0.00 655350.0 FORMAT "%8.1" /end CHARACTERISTIC
/begin CHARACTERISTIC T50CD_stDigInvIn_C "Invertierungsparameter des Eingangssignals" VALUE 0x1E82C4 Kw_Wu8 1.000 OneToOne 0.00 1.000 FORMAT "%5.3" EXTENDED_LIMITS 0.00 255.0 /end CHARACTERISTIC
/begin CHARACTERISTIC T50CD_stRxDigInvIn_C "Invertierungsparameter des Eingangssignals" VALUE 0x1E82CC Kw_Wu8 1.000 OneToOne 0.00 1.000 FORMAT "%5.3" EXTENDED_LIMITS 0.00 255.0 /end CHARACTERISTIC
/begin CHARACTERISTIC T50CD_swtDigInPresentVal_C "Softwareschalter ob Klemme 50 vorhanden ist (0 = Nein; 1 = Ja)" VALUE 0x1E82C5 Kw_Wu8 1.000 OneToOne 0.00 1.000 FORMAT "%5.3" EXTENDED_LIMITS 0.00 255.0 /end CHARACTERISTIC
/begin CHARACTERISTIC T50CD_swtDigInPresentType_C "Type des Softwareschalters" VALUE 0x1E82C6 Kw_Wu8 0.00 OneToOne 2.000 2.000 FORMAT "%5.3" EXTENDED_LIMITS 0.00 255.0 /end CHARACTERISTIC
/begin CHARACTERISTIC T50CD_swtRxDigInPVal_C "Softwareschalter ob Anlasserrückmeldeleitung vorhanden (0 = Nein; 1 = Ja)" VALUE 0x1E82CD Kw_Wu8 1.000 OneToOne 0.00 1.000 FORMAT "%5.3" EXTENDED_LIMITS 0.00 255.0 /end CHARACTERISTIC
/begin CHARACTERISTIC T50CD_swtRxDigInPType_C "Type des Softwareschalters" VALUE 0x1E82CE Kw_Wu8 0.00 OneToOne 2.000 2.000 FORMAT "%5.3" EXTENDED_LIMITS 0.00 255.0 /end CHARACTERISTIC
/begin CHARACTERISTIC Tp20_tiCanMuteTimeOut_C "Zeit für Timeout der CAN-Deaktivierung durch Tp2.0 broadcast Service" VALUE 0x1E82D0 Kw_Wu16 655.1400 Time_s 0.00 655.1400 FORMAT "%8.4" EXTENDED_LIMITS 0.00 655.3500 /end CHARACTERISTIC
/begin CHARACTERISTIC Tp20_vCanMuteThres_C "Obere Grenze Zur Deaktivierung CAN-Messages durch ein Tp2.0 Broadcast Services" VALUE 0x1E82D2 Kw_Ws16 5.000000 Vel 0.00 5.000000 FORMAT "%8.6" EXTENDED_LIMITS -327.6800 327.6700 /end CHARACTERISTIC
/begin CHARACTERISTIC TPUMon_ctDfctLim_C "Oberer Entprellzähler Grenzwert für Defekterkennung" VALUE 0x1C1610 Kw_Wu16 65535.00 OneToOne 0.00 65535.00 FORMAT "%8.2" /end CHARACTERISTIC
/begin CHARACTERISTIC TPUMon_ctTPU_C "Index der auf den Messpunkten dargestellten TPU" VALUE 0x1C1612 Kw_Wu8 255.0 OneToOne 0.00 255.0 FORMAT "%5.1" /end CHARACTERISTIC
/begin CHARACTERISTIC TPUMon_tiDiffMaxLimit_C "Maximal zulässige einzelne Timerdifferenz" VALUE 0x1C1614 Kw_Ws32 2147483647.00 TimeUSResolution 0.00 2147483647.00 FORMAT "%13.2" EXTENDED_LIMITS -2147483648.00 2147483647.00 /end CHARACTERISTIC
/begin CHARACTERISTIC TPUMon_tiDiffMinLimit_C "Minimal zulässige einzelne Timerdifferenz (negativer Wert)" VALUE 0x1C1618 Kw_Ws32 2147483648.00 TimeUSResolution -2147483648.00 0.00 FORMAT "%13.2" EXTENDED_LIMITS -2147483648.00 2147483647.00 /end CHARACTERISTIC
/begin CHARACTERISTIC TPUMon_tiDiffSumLimit_C "Maximal zulässige Betragsumme Timerdifferenz" VALUE 0x1C161C Kw_Ws32 2147483647.00 TimeUSResolution 0.00 2147483647.00 FORMAT "%13.2" EXTENDED_LIMITS -2147483648.00 2147483647.00 /end CHARACTERISTIC
/begin CHARACTERISTIC TstTog_Code_C "Test des Testercodes" VAL_BLK 0x1E82D4 Kwb_Wu16 65535.00 OneToOne 0.00 65535.00 FORMAT "%8.2" NUMBER 29 /end CHARACTERISTIC
/begin CHARACTERISTIC TstTog_Demand_C "Signalnummer des Testers" VAL_BLK 0x1E830E Kwb_Wu8 255.000000000 SigTstName 0.00 255.000000000 FORMAT "%13.9" NUMBER 29 /end CHARACTERISTIC
/begin CHARACTERISTIC TstTog_DemStartMaxEngN_C "maximale Motordrehzahl für den Start des Test" VALUE 0x1E832C Kw_Ws16 65535.00 EngN -32768.00 32767.00 FORMAT "%8.2" /end CHARACTERISTIC
/begin CHARACTERISTIC TstTog_K2SigBlkVal1_MAP "Signalblock für Wert 1" MAP 0x1E832E Kf_Xs16_Ys16_Ws16 32766.00 OneToOne 0.00 32766.00 FORMAT "%8.2" EXTENDED_LIMITS -32768.00 32767.00
 /begin AXIS_DESCR STD_AXIS TstTog_DNULL_mp OneToOne 4 1.000 4.000 FORMAT "%5.3" EXTENDED_LIMITS 0.00 255.0 DEPOSIT ABSOLUTE /end AXIS_DESCR
 /begin AXIS_DESCR STD_AXIS TstTog_ActRout_mp OneToOne 29 0.00 28.00 FORMAT "%5.2" EXTENDED_LIMITS 0.00 255.0 DEPOSIT ABSOLUTE /end AXIS_DESCR
/end CHARACTERISTIC
/begin CHARACTERISTIC TstTog_K2SigBlkVal2_MAP "Signalblock für Wert 2" MAP 0x1E845C Kf_Xs16_Ys16_Ws16 32766.00 OneToOne 0.00 32766.00 FORMAT "%8.2" EXTENDED_LIMITS -32768.00 32767.00
 /begin AXIS_DESCR STD_AXIS TstTog_DNULL_mp OneToOne 4 1.000 4.000 FORMAT "%5.3" EXTENDED_LIMITS 0.00 255.0 DEPOSIT ABSOLUTE /end AXIS_DESCR
 /begin AXIS_DESCR STD_AXIS TstTog_ActRout_mp OneToOne 29 0.00 28.00 FORMAT "%5.2" EXTENDED_LIMITS 0.00 255.0 DEPOSIT ABSOLUTE /end AXIS_DESCR
/end CHARACTERISTIC
/begin CHARACTERISTIC TstTog_tiBetweenTogVal_C "Zeit zwischen Tastverhältnisveränderungen" VAL_BLK 0x1E858A Kwb_Wu16 655350.0 Time_ms 0.00 655350.0 FORMAT "%8.1" NUMBER 29 /end CHARACTERISTIC
/begin CHARACTERISTIC TstTog_tiRoutDemMax_C "Zeit des Testers um ein Kommando zu wiederholen" VALUE 0x1E85C4 Kw_Wu16 655350.0 Time_ms 0.00 655350.0 FORMAT "%8.1" /end CHARACTERISTIC
/begin CHARACTERISTIC TstTog_Val1_C "1. Tastverhältnis" VAL_BLK 0x1E85C6 Kwb_Ws16 655.3500 DtyCyc -327.6800 327.6700 FORMAT "%8.4" NUMBER 29 /end CHARACTERISTIC
/begin CHARACTERISTIC TstTog_Val2_C "2. Tastverhältnis" VAL_BLK 0x1E8600 Kwb_Ws16 655.3500 DtyCyc -327.6800 327.6700 FORMAT "%8.4" NUMBER 29 /end CHARACTERISTIC
/begin CHARACTERISTIC TTSCD_uSRCMin_C "SRC-Min-Tanktemperatursensor Spannungsrohwert" VALUE 0x1E863C Kw_Ws16 5200.391 Volt 0.00 5200.391 FORMAT "%8.3" EXTENDED_LIMITS -160156.4 160151.5 /end CHARACTERISTIC
/begin CHARACTERISTIC TTSCD_uSRCMax_C "SRC-Max-Tanktemperatursensor Spannungsrohwert" VALUE 0x1E863E Kw_Ws16 5200.391 Volt 0.00 5200.391 FORMAT "%8.3" EXTENDED_LIMITS -160156.4 160151.5 /end CHARACTERISTIC
/begin CHARACTERISTIC TTSCD_tLin_CUR "Linearisierungskennlinie der Tanktemperatur" CURVE 0x1E8640 Kl_Xs16_Ws16 200.0000 Temp_Cels -50.14000 149.8600 FORMAT "%8.4" EXTENDED_LIMITS -3549.940 3003.560
 /begin AXIS_DESCR STD_AXIS TTSCD_uRaw Volt 20 0.00 5200.391 FORMAT "%8.3" EXTENDED_LIMITS -160156.4 160151.5 DEPOSIT ABSOLUTE /end AXIS_DESCR
/end CHARACTERISTIC
/begin CHARACTERISTIC TTSCD_DebSRCHighDef_C "Fehlerentprellung SRC-High-Fehler Tanktemperatur" VALUE 0x1E8692 Kw_Wu16 655350.0 Time_ms 0.00 655350.0 FORMAT "%8.1" /end CHARACTERISTIC
/begin CHARACTERISTIC TTSCD_DebSRCHighOk_C "Heilungsentprellung SRC-High-Fehler Tanktemperatur" VALUE 0x1E8694 Kw_Wu16 655350.0 Time_ms 0.00 655350.0 FORMAT "%8.1" /end CHARACTERISTIC
/begin CHARACTERISTIC TTSCD_DebSRCLowDef_C "Fehlerentprellung SRC-Low-Fehler Tanktemperatur" VALUE 0x1E8696 Kw_Wu16 655350.0 Time_ms 0.00 655350.0 FORMAT "%8.1" /end CHARACTERISTIC
/begin CHARACTERISTIC TTSCD_DebSRCLowOk_C "Heilungsentprellung SRC-Low-Fehler Tanktemperatur" VALUE 0x1E8698 Kw_Wu16 655350.0 Time_ms 0.00 655350.0 FORMAT "%8.1" /end CHARACTERISTIC
/begin CHARACTERISTIC TTSCD_dtRmpSlpUp_C "Aufw.-Schritt fuer Rampe Tankttemperatur" VALUE 0x1E869C Kw_Wu32 6553598.99902 RmpTemp 0.999450683594 6553599.99847 FORMAT "%13.5" EXTENDED_LIMITS 0.00 6553599.99847 /end CHARACTERISTIC
/begin CHARACTERISTIC TTSCD_dtRmpSlpDwn_C "Abw.-Schritt fuer Rampe Tankttemperatur" VALUE 0x1E86A0 Kw_Wu32 6553598.99902 RmpTemp 0.999450683594 6553599.99847 FORMAT "%13.5" EXTENDED_LIMITS 0.00 6553599.99847 /end CHARACTERISTIC
/begin CHARACTERISTIC TTSCD_stSensIDWord_C "Geberkennwort Tanktemperatur" VALUE 0x1E86A4 Kw_Wu16 65535.00 OneToOne 0.00 65535.00 FORMAT "%8.2" /end CHARACTERISTIC
/begin CHARACTERISTIC TTSCD_tDfl_C "Tanktemperatur-Vorgabewert" VALUE 0x1E86A6 Kw_Ws16 200.0000 Temp_Cels -50.14000 149.8600 FORMAT "%8.4" EXTENDED_LIMITS -3549.940 3003.560 /end CHARACTERISTIC
/begin CHARACTERISTIC TVACD_DebExcTempDef_C "Fehlerentprellzeit für Übertemperatur" VALUE 0x1E86A8 Kw_Wu16 655350.0 Time_ms 0.00 655350.0 FORMAT "%8.1" /end CHARACTERISTIC
/begin CHARACTERISTIC TVACD_DebExcTempOk_C "Heilungsentprellzeit für Übertemperatur" VALUE 0x1E86AA Kw_Wu16 655350.0 Time_ms 0.00 655350.0 FORMAT "%8.1" /end CHARACTERISTIC
/begin CHARACTERISTIC TVACD_DebNoLoadDef_C "Fehlerentprellzeit für Lastabfall" VALUE 0x1E86AC Kw_Wu16 655350.0 Time_ms 0.00 655350.0 FORMAT "%8.1" /end CHARACTERISTIC
/begin CHARACTERISTIC TVACD_DebNoLoadOk_C "Heilungsentprellzeit für Lastabfall" VALUE 0x1E86AE Kw_Wu16 655350.0 Time_ms 0.00 655350.0 FORMAT "%8.1" /end CHARACTERISTIC
/begin CHARACTERISTIC TVACD_DebNplstErrDef_C "Fehlerentprellzeit für Anmeldefehler der Statusleitung" VALUE 0x1E86B0 Kw_Wu16 65535.00 OneToOne 0.00 65535.00 FORMAT "%8.2" /end CHARACTERISTIC
/begin CHARACTERISTIC TVACD_DebNplstErrOk_C "Heilungsentprellzeit für Anmeldefehler der Statusleitung" VALUE 0x1E86B2 Kw_Wu16 65535.00 OneToOne 0.00 65535.00 FORMAT "%8.2" /end CHARACTERISTIC
/begin CHARACTERISTIC TVACD_DebShortCircBatDef_C "Fehlerentprellzeit für Kurzschluß nach Batterie" VALUE 0x1E86B4 Kw_Wu16 655350.0 Time_ms 0.00 655350.0 FORMAT "%8.1" /end CHARACTERISTIC
/begin CHARACTERISTIC TVACD_DebShortCircBatOk_C "Heilungsentprellzeit für Kurzschluß nach Batterie" VALUE 0x1E86B6 Kw_Wu16 655350.0 Time_ms 0.00 655350.0 FORMAT "%8.1" /end CHARACTERISTIC
/begin CHARACTERISTIC TVACD_DebShortCircGndDef_C "Fehlerentprellzeit für Kurzschluß nach Masse" VALUE 0x1E86B8 Kw_Wu16 655350.0 Time_ms 0.00 655350.0 FORMAT "%8.1" /end CHARACTERISTIC
/begin CHARACTERISTIC TVACD_DebShortCircGndOk_C "Heilungsentprellzeit für Kurzschluß nach Masse" VALUE 0x1E86BA Kw_Wu16 655350.0 Time_ms 0.00 655350.0 FORMAT "%8.1" /end CHARACTERISTIC
/begin CHARACTERISTIC TVACD_DebSigstErrDef_C "Fehlerentprellzeit für Signalfehler der Statusleitung" VALUE 0x1E86BC Kw_Wu16 655350.0 Time_ms 0.00 655350.0 FORMAT "%8.1" /end CHARACTERISTIC
/begin CHARACTERISTIC TVACD_DebSigstErrOk_C "Heilungsentprellzeit für Signalfehler der Statusleitung" VALUE 0x1E86BE Kw_Wu16 655350.0 Time_ms 0.00 655350.0 FORMAT "%8.1" /end CHARACTERISTIC
/begin CHARACTERISTIC TVACD_stInvOut_C "Invertierungsparameter für das Signal der Drosselklappenstellerendstufe" VALUE 0x1E86C0 Kw_Wu8 1.000 OneToOne 0.00 1.000 FORMAT "%5.3" EXTENDED_LIMITS 0.00 255.0 /end CHARACTERISTIC
/begin CHARACTERISTIC TVACD_tiPer_C "Periodendauer Drosselklappensteller" VALUE 0x1E86C2 Kw_Ws16 6553.500 Period -3276.800 3276.700 FORMAT "%8.3" /end CHARACTERISTIC
/begin CHARACTERISTIC TVACD_rCnv_CUR "Kennlinie zur konvertierung von Öffnungsgrad in Tastverhältnis" CURVE 0x1E86C4 Kl_Xs16_Ws16 100.0000 DtyCyc 0.00 100.0000 FORMAT "%8.4" EXTENDED_LIMITS -327.6800 327.6700
 /begin AXIS_DESCR STD_AXIS AirCtl_rTVA Prc 25 -100.0000 200.0000 FORMAT "%8.4" EXTENDED_LIMITS -327.6800 327.6700 DEPOSIT ABSOLUTE /end AXIS_DESCR
/end CHARACTERISTIC
/begin CHARACTERISTIC TVACD_rOutMax_C "Maximal auszugebendes Tastverhältnis" VALUE 0x1E872A Kw_Ws16 655.3500 DtyCyc -327.6800 327.6700 FORMAT "%8.4" /end CHARACTERISTIC
/begin CHARACTERISTIC TVACD_rOutMin_C "Minimal auszugebendes Tastverhältnis" VALUE 0x1E872C Kw_Ws16 655.3500 DtyCyc -327.6800 327.6700 FORMAT "%8.4" /end CHARACTERISTIC
/begin CHARACTERISTIC TVACD_rTst_C "Tastverhältnis, dass im Fehlerfall zyklisch ausgegeben wird" VALUE 0x1E872E Kw_Ws16 100.0000 DtyCyc 0.00 100.0000 FORMAT "%8.4" EXTENDED_LIMITS -327.6800 327.6700 /end CHARACTERISTIC
/begin CHARACTERISTIC TVACD_stDigInInvStLine_C "Invertierungsparameter für die Status-Leitung" VALUE 0x1E8730 Kw_Wu8 1.000 OneToOne 0.00 1.000 FORMAT "%5.3" EXTENDED_LIMITS 0.00 255.0 /end CHARACTERISTIC
/begin CHARACTERISTIC TVACD_stPwrStgActv_C "Aktivierung der Abschaltbedingungen der Endstufe" VALUE 0x1E8731 Kw_Wu8 255.0 OneToOne 0.00 255.0 FORMAT "%5.1" /end CHARACTERISTIC
/begin CHARACTERISTIC TVACD_stPwrStgDia_C "Aktivierung der Abschaltbedingungen der Endstufendiagnose" VALUE 0x1E8732 Kw_Wu8 255.0 OneToOne 0.00 255.0 FORMAT "%5.1" /end CHARACTERISTIC
/begin CHARACTERISTIC TVACD_swtDigInPresent_C "Schalter zur Deaktivierung des digitalen Eingangs von TVACD" VALUE 0x1E8733 Kw_Wu8 1.000 OneToOne 0.00 1.000 FORMAT "%5.3" EXTENDED_LIMITS 0.00 255.0 /end CHARACTERISTIC
/begin CHARACTERISTIC TVACD_swt_C "Schalter Batteriespannungskorrektur (0 = AUS, 1 = EIN)" VALUE 0x1E8734 Kw_Wu8 255.0 OneToOne 0.00 255.0 FORMAT "%5.1" /end CHARACTERISTIC
/begin CHARACTERISTIC TVACD_tiBtwTst_C "Zeitabstand, in dem im Fehlerfall die Endstufe getestet wird" VALUE 0x1E8736 Kw_Wu16 29980.00 Time_ms 20.00000 30000.00 FORMAT "%8.2" EXTENDED_LIMITS 0.00 655350.0 /end CHARACTERISTIC
/begin CHARACTERISTIC TVACD_tiDebRst_C "Entprellzeit nach Klemme 15 reset im Nachlauf" VALUE 0x1E8738 Kw_Wu16 28200.00 Time_ms 1800.000 30000.00 FORMAT "%8.2" EXTENDED_LIMITS 0.00 655350.0 /end CHARACTERISTIC
/begin CHARACTERISTIC TVACD_tiHigh_C "minimal notwendige Zeit für High-Signal der Statusleitung bei Überwachung" VALUE 0x1E873A Kw_Wu16 29980.00 Time_ms 20.00000 30000.00 FORMAT "%8.2" EXTENDED_LIMITS 0.00 655350.0 /end CHARACTERISTIC
/begin CHARACTERISTIC TVACD_tiLow_C "maximalE Zeit für anfängliches Low-Signal der Statusleitung bei Beginn der Überwachung" VALUE 0x1E873C Kw_Wu16 29980.00 Time_ms 20.00000 30000.00 FORMAT "%8.2" EXTENDED_LIMITS 0.00 655350.0 /end CHARACTERISTIC
/begin CHARACTERISTIC UAcc_ACCodePos_C "AC-Stellung im Funktionscode" VALUE 0x1E917C Kw_Wu8 255.0 OneToOne 0.00 255.0 FORMAT "%5.1" /end CHARACTERISTIC
/begin CHARACTERISTIC Uacc_AdjValK2SigBlkVal_MAP "Kennfeld zur Auswahl der am Tester ausgegebenen Werte" MAP 0x1E8742 Kf_Xs16_Ys16_Ws16 32766.00 OneToOne 0.00 32766.00 FORMAT "%8.2" EXTENDED_LIMITS -32768.00 32767.00
 /begin AXIS_DESCR STD_AXIS AdjVal_dispx_mp OneToOne 5 0.00 4.000 FORMAT "%5.3" EXTENDED_LIMITS 0.00 255.0 DEPOSIT ABSOLUTE /end AXIS_DESCR
 /begin AXIS_DESCR STD_AXIS AdjVal_actRout_mp OneToOne 23 0.00 23.00 FORMAT "%5.2" EXTENDED_LIMITS 0.00 255.0 DEPOSIT ABSOLUTE /end AXIS_DESCR
/end CHARACTERISTIC
/begin CHARACTERISTIC Uacc_AdjValOffset_C "Offset für den Abgleichwert" VAL_BLK 0x1E8864 Kwb_Wu16 65535.00 OneToOne 0.00 65535.00 FORMAT "%8.2" NUMBER 23 /end CHARACTERISTIC
/begin CHARACTERISTIC Uacc_AdjValScale_C "Skalierungsfaktor für den Abgleichwert" VAL_BLK 0x1E8892 Kwb_Wu16 6.553500 FactHigh 0.00 6.553500 FORMAT "%8.6" NUMBER 23 /end CHARACTERISTIC
/begin CHARACTERISTIC Uacc_AdjValTesterLength_C "Vom Tester unterstützte Größe des Abgleichswertes (Anzahl der Bytes des Abgleichswertes die der Tester auswerten kann)" VALUE 0x1E88C0 Kw_Wu8 255.0 OneToOne 0.00 255.0 FORMAT "%5.1" /end CHARACTERISTIC
/begin CHARACTERISTIC Uacc_EOPDFormat_C "Format der übertragenen EVP-Daten" VAL_BLK 0x1E88C2 Kwb_Wu16 65535.00 OneToOne 0.00 65535.00 FORMAT "%8.2" NUMBER 23 /end CHARACTERISTIC
/begin CHARACTERISTIC Uacc_EOPDK2SigBlkVal_MAP "Applikation der EVP-Kanäle" MAP 0x1E88F0 Kf_Xs16_Ys16_Ws16 32766.00 OneToOne 0.00 32766.00 FORMAT "%8.2" EXTENDED_LIMITS -32768.00 32767.00
 /begin AXIS_DESCR STD_AXIS EOPD_dispx_mp OneToOne 5 0.00 4.000 FORMAT "%5.3" EXTENDED_LIMITS 0.00 255.0 DEPOSIT ABSOLUTE /end AXIS_DESCR
 /begin AXIS_DESCR STD_AXIS EOPD_actRout_mp OneToOne 10 0.00 16.00 FORMAT "%5.2" EXTENDED_LIMITS 0.00 255.0 DEPOSIT ABSOLUTE /end AXIS_DESCR
/end CHARACTERISTIC
/begin CHARACTERISTIC Uacc_EOPDTesterLength_C "Anzahl der EVP-Daten Bytes" VAL_BLK 0x1E8976 Kwb_Wu8 255.0 OneToOne 0.00 255.0 FORMAT "%5.1" NUMBER 23 /end CHARACTERISTIC
/begin CHARACTERISTIC UACC_ESBFormular_C "Formeltabelle für Meßwerteblöcke" VAL_BLK 0x1E8990 Kwb_Wu8 255.0 OneToOne 0.00 255.0 FORMAT "%5.1" NUMBER 451 /end CHARACTERISTIC
/begin CHARACTERISTIC UACC_ESBNormVal_C "Normierwert für Meßwerteblöcke" VAL_BLK 0x1E8B53 Kwb_Wu8 255.0 OneToOne 0.00 255.0 FORMAT "%5.1" NUMBER 451 /end CHARACTERISTIC
/begin CHARACTERISTIC UACC_ESBSigNr_C "Signalnummertabelle für Meßwertblöcke" VAL_BLK 0x1E8D16 Kwb_Wu16 65535.00 OneToOne 0.00 65535.00 FORMAT "%8.2" NUMBER 451 /end CHARACTERISTIC
/begin CHARACTERISTIC UAcc_ESPCodePos_C "ESP-Stellung im Funktionscode" VALUE 0x1E917D Kw_Wu8 255.0 OneToOne 0.00 255.0 FORMAT "%5.1" /end CHARACTERISTIC
/begin CHARACTERISTIC UAcc_FactoryId_C "Herstellerwerkskennzahl" ASCII 0x1C1240 Ktx 255.0 defaultAscii 0.00 255.0 NUMBER 3 /end CHARACTERISTIC
/begin CHARACTERISTIC UAcc_LogReqAddPmpFirst_C "Login Passwort für Aktivierung der Entlüftung des Additivpumpensystems [-]" VALUE 0x1C1268 Kw_Wu16 55535.00 OneToOne 10000.00 65535.00 FORMAT "%8.2" EXTENDED_LIMITS 0.00 65535.00 /end CHARACTERISTIC
/begin CHARACTERISTIC UAcc_LogReqAddPmpTest_C "Login Passwort für Stellgliedtest der Additivpumpe [-]" VALUE 0x1C126A Kw_Wu16 55535.00 OneToOne 10000.00 65535.00 FORMAT "%8.2" EXTENDED_LIMITS 0.00 65535.00 /end CHARACTERISTIC
/begin CHARACTERISTIC UAcc_LogReqPWAAGAct_C "Passwort für Aktivierung ""Anhängersteuergerät verbaut""" VALUE 0x1C126C Kw_Wu16 55535.00 OneToOne 10000.00 65535.00 FORMAT "%8.2" EXTENDED_LIMITS 0.00 65535.00 /end CHARACTERISTIC
/begin CHARACTERISTIC UAcc_LogReqPWAAGdeAct_C "Passwort für Deaktivierung ""verbautes Anhängersteuergerät""" VALUE 0x1C126E Kw_Wu16 55535.00 OneToOne 10000.00 65535.00 FORMAT "%8.2" EXTENDED_LIMITS 0.00 65535.00 /end CHARACTERISTIC
/begin CHARACTERISTIC UAcc_LogReqPWACCAct_C "Paßwort zum Aktivieren der ACC" VALUE 0x1C1270 Kw_Wu16 55535.00 OneToOne 10000.00 65535.00 FORMAT "%8.2" EXTENDED_LIMITS 0.00 65535.00 /end CHARACTERISTIC
/begin CHARACTERISTIC UAcc_LogReqPWAirCtlOff_C "Passwort für Abschaltung EGR durch Login im aktuellen Fahrzyklus" VALUE 0x1C1272 Kw_Wu16 55535.00 OneToOne 10000.00 65535.00 FORMAT "%8.2" EXTENDED_LIMITS 0.00 65535.00 /end CHARACTERISTIC
/begin CHARACTERISTIC UAcc_LogReqPWCrCtlAct_C "Paßwort zum Aktivieren der FGR" VALUE 0x1C1274 Kw_Wu16 55535.00 OneToOne 10000.00 65535.00 FORMAT "%8.2" EXTENDED_LIMITS 0.00 65535.00 /end CHARACTERISTIC
/begin CHARACTERISTIC UAcc_LogReqPWCrCtldeAct_C "Paßwort zum Deaktivieren der FGR" VALUE 0x1C1276 Kw_Wu16 55535.00 OneToOne 10000.00 65535.00 FORMAT "%8.2" EXTENDED_LIMITS 0.00 65535.00 /end CHARACTERISTIC
/begin CHARACTERISTIC UAcc_LogReqPWDSMRdyAcc_C "Paßwort für Login-Funktion ""Readinessbeschleunigung""" VALUE 0x1C1278 Kw_Wu16 55535.00 OneToOne 10000.00 65535.00 FORMAT "%8.2" EXTENDED_LIMITS 0.00 65535.00 /end CHARACTERISTIC
/begin CHARACTERISTIC UAcc_LogReqPWFlPpCDAct_C "Paßwort zum Aktivieren der KSK" VALUE 0x1C127A Kw_Wu16 55535.00 OneToOne 10000.00 65535.00 FORMAT "%8.2" EXTENDED_LIMITS 0.00 65535.00 /end CHARACTERISTIC
/begin CHARACTERISTIC UAcc_LogReqPWFlPpCDdeAct_C "Paßwort zum Deaktivieren der KSK" VALUE 0x1C127C Kw_Wu16 55535.00 OneToOne 10000.00 65535.00 FORMAT "%8.2" EXTENDED_LIMITS 0.00 65535.00 /end CHARACTERISTIC
/begin CHARACTERISTIC UAcc_LogReqPWFMARst_C "Paßwort für Login-Funktion ""Lernkennfeld der FMA löschen""" VALUE 0x1C127E Kw_Wu16 55535.00 OneToOne 10000.00 65535.00 FORMAT "%8.2" EXTENDED_LIMITS 0.00 65535.00 /end CHARACTERISTIC
/begin CHARACTERISTIC UAcc_LogReqPWMxSpdResetdeAct_C "Paßwort zum Deaktivieren der HGB" VALUE 0x1C1280 Kw_Wu16 55535.00 OneToOne 10000.00 65535.00 FORMAT "%8.2" EXTENDED_LIMITS 0.00 65535.00 /end CHARACTERISTIC
/begin CHARACTERISTIC UAcc_Manufacturer_Ver_C "Herstelleränderungsstand" ASCII 0x1C1244 Ktx 255.0 defaultAscii 0.00 255.0 NUMBER 8 /end CHARACTERISTIC
/begin CHARACTERISTIC UAcc_Production_Group_HW_C "Baugruppe Hardware" ASCII 0x1C124D Ktx 255.0 defaultAscii 0.00 255.0 NUMBER 3 /end CHARACTERISTIC
/begin CHARACTERISTIC UAcc_Production_Group_SW_C "Baugruppe Software" ASCII 0x1C1251 Ktx 255.0 defaultAscii 0.00 255.0 NUMBER 3 /end CHARACTERISTIC
/begin CHARACTERISTIC UACC_RSigBlkGrp_MAP "Lesesignal fuer Signalbloecke" MAP 0x1E9180 Kf_Xs16_Ys16_Ws16 32766.00 OneToOne 0.00 32766.00 FORMAT "%8.2" EXTENDED_LIMITS -32768.00 32767.00
 /begin AXIS_DESCR STD_AXIS EngM_numCyl OneToOne 4 1.000 4.000 FORMAT "%5.3" EXTENDED_LIMITS 0.00 255.0 DEPOSIT ABSOLUTE /end AXIS_DESCR
 /begin AXIS_DESCR STD_AXIS EngM_numCyl OneToOne 255 1.000 255.0 FORMAT "%5.1" EXTENDED_LIMITS 0.00 255.0 DEPOSIT ABSOLUTE /end AXIS_DESCR
/end CHARACTERISTIC
/begin CHARACTERISTIC UAcc_SortCode_HW_C "Sortenschlüssel Hardware" ASCII 0x1C1255 Ktx 255.0 defaultAscii 0.00 255.0 NUMBER 4 /end CHARACTERISTIC
/begin CHARACTERISTIC UAcc_SortCode_SW_C "Sortenschlüssel Software" ASCII 0x1C125A Ktx 255.0 defaultAscii 0.00 255.0 NUMBER 4 /end CHARACTERISTIC
/begin CHARACTERISTIC Uacc_stCANText_CA "Nummern der Texte die am VAG -Tester ausgegeben werden" VAL_BLK 0x1E909C Kwb_Wu8 255.0 OneToOne 0.00 255.0 FORMAT "%5.1" NUMBER 32 /end CHARACTERISTIC
/begin CHARACTERISTIC Uacc_stTOMskRxMsg_CA "Array zur Ausmaskierung der einzelnen ECUs (für Empfangsbotschaften)" VAL_BLK 0x1E90BC Kwb_Wu32 4294967295.00 OneToOne 0.00 4294967295.00 FORMAT "%13.2" NUMBER 32 /end CHARACTERISTIC
/begin CHARACTERISTIC Uacc_stTOMskUsrMsg_CA "Array mit zur Ausmaskierung der einzelnen ECUs (für User-Botschafen)" VAL_BLK 0x1E913C Kwb_Wu16 65535.00 OneToOne 0.00 65535.00 FORMAT "%8.2" NUMBER 32 /end CHARACTERISTIC
/begin CHARACTERISTIC UAcc_swtCodRcy_C "Schalter für die Aktivierung des Recovery nach der Varianten-Kodierung" VALUE 0x1E873E Kw_Wu8 1.000 OneToOne 0.00 1.000 FORMAT "%5.3" EXTENDED_LIMITS 0.00 255.0 /end CHARACTERISTIC
/begin CHARACTERISTIC UAcc_TypeTestNum_C "Typprüfnummer" ASCII 0x1C125F Ktx 255.0 defaultAscii 0.00 255.0 NUMBER 7 /end CHARACTERISTIC
/begin CHARACTERISTIC UAcc_vCodRcyMax_C "Fahrgeschwindigkeitsmax. für Ausführen der Recovery nach Varianten-Kodierung" VALUE 0x1E8740 Kw_Ws16 655.3500 Vel -327.6800 327.6700 FORMAT "%8.4" /end CHARACTERISTIC
/begin CHARACTERISTIC UAcc_VehVelCodePos_C "Stellung der Fahrzeugeschwindigkeit im Funktionscode" VALUE 0x1E917E Kw_Wu8 255.0 OneToOne 0.00 255.0 FORMAT "%5.1" /end CHARACTERISTIC
/begin CHARACTERISTIC UAcc_WIVCodePos_C "WIV-Stellung im Funktionscode" VALUE 0x1E917F Kw_Wu8 255.0 OneToOne 0.00 255.0 FORMAT "%5.1" /end CHARACTERISTIC
/begin CHARACTERISTIC UAddr_stCalibration_C "ECU Applikationszugriff (0 = unterbunden, 1 = erlaubt)" VALUE 0x1C1282 Kw_Wu8 1.000 OneToOne 0.00 1.000 FORMAT "%5.3" EXTENDED_LIMITS 0.00 255.0 /end CHARACTERISTIC
/begin CHARACTERISTIC UKey_stAdjChan_CA "Matrix zum sperren und entsperren der Anpassungskanäle" MAP 0x1E9B84 Kf_Xu8_Yu8_Wu8 255.0 OneToOne 0.00 255.0 FORMAT "%5.1"
 /begin AXIS_DESCR STD_AXIS UKey_stNumPassWD_mp OneToOne 10 0.00 255.0 FORMAT "%5.1" DEPOSIT ABSOLUTE /end AXIS_DESCR
 /begin AXIS_DESCR STD_AXIS UKey_stNumCannel_mp OneToOne 23 0.00 255.0 FORMAT "%5.1" DEPOSIT ABSOLUTE /end AXIS_DESCR
/end CHARACTERISTIC
/begin CHARACTERISTIC UKey_stPassWD_C "Array indem der Wert für jedes Passwort appliziert ist" VAL_BLK 0x1E9C90 Kwb_Wu32 99999.0000000 OneToOne 0.00 99999.0000000 FORMAT "%13.7" EXTENDED_LIMITS 0.00 4294967295.00 NUMBER 10 /end CHARACTERISTIC
/begin CHARACTERISTIC UKey_UpLoadPassWD_C "Passwort fuer Readiness-Beschleunigung" VALUE 0x1E9CB8 Kw_Wu32 99999.0000000 OneToOne 0.00 99999.0000000 FORMAT "%13.7" EXTENDED_LIMITS 0.00 4294967295.00 /end CHARACTERISTIC
/begin CHARACTERISTIC USAp_dCodeTblInv_C "Identifier dieser Datensatzvariante (invertiert)" VALUE 0x1E9CBC Kw_Wu32 4294967295.00 OneToOne 0.00 4294967295.00 FORMAT "%13.2" /end CHARACTERISTIC
/begin CHARACTERISTIC USAp_dCodeTbl_C "Identifier dieser Datensatzvariante" VALUE 0x1E9CC0 Kw_Wu32 4294967295.00 OneToOne 0.00 4294967295.00 FORMAT "%13.2" /end CHARACTERISTIC
/begin CHARACTERISTIC USAp_dDatasetType_C "Duch diesen Label wird der Datensatz für Master- oder Slave- oder Single-Steuergerät markiert." VALUE 0x1E9CC4 Kw_Wu8 255.0 OneToOne 0.00 255.0 FORMAT "%5.1" /end CHARACTERISTIC
/begin CHARACTERISTIC USAp_numFuncCodeBits_C "Bitanzahl für Function Code" VALUE 0x1C1283 Kw_Wu8 20.00 OneToOne 0.00 20.00 FORMAT "%5.2" EXTENDED_LIMITS 0.00 255.0 /end CHARACTERISTIC
/begin CHARACTERISTIC VehDa_lStore_C "EEPROM Speicherintervall im Betrieb" VALUE 0x1E9CC8 Kw_Wu32 4294967295.00 Length 0.00 4294967295.00 FORMAT "%13.2" /end CHARACTERISTIC
/begin CHARACTERISTIC VehDa_nThres_C "Drehzahlschwelle für Betriebsstundenerfassung" VALUE 0x1E9CCC Kw_Ws16 65535.00 EngN -32768.00 32767.00 FORMAT "%8.2" /end CHARACTERISTIC
/begin CHARACTERISTIC VehDa_qThres_C "akt. Einspritzmengenschwelle für Betriebsstundenerfassung" VALUE 0x1E9CCE Kw_Ws16 655.3500 InjMass -327.6800 327.6700 FORMAT "%8.4" /end CHARACTERISTIC
/begin CHARACTERISTIC VehDa_rVnMax_C "maximales v/n-Verhältnis" VALUE 0x1E9CD0 Kw_Ws16 0.3276700 VelToN 0.00 0.3276700 FORMAT "%9.7" EXTENDED_LIMITS -0.3276800 0.3276700 /end CHARACTERISTIC
/begin CHARACTERISTIC VehDa_tiNPT1_C "T1 Zeitkonstante zur Vorfilterung der Motordrehzahl für v/n-Verhältnis" VALUE 0x1E9CD4 Kw_Wu32 4294.9673 TimeDelay_s 0.0000010000000 4294.9673 FORMAT "%9.4" /end CHARACTERISTIC
/begin CHARACTERISTIC VehDa_tiStore_C "EEPROM Speicherintervall im Betrieb" VALUE 0x1E9CD8 Kw_Wu32 4294967295.00 TimeEngOn 0.00 4294967295.00 FORMAT "%13.2" /end CHARACTERISTIC
/begin CHARACTERISTIC VehDa_tiVnPT1_C "T1 Zeitkonstante zur Filterung des v/n-Verhältnisses" VALUE 0x1E9CDC Kw_Wu32 4294.9673 TimeDelay_s 0.0000010000000 4294.9673 FORMAT "%9.4" /end CHARACTERISTIC
/begin CHARACTERISTIC VSACD_DebExcTempDef_C "Fehlerentprellzeit für Übertemperatur" VALUE 0x1E9CF0 Kw_Wu16 655350.0 Time_ms 0.00 655350.0 FORMAT "%8.1" /end CHARACTERISTIC
/begin CHARACTERISTIC VSACD_DebExcTempOk_C "Heilungsentprellzeit für Übertemperatur" VALUE 0x1E9CF2 Kw_Wu16 655350.0 Time_ms 0.00 655350.0 FORMAT "%8.1" /end CHARACTERISTIC
/begin CHARACTERISTIC VSACD_DebNoLoadDef_C "Fehlerentprellzeit für Lastabfall" VALUE 0x1E9CF4 Kw_Wu16 655350.0 Time_ms 0.00 655350.0 FORMAT "%8.1" /end CHARACTERISTIC
/begin CHARACTERISTIC VSACD_DebNoLoadOk_C "Heilungsentprellzeit für Lastabfall" VALUE 0x1E9CF6 Kw_Wu16 655350.0 Time_ms 0.00 655350.0 FORMAT "%8.1" /end CHARACTERISTIC
/begin CHARACTERISTIC VSACD_DebShortCircBatDef_C "Fehlerentprellzeit für Kurzschluß nach Batterie" VALUE 0x1E9CF8 Kw_Wu16 655350.0 Time_ms 0.00 655350.0 FORMAT "%8.1" /end CHARACTERISTIC
/begin CHARACTERISTIC VSACD_DebShortCircBatOk_C "Heilungsentprellzeit für Kurzschluß nach Batterie" VALUE 0x1E9CFA Kw_Wu16 655350.0 Time_ms 0.00 655350.0 FORMAT "%8.1" /end CHARACTERISTIC
/begin CHARACTERISTIC VSACD_DebShortCircGndDef_C "Fehlerentprellzeit für Kurzschluß nach Masse" VALUE 0x1E9CFC Kw_Wu16 655350.0 Time_ms 0.00 655350.0 FORMAT "%8.1" /end CHARACTERISTIC
/begin CHARACTERISTIC VSACD_DebShortCircGndOk_C "Heilungsentprellzeit für Kurzschluß nach Masse" VALUE 0x1E9CFE Kw_Wu16 655350.0 Time_ms 0.00 655350.0 FORMAT "%8.1" /end CHARACTERISTIC
/begin CHARACTERISTIC VSACD_stInvOut_C "Invertierungsparameter für das Signal der Drallniveaustellerendstufe" VALUE 0x1E9D00 Kw_Wu8 1.000 OneToOne 0.00 1.000 FORMAT "%5.3" EXTENDED_LIMITS 0.00 255.0 /end CHARACTERISTIC
/begin CHARACTERISTIC VSACD_tiPer_C "Periodendauer des Ausgangssignal für den Drallniveausteller" VALUE 0x1E9D02 Kw_Ws16 6553.500 Period -3276.800 3276.700 FORMAT "%8.3" /end CHARACTERISTIC
/begin CHARACTERISTIC VSACD_rCnv1_CUR "Kennlinie zur Konvertierung von Öffnungsgrad in Tastverhältnis" CURVE 0x1E9D04 Kl_Xs16_Ws16 100.0000 DtyCyc 0.00 100.0000 FORMAT "%8.4" EXTENDED_LIMITS -327.6800 327.6700
 /begin AXIS_DESCR STD_AXIS VSA_rVSA1 DtyCyc 2 -100.0000 200.0000 FORMAT "%8.4" EXTENDED_LIMITS -327.6800 327.6700 DEPOSIT ABSOLUTE /end AXIS_DESCR
/end CHARACTERISTIC
/begin CHARACTERISTIC VSACD_rCnv2_CUR "Kennlinie zur Konvertierung von Öffnungsgrad des Ventils vom zweiten Komponententreiber in Tastverhältnis" CURVE 0x1E9D0E Kl_Xs16_Ws16 100.0000 DtyCyc 0.00 100.0000 FORMAT "%8.4" EXTENDED_LIMITS -327.6800 327.6700
 /begin AXIS_DESCR STD_AXIS VSA_rVSA2 DtyCyc 2 -100.0000 200.0000 FORMAT "%8.4" EXTENDED_LIMITS -327.6800 327.6700 DEPOSIT ABSOLUTE /end AXIS_DESCR
/end CHARACTERISTIC
/begin CHARACTERISTIC VSACD_rErrDflVal_C "Ausgabetastverhältnis im Fehlerfall" VALUE 0x1E9D18 Kw_Ws16 0.00 DtyCyc 0.00 0.00 FORMAT "%8.2" EXTENDED_LIMITS -327.6800 327.6700 /end CHARACTERISTIC
/begin CHARACTERISTIC VSACD_rLrnLMS_C "Tastverhältnis für Lernen des unteren mechanischen Anschlags" VALUE 0x1E9D1A Kw_Ws16 0.00 DtyCyc 84.00000 84.00000 FORMAT "%8.5" EXTENDED_LIMITS -327.6800 327.6700 /end CHARACTERISTIC
/begin CHARACTERISTIC VSACD_rLrnUMS_C "Tastverhältnis für Lernen des oberen mechanischen Anschlags" VALUE 0x1E9D1C Kw_Ws16 0.00 DtyCyc 16.00000 16.00000 FORMAT "%8.5" EXTENDED_LIMITS -327.6800 327.6700 /end CHARACTERISTIC
/begin CHARACTERISTIC VSACD_rOutMax_C "Maximal auszugebendes Tastverhältnis" VALUE 0x1E9D1E Kw_Ws16 100.0000 DtyCyc 0.00 100.0000 FORMAT "%8.4" EXTENDED_LIMITS -327.6800 327.6700 /end CHARACTERISTIC
/begin CHARACTERISTIC VSACD_rOutMin_C "Minimal auszugebendes Tastverhältnis" VALUE 0x1E9D20 Kw_Ws16 100.0000 DtyCyc 0.00 100.0000 FORMAT "%8.4" EXTENDED_LIMITS -327.6800 327.6700 /end CHARACTERISTIC
/begin CHARACTERISTIC VSACD_rTst_C "Tastverhältnis, dass im Fehlerfall zyklisch ausgegeben wird" VALUE 0x1E9D22 Kw_Ws16 100.0000 DtyCyc 0.00 100.0000 FORMAT "%8.4" EXTENDED_LIMITS -327.6800 327.6700 /end CHARACTERISTIC
/begin CHARACTERISTIC VSACD_rVSAOff_C "Tastverhältnis für ""Sleep Mode"" Drallniveausteller""" VALUE 0x1E9D24 Kw_Ws16 0.00 DtyCyc 12.00000 12.00000 FORMAT "%8.5" EXTENDED_LIMITS -327.6800 327.6700 /end CHARACTERISTIC
/begin CHARACTERISTIC VSACD_stPwrStgActv_C "Aktivierung der Abschaltbedingungen der Endstufe" VALUE 0x1E9D26 Kw_Wu8 1.000 OneToOne 0.00 1.000 FORMAT "%5.3" EXTENDED_LIMITS 0.00 255.0 /end CHARACTERISTIC
/begin CHARACTERISTIC VSACD_stPwrStgDia_C "Aktivierung der Abschaltbedingungen der Endstufendiagnose" VALUE 0x1E9D27 Kw_Wu8 1.000 OneToOne 0.00 1.000 FORMAT "%5.3" EXTENDED_LIMITS 0.00 255.0 /end CHARACTERISTIC
/begin CHARACTERISTIC VSACD_swtBattCor_C "Schalter Batteriespannungskorrektur (0 = AUS, 1 = EIN)" VALUE 0x1E9D28 Kw_Wu8 1.000 OneToOne 0.00 1.000 FORMAT "%5.3" EXTENDED_LIMITS 0.00 255.0 /end CHARACTERISTIC
/begin CHARACTERISTIC VSACD_swtVSAInv_C "Invertierung des Ausgangstastverhältnis" VALUE 0x1E9D29 Kw_Wu8 1.000 OneToOne 0.00 1.000 FORMAT "%5.3" EXTENDED_LIMITS 0.00 255.0 /end CHARACTERISTIC
/begin CHARACTERISTIC VSACD_tiBtwTst_C "Zeitabstand, in dem im Fehlerfall die Endstufe getestet wird" VALUE 0x1E9D2A Kw_Wu16 29980.00 Time_ms 20.00000 30000.00 FORMAT "%8.2" EXTENDED_LIMITS 0.00 655350.0 /end CHARACTERISTIC
/begin CHARACTERISTIC VSASCD_DebRngErrDef_C "Defekterkennungszeit Tastverhältnis im undefinierten Bereich" VALUE 0x1E9D2C Kw_Wu16 655350.0 Time_ms 0.00 655350.0 FORMAT "%8.1" /end CHARACTERISTIC
/begin CHARACTERISTIC VSASCD_DebRngErrOk_C "Heilzeit Tastverhältnis im undefinierten Bereich" VALUE 0x1E9D2E Kw_Wu16 655350.0 Time_ms 0.00 655350.0 FORMAT "%8.1" /end CHARACTERISTIC
/begin CHARACTERISTIC VSASCD_DebMaxPeriodDef_C "Defekterkennungszeit Periodendauer zu hoch (SRC)" VALUE 0x1E9D30 Kw_Wu16 655350.0 Time_ms 0.00 655350.0 FORMAT "%8.1" /end CHARACTERISTIC
/begin CHARACTERISTIC VSASCD_DebMaxPeriodOk_C "Heilzeit Periodendauer zu hoch (SRC)" VALUE 0x1E9D32 Kw_Wu16 655350.0 Time_ms 0.00 655350.0 FORMAT "%8.1" /end CHARACTERISTIC
/begin CHARACTERISTIC VSASCD_DebMaxDef_C "Defekterkennungszeit Tastverhältnis zu hoch (SRC)" VALUE 0x1E9D34 Kw_Wu16 655350.0 Time_ms 0.00 655350.0 FORMAT "%8.1" /end CHARACTERISTIC
/begin CHARACTERISTIC VSASCD_DebMaxOk_C "Heilzeit Tastverhältnis zu niedrig (SRC)" VALUE 0x1E9D36 Kw_Wu16 655350.0 Time_ms 0.00 655350.0 FORMAT "%8.1" /end CHARACTERISTIC
/begin CHARACTERISTIC VSASCD_DebMinPeriodDef_C "Defekterkennungszeit Periodendauer zu niedrig" VALUE 0x1E9D38 Kw_Wu16 655350.0 Time_ms 0.00 655350.0 FORMAT "%8.1" /end CHARACTERISTIC
/begin CHARACTERISTIC VSASCD_DebMinPeriodOk_C "Heilzeit Periodendauer zu niedrig" VALUE 0x1E9D3A Kw_Wu16 655350.0 Time_ms 0.00 655350.0 FORMAT "%8.1" /end CHARACTERISTIC
/begin CHARACTERISTIC VSASCD_DebMinDef_C "Defekterkennungszeit Tastverhältnis zu niedrig (SRC)" VALUE 0x1E9D3C Kw_Wu16 655350.0 Time_ms 0.00 655350.0 FORMAT "%8.1" /end CHARACTERISTIC
/begin CHARACTERISTIC VSASCD_DebMinOk_C "Heilzeit Tastverhältnis zu niedrig (SRC)" VALUE 0x1E9D3E Kw_Wu16 655350.0 Time_ms 0.00 655350.0 FORMAT "%8.1" /end CHARACTERISTIC
/begin CHARACTERISTIC VSASCD_stPwmInInv_C "Invertierung des Eingangstastverhältnis" VALUE 0x1E9D40 Kw_Wu8 1.000 OneToOne 0.00 1.000 FORMAT "%5.3" EXTENDED_LIMITS 0.00 255.0 /end CHARACTERISTIC
/begin CHARACTERISTIC VSASCD_tiPwmInMinPer_C "Mindestperiodendauer des PWM-Eingangssignals" VALUE 0x1E9D42 Kw_Ws16 6553.500 Period -3276.800 3276.700 FORMAT "%8.3" /end CHARACTERISTIC
/begin CHARACTERISTIC VSASCD_tiPwmInMaxPer_C "Maximale Periodendauer des PWM_Eingangssignals" VALUE 0x1E9D44 Kw_Ws16 6553.500 Period -3276.800 3276.700 FORMAT "%8.3" /end CHARACTERISTIC
/begin CHARACTERISTIC VSASCD_dcycPwmInMin_C "Mindesttastverhältnis des PWM-Eingangssignals" VALUE 0x1E9D46 Kw_Ws16 100.0000 DtyCyc 0.00 100.0000 FORMAT "%8.4" EXTENDED_LIMITS -327.6800 327.6700 /end CHARACTERISTIC
/begin CHARACTERISTIC VSASCD_dcycPwmInMax_C "Maximales Tastverhältnis des PWM-Eingangssignals" VALUE 0x1E9D48 Kw_Ws16 100.0000 DtyCyc 0.00 100.0000 FORMAT "%8.4" EXTENDED_LIMITS -327.6800 327.6700 /end CHARACTERISTIC
/begin CHARACTERISTIC VSASCD_rDevTempExcMax_C "oberer Grenzwert der Sensorrückmeldung: Steller überhitzt" VALUE 0x1E9D4A Kw_Ws16 0.00 Prc 90.50000 90.50000 FORMAT "%8.5" EXTENDED_LIMITS -327.6800 327.6700 /end CHARACTERISTIC
/begin CHARACTERISTIC VSASCD_rDevTempExcMin_C "unterer Grenzwert der Sensorrückmeldung: Steller überhitzt" VALUE 0x1E9D4C Kw_Ws16 0.00 Prc 89.50000 89.50000 FORMAT "%8.5" EXTENDED_LIMITS -327.6800 327.6700 /end CHARACTERISTIC
/begin CHARACTERISTIC VSASCD_rLinDcyc1_CUR "Linearisierungskennlinie Drallklappenrückmeldeleitung 1" CURVE 0x1E9D4E Kl_Xs16_Ws16 100.0000 Prc 0.00 100.0000 FORMAT "%8.4" EXTENDED_LIMITS -327.6800 327.6700
 /begin AXIS_DESCR STD_AXIS VSASCD_dcycIn1 DtyCyc 2 0.00 100.0000 FORMAT "%8.4" EXTENDED_LIMITS -327.6800 327.6700 DEPOSIT ABSOLUTE /end AXIS_DESCR
/end CHARACTERISTIC
/begin CHARACTERISTIC VSASCD_rLinDcyc2_CUR "Linearisierungskennlinie Drallklappenrückmeldeleitung 2" CURVE 0x1E9D58 Kl_Xs16_Ws16 100.0000 Prc 0.00 100.0000 FORMAT "%8.4" EXTENDED_LIMITS -327.6800 327.6700
 /begin AXIS_DESCR STD_AXIS VSASCD_dcycIn2 DtyCyc 2 0.00 100.0000 FORMAT "%8.4" EXTENDED_LIMITS -327.6800 327.6700 DEPOSIT ABSOLUTE /end AXIS_DESCR
/end CHARACTERISTIC
/begin CHARACTERISTIC VSASCD_rLMSLrnDefMax_C "oberer Grenzwert der Sensorrückmeldung: Lernfehler unterer mechanischer Anschlag" VALUE 0x1E9D62 Kw_Ws16 0.00 Prc 89.00000 89.00000 FORMAT "%8.5" EXTENDED_LIMITS -327.6800 327.6700 /end CHARACTERISTIC
/begin CHARACTERISTIC VSASCD_rLMSLrnDefMin_C "unterer Grenzwert der Sensorrückmeldung: Lernfehler unterer mechanischer Anschlag" VALUE 0x1E9D64 Kw_Ws16 0.00 Prc 87.00000 87.00000 FORMAT "%8.5" EXTENDED_LIMITS -327.6800 327.6700 /end CHARACTERISTIC
/begin CHARACTERISTIC VSASCD_rLMSLrnOkMax_C "oberer Grenzwert der Sensorrückmeldung: unterer mechanischer Anschlag gelernt" VALUE 0x1E9D66 Kw_Ws16 0.00 Prc 85.00000 85.00000 FORMAT "%8.5" EXTENDED_LIMITS -327.6800 327.6700 /end CHARACTERISTIC
/begin CHARACTERISTIC VSASCD_rLMSLrnOkMin_C "unterer Grenzwert der Sensorrückmeldung: unterer mechanischer Anschlag gelernt" VALUE 0x1E9D68 Kw_Ws16 0.00 Prc 83.00000 83.00000 FORMAT "%8.5" EXTENDED_LIMITS -327.6800 327.6700 /end CHARACTERISTIC
/begin CHARACTERISTIC VSASCD_rPWMDefMax_C "oberer Grenzwert der Sensorrückmeldung: Signalfehler am PWM-Eingang" VALUE 0x1E9D6A Kw_Ws16 0.00 Prc 9.000000 9.000000 FORMAT "%8.6" EXTENDED_LIMITS -327.6800 327.6700 /end CHARACTERISTIC
/begin CHARACTERISTIC VSASCD_rPWMDefMin_C "unterer Grenzwert der Sensorrückmeldung: Signalfehler am PWM-Eingang" VALUE 0x1E9D6C Kw_Ws16 0.00 Prc 7.000000 7.000000 FORMAT "%8.6" EXTENDED_LIMITS -327.6800 327.6700 /end CHARACTERISTIC
/begin CHARACTERISTIC VSASCD_rUMSLrnDefMax_C "oberer Grenzwert der Sensorrückmeldung: Lernfehler oberer mechanischer Anschlag" VALUE 0x1E9D6E Kw_Ws16 0.00 Prc 13.00000 13.00000 FORMAT "%8.5" EXTENDED_LIMITS -327.6800 327.6700 /end CHARACTERISTIC
/begin CHARACTERISTIC VSASCD_rUMSLrnDefMin_C "unterer Grenzwert der Sensorrückmeldung: Lernfehler oberer mechanischer Anschlag" VALUE 0x1E9D70 Kw_Ws16 0.00 Prc 11.00000 11.00000 FORMAT "%8.5" EXTENDED_LIMITS -327.6800 327.6700 /end CHARACTERISTIC
/begin CHARACTERISTIC VSASCD_rUMSLrnOkMax_C "oberer Grenzwert der Sensorrückmeldung:  oberer mechanischer Anschlag gelernt" VALUE 0x1E9D72 Kw_Ws16 0.00 Prc 17.00000 17.00000 FORMAT "%8.5" EXTENDED_LIMITS -327.6800 327.6700 /end CHARACTERISTIC
/begin CHARACTERISTIC VSASCD_rUMSLrnOkMin_C "unterer Grenzwert der Sensorrückmeldung: oberer mechanischer Anschlag gelernt" VALUE 0x1E9D74 Kw_Ws16 0.00 Prc 15.00000 15.00000 FORMAT "%8.5" EXTENDED_LIMITS -327.6800 327.6700 /end CHARACTERISTIC
/begin CHARACTERISTIC VSASCD_rVSAMax_C "oberer Grenzwert der Sensorrückmeldung: Regelbetrieb" VALUE 0x1E9D76 Kw_Ws16 0.00 Prc 81.00000 81.00000 FORMAT "%8.5" EXTENDED_LIMITS -327.6800 327.6700 /end CHARACTERISTIC
/begin CHARACTERISTIC VSASCD_rVSAMin_C "unterer Grenzwert der Sensorrückmeldung: Regelbetrieb" VALUE 0x1E9D78 Kw_Ws16 0.00 Prc 19.00000 19.00000 FORMAT "%8.5" EXTENDED_LIMITS -327.6800 327.6700 /end CHARACTERISTIC
/begin CHARACTERISTIC VSA_DebErrLrnLMSDef_C "Fehlerentprellzeit für unterer mechanischer Anschlag nicht gelernt" VALUE 0x1E9CE0 Kw_Wu16 655350.0 Time_ms 0.00 655350.0 FORMAT "%8.1" /end CHARACTERISTIC
/begin CHARACTERISTIC VSA_DebErrLrnLMSOk_C "Heilzeit für unterer mechanischer Anschlag nicht gelernt" VALUE 0x1E9CE2 Kw_Wu16 655350.0 Time_ms 0.00 655350.0 FORMAT "%8.1" /end CHARACTERISTIC
/begin CHARACTERISTIC VSA_DebErrLrnUMSDef_C "Fehlerentprellzeit für oberer mechanischer Anschlag nicht gelernt" VALUE 0x1E9CE4 Kw_Wu16 655350.0 Time_ms 0.00 655350.0 FORMAT "%8.1" /end CHARACTERISTIC
/begin CHARACTERISTIC VSA_DebErrLrnUMSOk_C "Heilzeit für oberer mechanischer Anschlag nicht gelernt" VALUE 0x1E9CE6 Kw_Wu16 655350.0 Time_ms 0.00 655350.0 FORMAT "%8.1" /end CHARACTERISTIC
/begin CHARACTERISTIC VSA_DebErrPWMDef_C "Fehlerentprellzeit für Signalfehler am Drallsteller PWM-Eingang" VALUE 0x1E9CE8 Kw_Wu16 655350.0 Time_ms 0.00 655350.0 FORMAT "%8.1" /end CHARACTERISTIC
/begin CHARACTERISTIC VSA_DebErrPWMOk_C "Heilungsentprellzeit für Signalfehler am Drallsteller PWM-Eingang" VALUE 0x1E9CEA Kw_Wu16 655350.0 Time_ms 0.00 655350.0 FORMAT "%8.1" /end CHARACTERISTIC
/begin CHARACTERISTIC VSA_DebExcSensTempDef_C "Fehlerentprellzeit für Bauteiltemperatur überschritten" VALUE 0x1E9CEC Kw_Wu16 655350.0 Time_ms 0.00 655350.0 FORMAT "%8.1" /end CHARACTERISTIC
/begin CHARACTERISTIC VSA_DebExcSensTempOk_C "Heilzeit für Bauteiltemperatur überschritten" VALUE 0x1E9CEE Kw_Wu16 655350.0 Time_ms 0.00 655350.0 FORMAT "%8.1" /end CHARACTERISTIC
/begin CHARACTERISTIC VSA_rVSA1_Vector "Konfigurationslabel für Bypass" VALUE 0x1C0B4A Kw_Wu8 255.0 OneToOne 0.00 255.0 FORMAT "%5.1" /end CHARACTERISTIC
/begin CHARACTERISTIC VSA_rVSA1_Channel "Konfigurationslabel für Bypass" VALUE 0x1C0B4B Kw_Wu8 255.0 OneToOne 0.00 255.0 FORMAT "%5.1" /end CHARACTERISTIC
/begin CHARACTERISTIC VSA_rVSA2_Vector "Konfigurationslabel für Bypass" VALUE 0x1C0B4C Kw_Wu8 255.0 OneToOne 0.00 255.0 FORMAT "%5.1" /end CHARACTERISTIC
/begin CHARACTERISTIC VSA_rVSA2_Channel "Konfigurationslabel für Bypass" VALUE 0x1C0B4D Kw_Wu8 255.0 OneToOne 0.00 255.0 FORMAT "%5.1" /end CHARACTERISTIC
/begin CHARACTERISTIC VSSCD_DebBrkLowVltgDef_C "Fehlerentprellzeit für Geschwindigkeitssensorunterspannung aus BRK1" VALUE 0x1E9D7C Kw_Wu16 655350.0 Time_ms 0.00 655350.0 FORMAT "%8.1" /end CHARACTERISTIC
/begin CHARACTERISTIC VSSCD_DebBrkLowVltgOk_C "Heilzeit für Geschwindigkeitssensorunterspannung in BRK1" VALUE 0x1E9D7E Kw_Wu16 655350.0 Time_ms 0.00 655350.0 FORMAT "%8.1" /end CHARACTERISTIC
/begin CHARACTERISTIC VSSCD_DebCanMsgSigDef_C "Defekt-Entprellzeit CAN-spezifischer Botschaftsfehler für Fahrgeschwindigkeit" VALUE 0x1E9D80 Kw_Wu16 655350.0 Time_ms 0.00 655350.0 FORMAT "%8.1" /end CHARACTERISTIC
/begin CHARACTERISTIC VSSCD_DebCanMsgSigOk_C "Heil-Entprellzeit CAN-spezifischer Botschaftsfehler für Fahrgeschwindigkeit" VALUE 0x1E9D82 Kw_Wu16 655350.0 Time_ms 0.00 655350.0 FORMAT "%8.1" /end CHARACTERISTIC
/begin CHARACTERISTIC VSSCD_DebCanSigDef_C "Entprellzeit CAN Signal für Fahrgeschwindigkeit defekt" VALUE 0x1E9D84 Kw_Wu16 655350.0 Time_ms 0.00 655350.0 FORMAT "%8.1" /end CHARACTERISTIC
/begin CHARACTERISTIC VSSCD_DebCanSigOk_C "Entprellzeit Heilung CAN-Signal für Fahrgeschwindigkeit" VALUE 0x1E9D86 Kw_Wu16 655350.0 Time_ms 0.00 655350.0 FORMAT "%8.1" /end CHARACTERISTIC
/begin CHARACTERISTIC VSSCD_DebMaxDef_C "Entprellzeit für Defekterkennung bei Maximumtest der Fahrgeschwindigkeit" VALUE 0x1E9D88 Kw_Wu16 655350.0 Time_ms 0.00 655350.0 FORMAT "%8.1" /end CHARACTERISTIC
/begin CHARACTERISTIC VSSCD_DebMaxOk_C "Entprellzeit für Heilung bei Maximumtest der Fahrgeschwindigkeit" VALUE 0x1E9D8A Kw_Wu16 655350.0 Time_ms 0.00 655350.0 FORMAT "%8.1" /end CHARACTERISTIC
/begin CHARACTERISTIC VSSCD_DebPlaDef_C "Entprellzeit für Defekterkennung bei Plausibilitätstest der Fahrgeschwindigkeit" VALUE 0x1E9D8C Kw_Wu16 655350.0 Time_ms 0.00 655350.0 FORMAT "%8.1" /end CHARACTERISTIC
/begin CHARACTERISTIC VSSCD_DebPlaOk_C "Entprellzeit für Heilung bei Plausibilitätstest der Fahrgeschwindigkeit" VALUE 0x1E9D8E Kw_Wu16 655350.0 Time_ms 0.00 655350.0 FORMAT "%8.1" /end CHARACTERISTIC
/begin CHARACTERISTIC VSSCD_DebSigDef_C "Entprellzeit defekt für ungültiges Eingangssignal Fahrgeschwindigkeit" VALUE 0x1E9D90 Kw_Wu16 655350.0 Time_ms 0.00 655350.0 FORMAT "%8.1" /end CHARACTERISTIC
/begin CHARACTERISTIC VSSCD_DebSigOk_C "Entprellzeit für Heilung ungültiges Eingangssignal der Fahrgeschwindigkeit" VALUE 0x1E9D92 Kw_Wu16 655350.0 Time_ms 0.00 655350.0 FORMAT "%8.1" /end CHARACTERISTIC
/begin CHARACTERISTIC VSSCD_DebPlausDef_C "Fahrgeschwindigkeitssignal Defekterkennungszeit fuer Plausibilitaetsfehler mit Schub" VALUE 0x1E9D94 Kw_Wu16 655350.0 Time_ms 0.00 655350.0 FORMAT "%8.1" /end CHARACTERISTIC
/begin CHARACTERISTIC VSSCD_DebPlausOk_C "Fahrgeschwindigkeitssignal Heilzeit fuer Plausibilitaetsfehler mit Schub" VALUE 0x1E9D96 Kw_Wu16 655350.0 Time_ms 0.00 655350.0 FORMAT "%8.1" /end CHARACTERISTIC
/begin CHARACTERISTIC VSSCD_ImpPerDist_C "Streckenfaktor: FGG-Impulse pro Strecke" VALUE 0x1E9DB8 Kw_Wu32 17.500000000000000 VSS_DistFac 2.5000000000000000 20.000000000000000 FORMAT "%20.17" EXTENDED_LIMITS 0.83819031734908711 3600000000.0000000 /end CHARACTERISTIC
/begin CHARACTERISTIC VSSCD_nThresPla_C "Drehzahschwelle für NPL-Test der Fahrgeschwindigkeit" VALUE 0x1E9D98 Kw_Ws16 32767.00 EngN 0.00 32767.00 FORMAT "%8.2" EXTENDED_LIMITS -32768.00 32767.00 /end CHARACTERISTIC
/begin CHARACTERISTIC VSSCD_numSegSens_C "Anzahl der Segmente des FGG" VALUE 0x1E9D9A Kw_Wu8 8.000 OneToOne 4.000 12.00 FORMAT "%5.2" EXTENDED_LIMITS 0.00 255.0 /end CHARACTERISTIC
/begin CHARACTERISTIC VSSCD_qThresPla_C "Einspritzschwelle für NPL-Test der Fahrgeschwindigkeit" VALUE 0x1E9D9C Kw_Ws16 327.6700 InjMass 0.00 327.6700 FORMAT "%8.4" EXTENDED_LIMITS -327.6800 327.6700 /end CHARACTERISTIC
/begin CHARACTERISTIC VSSCD_swtSigVal_C "Signalquelle Fahrgeschwindigkeit, Datensatzwert für SW-Schalter VSSCD_swtSig" VALUE 0x1E9D9E Kw_Wu8 5.000 OneToOne 0.00 5.000 FORMAT "%5.3" EXTENDED_LIMITS 0.00 255.0 /end CHARACTERISTIC
/begin CHARACTERISTIC VSSCD_swtSigType_C "Einlesen SW-Schalter VSSCD_swtSig aus E2PROM (1) oder VSSCD_swtSigVal_C (2) bei Ini." VALUE 0x1E9D9F Kw_Wu8 1.000 OneToOne 1.000 2.000 FORMAT "%5.3" EXTENDED_LIMITS 0.00 255.0 /end CHARACTERISTIC
/begin CHARACTERISTIC VSSCD_tiAPT1_C "Zeitkonstante Filterung Fahrbeschleunigung" VALUE 0x1E9DA0 Kw_Wu32 4294.9673 TimeDelay_s 0.0000010000000 4294.9673 FORMAT "%9.4" /end CHARACTERISTIC
/begin CHARACTERISTIC VSSCD_tiPlausOvrRun_C "Fahrgeschwindigkeitsignal Timer fuer Plausibilitaet mit Schub" VALUE 0x1E9DA4 Kw_Wu16 655350.0 Time_ms 0.00 655350.0 FORMAT "%8.1" /end CHARACTERISTIC
/begin CHARACTERISTIC VSSCD_tiVPT1_C "Zeitkonstante Filterung Fahrgeschwindigkeit" VALUE 0x1E9DA8 Kw_Wu32 4294.9673 TimeDelay_s 0.0000010000000 4294.9673 FORMAT "%9.4" /end CHARACTERISTIC
/begin CHARACTERISTIC VSSCD_vDfl_C "Vorgabewert Fahrgeschwindigkeit" VALUE 0x1E9DAC Kw_Ws16 327.6700 Vel 0.00 327.6700 FORMAT "%8.4" EXTENDED_LIMITS -327.6800 327.6700 /end CHARACTERISTIC
/begin CHARACTERISTIC VSSCD_vMax_C "v-Schwelle für Max-Test der Fahrgeschwindigkeit" VALUE 0x1E9DAE Kw_Ws16 327.6700 Vel 0.00 327.6700 FORMAT "%8.4" EXTENDED_LIMITS -327.6800 327.6700 /end CHARACTERISTIC
/begin CHARACTERISTIC VSSCD_vMin_C "Minimum-Schwelle für v=0 Erkennung" VALUE 0x1E9DB0 Kw_Ws16 20.00000 Vel 0.00 20.00000 FORMAT "%8.5" EXTENDED_LIMITS -327.6800 327.6700 /end CHARACTERISTIC
/begin CHARACTERISTIC VSSCD_vRawMin_C "Fahrgeschwindigkeitssignal Rohwert Minimum Schwelle für Plausibilität mit Schub" VALUE 0x1E9DB2 Kw_Ws16 5.000000 Vel 0.00 5.000000 FORMAT "%8.6" EXTENDED_LIMITS -327.6800 327.6700 /end CHARACTERISTIC
/begin CHARACTERISTIC VSSCD_vThresPla_C "v-Schwelle für NPL-Test der Fahrgeschwindigkeit" VALUE 0x1E9DB4 Kw_Ws16 327.6700 Vel 0.00 327.6700 FORMAT "%8.4" EXTENDED_LIMITS -327.6800 327.6700 /end CHARACTERISTIC
/begin CHARACTERISTIC ZFC_nAvrgMax_C "Maximale Drehzahl für die Nullmengenkalibrierung" VALUE 0x1E9DF2 Kw_Ws16 5960.000 EngN 40.00000 6000.000 FORMAT "%8.3" EXTENDED_LIMITS -32768.00 32767.00 /end CHARACTERISTIC
/begin CHARACTERISTIC ZFC_nAvrgMin_C "Minimale Drehzahl für die Nullmengenkalibrierung" VALUE 0x1E9DF4 Kw_Ws16 5960.000 EngN 40.00000 6000.000 FORMAT "%8.3" EXTENDED_LIMITS -32768.00 32767.00 /end CHARACTERISTIC
/begin CHARACTERISTIC ZFC_nHyst_C "Hysteresewert Drehzahl für die Nullmengenkalibrierung" VALUE 0x1E9DF6 Kw_Ws16 5960.000 EngN 40.00000 6000.000 FORMAT "%8.3" EXTENDED_LIMITS -32768.00 32767.00 /end CHARACTERISTIC
/begin CHARACTERISTIC ZFC_numRatETClb_C "Anzahl der Ansteuerdauer-Kalibrierungen hintereinander" VALUE 0x1E9DF8 Kw_Wu8 255.0 OneToOne 0.00 255.0 FORMAT "%5.1" /end CHARACTERISTIC
/begin CHARACTERISTIC ZFC_numRatNVClb_C "Anzahl der Ansteuerspannungs-Kalibrierungen hintereinander" VALUE 0x1E9DF9 Kw_Wu8 255.0 OneToOne 0.00 255.0 FORMAT "%5.1" /end CHARACTERISTIC
/begin CHARACTERISTIC ZFC_phiSet_CUR "Ansteuerbeginn für Einspritzung der Nullmengenkalibrierung" CURVE 0x1E9E12 Kl_Xs16_Ws16 1440.000 AngleCrS -720.0000 720.0000 FORMAT "%8.4" EXTENDED_LIMITS -768.0000 767.9766
 /begin AXIS_DESCR STD_AXIS Eng_nAvrg EngN 16 40.00000 6000.000 FORMAT "%8.3" EXTENDED_LIMITS -32768.00 32767.00 DEPOSIT ABSOLUTE /end AXIS_DESCR
/end CHARACTERISTIC
/begin CHARACTERISTIC ZFC_stGearRls_CA "Gangabhängige freigabe der ZFC Kalibrierung" VAL_BLK 0x1E9DFA Kwb_Wu8 1.000 OneToOne 0.00 1.000 FORMAT "%5.3" EXTENDED_LIMITS 0.00 255.0 NUMBER 7 /end CHARACTERISTIC
/begin CHARACTERISTIC ZFC_swtClbActvVal_C "Applikationswert für SW-Schalter der ZFC Kalibrierung" VALUE 0x1E9E01 Kw_Wu8 1.000 OneToOne 0.00 1.000 FORMAT "%5.3" EXTENDED_LIMITS 0.00 255.0 /end CHARACTERISTIC
/begin CHARACTERISTIC ZFC_swtClbActvType_C "Typ des Softwareschalters für die ZFC Kalibrierung" VALUE 0x1E9E02 Kw_Wu8 2.000 OneToOne 0.00 2.000 FORMAT "%5.3" EXTENDED_LIMITS 0.00 255.0 /end CHARACTERISTIC
/begin CHARACTERISTIC ZFC_tAirThres_C "Minimale Ansauglufttemperatur für die Nullmengenkalibrierung" VALUE 0x1E9E04 Kw_Ws16 250.0000 Temp_Cels -50.14000 199.8600 FORMAT "%8.4" EXTENDED_LIMITS -3549.940 3003.560 /end CHARACTERISTIC
/begin CHARACTERISTIC ZFC_tEngThres_C "Minimale Motortemperatur für die Nullmengenkalibrierung" VALUE 0x1E9E06 Kw_Ws16 250.0000 Temp_Cels -50.14000 199.8600 FORMAT "%8.4" EXTENDED_LIMITS -3549.940 3003.560 /end CHARACTERISTIC
/begin CHARACTERISTIC ZFC_tFuelThresMax_C "Maximale Kraftstofftemperatur für die Nullmengenkalibrierung" VALUE 0x1E9E08 Kw_Ws16 200.0000 Temp_Cels -50.14000 149.8600 FORMAT "%8.4" EXTENDED_LIMITS -3549.940 3003.560 /end CHARACTERISTIC
/begin CHARACTERISTIC ZFC_tFuelThresMin_C "Minimale Kraftstofftemperatur für die Nullmengenkalibrierung" VALUE 0x1E9E0A Kw_Ws16 200.0000 Temp_Cels -50.14000 149.8600 FORMAT "%8.4" EXTENDED_LIMITS -3549.940 3003.560 /end CHARACTERISTIC
/begin CHARACTERISTIC ZFC_tiCldCham_CUR "Zeit bis der Brennraum für die Nullmengenkalibrierung zu stark abgekühlt ist" CURVE 0x1E9DBE Kl_Xs16_Ws16 655140.0 Time_ms 0.00 655140.0 FORMAT "%8.1" EXTENDED_LIMITS -327680.0 327670.0
 /begin AXIS_DESCR STD_AXIS IATSCD_tAir Temp_Cels 12 -50.14000 199.8600 FORMAT "%8.4" EXTENDED_LIMITS -3549.940 3003.560 DEPOSIT ABSOLUTE /end AXIS_DESCR
/end CHARACTERISTIC
/begin CHARACTERISTIC ZFC_tiDelOvrRun_C "Verzögerung nach dem Einsetzen der Schubphase für die Nullmengenkalibrierung" VALUE 0x1E9E0C Kw_Ws16 655140.0 Time_ms 0.00 655140.0 FORMAT "%8.1" EXTENDED_LIMITS -327680.0 327670.0 /end CHARACTERISTIC
/begin CHARACTERISTIC ZFC_tiDelpRailLim_C "Verzögerung zum Einschwingen des Raildrucks für die Nullmengenkalibrierung" VALUE 0x1E9E0E Kw_Ws16 655140.0 Time_ms 0.00 655140.0 FORMAT "%8.1" EXTENDED_LIMITS -327680.0 327670.0 /end CHARACTERISTIC
/begin CHARACTERISTIC ZFC_tiHotCham_C "Zeit bis der Brennraum warm genug für die Nullmengenkalibrierung ist" VALUE 0x1E9DF0 Kw_Ws16 655140.0 Time_ms 0.00 655140.0 FORMAT "%8.1" EXTENDED_LIMITS -327680.0 327670.0 /end CHARACTERISTIC
/begin CHARACTERISTIC ZFC_uBattMin_C "Minimale Batteriespannung für die Nullmengenkalibrierung" VALUE 0x1E9E10 Kw_Ws16 665653.8 Volt_Batt 0.00 665653.8 FORMAT "%8.1" EXTENDED_LIMITS -665674.1 665653.8 /end CHARACTERISTIC
/begin MEASUREMENT AdjVal_actRout_mp "Messpunkt für die  ""eingangsgroesse_y"" von Uacc_AdjValK2SigBlkVal_MAP (aktuelle Testerroutine)" UBYTE OneToOne 1 100 0.00 255.0 FORMAT "%5.1" ECU_ADDRESS 0x803844 /end MEASUREMENT
/begin MEASUREMENT AdjVal_dispx_mp "Messpunkt für ""eingangsgroesse_x"" von Uacc_AdjValK2SigBlkVal_MAP (hat immer den Wert 0)" UBYTE OneToOne 1 100 0.00 255.0 FORMAT "%5.1" ECU_ADDRESS 0x803845 /end MEASUREMENT
/begin MEASUREMENT EOPD_actRout_mp "Aktive EOPD-routine" UBYTE OneToOne 1 100 0.00 255.0 FORMAT "%5.1" ECU_ADDRESS 0x803846 /end MEASUREMENT
/begin MEASUREMENT EOPD_dispx_mp "dummy" UBYTE OneToOne 1 100 0.00 255.0 FORMAT "%5.1" ECU_ADDRESS 0x803847 /end MEASUREMENT
/begin MEASUREMENT StSys_dtrqInc_mp "gültiges Momentinkrement" ULONG RmpTrq 1 100 0.00 6553599.99847 FORMAT "%13.5" ECU_ADDRESS 0x8037DC /end MEASUREMENT
/begin MEASUREMENT StSys_duBattDiff_mp "Differenz der letzen Mittelungsdurchläufe für die Batteriewerte" SWORD Volt_Batt_PerSec_20ms 1 100 -332837.0 332826.9 FORMAT "%8.1" ECU_ADDRESS 0x8037E6 /end MEASUREMENT
/begin MEASUREMENT StSys_nThresStrtCutOut_mp "Startabwurfdrehzahl" SWORD EngN 1 100 -32768.00 32767.00 FORMAT "%8.2" ECU_ADDRESS 0x8037D2 /end MEASUREMENT
/begin MEASUREMENT StSys_nThrestEng_mp "Temperaturabhängige Drehzahlschwelle für Zweimassenschwungrad" SWORD EngN 1 100 -32768.00 32767.00 FORMAT "%8.2" ECU_ADDRESS 0x8037E8 /end MEASUREMENT
/begin MEASUREMENT StSys_nUpLiThrestEng_mp "Temperaturabhängige obere Drehzahlschwelle für Zweimassenschwungrad" SWORD EngN 1 100 -32768.00 32767.00 FORMAT "%8.2" ECU_ADDRESS 0x8037EA /end MEASUREMENT
/begin MEASUREMENT StSys_stRlsHtg "Freigabestatus des Heizungssystems" UBYTE OneToOne 1 100 0.00 255.0 FORMAT "%5.1" ECU_ADDRESS 0x7F950D /end MEASUREMENT
/begin MEASUREMENT StSys_stRmpMon "Zustand der Startmomenterhoehung" UBYTE OneToOne 1 100 0.00 255.0 FORMAT "%5.1" ECU_ADDRESS 0x7F950E /end MEASUREMENT
/begin MEASUREMENT StSys_stShutOfftimer_mp "Meßpunkt der Startmomentabschaltung" UBYTE OneToOne 1 100 0.00 255.0 FORMAT "%5.1" ECU_ADDRESS 0x8037EC /end MEASUREMENT
/begin MEASUREMENT StSys_stStallEng_mp "Bit für abgestorbenen Motor" UBYTE OneToOne 1 100 0.00 255.0 FORMAT "%5.1" ECU_ADDRESS 0x8037E0 /end MEASUREMENT
/begin MEASUREMENT StSys_stStrt "Startzustand" UBYTE OneToOne 1 100 0.00 255.0 FORMAT "%5.1" ECU_ADDRESS 0x7F9510 /end MEASUREMENT
/begin MEASUREMENT StSys_stStrtCutOutMon "Zustand des Startabwurfs" UBYTE OneToOne 1 100 0.00 255.0 FORMAT "%5.1" ECU_ADDRESS 0x7F9511 /end MEASUREMENT
/begin MEASUREMENT StSys_stTMFW_mp "Statusbits für Zweimassenschwungrad" UBYTE OneToOne 1 100 0.00 255.0 FORMAT "%5.1" ECU_ADDRESS 0x8037ED /end MEASUREMENT
/begin MEASUREMENT StSys_stTrqShutOff "globales Interface fuer die Startmomentabschaltung" UBYTE OneToOne 1 100 0.00 255.0 FORMAT "%5.1" ECU_ADDRESS 0x7F9512 /end MEASUREMENT
/begin MEASUREMENT StSys_tiRmpLck_mp "gültige Rampensperrzeit" UWORD Time_ms 1 100 0.00 655350.0 FORMAT "%8.1" ECU_ADDRESS 0x8037E2 /end MEASUREMENT
/begin MEASUREMENT StSys_trqAddCor "zusaetzliches Korrekturmoment f. Startmoment" SWORD Trq 1 100 -3276.800 3276.700 FORMAT "%8.3" ECU_ADDRESS 0x7F9B68 /end MEASUREMENT
/begin MEASUREMENT StSys_trqBas "Startbasismoment" SWORD Trq 1 100 -3276.800 3276.700 FORMAT "%8.3" ECU_ADDRESS 0x7F9B6A /end MEASUREMENT
/begin MEASUREMENT StSys_trqLim_mp "Grenzmoment beim Startvorgang" SWORD Trq 1 100 -3276.800 3276.700 FORMAT "%8.3" ECU_ADDRESS 0x8037E4 /end MEASUREMENT
/begin MEASUREMENT StSys_trqRmpState "Moment der Startrampe" SWORD Trq 1 100 -3276.800 3276.700 FORMAT "%8.3" ECU_ADDRESS 0x7F9B6C /end MEASUREMENT
/begin MEASUREMENT StSys_trqStrt "inneres Moment Startwert" SWORD Trq 1 100 -3276.800 3276.700 FORMAT "%8.3" ECU_ADDRESS 0x7F9B6E /end MEASUREMENT
/begin MEASUREMENT SvLpCD_dFillLvlCnt "Anzahl der plausiblen Füllstände" UBYTE OneToOne 1 100 0.00 255.0 FORMAT "%5.1" ECU_ADDRESS 0x7F9513 /end MEASUREMENT
/begin MEASUREMENT SvLpCD_lFillLvl_1_mp "Füllstand 1" UWORD Length1_mm 1 100 0.00 131.0700 FORMAT "%8.4" ECU_ADDRESS 0x803818 /end MEASUREMENT
/begin MEASUREMENT SvLpCD_lFillLvl_2_mp "Füllstand 2" UWORD Length1_mm 1 100 0.00 131.0700 FORMAT "%8.4" ECU_ADDRESS 0x80381A /end MEASUREMENT
/begin MEASUREMENT SvLpCD_lFillLvl_3_mp "Füllstand 3" UWORD Length1_mm 1 100 0.00 131.0700 FORMAT "%8.4" ECU_ADDRESS 0x80381C /end MEASUREMENT
/begin MEASUREMENT SvLpCD_lFillLvl_4_mp "Füllstand 4" UWORD Length1_mm 1 100 0.00 131.0700 FORMAT "%8.4" ECU_ADDRESS 0x80381E /end MEASUREMENT
/begin MEASUREMENT SvLpCD_ltmpMin2_mp "Ölwarnungskompensation" UWORD Length1_mm 1 100 0.00 131.0700 FORMAT "%8.4" ECU_ADDRESS 0x803820 /end MEASUREMENT
/begin MEASUREMENT SvLpCD_nAvrgFlt "geglättete Drehzahl" SWORD EngN 1 100 -32768.00 32767.00 FORMAT "%8.2" ECU_ADDRESS 0x7F9B74 /end MEASUREMENT
/begin MEASUREMENT SvLpCD_stFillLvlNotPlaus "Status der Füllstandsplausibilisierung" UBYTE OneToOne 1 100 0.00 255.0 FORMAT "%5.1" ECU_ADDRESS 0x7F9514 /end MEASUREMENT
/begin MEASUREMENT SvLpCD_volSingleDiff_1_mp "Einzelfüllstandsdifferenz 1" SWORD volFillLvl_ml 1 100 -32768.00 32767.00 FORMAT "%8.2" ECU_ADDRESS 0x803822 /end MEASUREMENT
/begin MEASUREMENT SvLpCD_volSingleDiff_2_mp "Einzelfüllstandsdifferenz 2" SWORD volFillLvl_ml 1 100 -32768.00 32767.00 FORMAT "%8.2" ECU_ADDRESS 0x803824 /end MEASUREMENT
/begin MEASUREMENT SvLpCD_volSingleDiff_3_mp "Einzelfüllstandsdifferenz 3" SWORD volFillLvl_ml 1 100 -32768.00 32767.00 FORMAT "%8.2" ECU_ADDRESS 0x803826 /end MEASUREMENT
/begin MEASUREMENT SvLpCD_volSingleDiff_4_mp "Einzelfüllstandsdifferenz 4" SWORD volFillLvl_ml 1 100 -32768.00 32767.00 FORMAT "%8.2" ECU_ADDRESS 0x803828 /end MEASUREMENT
/begin MEASUREMENT SvLpCD_volSumSingleDiff "Summe der einzelnen Füllstandsmengenunterschiede" SWORD volFillLvl_ml 1 100 -32768.00 32767.00 FORMAT "%8.2" ECU_ADDRESS 0x7F9B76 /end MEASUREMENT
/begin MEASUREMENT SvLp_aTrnvrsFlt_mp "geglättete Querbeschleunigung(PT1)" SWORD TrnvrsAcc 1 100 -327.6800 327.6700 FORMAT "%8.4" ECU_ADDRESS 0x8037FC /end MEASUREMENT
/begin MEASUREMENT SvLp_dOilLoad "Öltemp.- und Drehzahlabhängige Berechnung" UWORD Fact_WearSootIdx 1 100 0.00 0.001310700 FORMAT "%11.9" ECU_ADDRESS 0x7F9B78 /end MEASUREMENT
/begin MEASUREMENT SvLp_dOilLoadWIV2 "Öltemp.- und Drehzahlabhängige Berechnung für WIV2" SWORD OneToOne 1 100 -32768.00 32767.00 FORMAT "%8.2" ECU_ADDRESS 0x7F9B7A /end MEASUREMENT
/begin MEASUREMENT SvLp_dOilLvlCnt "Ölstandszähler" UBYTE OneToOne 1 100 0.00 255.0 FORMAT "%5.1" ECU_ADDRESS 0x7F9515 /end MEASUREMENT
/begin MEASUREMENT SvLp_dOilLvlCnt_tmp_mp "Ölstandszähler für die Plausibilisierung der Füllstandszeit" UBYTE OneToOne 1 100 0.00 255.0 FORMAT "%5.1" ECU_ADDRESS 0x8037FE /end MEASUREMENT
/begin MEASUREMENT SvLp_dSootLoad "Drehzahl- und Einspritzmengenabhängige Berechnung" UWORD Fact_WearSootIdx 1 100 0.00 0.001310700 FORMAT "%11.9" ECU_ADDRESS 0x7F9B7C /end MEASUREMENT
/begin MEASUREMENT SvLp_dSootLoadByp_mp "Bypass message für SvLp_dSootLoad" UWORD Fact_WearSootIdx 1 100 0.00 0.001310700 FORMAT "%11.9" ECU_ADDRESS 0x803800 /end MEASUREMENT
/begin MEASUREMENT SvLp_dSootLoadWIV2 "Drehzahl- und Einspritzmengenabhängige Berechnung für WIV2" SWORD OneToOne 1 100 -32768.00 32767.00 FORMAT "%8.2" ECU_ADDRESS 0x7F9B7E /end MEASUREMENT
/begin MEASUREMENT SvLp_dSootLoadWIV2Byp_mp "Bypass message für SvLp_dSootLoadWIV2" SWORD OneToOne 1 100 -32768.00 32767.00 FORMAT "%8.2" ECU_ADDRESS 0x803802 /end MEASUREMENT
/begin MEASUREMENT SvLp_dSootWear_z_mp "Zähler zur Anzeige der Summe der Ruß-/Verschleißindizes über einen Zeitraum von 2.4s" UBYTE OneToOne 1 100 0.00 255.0 FORMAT "%5.1" ECU_ADDRESS 0x803804 /end MEASUREMENT
/begin MEASUREMENT SvLp_facQI_mp "Guete-Faktor für die Berechnung des Kurzzeitmittelwerts und des Ölstandzählers" UWORD OneToOne 1 100 0.00 65535.00 FORMAT "%8.2" ECU_ADDRESS 0x803806 /end MEASUREMENT
/begin MEASUREMENT SvLp_lSootIdx_mp "Rußindex - Zwischen- und Summenwert des Rußkennfeldes" UWORD Length 1 100 0.00 65535.00 FORMAT "%8.2" ECU_ADDRESS 0x803808 /end MEASUREMENT
/begin MEASUREMENT SvLp_lSootLoad_mp "Russindexwert berechnet aus dem Russ- Eintragskennfeld[ m]" SWORD Length 1 100 -32768.00 32767.00 FORMAT "%8.2" ECU_ADDRESS 0x80380A /end MEASUREMENT
/begin MEASUREMENT SvLp_lWearIdx_mp "Verschleißindex - Zwischen- und Summenwert des Ölkennfeldes" UWORD Length 1 100 0.00 65535.00 FORMAT "%8.2" ECU_ADDRESS 0x80380C /end MEASUREMENT
/begin MEASUREMENT SvLp_stFillLvlPlaus_mp "Status Füllsatndsplausibilität nach jedem empfangen der TOG Botschaft" UBYTE OneToOne 1 100 0.00 255.0 FORMAT "%5.1" ECU_ADDRESS 0x80380E /end MEASUREMENT
/begin MEASUREMENT SvLp_stTogglefvfr "Status, der die neue Berechnung von Wear/Soot anzeigt" UBYTE OneToOne 1 100 0.00 255.0 FORMAT "%5.1" ECU_ADDRESS 0x7F9517 /end MEASUREMENT
/begin MEASUREMENT SvLp_stToggle_dCANzCAN "Toggle message, die bei jedem neuen Wert des Kurzzeitmittelwertes den Zustand ändert" UBYTE OneToOne 1 100 0.00 255.0 FORMAT "%5.1" ECU_ADDRESS 0x7F9516 /end MEASUREMENT
/begin MEASUREMENT SvLp_swtPresent "Schalterstellung, ob SI berechnet wird" UBYTE OneToOne 1 100 0.00 255.0 FORMAT "%5.1" ECU_ADDRESS 0x7F9518 /end MEASUREMENT
/begin MEASUREMENT SvLp_swtSotLdRgn_mp "Statuswort zur Umschaltung zwischen Russ- Eingangskennfeldern[]" UBYTE OneToOne 1 100 0.00 255.0 FORMAT "%5.1" ECU_ADDRESS 0x80380F /end MEASUREMENT
/begin MEASUREMENT SvLp_volMeanValPerTOSMsg_mp "Differenzensumme Mittelwerte" SWORD volFillLvl_ml 1 100 -32768.00 32767.00 FORMAT "%8.2" ECU_ADDRESS 0x803810 /end MEASUREMENT
/begin MEASUREMENT SvLp_volShTiMeanVal "Kurzzeitmittelwert" SWORD volFillLvl_ml 1 100 -32768.00 32767.00 FORMAT "%8.2" ECU_ADDRESS 0x7F9B80 /end MEASUREMENT
/begin MEASUREMENT SvLp_volShTiMeanVal_tmp_mp "Summe der einzelnen Füllstandsunterschiede des Komponententreibers" SLONG volFillLvl_ml 1 100 -2147483648.00 2147483647.00 FORMAT "%13.2" ECU_ADDRESS 0x803814 /end MEASUREMENT
/begin MEASUREMENT SWTmr_tiTmr16 "16-Bit Referenzzeit für Timer" UWORD Time_ms 1 100 0.00 655350.0 FORMAT "%8.1" ECU_ADDRESS 0x7F92DA /end MEASUREMENT
/begin MEASUREMENT SWTmr_tiTmr32 "32-Bit Referenzzeit für Timer" ULONG Time_ms 1 100 0.00 42949672950.0 FORMAT "%13.1" ECU_ADDRESS 0x7F92DC /end MEASUREMENT
/begin MEASUREMENT T15CD_stAnDebVal "Entprellter Wert der Klemme 15 aus Analogerfassung" UBYTE OneToOne 1 100 0.00 255.0 FORMAT "%5.1" ECU_ADDRESS 0x7F9519 /end MEASUREMENT
/begin MEASUREMENT T15CD_stAnRawVal "Status der Klemme 15 aus Analogerfassung" UBYTE OneToOne 1 100 0.00 255.0 FORMAT "%5.1" ECU_ADDRESS 0x7F951A /end MEASUREMENT
/begin MEASUREMENT T15CD_stCutOff "Abschaltung der CAN/Suspend-Mode Überwachung" UBYTE OneToOne 1 100 0.00 255.0 FORMAT "%5.1" ECU_ADDRESS 0x7F951B /end MEASUREMENT
/begin MEASUREMENT T15CD_stDebVal "entprellter Wert der Klemme 15" UBYTE OneToOne 1 100 0.00 255.0 FORMAT "%5.1" ECU_ADDRESS 0x7F951C /end MEASUREMENT
/begin MEASUREMENT T15CD_stRawVal "Rohwert der Klemme 15" UBYTE OneToOne 1 100 0.00 255.0 FORMAT "%5.1" ECU_ADDRESS 0x7F951D /end MEASUREMENT
/begin MEASUREMENT T15CD_uFltVal "Klemme 15 gefilterter Analogwert" SWORD Volt_Batt 1 100 -665674.1 665653.8 FORMAT "%8.1" ECU_ADDRESS 0x7F9B82 /end MEASUREMENT
/begin MEASUREMENT T15CD_uLinVal "Klemme 15 linearer Analogwert" SWORD Volt_Batt 1 100 -665674.1 665653.8 FORMAT "%8.1" ECU_ADDRESS 0x7F9B84 /end MEASUREMENT
/begin MEASUREMENT T15CD_uRawVal "Klemme 15 analoger Rohwert" SWORD Volt_Batt 1 100 -665674.1 665653.8 FORMAT "%8.1" ECU_ADDRESS 0x7F9B86 /end MEASUREMENT
/begin MEASUREMENT T15CD_uVal "Aktueller Wert der Klemme 15" SWORD Volt_Batt 1 100 -665674.1 665653.8 FORMAT "%8.1" ECU_ADDRESS 0x7F9B88 /end MEASUREMENT
/begin MEASUREMENT T50CD_stDebVal "entprellter Statuswert der Klemme 50" UBYTE OneToOne 1 100 0.00 255.0 FORMAT "%5.1" ECU_ADDRESS 0x7F951E /end MEASUREMENT
/begin MEASUREMENT T50CD_stRawVal "unentprellter Wert des Eingangssignals für Klemme 50" UBYTE OneToOne 1 100 0.00 255.0 FORMAT "%5.1" ECU_ADDRESS 0x7F951F /end MEASUREMENT
/begin MEASUREMENT T50CD_stRxDebVal "Entprellter Statuswert der Anlasserrückmeldeleitung" UBYTE OneToOne 1 100 0.00 255.0 FORMAT "%5.1" ECU_ADDRESS 0x7F9520 /end MEASUREMENT
/begin MEASUREMENT T50CD_stRxRawVal "Anlasserrückmeldeleitung Rohwert" UBYTE OneToOne 1 100 0.00 255.0 FORMAT "%5.1" ECU_ADDRESS 0x7F9521 /end MEASUREMENT
/begin MEASUREMENT T50CD_swtDigInPresentVal "Klemme 50 vorhanden" UBYTE OneToOne 1 100 0.00 255.0 FORMAT "%5.1" ECU_ADDRESS 0x7F9522 /end MEASUREMENT
/begin MEASUREMENT T50CD_swtRxDigInPVal "Anlasserrückmeldeleitung vorhanden" UBYTE OneToOne 1 100 0.00 255.0 FORMAT "%5.1" ECU_ADDRESS 0x7F9523 /end MEASUREMENT
/begin MEASUREMENT TPUMon_ctUpDwnDeb_mp "Meßpunkt für den Entprellungszähler der TPUMon Zeitabweichung" UWORD OneToOne 1 100 0.00 65535.00 FORMAT "%8.2" ECU_ADDRESS 0x80382C /end MEASUREMENT
/begin MEASUREMENT TPUMon_tiDiffMax_mp "Meßpunkt der maximalen Differenzen aus Timervergleich in den letzten 100 ms" SLONG TimeUSResolution 1 100 -2147483648.00 2147483647.00 FORMAT "%13.2" ECU_ADDRESS 0x803830 /end MEASUREMENT
/begin MEASUREMENT TPUMon_tiDiffMin_mp "Meßpunkt der minimalen (negativer Wert) Differenzen aus Timervergleich in den letzten 100 ms" SLONG TimeUSResolution 1 100 -2147483648.00 2147483647.00 FORMAT "%13.2" ECU_ADDRESS 0x803834 /end MEASUREMENT
/begin MEASUREMENT TPUMon_tiDiffSum_mp "Meßpunkt der Summe aller Differenzen aus Timervergleich in den letzten 100 ms" SLONG TimeUSResolution 1 100 -2147483648.00 2147483647.00 FORMAT "%13.2" ECU_ADDRESS 0x803838 /end MEASUREMENT
/begin MEASUREMENT TstTog_ActRout_mp "Anzahl der Testroutinen die durchlaufen werden müssen" UBYTE OneToOne 1 100 0.00 255.0 FORMAT "%5.1" ECU_ADDRESS 0x80383C /end MEASUREMENT
/begin MEASUREMENT TstTog_DNULL_mp "Dummy Meßpunkt für tsttog.kgs" UBYTE OneToOne 1 100 0.00 255.0 FORMAT "%5.1" ECU_ADDRESS 0x80383D /end MEASUREMENT
/begin MEASUREMENT TstTog_lastRout_mp "letzte Testerroutine" UBYTE OneToOne 1 100 0.00 255.0 FORMAT "%5.1" ECU_ADDRESS 0x80383E /end MEASUREMENT
/begin MEASUREMENT TstTog_stActRout_mp "Status der durchgeführten Routine" UBYTE OneToOne 1 100 0.00 255.0 FORMAT "%5.1" ECU_ADDRESS 0x80383F /end MEASUREMENT
/begin MEASUREMENT TstTog_stRoutDem_mp "Status der Anforderung" UBYTE OneToOne 1 100 0.00 255.0 FORMAT "%5.1" ECU_ADDRESS 0x803840 /end MEASUREMENT
/begin MEASUREMENT TstTog_st_mp "TstTog Togglestatus" UBYTE OneToOne 1 100 0.00 255.0 FORMAT "%5.1" ECU_ADDRESS 0x803841 /end MEASUREMENT
/begin MEASUREMENT TTSCD_tTnk "Tanktemperaturwert" SWORD Temp_Cels 1 100 -3549.940 3003.560 FORMAT "%8.3" ECU_ADDRESS 0x7F9B8A /end MEASUREMENT
/begin MEASUREMENT TTSCD_tTnkLin "linearisierter Wert der Tanktemperatur" SWORD Temp_Cels 1 100 -3549.940 3003.560 FORMAT "%8.3" ECU_ADDRESS 0x7F9B8C /end MEASUREMENT
/begin MEASUREMENT TTSCD_uRaw "Tanktemperatursensor Spannungsrohwert" SWORD Volt 1 100 -160156.4 160151.5 FORMAT "%8.1" ECU_ADDRESS 0x7F9B8E /end MEASUREMENT
/begin MEASUREMENT TVACD_rCnv_mp "Tastverhältnis basierend aus dem Ausgang des Abgasrückführreglers" SWORD DtyCyc 1 100 -327.6800 327.6700 FORMAT "%8.4" ECU_ADDRESS 0x803842 /end MEASUREMENT
/begin MEASUREMENT TVACD_rOut "Tastverhältnis zür Endstufenansteuerung" SWORD DtyCyc 1 100 -327.6800 327.6700 FORMAT "%8.4" ECU_ADDRESS 0x7F9B90 /end MEASUREMENT
/begin MEASUREMENT TVACD_st "Status der Drosselklappenüberwachung" UBYTE OneToOne 1 100 0.00 255.0 FORMAT "%5.1" ECU_ADDRESS 0x7F9524 /end MEASUREMENT
/begin MEASUREMENT TVACD_stLine "Digitalwert der Statusleitung" UBYTE OneToOne 1 100 0.00 255.0 FORMAT "%5.1" ECU_ADDRESS 0x7F9525 /end MEASUREMENT
/begin MEASUREMENT UAcc_stFuncCodePresent "Status der Funktionscodierung für verschiedene Funktionen" UBYTE OneToOne 1 100 0.00 255.0 FORMAT "%5.1" ECU_ADDRESS 0x7F952D /end MEASUREMENT
/begin MEASUREMENT UAcc_swtFuncCodeAC "Funktionscode für Klimaanlage" UBYTE OneToOne 1 100 0.00 255.0 FORMAT "%5.1" ECU_ADDRESS 0x7F952E /end MEASUREMENT
/begin MEASUREMENT UAcc_swtFuncCodeESP "Funktionscode für EPS-Funktion" UBYTE OneToOne 1 100 0.00 255.0 FORMAT "%5.1" ECU_ADDRESS 0x7F952F /end MEASUREMENT
/begin MEASUREMENT UAcc_swtFuncCodeVehVel "Funktionscode für Fahrzeuggeschwindigkeit" UBYTE OneToOne 1 100 0.00 255.0 FORMAT "%5.1" ECU_ADDRESS 0x7F9530 /end MEASUREMENT
/begin MEASUREMENT UAcc_swtFuncCodeWIV "Funktionscode für WIV- und OTS-Funktion" UBYTE OneToOne 1 100 0.00 255.0 FORMAT "%5.1" ECU_ADDRESS 0x7F9531 /end MEASUREMENT
/begin MEASUREMENT UKey_stNumCannel_mp "Meßpunkt der als Eingangsgrösse für UKey_stAdjChan_CA dient und bei der Initialisierung den jeweiligen Kanal anzeigt" UBYTE OneToOne 1 100 0.00 255.0 FORMAT "%5.1" ECU_ADDRESS 0x803848 /end MEASUREMENT
/begin MEASUREMENT UKey_stNumPassWD_mp "Meßpunkt der als Eingangsgrösse für UKey_stAdjChan_CA dient und bei der Initialisierung das jeweilige Passwort anzeigt" UBYTE OneToOne 1 100 0.00 255.0 FORMAT "%5.1" ECU_ADDRESS 0x803849 /end MEASUREMENT
/begin MEASUREMENT USAp_numFuncCodeBits "Anzahl der Function Code Bits" UBYTE OneToOne 1 100 0.00 255.0 FORMAT "%5.1" ECU_ADDRESS 0x7F9532 /end MEASUREMENT
/begin MEASUREMENT USAp_stFuncCode "Function Code für CAN" ULONG OneToOne 1 100 0.00 4294967295.00 FORMAT "%13.2" ECU_ADDRESS 0x7F9D0C /end MEASUREMENT
/begin MEASUREMENT VehDa_AdjVal_lSum_mp "Zuletzt gespeicherter Wert der gefahrenen Strecke im EEPROM oder Wert über KWP2000 (32-Bit)" ULONG Length 1 100 0.00 4294967295.00 FORMAT "%13.2" ECU_ADDRESS 0x80384C /end MEASUREMENT
/begin MEASUREMENT VehDa_AdjVal_stSum_mp "uint8 - Meßpunkt von VehDa_stSum des EEPROM-Wertes" UBYTE OneToOne 1 100 0.00 255.0 FORMAT "%5.1" ECU_ADDRESS 0x803850 /end MEASUREMENT
/begin MEASUREMENT VehDa_AdjVal_tiEngOn_mp "Zuletzt gespeicherter Wert der aktuellen Betriebszeit im EEPROM oder Wert über KWP2000 (32-Bit)" ULONG TimeEngOn 1 100 0.00 4294967295.00 FORMAT "%13.2" ECU_ADDRESS 0x803858 /end MEASUREMENT
/begin MEASUREMENT VehDa_lSum "Erfassung gefahrene Strecke" ULONG Length 1 100 0.00 4294967295.00 FORMAT "%13.2" ECU_ADDRESS 0x7F9D14 /end MEASUREMENT
/begin MEASUREMENT VehDa_nEngFilt_mp "vorgefilterte Motordrehzahl für v/n Verhältnis" SWORD EngN 1 100 -32768.00 32767.00 FORMAT "%8.2" ECU_ADDRESS 0x80385E /end MEASUREMENT
/begin MEASUREMENT VehDa_PerCnt_mp "Zählerwert" UWORD OneToOne 1 100 0.00 65535.00 FORMAT "%8.2" ECU_ADDRESS 0x80385C /end MEASUREMENT
/begin MEASUREMENT VehDa_rVn "Verhältnis von Fahrgeschwindigkeit zur Motordrehzahl" SWORD VelToN 1 100 0.00 0.1000000 FORMAT "%9.7" ECU_ADDRESS 0x7F9BB2 /end MEASUREMENT
/begin MEASUREMENT VehDa_stSum "Status der gefahrenen Strecke" UBYTE OneToOne 1 100 0.00 255.0 FORMAT "%5.1" ECU_ADDRESS 0x7F953A /end MEASUREMENT
/begin MEASUREMENT VehDa_stTrqDem "Status der aktuellen Momentenanforderungen" UWORD OneToOne 1 100 0.00 65535.00 FORMAT "%8.2" ECU_ADDRESS 0x7F9BB4 /end MEASUREMENT
/begin MEASUREMENT VehDa_tiEngOn "Erfassung der aktuellen Betriebszeit" ULONG TimeEngOn 1 100 0.00 4294967295.00 FORMAT "%13.2" ECU_ADDRESS 0x7F9D18 /end MEASUREMENT
/begin MEASUREMENT VehDa_vSum_mp "aufsummierte Geschwindigkeit" SWORD Vel_SI 1 100 -91.02222 91.01944 FORMAT "%8.5" ECU_ADDRESS 0x803852 /end MEASUREMENT
/begin MEASUREMENT VehDa_vThres_mp "Schwellwert der aufsummierten Geschwindigkeit" SWORD Vel_SI 1 100 -91.02222 91.01944 FORMAT "%8.5" ECU_ADDRESS 0x803854 /end MEASUREMENT
/begin MEASUREMENT VehMot_nMax "Grenzdrehzahl für Fahrzeugbewegung" SWORD EngN 1 100 -32768.00 32767.00 FORMAT "%8.2" ECU_ADDRESS 0x7F9BB6 /end MEASUREMENT
/begin MEASUREMENT VehMot_nMin "Leerlaufdrehzahl für Fahrzeugbewegung" SWORD EngN 1 100 -32768.00 32767.00 FORMAT "%8.2" ECU_ADDRESS 0x7F9BB8 /end MEASUREMENT
/begin MEASUREMENT VehMot_pwrAcsDes "Gesamtbedarf Leistung der Nebenaggregate in der Fahrzeugbewegung" SWORD Pwr 1 100 -308831.1 308821.7 FORMAT "%8.1" ECU_ADDRESS 0x7F9BBA /end MEASUREMENT
/begin MEASUREMENT VehMot_pwrAcsLead "Leistungsvorhalt der Nebenaggregate in der Fahrzeugbewegung" SWORD Pwr 1 100 -308831.1 308821.7 FORMAT "%8.1" ECU_ADDRESS 0x7F9BBC /end MEASUREMENT
/begin MEASUREMENT VESGov_trq "Momentenanforderung Arbeitsdrehzahlregler" SWORD Trq 1 100 -3276.800 3276.700 FORMAT "%8.3" ECU_ADDRESS 0x7F9B92 /end MEASUREMENT
/begin MEASUREMENT VSACD_rCnv1_mp "Tastverhältnis basierend aus dem Ausgang der Drallniveausteuerung" SWORD DtyCyc 1 100 -327.6800 327.6700 FORMAT "%8.4" ECU_ADDRESS 0x803866 /end MEASUREMENT
/begin MEASUREMENT VSACD_rCnv2_mp "Tastverhältnis basierend aus dem Ausgang der Drallniveausteuerung vom zweiten Komponententreiber" SWORD DtyCyc 1 100 -327.6800 327.6700 FORMAT "%8.4" ECU_ADDRESS 0x803868 /end MEASUREMENT
/begin MEASUREMENT VSACD_rOut1 "Tastverhältnis zur Endstufenansteuerung Drallniveausteller eins" SWORD DtyCyc 1 100 -327.6800 327.6700 FORMAT "%8.4" ECU_ADDRESS 0x7F9B94 /end MEASUREMENT
/begin MEASUREMENT VSACD_rOut2 "Tastverhältnis zur Endstufenansteuerung Drallniveausteller zwei" SWORD DtyCyc 1 100 -327.6800 327.6700 FORMAT "%8.4" ECU_ADDRESS 0x7F9B96 /end MEASUREMENT
/begin MEASUREMENT VSASCD_dcycIn1 "Tastverhältnis der Drallklappenrückmeldeleitung 1" SWORD DtyCyc 1 100 -327.6800 327.6700 FORMAT "%8.4" ECU_ADDRESS 0x7F9B98 /end MEASUREMENT
/begin MEASUREMENT VSASCD_dcycIn2 "Tastverhältnis der Drallklappenrückmeldeleitung 2" SWORD DtyCyc 1 100 -327.6800 327.6700 FORMAT "%8.4" ECU_ADDRESS 0x7F9B9A /end MEASUREMENT
/begin MEASUREMENT VSASCD_rIn1 "linearisiertes Tastverhältnis der Drallklappenrückmeldeleitung 1" SWORD Prc 1 100 -327.6800 327.6700 FORMAT "%8.4" ECU_ADDRESS 0x7F9B9C /end MEASUREMENT
/begin MEASUREMENT VSASCD_rIn2 "linearisiertes Tastverhältnis der Drallklappenrückmeldeleitung 2" SWORD Prc 1 100 -327.6800 327.6700 FORMAT "%8.4" ECU_ADDRESS 0x7F9B9E /end MEASUREMENT
/begin MEASUREMENT VSASCD_st1 "Status der Drallklappenrückmeldung 1" UBYTE OneToOne 1 100 0.00 255.0 FORMAT "%5.1" ECU_ADDRESS 0x7F9533 /end MEASUREMENT
/begin MEASUREMENT VSASCD_st2 "Status der Drallklappenrückmeldung 2" UBYTE OneToOne 1 100 0.00 255.0 FORMAT "%5.1" ECU_ADDRESS 0x7F9534 /end MEASUREMENT
/begin MEASUREMENT VSASCD_stErr1_mp "Fehlerdaten der Drallklappenrückmeldung 1" UBYTE OneToOne 1 100 0.00 255.0 FORMAT "%5.1" ECU_ADDRESS 0x80386A /end MEASUREMENT
/begin MEASUREMENT VSASCD_stErr2_mp "Fehlerdaten der Drallklappenrückmeldeleitung 2" UBYTE OneToOne 1 100 0.00 255.0 FORMAT "%5.1" ECU_ADDRESS 0x80386B /end MEASUREMENT
/begin MEASUREMENT VSASCD_tiActPer1_mp "Periodendauer der Drallklappenrückmeldeleitung 1" UWORD Period_ms 1 100 0.00 6553.500 FORMAT "%8.3" ECU_ADDRESS 0x80386C /end MEASUREMENT
/begin MEASUREMENT VSASCD_tiActPer2_mp "Periodendauer der Drallklappenrückmeldeleitung 2" UWORD Period_ms 1 100 0.00 6553.500 FORMAT "%8.3" ECU_ADDRESS 0x80386E /end MEASUREMENT
/begin MEASUREMENT VSA_dcycIn "Tastverhältnis der Drallklappenrückmeldeleitung 1 und 2 (MS)" SWORD DtyCyc 1 100 -327.6800 327.6700 FORMAT "%8.4" ECU_ADDRESS 0x7F9BA0 /end MEASUREMENT
/begin MEASUREMENT VSA_rVSA1 "Drallniveaustellerkoordinatorausgang 1" SWORD DtyCyc 1 100 -327.6800 327.6700 FORMAT "%8.4" ECU_ADDRESS 0x7F9BA2 /end MEASUREMENT
/begin MEASUREMENT VSA_rVSA2 "Drallniveaustellerkoordinatorausgang 2" SWORD DtyCyc 1 100 -327.6800 327.6700 FORMAT "%8.4" ECU_ADDRESS 0x7F9BA4 /end MEASUREMENT
/begin MEASUREMENT VSA_rVSAByp1_mp "Bypass message für VSA_rVSA1" SWORD Prc 1 100 -327.6800 327.6700 FORMAT "%8.4" ECU_ADDRESS 0x803860 /end MEASUREMENT
/begin MEASUREMENT VSA_rVSAByp2_mp "Bypass message für VSA_rVSA2" SWORD Prc 1 100 -327.6800 327.6700 FORMAT "%8.4" ECU_ADDRESS 0x803862 /end MEASUREMENT
/begin MEASUREMENT VSA_stErrHdl1_mp "Status der Fehlerreaktion im Steller 1 in Abhängigkeit der Anzahl" UBYTE OneToOne 1 100 0.00 255.0 FORMAT "%5.1" ECU_ADDRESS 0x803864 /end MEASUREMENT
/begin MEASUREMENT VSA_stErrHdl2_mp "Status der Fehlerreaktion im Steller 2 in Abhängigkeit der Anzahl" UBYTE OneToOne 1 100 0.00 255.0 FORMAT "%5.1" ECU_ADDRESS 0x803865 /end MEASUREMENT
/begin MEASUREMENT VSA_stVSA1 "Stellerkoordinatorstatus 1" UBYTE OneToOne 1 100 0.00 255.0 FORMAT "%5.1" ECU_ADDRESS 0x7F9535 /end MEASUREMENT
/begin MEASUREMENT VSA_stVSA2 "Stellerkoordinatorstatus 2" UBYTE OneToOne 1 100 0.00 255.0 FORMAT "%5.1" ECU_ADDRESS 0x7F9536 /end MEASUREMENT
/begin MEASUREMENT VSSCD_a "Fahrbeschleunigung" SWORD Acc 1 100 -20.00000 20.00000 FORMAT "%8.5" ECU_ADDRESS 0x7F9BA6 /end MEASUREMENT
/begin MEASUREMENT VSSCD_aRaw "Rohwert Fahrbeschleunigung" SWORD Acc 1 100 -20.00000 20.00000 FORMAT "%8.5" ECU_ADDRESS 0x7F9BA8 /end MEASUREMENT
/begin MEASUREMENT VSSCD_ctImp "Impulszähler Fahrgeschwindigkeit Impulssignal" UWORD OneToOne 1 100 0.00 65535.00 FORMAT "%8.2" ECU_ADDRESS 0x7F9BAA /end MEASUREMENT
/begin MEASUREMENT VSSCD_stErrPwm "Error Status der PWM-In Funktion (HWE) des VSSCD" UBYTE OneToOne 1 100 0.00 255.0 FORMAT "%5.1" ECU_ADDRESS 0x7F9538 /end MEASUREMENT
/begin MEASUREMENT VSSCD_swtSig "Signaleingangsschalter Fahrgeschwindigkeit" UBYTE OneToOne 1 100 0.00 255.0 FORMAT "%5.1" ECU_ADDRESS 0x7F9539 /end MEASUREMENT
/begin MEASUREMENT VSSCD_tiPerAvrgFilt "Gefilterte Periodendauer des FGG's" SLONG Time_PwmHigh 1 100 -214748364.800 214748364.700 FORMAT "%13.3" ECU_ADDRESS 0x7F9D10 /end MEASUREMENT
/begin MEASUREMENT VSSCD_v "Fahrzeuggeschwindigkeit" SWORD Vel 1 100 0.00 300.0000 FORMAT "%8.4" ECU_ADDRESS 0x7F9BAC /end MEASUREMENT
/begin MEASUREMENT VSSCD_vCarb1 "Fahrzeuggeschwindigkeit für Carb Mode $1 ohne Ersatzwert" SWORD Vel 1 100 0.00 300.0000 FORMAT "%8.4" ECU_ADDRESS 0x7F9BAE /end MEASUREMENT
/begin MEASUREMENT VSSCD_vRaw "Rohwert Fahrgeschwindigkeit" SWORD Vel 1 100 0.00 300.0000 FORMAT "%8.4" ECU_ADDRESS 0x7F9BB0 /end MEASUREMENT
/begin MEASUREMENT WDCom_dChisteResponse_u32 "Antwortbeitrag des Befehlstests" UWORD OneToOne 1 100 0.00 65535.00 FORMAT "%8.2" ECU_ADDRESS 0x801AC4 /end MEASUREMENT
/begin MEASUREMENT WDCom_dErrorCountForCntler_u8 "Kopie des überwachungsmodul-internen Fehlerzählers für den Funktionsrechner" UBYTE OneToOne 1 100 0.00 255.0 FORMAT "%5.1" ECU_ADDRESS 0x801B06 /end MEASUREMENT
/begin MEASUREMENT WDCom_dErrorCountForWD_u8 "Fehlerzähler für das Überwachungsmodul" UBYTE OneToOne 1 100 0.00 255.0 FORMAT "%5.1" ECU_ADDRESS 0x7FAD2D /end MEASUREMENT
/begin MEASUREMENT WDCom_dRequest_u32 "Aktuelle Frage des Überwachungsmoduls" UWORD OneToOne 1 100 0.00 65535.00 FORMAT "%8.2" ECU_ADDRESS 0x801ACC /end MEASUREMENT
/begin MEASUREMENT WDCom_ErrorCntForSPI_u8 "Fehlerzähler für den SPI Handler" UBYTE OneToOne 1 100 0.00 255.0 FORMAT "%5.1" ECU_ADDRESS 0x803870 /end MEASUREMENT
/begin MEASUREMENT WDCom_ErrorCntForUC_u8 "Kopie des Fehlerzählers des externen Watch Dog" UBYTE OneToOne 1 100 0.00 255.0 FORMAT "%5.1" ECU_ADDRESS 0x803871 /end MEASUREMENT
/begin MEASUREMENT WDCom_ErrorCntForWD_u8 "Fehlerzähler für den externen Watch dog" UBYTE OneToOne 1 100 0.00 255.0 FORMAT "%5.1" ECU_ADDRESS 0x803872 /end MEASUREMENT
/begin MEASUREMENT ZFC_dpRailLim_mp "Aktuelle max Raildruckabweichung für die Nullmengenkalibrierung" SWORD Pres_Rail 1 100 -3276800. 3276700. FORMAT "%8.0" ECU_ADDRESS 0x803874 /end MEASUREMENT
/begin MEASUREMENT ZFC_dpRail_mp "Raildruckabweichung zum Raildruck Kalibrierungspunkt" SWORD Pres_Rail 1 100 -3276800. 3276700. FORMAT "%8.0" ECU_ADDRESS 0x803876 /end MEASUREMENT
/begin MEASUREMENT ZFC_numCylInj_mp "Aktuelle Zylindernummer für die Einspritzung der Nullmengenkalibrierung" UBYTE OneToOne 1 100 0.00 255.0 FORMAT "%5.1" ECU_ADDRESS 0x80389C /end MEASUREMENT
/begin MEASUREMENT ZFC_phiInj_mp "Ansteuerbeginng der Einspritzung für die Nullmengenkalibrierung" SWORD AngleCrS 1 100 -768.0000 767.9766 FORMAT "%8.4" ECU_ADDRESS 0x80389E /end MEASUREMENT
/begin MEASUREMENT ZFC_pRailSetPoint_mp "Angeforderter Raildrucksollwert der Nullmengenkalibrierung" SWORD Pres_Rail 1 100 -3276800. 3276700. FORMAT "%8.0" ECU_ADDRESS 0x803878 /end MEASUREMENT
/begin MEASUREMENT ZFC_SigThres_mp "Aktuelle Signalschwelle für die Nullmengenkalibrierung" SWORD OneToOne 1 100 -32768.00 32767.00 FORMAT "%8.2" ECU_ADDRESS 0x803898 /end MEASUREMENT
/begin MEASUREMENT ZFC_Sig_mp "Messwert der Kalibrierung" SLONG OneToOne 1 100 -2147483648.00 2147483647.00 FORMAT "%13.2" ARRAY_SIZE 6 ECU_ADDRESS 0x803880 /end MEASUREMENT
/begin MEASUREMENT ZFC_stCldCham "Zustand des Brennraums für die Nullmengenkalibrierung" UBYTE OneToOne 1 100 0.00 255.0 FORMAT "%5.1" ECU_ADDRESS 0x7F953B /end MEASUREMENT
/begin MEASUREMENT ZFC_stCmbCham_mp "Zustand der Erkennung kalter Brennraum für die Nullmengenkalibrierung" UBYTE OneToOne 1 100 0.00 255.0 FORMAT "%5.1" ECU_ADDRESS 0x803873 /end MEASUREMENT
/begin MEASUREMENT ZFC_stDem_mp "Anforderungen der Nullmengenkalibrierung" UBYTE OneToOne 1 100 0.00 255.0 FORMAT "%5.1" ECU_ADDRESS 0x80387A /end MEASUREMENT
/begin MEASUREMENT ZFC_stEvalSig_mp "Status der Auswertung des Signals der Nullmengenkalibrierung" UBYTE ZFC_EvalEngSpd_Rslt 1 100 0.00 2.00000000000 FORMAT "%13.11" ECU_ADDRESS 0x80389A /end MEASUREMENT
/begin MEASUREMENT ZFC_stInj_mp "Status der Einspritzprogrammierung der Nullmengenkalibrierung" UBYTE ZFC_Inj_State 1 100 0.00 64.0000000000 FORMAT "%13.10" ECU_ADDRESS 0x8038A0 /end MEASUREMENT
/begin MEASUREMENT ZFC_st_mp "Status der Nullmengenkalibrierung" UBYTE ZFC_State 1 100 1.00000000000 16.0000000000 FORMAT "%13.10" ECU_ADDRESS 0x80387B /end MEASUREMENT
/begin MEASUREMENT ZFC_swtClbActv "SW-Schalter für die Aktivierung der ZFC Kalibrierung" UBYTE OneToOne 1 100 0.00 255.0 FORMAT "%5.1" ECU_ADDRESS 0x7F953C /end MEASUREMENT
/begin MEASUREMENT ZFC_tiET_mp "Ansteuerdauer für die Einspritzung der Nullmengenkalibrierung" SWORD InjTime_us 1 100 -32768.00 32767.00 FORMAT "%8.2" ECU_ADDRESS 0x8038A2 /end MEASUREMENT
/begin MEASUREMENT ZFC_vStopClb_mp "Minimale Fahrzeuggeschwindigkeit der aktuellen Ansteuerdauerkalibrierung" SWORD Vel 1 100 -327.6800 327.6700 FORMAT "%8.4" ECU_ADDRESS 0x80387C /end MEASUREMENT
/begin FUNCTION stsys_strtrmp "Startrampe"
 /begin DEF_CHARACTERISTIC StSys_nFreezeTrqRmp_C StSys_nReleaseTrqRmp_C StSys_tFuelHi_C StSys_tFuelLo_C StSys_tiEngTempValid_C StSys_dtrqColdInc_C StSys_tiColdRmpLck_C StSys_trqColdLim_C StSys_dtrqHotInc_C StSys_tiHotRmpLck_C StSys_trqHotLim_C StSys_dtrqWarmInc_C StSys_tiWarmRmpLck_C StSys_trqWarmLim_C /end DEF_CHARACTERISTIC
/end FUNCTION
/begin FUNCTION stsys_strtrmp_uic ""
 /begin OUT_MEASUREMENT StSys_dtrqInc_mp StSys_stStallEng_mp StSys_tiRmpLck_mp StSys_trqLim_mp /end OUT_MEASUREMENT
/end FUNCTION
/begin FUNCTION stsys_strt_uic "" /begin OUT_MEASUREMENT StSys_nThresStrtCutOut_mp /end OUT_MEASUREMENT /end FUNCTION
/begin FUNCTION stsys_trqshutoff "Startmomentabschaltung"
 /begin DEF_CHARACTERISTIC StSys_nThrestEng_CUR StSys_nThresTMFW_C StSys_numAvrgRun_C StSys_nUpLiThrestEng_CUR StSys_tiDelnUpLiThres_C StSys_tiDelTMFW_C StSys_tiShutOff_MAP StSys_uAltTMFW_C StSys_uThresTMFW_C /end DEF_CHARACTERISTIC
 /begin IN_MEASUREMENT Eng_tEng GlwCtl_tiPreGlw /end IN_MEASUREMENT
/end FUNCTION
/begin FUNCTION stsys_trqshutoff_msg ""
 /begin OUT_MEASUREMENT StSys_stRlsHtg StSys_stRmpMon StSys_stStrt StSys_stStrtCutOutMon StSys_stTrqShutOff StSys_trqAddCor StSys_trqBas StSys_trqRmpState StSys_trqStrt /end OUT_MEASUREMENT
/end FUNCTION
/begin FUNCTION stsys_trqshutoff_uic ""
 /begin OUT_MEASUREMENT StSys_duBattDiff_mp StSys_nThrestEng_mp StSys_nUpLiThrestEng_mp StSys_stShutOfftimer_mp StSys_stTMFW_mp /end OUT_MEASUREMENT
/end FUNCTION
/begin FUNCTION svlp "Wartungsintervallverlängerung"
 /begin DEF_CHARACTERISTIC SvLp_dOilLoad_MAP SvLp_dSootLoad_MAP SvLp_facQI_MAP SvLp_facSoot_C SvLp_facWear_C SvLp_lEquCalc_C SvLp_lOilLoad_MAP SvLp_lSootLoad_MAP SvLp_lSotLdRgn1_MAP SvLp_lSotLdRgn2_MAP SvLp_lSotLdRgn3_MAP SvLp_stSotLdRgnMsk1_C SvLp_stSotLdRgnMsk2_C SvLp_stSotLdRgnMsk3_C SvLp_swtPresentVal_C SvLp_swtPresentType_C SvLp_tiPlausWIV_C SvLp_tiShTiMeanVal_C SvLp_tiTrnvrsAccPT1_C /end DEF_CHARACTERISTIC
 /begin IN_MEASUREMENT Eng_nAvrg InjCrv_qTot InjCtl_qSetUnBal OTSCD_tEngOil OTSCD_tEngOilWIV SvLpCD_nAvrgFlt SvLp_aTrnvrsFlt_mp /end IN_MEASUREMENT
/end FUNCTION
/begin FUNCTION svlpcd "Komponententreiber Wartungsintervallverlängerung"
 /begin DEF_CHARACTERISTIC SvLpCD_dGradFillCrv_C SvLpCD_tiEngNPT1_C SvLpCD_lFillLvl_CUR SvLpCD_lOilWarn_MAP SvLpCD_nEngMax_C SvLpCD_nEngMin_C SvLpCD_tiFillLvlMax_C SvLpCD_tiFillLvlMin_C SvLpCD_tOilMax_C SvLpCD_tOilMin_C /end DEF_CHARACTERISTIC
 /begin IN_MEASUREMENT FrmMng_tiTOSFillLvl1 OTSCD_tEngOilWIV SvLpCD_nAvrgFlt /end IN_MEASUREMENT
/end FUNCTION
/begin FUNCTION svlpcd_msg ""
 /begin OUT_MEASUREMENT SvLpCD_dFillLvlCnt SvLpCD_nAvrgFlt SvLpCD_stFillLvlNotPlaus SvLpCD_volSumSingleDiff /end OUT_MEASUREMENT
/end FUNCTION
/begin FUNCTION svlpcd_uic ""
 /begin OUT_MEASUREMENT SvLpCD_lFillLvl_1_mp SvLpCD_lFillLvl_2_mp SvLpCD_lFillLvl_3_mp SvLpCD_lFillLvl_4_mp SvLpCD_ltmpMin2_mp SvLpCD_volSingleDiff_1_mp SvLpCD_volSingleDiff_2_mp SvLpCD_volSingleDiff_3_mp SvLpCD_volSingleDiff_4_mp /end OUT_MEASUREMENT
/end FUNCTION
/begin FUNCTION svlp_msg ""
 /begin OUT_MEASUREMENT SvLp_dOilLoad SvLp_dOilLoadWIV2 SvLp_dOilLvlCnt SvLp_dSootLoad SvLp_dSootLoadWIV2 SvLp_stTogglefvfr SvLp_stToggle_dCANzCAN SvLp_swtPresent SvLp_volShTiMeanVal /end OUT_MEASUREMENT
/end FUNCTION
/begin FUNCTION svlp_uic ""
 /begin DEF_CHARACTERISTIC SvLp_dSootLoadWIV2_Vector SvLp_dSootLoadWIV2_Channel SvLp_dSootLoad_Vector SvLp_dSootLoad_Channel /end DEF_CHARACTERISTIC
 /begin OUT_MEASUREMENT SvLp_aTrnvrsFlt_mp SvLp_dOilLvlCnt_tmp_mp SvLp_dSootLoadByp_mp SvLp_dSootLoadWIV2Byp_mp SvLp_dSootWear_z_mp SvLp_facQI_mp SvLp_lSootIdx_mp SvLp_lSootLoad_mp SvLp_lWearIdx_mp SvLp_stFillLvlPlaus_mp SvLp_swtSotLdRgn_mp SvLp_volMeanValPerTOSMsg_mp SvLp_volShTiMeanVal_tmp_mp /end OUT_MEASUREMENT
/end FUNCTION
/begin FUNCTION switches_base "" /end FUNCTION
/begin FUNCTION switches_proj "" /end FUNCTION
/begin FUNCTION switches_sys "" /end FUNCTION
/begin FUNCTION swtmr_inc10ms "" /end FUNCTION
/begin FUNCTION swtmr_inc10ms_uic "" /end FUNCTION
/begin FUNCTION swtmr_msg "" /begin OUT_MEASUREMENT SWTmr_tiTmr16 SWTmr_tiTmr32 /end OUT_MEASUREMENT /end FUNCTION
/begin FUNCTION system_const_base "" /end FUNCTION
/begin FUNCTION system_const_conf "" /end FUNCTION
/begin FUNCTION system_const_proj "" /end FUNCTION
/begin FUNCTION system_const_sys "" /end FUNCTION
/begin FUNCTION t15cd "Klemme 15 Komponententreiber"
 /begin DEF_CHARACTERISTIC T15CD_uSRCMin_C T15CD_uSRCMax_C T15CD_uLin_CUR T15CD_uCutOffHysXLow_C T15CD_uCutOffHysXHigh_C T15CD_stCutOffHysYLow_C T15CD_stCutOffHysYHigh_C T15CD_DebNplDef_C T15CD_DebNplOk_C T15CD_tiDebNeg_C T15CD_tiDebPos_C T15CD_DebSRCHighDef_C T15CD_DebSRCHighOk_C T15CD_DebSRCLowDef_C T15CD_DebSRCLowOk_C T15CD_dtRmpSlpUp_C T15CD_dtRmpSlpDwn_C T15CD_stCutOffPreset_C T15CD_stInvIn_C T15CD_tiucoPT1_C T15CD_stSensIDWord_C T15CD_uDfl_C T15CD_uA2DThres_C T15CD_uCutOffPreset_C /end DEF_CHARACTERISTIC
 /begin IN_MEASUREMENT T15CD_uRawVal /end IN_MEASUREMENT
/end FUNCTION
/begin FUNCTION t15cd_msg ""
 /begin OUT_MEASUREMENT T15CD_stAnDebVal T15CD_stAnRawVal T15CD_stCutOff T15CD_stDebVal T15CD_stRawVal T15CD_uFltVal T15CD_uLinVal T15CD_uRawVal T15CD_uVal /end OUT_MEASUREMENT
/end FUNCTION
/begin FUNCTION t50cd "Komponententreiber Klemme 50"
 /begin DEF_CHARACTERISTIC T50CD_tiDigInDebNeg_C T50CD_tiDigInDebPos_C T50CD_stDigInvIn_C T50CD_swtDigInPresentVal_C T50CD_swtDigInPresentType_C /end DEF_CHARACTERISTIC
/end FUNCTION
/begin FUNCTION t50cd_msg ""
 /begin OUT_MEASUREMENT T50CD_stDebVal T50CD_stRawVal T50CD_stRxDebVal T50CD_stRxRawVal T50CD_swtDigInPresentVal T50CD_swtRxDigInPVal /end OUT_MEASUREMENT
/end FUNCTION
/begin FUNCTION t50cd_rx "Anlasserrückmeldeleitung Komponententreiber"
 /begin DEF_CHARACTERISTIC T50CD_tiRxDigInDebNeg_C T50CD_tiRxDigInDebPos_C T50CD_stRxDigInvIn_C T50CD_swtRxDigInPVal_C T50CD_swtRxDigInPType_C /end DEF_CHARACTERISTIC
/end FUNCTION
/begin FUNCTION t50cd_rx_uic "" /end FUNCTION
/begin FUNCTION tp20 "Transportprotokoll 2.0" /begin DEF_CHARACTERISTIC Tp20_tiCanMuteTimeOut_C Tp20_vCanMuteThres_C /end DEF_CHARACTERISTIC /end FUNCTION
/begin FUNCTION tpumon "Timer Überwachung"
 /begin DEF_CHARACTERISTIC TPUMon_ctDfctLim_C TPUMon_ctTPU_C TPUMon_tiDiffMaxLimit_C TPUMon_tiDiffMinLimit_C TPUMon_tiDiffSumLimit_C /end DEF_CHARACTERISTIC
/end FUNCTION
/begin FUNCTION tpumon_uic ""
 /begin OUT_MEASUREMENT TPUMon_ctUpDwnDeb_mp TPUMon_tiDiffMax_mp TPUMon_tiDiffMin_mp TPUMon_tiDiffSum_mp /end OUT_MEASUREMENT
/end FUNCTION
/begin FUNCTION tsttog "Funktionen welche nötig sind um die automatischen Testeranforderungen zu gewährleisten"
 /begin DEF_CHARACTERISTIC TstTog_Code_C TstTog_Demand_C TstTog_DemStartMaxEngN_C TstTog_K2SigBlkVal1_MAP TstTog_K2SigBlkVal2_MAP TstTog_tiBetweenTogVal_C TstTog_tiRoutDemMax_C TstTog_Val1_C TstTog_Val2_C /end DEF_CHARACTERISTIC
 /begin IN_MEASUREMENT TstTog_ActRout_mp TstTog_DNULL_mp /end IN_MEASUREMENT
/end FUNCTION
/begin FUNCTION tsttog_uic ""
 /begin OUT_MEASUREMENT TstTog_ActRout_mp TstTog_DNULL_mp TstTog_lastRout_mp TstTog_stActRout_mp TstTog_stRoutDem_mp TstTog_st_mp /end OUT_MEASUREMENT
/end FUNCTION
/begin FUNCTION ttlpcd "Komponententreiber Warnlampen" /end FUNCTION
/begin FUNCTION ttlpcd_msg "" /end FUNCTION
/begin FUNCTION ttlpcd_uic "" /end FUNCTION
/begin FUNCTION ttscd_co "Kraftstoff-/Tanktemperatursensor Komponententreiber"
 /begin DEF_CHARACTERISTIC TTSCD_uSRCMin_C TTSCD_uSRCMax_C TTSCD_tLin_CUR TTSCD_DebSRCHighDef_C TTSCD_DebSRCHighOk_C TTSCD_DebSRCLowDef_C TTSCD_DebSRCLowOk_C TTSCD_dtRmpSlpUp_C TTSCD_dtRmpSlpDwn_C TTSCD_stSensIDWord_C TTSCD_tDfl_C /end DEF_CHARACTERISTIC
 /begin IN_MEASUREMENT TTSCD_uRaw /end IN_MEASUREMENT
/end FUNCTION
/begin FUNCTION ttscd_co_msg "" /begin OUT_MEASUREMENT TTSCD_tTnk TTSCD_tTnkLin TTSCD_uRaw /end OUT_MEASUREMENT /end FUNCTION
/begin FUNCTION tvacd "Drosselklappensteller Komponententreiber"
 /begin DEF_CHARACTERISTIC TVACD_DebExcTempDef_C TVACD_DebExcTempOk_C TVACD_DebNoLoadDef_C TVACD_DebNoLoadOk_C TVACD_DebNplstErrDef_C TVACD_DebNplstErrOk_C TVACD_DebShortCircBatDef_C TVACD_DebShortCircBatOk_C TVACD_DebShortCircGndDef_C TVACD_DebShortCircGndOk_C TVACD_DebSigstErrDef_C TVACD_DebSigstErrOk_C TVACD_stInvOut_C TVACD_tiPer_C TVACD_rCnv_CUR TVACD_rOutMax_C TVACD_rOutMin_C TVACD_rTst_C TVACD_stDigInInvStLine_C TVACD_stPwrStgActv_C TVACD_stPwrStgDia_C TVACD_swtDigInPresent_C TVACD_swt_C TVACD_tiBtwTst_C TVACD_tiDebRst_C TVACD_tiHigh_C TVACD_tiLow_C /end DEF_CHARACTERISTIC
 /begin IN_MEASUREMENT AirCtl_rTVA /end IN_MEASUREMENT
/end FUNCTION
/begin FUNCTION tvacd_msg "" /begin OUT_MEASUREMENT TVACD_rOut TVACD_st TVACD_stLine /end OUT_MEASUREMENT /end FUNCTION
/begin FUNCTION tvacd_uic "" /begin OUT_MEASUREMENT TVACD_rCnv_mp /end OUT_MEASUREMENT /end FUNCTION
/begin FUNCTION uacc "Benutzerzugriffsfunktionen"
 /begin DEF_CHARACTERISTIC K2RDI_DiaNum_C K2RDI_SWPartNum_C UAcc_FactoryId_C UAcc_Manufacturer_Ver_C UAcc_Production_Group_HW_C UAcc_Production_Group_SW_C UAcc_SortCode_HW_C UAcc_SortCode_SW_C UAcc_swtCodRcy_C UAcc_TypeTestNum_C UAcc_vCodRcyMax_C /end DEF_CHARACTERISTIC
/end FUNCTION
/begin FUNCTION uacc_adjval "Motorspezifische Abgleichwerte (KW2000)"
 /begin DEF_CHARACTERISTIC Uacc_AdjValK2SigBlkVal_MAP Uacc_AdjValOffset_C Uacc_AdjValScale_C Uacc_AdjValTesterLength_C /end DEF_CHARACTERISTIC
 /begin IN_MEASUREMENT AdjVal_actRout_mp AdjVal_dispx_mp /end IN_MEASUREMENT
/end FUNCTION
/begin FUNCTION uacc_adjval_uic "" /begin OUT_MEASUREMENT AdjVal_actRout_mp AdjVal_dispx_mp /end OUT_MEASUREMENT /end FUNCTION
/begin FUNCTION uacc_eopd "Eingabe von Prozessdaten"
 /begin DEF_CHARACTERISTIC Uacc_EOPDFormat_C Uacc_EOPDK2SigBlkVal_MAP Uacc_EOPDTesterLength_C /end DEF_CHARACTERISTIC
 /begin IN_MEASUREMENT EOPD_actRout_mp EOPD_dispx_mp /end IN_MEASUREMENT
/end FUNCTION
/begin FUNCTION uacc_eopd_uic "" /begin OUT_MEASUREMENT EOPD_actRout_mp EOPD_dispx_mp /end OUT_MEASUREMENT /end FUNCTION
/begin FUNCTION uacc_evalsigblk "Auswertung eines Meßwerteblocks"
 /begin DEF_CHARACTERISTIC UACC_ESBFormular_C UACC_ESBNormVal_C UACC_ESBSigNr_C Uacc_stCANText_CA Uacc_stTOMskRxMsg_CA Uacc_stTOMskUsrMsg_CA /end DEF_CHARACTERISTIC
/end FUNCTION
/begin FUNCTION uacc_funccode "Funktionscodierung mittels Servicetester"
 /begin DEF_CHARACTERISTIC UAcc_ACCodePos_C UAcc_ESPCodePos_C UAcc_VehVelCodePos_C UAcc_WIVCodePos_C /end DEF_CHARACTERISTIC
/end FUNCTION
/begin FUNCTION uacc_funccode_msg ""
 /begin OUT_MEASUREMENT UAcc_stFuncCodePresent UAcc_swtFuncCodeAC UAcc_swtFuncCodeESP UAcc_swtFuncCodeVehVel UAcc_swtFuncCodeWIV /end OUT_MEASUREMENT
/end FUNCTION
/begin FUNCTION uacc_funccode_uic "" /end FUNCTION
/begin FUNCTION uacc_logreq "Loginfunktion zum Freischalten und Sperren von Steuergerätezusatzfunktionen"
 /begin DEF_CHARACTERISTIC UAcc_LogReqAddPmpFirst_C UAcc_LogReqAddPmpTest_C UAcc_LogReqPWAAGAct_C UAcc_LogReqPWAAGdeAct_C UAcc_LogReqPWACCAct_C UAcc_LogReqPWAirCtlOff_C UAcc_LogReqPWCrCtlAct_C UAcc_LogReqPWCrCtldeAct_C UAcc_LogReqPWDSMRdyAcc_C UAcc_LogReqPWFlPpCDAct_C UAcc_LogReqPWFlPpCDdeAct_C UAcc_LogReqPWFMARst_C UAcc_LogReqPWMxSpdResetdeAct_C /end DEF_CHARACTERISTIC
/end FUNCTION
/begin FUNCTION uacc_rsignalblock "Lesen eines Meßwerteblocks" /begin DEF_CHARACTERISTIC UACC_RSigBlkGrp_MAP /end DEF_CHARACTERISTIC /begin IN_MEASUREMENT EngM_numCyl /end IN_MEASUREMENT /end FUNCTION
/begin FUNCTION uaddr "" /begin DEF_CHARACTERISTIC UAddr_stCalibration_C /end DEF_CHARACTERISTIC /end FUNCTION
/begin FUNCTION ukey_custom "Passwort zur Freischaltung der Anpassungskanäle" /begin DEF_CHARACTERISTIC UKey_stAdjChan_CA UKey_stPassWD_C UKey_UpLoadPassWD_C /end DEF_CHARACTERISTIC /begin IN_MEASUREMENT UKey_stNumCannel_mp UKey_stNumPassWD_mp /end IN_MEASUREMENT /end FUNCTION
/begin FUNCTION ukey_custom_uic "" /begin OUT_MEASUREMENT UKey_stNumCannel_mp UKey_stNumPassWD_mp /end OUT_MEASUREMENT /end FUNCTION
/begin FUNCTION usap "Datensatzvarianten Bezeichner"
 /begin DEF_CHARACTERISTIC USAp_dCodeTblInv_C USAp_dCodeTbl_C USAp_dDatasetType_C USAp_numFuncCodeBits_C /end DEF_CHARACTERISTIC
/end FUNCTION
/begin FUNCTION usap_msg "" /begin OUT_MEASUREMENT USAp_numFuncCodeBits USAp_stFuncCode /end OUT_MEASUREMENT /end FUNCTION
/begin FUNCTION variant_conf "" /end FUNCTION
/begin FUNCTION vehda "Fahrzeuggrößen"
 /begin DEF_CHARACTERISTIC VehDa_lStore_C VehDa_nThres_C VehDa_qThres_C VehDa_rVnMax_C VehDa_tiNPT1_C VehDa_tiStore_C VehDa_tiVnPT1_C /end DEF_CHARACTERISTIC
/end FUNCTION
/begin FUNCTION vehda_lsum_uic ""
 /begin OUT_MEASUREMENT VehDa_AdjVal_lSum_mp VehDa_AdjVal_stSum_mp VehDa_vSum_mp VehDa_vThres_mp /end OUT_MEASUREMENT
/end FUNCTION
/begin FUNCTION vehda_msg ""
 /begin OUT_MEASUREMENT VehDa_lSum VehDa_rVn VehDa_stSum VehDa_stTrqDem VehDa_tiEngOn /end OUT_MEASUREMENT
/end FUNCTION
/begin FUNCTION vehda_tiengon_uic "" /begin OUT_MEASUREMENT VehDa_AdjVal_tiEngOn_mp VehDa_PerCnt_mp /end OUT_MEASUREMENT /end FUNCTION
/begin FUNCTION vehda_uic "" /begin OUT_MEASUREMENT VehDa_nEngFilt_mp /end OUT_MEASUREMENT /end FUNCTION
/begin FUNCTION vehmot "Fahrzeugbewegung" /end FUNCTION
/begin FUNCTION vehmot_msg "" /begin OUT_MEASUREMENT VehMot_nMax VehMot_nMin VehMot_pwrAcsDes VehMot_pwrAcsLead /end OUT_MEASUREMENT /end FUNCTION
/begin FUNCTION vesgov_governor "Arbeitsdrehzahlregler" /end FUNCTION
/begin FUNCTION vesgov_governor_msg "" /begin OUT_MEASUREMENT VESGov_trq /end OUT_MEASUREMENT /end FUNCTION
/begin FUNCTION vesgov_governor_uic "" /end FUNCTION
/begin FUNCTION vsacd "Drallniveausteller Komponententreiber"
 /begin DEF_CHARACTERISTIC VSACD_DebExcTempDef_C VSACD_DebExcTempOk_C VSACD_DebNoLoadDef_C VSACD_DebNoLoadOk_C VSACD_DebShortCircBatDef_C VSACD_DebShortCircBatOk_C VSACD_DebShortCircGndDef_C VSACD_DebShortCircGndOk_C VSACD_stInvOut_C VSACD_tiPer_C VSACD_rCnv1_CUR VSACD_rCnv2_CUR VSACD_rErrDflVal_C VSACD_rLrnLMS_C VSACD_rLrnUMS_C VSACD_rOutMax_C VSACD_rOutMin_C VSACD_rTst_C VSACD_rVSAOff_C VSACD_stPwrStgActv_C VSACD_stPwrStgDia_C VSACD_swtBattCor_C VSACD_swtVSAInv_C VSACD_tiBtwTst_C /end DEF_CHARACTERISTIC
 /begin IN_MEASUREMENT VSA_rVSA1 VSA_rVSA2 /end IN_MEASUREMENT
/end FUNCTION
/begin FUNCTION vsacd_msg "" /begin OUT_MEASUREMENT VSACD_rOut1 VSACD_rOut2 /end OUT_MEASUREMENT /end FUNCTION
/begin FUNCTION vsacd_uic "" /begin OUT_MEASUREMENT VSACD_rCnv1_mp VSACD_rCnv2_mp /end OUT_MEASUREMENT /end FUNCTION
/begin FUNCTION vsacd_var "" /end FUNCTION
/begin FUNCTION vsascd "Analogwertverarbeitung des Drallniveausteller-Sensors"
 /begin DEF_CHARACTERISTIC VSASCD_DebRngErrDef_C VSASCD_DebRngErrOk_C VSASCD_DebMaxPeriodDef_C VSASCD_DebMaxPeriodOk_C VSASCD_DebMaxDef_C VSASCD_DebMaxOk_C VSASCD_DebMinPeriodDef_C VSASCD_DebMinPeriodOk_C VSASCD_DebMinDef_C VSASCD_DebMinOk_C VSASCD_stPwmInInv_C VSASCD_tiPwmInMinPer_C VSASCD_tiPwmInMaxPer_C VSASCD_dcycPwmInMin_C VSASCD_dcycPwmInMax_C VSASCD_rDevTempExcMax_C VSASCD_rDevTempExcMin_C VSASCD_rLinDcyc1_CUR VSASCD_rLinDcyc2_CUR VSASCD_rLMSLrnDefMax_C VSASCD_rLMSLrnDefMin_C VSASCD_rLMSLrnOkMax_C VSASCD_rLMSLrnOkMin_C VSASCD_rPWMDefMax_C VSASCD_rPWMDefMin_C VSASCD_rUMSLrnDefMax_C VSASCD_rUMSLrnDefMin_C VSASCD_rUMSLrnOkMax_C VSASCD_rUMSLrnOkMin_C VSASCD_rVSAMax_C VSASCD_rVSAMin_C /end DEF_CHARACTERISTIC
 /begin IN_MEASUREMENT VSASCD_dcycIn1 VSASCD_dcycIn2 /end IN_MEASUREMENT
/end FUNCTION
/begin FUNCTION vsascd_msg ""
 /begin OUT_MEASUREMENT VSASCD_dcycIn1 VSASCD_dcycIn2 VSASCD_rIn1 VSASCD_rIn2 VSASCD_st1 VSASCD_st2 /end OUT_MEASUREMENT
/end FUNCTION
/begin FUNCTION vsascd_uic ""
 /begin OUT_MEASUREMENT VSASCD_stErr1_mp VSASCD_stErr2_mp VSASCD_tiActPer1_mp VSASCD_tiActPer2_mp /end OUT_MEASUREMENT
/end FUNCTION
/begin FUNCTION vsa_co "Stellerkoordinator für Drallnivieausteller"
 /begin DEF_CHARACTERISTIC VSA_DebErrLrnLMSDef_C VSA_DebErrLrnLMSOk_C VSA_DebErrLrnUMSDef_C VSA_DebErrLrnUMSOk_C VSA_DebErrPWMDef_C VSA_DebErrPWMOk_C VSA_DebExcSensTempDef_C VSA_DebExcSensTempOk_C /end DEF_CHARACTERISTIC
/end FUNCTION
/begin FUNCTION vsa_co_msg "" /begin OUT_MEASUREMENT VSA_dcycIn VSA_rVSA1 VSA_rVSA2 VSA_stVSA1 VSA_stVSA2 /end OUT_MEASUREMENT /end FUNCTION
/begin FUNCTION vsa_co_uic ""
 /begin DEF_CHARACTERISTIC VSA_rVSA1_Vector VSA_rVSA1_Channel VSA_rVSA2_Vector VSA_rVSA2_Channel /end DEF_CHARACTERISTIC
 /begin OUT_MEASUREMENT VSA_rVSAByp1_mp VSA_rVSAByp2_mp VSA_stErrHdl1_mp VSA_stErrHdl2_mp /end OUT_MEASUREMENT
/end FUNCTION
/begin FUNCTION vsa_var "" /end FUNCTION
/begin FUNCTION vsscd_co "Fahrgeschwindigkeitsgeber Komponententreiber"
 /begin DEF_CHARACTERISTIC VSSCD_DebBrkLowVltgDef_C VSSCD_DebBrkLowVltgOk_C VSSCD_DebCanMsgSigDef_C VSSCD_DebCanMsgSigOk_C VSSCD_DebCanSigDef_C VSSCD_DebCanSigOk_C VSSCD_DebMaxDef_C VSSCD_DebMaxOk_C VSSCD_DebPlaDef_C VSSCD_DebPlaOk_C VSSCD_DebSigDef_C VSSCD_DebSigOk_C VSSCD_DebPlausDef_C VSSCD_DebPlausOk_C VSSCD_nThresPla_C VSSCD_numSegSens_C VSSCD_qThresPla_C VSSCD_swtSigVal_C VSSCD_swtSigType_C VSSCD_tiAPT1_C VSSCD_tiPlausOvrRun_C VSSCD_tiVPT1_C VSSCD_vDfl_C VSSCD_vMax_C VSSCD_vMin_C VSSCD_vRawMin_C VSSCD_vThresPla_C /end DEF_CHARACTERISTIC
/end FUNCTION
/begin FUNCTION vsscd_co_distfac "" /begin DEF_CHARACTERISTIC VSSCD_ImpPerDist_C /end DEF_CHARACTERISTIC /end FUNCTION
/begin FUNCTION vsscd_co_distfac_uic "" /end FUNCTION
/begin FUNCTION vsscd_co_uic "" /end FUNCTION
/begin FUNCTION vsscd_co_var "" /end FUNCTION
/begin FUNCTION vsscd_co_var_msg "" /begin OUT_MEASUREMENT VSSCD_ctImp VSSCD_tiPerAvrgFilt /end OUT_MEASUREMENT /end FUNCTION
/begin FUNCTION vsscd_co_var_uic "" /end FUNCTION
/begin FUNCTION vsscd_filt_uic "" /end FUNCTION
/begin FUNCTION vsscd_msg ""
 /begin OUT_MEASUREMENT VSSCD_a VSSCD_aRaw VSSCD_stErrPwm VSSCD_swtSig VSSCD_v VSSCD_vCarb1 VSSCD_vRaw /end OUT_MEASUREMENT
/end FUNCTION
/begin FUNCTION wdcom "Frage-Antwort-Kommunikation mit Überwachungsmodul" /begin DEF_CHARACTERISTIC Chiste_stEnaTst_C /end DEF_CHARACTERISTIC
 /begin OUT_MEASUREMENT WDCom_ErrorCntForSPI_u8 WDCom_ErrorCntForUC_u8 WDCom_ErrorCntForWD_u8 /end OUT_MEASUREMENT
/end FUNCTION
/begin FUNCTION wdcom_msg ""
 /begin OUT_MEASUREMENT WDCom_dChisteResponse_u32 WDCom_dErrorCountForCntler_u8 WDCom_dErrorCountForWD_u8 WDCom_dRequest_u32 /end OUT_MEASUREMENT
/end FUNCTION
/begin FUNCTION zfc_cldcmbcham "" /begin DEF_CHARACTERISTIC ZFC_tiCldCham_CUR ZFC_tiHotCham_C /end DEF_CHARACTERISTIC /begin IN_MEASUREMENT IATSCD_tAir /end IN_MEASUREMENT /end FUNCTION
/begin FUNCTION zfc_cldcmbcham_msg "" /begin OUT_MEASUREMENT ZFC_stCldCham /end OUT_MEASUREMENT /end FUNCTION
/begin FUNCTION zfc_cldcmbcham_uic "" /begin OUT_MEASUREMENT ZFC_stCmbCham_mp /end OUT_MEASUREMENT /end FUNCTION
/begin FUNCTION zfc_co ""
 /begin DEF_CHARACTERISTIC ZFC_nAvrgMax_C ZFC_nAvrgMin_C ZFC_nHyst_C ZFC_numRatETClb_C ZFC_numRatNVClb_C ZFC_stGearRls_CA ZFC_swtClbActvVal_C ZFC_swtClbActvType_C ZFC_tAirThres_C ZFC_tEngThres_C ZFC_tFuelThresMax_C ZFC_tFuelThresMin_C ZFC_tiDelOvrRun_C ZFC_tiDelpRailLim_C ZFC_uBattMin_C /end DEF_CHARACTERISTIC
/end FUNCTION
/begin FUNCTION zfc_co_uic ""
 /begin OUT_MEASUREMENT ZFC_dpRailLim_mp ZFC_dpRail_mp ZFC_pRailSetPoint_mp ZFC_stDem_mp ZFC_st_mp ZFC_vStopClb_mp /end OUT_MEASUREMENT
/end FUNCTION
/begin FUNCTION zfc_evalengspd "" /begin OUT_MEASUREMENT ZFC_Sig_mp /end OUT_MEASUREMENT /end FUNCTION
/begin FUNCTION zfc_evalengspd_uic "" /begin OUT_MEASUREMENT ZFC_SigThres_mp ZFC_stEvalSig_mp /end OUT_MEASUREMENT /end FUNCTION
/begin FUNCTION zfc_inj "Einspritzberechnung der Nullmengenkalibrierung" /begin DEF_CHARACTERISTIC ZFC_phiSet_CUR /end DEF_CHARACTERISTIC /begin IN_MEASUREMENT Eng_nAvrg /end IN_MEASUREMENT /end FUNCTION
/begin FUNCTION zfc_inj_uic "" /begin OUT_MEASUREMENT ZFC_numCylInj_mp ZFC_phiInj_mp ZFC_stInj_mp ZFC_tiET_mp /end OUT_MEASUREMENT /end FUNCTION
/begin FUNCTION zfc_msg "" /begin OUT_MEASUREMENT ZFC_swtClbActv /end OUT_MEASUREMENT /end FUNCTION
/begin FUNCTION _pa_branchtab "" /end FUNCTION
/begin COMPU_METHOD Acc "Fahrzeugbeschleunigung" RAT_FUNC "%6.5" "[m/s^2]" COEFFS 0 1000 0 0 0 1 /end COMPU_METHOD
/begin COMPU_METHOD AngleCrS "Winkel Kurbelwelle" RAT_FUNC "%6.4" "[deg CrS]" COEFFS 0 42.6666666666667 0 0 0 1 /end COMPU_METHOD
/begin COMPU_METHOD Dist1 "Umrechnungsformel für Strecke in km" RAT_FUNC "%6.0" "[km]" COEFFS 0 0.002 0 0 0 1 /end COMPU_METHOD
/begin COMPU_METHOD DtyCyc "Tastverhaeltnis" RAT_FUNC "%6.4" "[%]" COEFFS 0 100 0 0 0 1 /end COMPU_METHOD
/begin COMPU_METHOD EngN "Motordrehzahl" RAT_FUNC "%6.2" "[rpm]" COEFFS 0 1 0 0 0 1 /end COMPU_METHOD
/begin COMPU_METHOD Fact1 "Faktor mit Auflösung 0,01 (100 mal höherer Bereich als Fact)" RAT_FUNC "%6.4" "[-]" COEFFS 0 128 0 0 0 1 /end COMPU_METHOD
/begin COMPU_METHOD FactHigh "Faktor mit Auflösung 1/4096, hauptsächlich für einen Faktorenbereich 0.1...10 verwendet" RAT_FUNC "%7.6" "[-]" COEFFS 0 10000 0 0 0 1 /end COMPU_METHOD
/begin COMPU_METHOD Fact_WearSoot "Umrechnung für Ruß/Verschleißerfassungsfaktor" RAT_FUNC "%6.3" "[-]" COEFFS 0 10 0 0 0 1 /end COMPU_METHOD
/begin COMPU_METHOD Fact_WearSootIdx "Umrechnung für Ruß/Verschleißäquivalent" RAT_FUNC "%10.9" "[-]" COEFFS 0 50000000 0 0 0 1 /end COMPU_METHOD
/begin COMPU_METHOD GlwCtl_Time_ms "zur Zeitumrechnung von um den Faktor 10 größeren Zeiten als Time_ms" RAT_FUNC "%6.0" "[ms]" COEFFS 0 0.01 0 0 0 1 /end COMPU_METHOD
/begin COMPU_METHOD InjMass "Einspritzmenge" RAT_FUNC "%6.4" "[mg/hub]" COEFFS 0 100 0 0 0 1 /end COMPU_METHOD
/begin COMPU_METHOD InjMassCyc "Einspritzmenge pro Zyklus (mg/Zyklus)" RAT_FUNC "%6.4" "[mg/cyc]" COEFFS 0 100 0 0 0 1 /end COMPU_METHOD
/begin COMPU_METHOD InjTime_us "Zeit in Microsekunden für das Einspritztiming" RAT_FUNC "%6.2" "[us]" COEFFS 0 1 0 0 0 1 /end COMPU_METHOD
/begin COMPU_METHOD Length "Länge in Meter" RAT_FUNC "%6.2" "[m]" COEFFS 0 1 0 0 0 1 /end COMPU_METHOD
/begin COMPU_METHOD Length1_mm "Umrechnungsformel für Länge in mm" RAT_FUNC "%6.4" "[mm]" COEFFS 0 500 0 0 0 1 /end COMPU_METHOD
/begin COMPU_METHOD OneToOne "eins zu eins (physikalischer Wert ist gleich dem internen Wert)" RAT_FUNC "%6.2" "[-]" COEFFS 0 1 0 0 0 1 /end COMPU_METHOD
/begin COMPU_METHOD Period "Periodendauer" RAT_FUNC "%6.3" "[ms]" COEFFS 0 10 0 0 0 1 /end COMPU_METHOD
/begin COMPU_METHOD Period_ms "Periodendauer in ms" RAT_FUNC "%6.3" "[ms]" COEFFS 0 10 0 0 0 1 /end COMPU_METHOD
/begin COMPU_METHOD Prc "Prozent, gleiche interne Auflösung wie Fact, aber Darstellung in Prozent (0...100%)" RAT_FUNC "%6.4" "[%]" COEFFS 0 100 0 0 0 1 /end COMPU_METHOD
/begin COMPU_METHOD Pres_Rail "Raildruck in hPa" RAT_FUNC "%6.0" "[hPa]" COEFFS 0 0.01 0 0 0 1 /end COMPU_METHOD
/begin COMPU_METHOD Pwr "Leistung" RAT_FUNC "%6.2" "[W]" COEFFS 0 0.10610329539459 0 0 0 1 /end COMPU_METHOD
/begin COMPU_METHOD RatVolLength1 "Umrechnungsformel für Liter/mm" RAT_FUNC "%6.4" "[ml/mm]" COEFFS 0 128 0 0 0 1 /end COMPU_METHOD
/begin COMPU_METHOD RmpTemp "Rampengradient für Temperatur" RAT_FUNC "%6.4" "[deg C/s]" COEFFS 0 655.36 0 0 0 1 /end COMPU_METHOD
/begin COMPU_METHOD RmpTrq "Rampengradient für Motormoment" RAT_FUNC "%6.4" "[Nm/s]" COEFFS 0 655.36 0 0 0 1 /end COMPU_METHOD
/begin COMPU_METHOD RmpVoltBatt "Rampengradient für Batteriespannung" RAT_FUNC "%6.3" "[mV/s]" COEFFS 0 3.22602867866423 0 0 0 1 /end COMPU_METHOD
/begin COMPU_METHOD SigTstName "Verbale Umrechnung für Stellertest Referenz Nummern" TAB_VERB "%6.3" "[-]" COMPU_TAB_REF SigTstName /end COMPU_METHOD
/begin COMPU_VTAB SigTstName "Verbale Umrechnung für Stellertest Referenz Nummern" TAB_VERB 29 0 "SigTst_AC" 1 "SigTst_ADP" 2 "SigTst_AOHtCDHt1" 3 "SigTst_AOHtCDHt2" 4 "SigTst_AltRLYExc" 5 "SigTst_BPA" 6 "SigTst_CtAp" 7 "SigTst_CtT" 8 "SigTst_EGR" 9 "SigTst_EGRClgBypVlv" 10 "SigTst_ENGMENG" 11 "SigTst_ENGMGEAR" 12 "SigTst_Fan1" 13 "SigTst_Fan2" 14 "SigTst_FlPpCD" 15 "SigTst_GLWLAMP" 16 "SigTst_GLWRLY" 17 "SigTst_LSUCDHt0" 18 "SigTst_MILLAMP" 19 "SigTst_MeUn" 20 "SigTst_PCV" 21 "SigTst_PFltRLYHtg" 22 "SigTst_PSP" 23 "SigTst_SYSLAMP" 24 "SigTst_StrtCDRLYOffRly" 25 "SigTst_StrtCDRLYOnRly" 26 "SigTst_TVA" 27 "SigTst_VSA" 255 "SigTst_unused" /end COMPU_VTAB
/begin COMPU_METHOD Temp_Cels "Temperatur dargestellt in °C (gleiche interne Darstellung wie Temp_Kelv)" RAT_FUNC "%6.1" "[deg C]" COEFFS 0 10 2731.4 0 0 1 /end COMPU_METHOD
/begin COMPU_METHOD TimeDeb "Entprellzeit in Millisekunden für Libraryfunktion Debounce" RAT_FUNC "%6.1" "[ms]" COEFFS 0 0.1 0 0 0 1 /end COMPU_METHOD
/begin COMPU_METHOD TimeDelay_s "Zeitkonstante T1 (in s) für PT1, DT1, etc." RAT_FUNC "%9.3" "[s]" COEFFS 0 0 1 0 0.00023283064365387 0 /end COMPU_METHOD
/begin COMPU_METHOD TimeEngOn "Motorbetriebszeit in Sekunden" RAT_FUNC "%6.2" "[s]" COEFFS 0 1 0 0 0 1 /end COMPU_METHOD
/begin COMPU_METHOD TimeUSResolution "Zeit in Mikrosekunden für TPU Zeiten, Auflösung 1 us" RAT_FUNC "%6.2" "[us]" COEFFS 0 1 0 0 0 1 /end COMPU_METHOD
/begin COMPU_METHOD Time_ms "Zeit in ms für Fehlerentprellung (DSM) und SW-Timer" RAT_FUNC "%6.1" "[ms]" COEFFS 0 0.1 0 0 0 1 /end COMPU_METHOD
/begin COMPU_METHOD Time_PwmHigh "Periodenzeit von der HWE (Tio_PwmGetAvrg)" RAT_FUNC "%6.3" "[us]" COEFFS 0 10 0 0 0 1 /end COMPU_METHOD
/begin COMPU_METHOD Time_RtmLowRes "Zeit mit niedriger Auflösung für Laufzeitmessung" RAT_FUNC "%6.3" "[ms]" COEFFS 0 10 0 0 0 1 /end COMPU_METHOD
/begin COMPU_METHOD Time_s "Zeit in s für Fehlerentprellung (DSM) und SW-Timer" RAT_FUNC "%6.4" "[s]" COEFFS 0 100 0 0 0 1 /end COMPU_METHOD
/begin COMPU_METHOD TrnvrsAcc "Umrechnung für Querbeschleunigung" RAT_FUNC "%6.4" "[g]" COEFFS 0 100 0 0 0 1 /end COMPU_METHOD
/begin COMPU_METHOD Trq "Motormoment" RAT_FUNC "%6.3" "[Nm]" COEFFS 0 10 0 0 0 1 /end COMPU_METHOD
/begin COMPU_METHOD TrqPrpDT "zeitlich aufintegriertes Vortriebsmoment" RAT_FUNC "%6.2" "[Nm*s]" COEFFS 0 0.2 0 0 0 1 /end COMPU_METHOD
/begin COMPU_METHOD Vel "Fahrzeuggeschwindigkeit, gleiche interne Auflösung wie Vel_SI" RAT_FUNC "%6.4" "[km/h]" COEFFS 0 100 0 0 0 1 /end COMPU_METHOD
/begin COMPU_METHOD Vel2TrqPrp "Umwandlung von Fahrgeschwindigkeit zu Vortriebsmoment" RAT_FUNC "%6.4" "[Nm/(km/h)]" COEFFS 0 81.92 0 0 0 1 /end COMPU_METHOD
/begin COMPU_METHOD VelToN "Verhältnis Fahrzeuggeschwindigkeit zu Motordrehzahl v/n" RAT_FUNC "%8.7" "[(km/h)/rpm]" COEFFS 0 100000 0 0 0 1 /end COMPU_METHOD
/begin COMPU_METHOD Vel_SI "Fahrzeuggeschwindigkeit (in m/s)" RAT_FUNC "%6.4" "[m/s]" COEFFS 0 360 0 0 0 1 /end COMPU_METHOD
/begin COMPU_METHOD VlvVel "AGR Ventilgeschwindigkeit" RAT_FUNC "%6.3" "%/s" COEFFS 0 10 0 0 0 1 /end COMPU_METHOD
/begin COMPU_METHOD volFillLvl_ml "Umrechnungsformel für Volumen in ml" RAT_FUNC "%6.2" "[ml]" COEFFS 0 1 0 0 0 1 /end COMPU_METHOD
/begin COMPU_METHOD Volt "Spannung in V (von ADC)" RAT_FUNC "%6.2" "[mV]" COEFFS 0 0.2046 0 0 0 1 /end COMPU_METHOD
/begin COMPU_METHOD Volt_Batt "Batteriespannung" RAT_FUNC "%6.1" "[mV]" COEFFS 0 0.0492252911173131 0 0 0 1 /end COMPU_METHOD
/begin COMPU_METHOD Volt_Batt_PerSec_20ms "Batteriespannung (mit Aufweitungsfaktor) pro Sekunde (für 20ms Task) - [(du/dt) mV/s]" RAT_FUNC "%6.1" "[mV/s]" COEFFS 0 0.0984505822346261 0 0 0 1 /end COMPU_METHOD
/begin COMPU_METHOD VSS_DistFac "Streckenfaktor für FGG" RAT_FUNC "%20.2" "[Imp/m]" COEFFS 0 0 1 0 2.77777777777778e-10 0 /end COMPU_METHOD
/begin COMPU_METHOD ZFC_EvalEngSpd_Rslt "Umrechnung für das Ergebniss der Drehzahlsignalauswertung" TAB_VERB "%6.3" "-" COMPU_TAB_REF ZFC_EvalEngSpd_Rslt /end COMPU_METHOD
/begin COMPU_VTAB ZFC_EvalEngSpd_Rslt "Umrechnung für das Ergebniss der Drehzahlsignalauswertung" TAB_VERB 3 0 "ZFC_ST_ALL_INJ_LOW" 1 "ZFC_ST_DES_INJ_MAX" 2 "ZFC_ST_ERR_INJ_MAX" /end COMPU_VTAB
/begin COMPU_METHOD ZFC_Inj_State "Umrechnung für die Ausgabe des Zustandsautomaten für die Einspritzung der Nullmengenkalibrierung" TAB_VERB "%6.3" "-" COMPU_TAB_REF ZFC_Inj_State /end COMPU_METHOD
/begin COMPU_VTAB ZFC_Inj_State "Umrechnung für die Ausgabe des Zustandsautomaten für die Einspritzung der Nullmengenkalibrierung" TAB_VERB 5 0 "ZFC_ST_INJ_IDLE" 16 "ZFC_ST_INJ_DEM" 32 "ZFC_ST_INJ_PROG" 48 "ZFC_ST_INJ_RES_OK" 64 "ZFC_ST_INJ_RES_NOK" /end COMPU_VTAB
/begin COMPU_METHOD ZFC_State "Umrechnung für Ausgabe des Nullmengenkalibrierung Statuses" TAB_VERB "%6.3" "-" COMPU_TAB_REF ZFC_State /end COMPU_METHOD
/begin COMPU_VTAB ZFC_State "Umrechnung für Ausgabe des Nullmengenkalibrierung Statuses" TAB_VERB 8 1 "ZFC_ST_BREAK" 2 "ZFC_ST_WAIT" 3 "ZFC_ST_START_OVRRUN" 4 "ZFC_ST_CHANGE_PRAIL" 5 "ZFC_ST_CHECK_PRAIL" 6 "ZFC_ST_ETCLB" 7 "ZFC_ST_NVCLB" 16 "ZFC_ST_SUBS_FUNC" /end COMPU_VTAB
/begin COMPU_METHOD defaultAscii "" RAT_FUNC "%6.2" "" COEFFS 0 1 0 0 0 1 /end COMPU_METHOD
/begin RECORD_LAYOUT Kf_Xs16_Ys16_Ws16 NO_AXIS_PTS_X 1 SWORD NO_AXIS_PTS_Y 2 SWORD AXIS_PTS_X 3 SWORD INDEX_INCR DIRECT AXIS_PTS_Y 4 SWORD INDEX_INCR DIRECT FNC_VALUES 5 SWORD COLUMN_DIR DIRECT /end RECORD_LAYOUT
/begin RECORD_LAYOUT Kf_Xu8_Yu8_Wu8 NO_AXIS_PTS_X 1 UBYTE NO_AXIS_PTS_Y 2 UBYTE AXIS_PTS_X 3 UBYTE INDEX_INCR DIRECT AXIS_PTS_Y 4 UBYTE INDEX_INCR DIRECT FNC_VALUES 5 UBYTE COLUMN_DIR DIRECT /end RECORD_LAYOUT
/begin RECORD_LAYOUT Kl_Xs16_Ws16 NO_AXIS_PTS_X 1 SWORD AXIS_PTS_X 2 SWORD INDEX_INCR DIRECT FNC_VALUES 3 SWORD COLUMN_DIR DIRECT /end RECORD_LAYOUT
/begin RECORD_LAYOUT Ktx FNC_VALUES 1 UBYTE COLUMN_DIR DIRECT /end RECORD_LAYOUT
/begin RECORD_LAYOUT Kwb_Ws16 FNC_VALUES 1 SWORD COLUMN_DIR DIRECT /end RECORD_LAYOUT
/begin RECORD_LAYOUT Kwb_Wu16 FNC_VALUES 1 UWORD COLUMN_DIR DIRECT /end RECORD_LAYOUT
/begin RECORD_LAYOUT Kwb_Wu32 FNC_VALUES 1 ULONG COLUMN_DIR DIRECT /end RECORD_LAYOUT
/begin RECORD_LAYOUT Kwb_Wu8 FNC_VALUES 1 UBYTE COLUMN_DIR DIRECT /end RECORD_LAYOUT
/begin RECORD_LAYOUT Kw_Ws16 FNC_VALUES 1 SWORD COLUMN_DIR DIRECT /end RECORD_LAYOUT
/begin RECORD_LAYOUT Kw_Ws32 FNC_VALUES 1 SLONG COLUMN_DIR DIRECT /end RECORD_LAYOUT
/begin RECORD_LAYOUT Kw_Wu16 FNC_VALUES 1 UWORD COLUMN_DIR DIRECT /end RECORD_LAYOUT
/begin RECORD_LAYOUT Kw_Wu32 FNC_VALUES 1 ULONG COLUMN_DIR DIRECT /end RECORD_LAYOUT
/begin RECORD_LAYOUT Kw_Wu8 FNC_VALUES 1 UBYTE COLUMN_DIR DIRECT /end RECORD_LAYOUT
/end MODULE
/end PROJECT
