ASAP2_VERSION 1 3
/begin PROJECT C177 "EDC16CP"
/begin HEADER "" VERSION "VCP7A3" PROJECT_NO C177 /end HEADER
/begin MODULE DIM ""
/begin MOD_COMMON "" BYTE_ORDER MSB_FIRST ALIGNMENT_BYTE 1 ALIGNMENT_WORD 2 ALIGNMENT_LONG 4 ALIGNMENT_FLOAT32_IEEE 4 /end MOD_COMMON
/begin CHARACTERISTIC ExeMon_stEnaTst_C "Schalter zum Testen der Programmablaufkontrolle" VALUE 0x1C1284 Kw_Wu8 255.0 OneToOne 0.00 255.0 FORMAT "%5.1" /end CHARACTERISTIC
/begin CHARACTERISTIC OTSCD_uSRCMin_C "Minimalwert für SRC OTF-Sensor" VALUE 0x1DF9E0 Kw_Ws16 5200.391 Volt 0.00 5200.391 FORMAT "%8.3" EXTENDED_LIMITS -160156.4 160151.5 /end CHARACTERISTIC
/begin CHARACTERISTIC OTSCD_uSRCMax_C "Maximalwert für SRC OTF-Sensor" VALUE 0x1DF9E2 Kw_Ws16 5200.391 Volt 0.00 5200.391 FORMAT "%8.3" EXTENDED_LIMITS -160156.4 160151.5 /end CHARACTERISTIC
/begin CHARACTERISTIC OTSCD_tLin_CUR "Linearisierungskennlinie für OTF-Sensor" CURVE 0x1DF9E4 Kl_Xs16_Ws16 250.0000 Temp_Cels -50.04000 199.9600 FORMAT "%8.4" EXTENDED_LIMITS -3549.940 3003.560
 /begin AXIS_DESCR STD_AXIS OTSCD_uRaw Volt 25 0.00 5200.391 FORMAT "%8.3" EXTENDED_LIMITS -160156.4 160151.5 DEPOSIT ABSOLUTE /end AXIS_DESCR
/end CHARACTERISTIC
/begin CHARACTERISTIC OTSCD_DebCanDefDef_C "Fehlerentprellung  Öltemperatursensor defekt über CAN" VALUE 0x1DFA4A Kw_Wu16 655350.0 Time_ms 0.00 655350.0 FORMAT "%8.1" /end CHARACTERISTIC
/begin CHARACTERISTIC OTSCD_DebCanDefOk_C "Heilungsentprellung  Öltemperatursensor defekt über CAN" VALUE 0x1DFA4C Kw_Wu16 655350.0 Time_ms 0.00 655350.0 FORMAT "%8.1" /end CHARACTERISTIC
/begin CHARACTERISTIC OTSCD_DebCanInacDef_C "Fehlerentprellung  Öltemperatursensor ungenau über CAN" VALUE 0x1DFA4E Kw_Wu16 655350.0 Time_ms 0.00 655350.0 FORMAT "%8.1" /end CHARACTERISTIC
/begin CHARACTERISTIC OTSCD_DebCanInacOk_C "Heilungsentprellung  Öltemperatursensor ungenau über CAN" VALUE 0x1DFA50 Kw_Wu16 655350.0 Time_ms 0.00 655350.0 FORMAT "%8.1" /end CHARACTERISTIC
/begin CHARACTERISTIC OTSCD_DebCanNotImplDef_C "Fehlerentprellung  Öltemperatursensor nicht verbaut über CAN" VALUE 0x1DFA52 Kw_Wu16 655350.0 Time_ms 0.00 655350.0 FORMAT "%8.1" /end CHARACTERISTIC
/begin CHARACTERISTIC OTSCD_DebCanNotImplOk_C "Heilungsentprellung  Öltemperatursensor nicht verbaut über CAN" VALUE 0x1DFA54 Kw_Wu16 655350.0 Time_ms 0.00 655350.0 FORMAT "%8.1" /end CHARACTERISTIC
/begin CHARACTERISTIC OTSCD_DebNplDef_C "OTS Fehlerentprellzeit fuer Plausibilitaet" VALUE 0x1DFA56 Kw_Wu16 655350.0 Time_ms 0.00 655350.0 FORMAT "%8.1" /end CHARACTERISTIC
/begin CHARACTERISTIC OTSCD_DebNplOk_C "OTS Heilungsentprellzeit fuer Plausibilitaet" VALUE 0x1DFA58 Kw_Wu16 655350.0 Time_ms 0.00 655350.0 FORMAT "%8.1" /end CHARACTERISTIC
/begin CHARACTERISTIC OTSCD_DebSRCHighDef_C "OTS Fehlerentprellzeit fuer SRC-High" VALUE 0x1DFA5A Kw_Wu16 655350.0 Time_ms 0.00 655350.0 FORMAT "%8.1" /end CHARACTERISTIC
/begin CHARACTERISTIC OTSCD_DebSRCHighOk_C "OTS Heilungsentprellzeit fuer SRC-High" VALUE 0x1DFA5C Kw_Wu16 655350.0 Time_ms 0.00 655350.0 FORMAT "%8.1" /end CHARACTERISTIC
/begin CHARACTERISTIC OTSCD_DebSRCLowDef_C "OTS Fehlerentprellzeit fuer SRC-Low" VALUE 0x1DFA5E Kw_Wu16 655350.0 Time_ms 0.00 655350.0 FORMAT "%8.1" /end CHARACTERISTIC
/begin CHARACTERISTIC OTSCD_DebSRCLowOk_C "OTS Heilungsentprellzeit fuer SRC-Low" VALUE 0x1DFA60 Kw_Wu16 655350.0 Time_ms 0.00 655350.0 FORMAT "%8.1" /end CHARACTERISTIC
/begin CHARACTERISTIC OTSCD_tiStrtOilClntPlaus_C "Zeit nach Start für Plausibilitätsprüfung OTF mit WTF" VALUE 0x1DFA64 Kw_Wu32 42949672.9500 Time_s 0.00 42949672.9500 FORMAT "%13.4" /end CHARACTERISTIC
/begin CHARACTERISTIC OTSCD_tiDelOilClntPlaus_C "Verzögerungszeit für Plausibilitätsprüfung OTF mit WTF" VALUE 0x1DFA68 Kw_Wu32 42949672.9500 Time_s 0.00 42949672.9500 FORMAT "%13.4" /end CHARACTERISTIC
/begin CHARACTERISTIC OTSCD_tThresOilClntPlaus_C "Schwelle für Plausibilitätsprüfung OTF mit WTF" VALUE 0x1DFA6C Kw_Ws16 6553.500 Temp_Cels -3549.940 3003.560 FORMAT "%8.3" /end CHARACTERISTIC
/begin CHARACTERISTIC OTSCD_tLimOilClntPlaus_C "Plausibilitaets-Fehlergrenze fuer die Oeltemperatur" VALUE 0x1DFA6E Kw_Ws16 6553.500 Temp_Cels -3549.940 3003.560 FORMAT "%8.3" /end CHARACTERISTIC
/begin CHARACTERISTIC OTSCD_dtRmpSlpUp_C "Rampensteigung bei Heilung/Vorgabewert für OTF" VALUE 0x1DFA70 Kw_Wu32 6553599.99847 RmpTemp 0.00 6553599.99847 FORMAT "%13.5" /end CHARACTERISTIC
/begin CHARACTERISTIC OTSCD_dtRmpSlpDwn_C "Rampensteigung bei Heilung/Vorgabewert für OTF" VALUE 0x1DFA74 Kw_Wu32 6553599.99847 RmpTemp 0.00 6553599.99847 FORMAT "%13.5" /end CHARACTERISTIC
/begin CHARACTERISTIC OTSCD_swtDflVal_C "SW- Schalter zur Auswahl des Ersatzwerts aus der Apllikation oder dem Modell" VALUE 0x1DFA80 Kw_Wu8 255.0 OneToOne 0.00 255.0 FORMAT "%5.1" /end CHARACTERISTIC
/begin CHARACTERISTIC OTSCD_swtSigVal_C "Schalterwert, Signal von ADC/CAN" VALUE 0x1DFA78 Kw_Wu8 1.000 OneToOne 0.00 1.000 FORMAT "%5.3" EXTENDED_LIMITS 0.00 255.0 /end CHARACTERISTIC
/begin CHARACTERISTIC OTSCD_swtSigType_C "Softwareschaltertype" VALUE 0x1DFA79 Kw_Wu8 0.00 OneToOne 2.000 2.000 FORMAT "%5.3" EXTENDED_LIMITS 0.00 255.0 /end CHARACTERISTIC
/begin CHARACTERISTIC OTSCD_tClntThres_C "Kühlmitteltemperaturschwellwert,bei welchem der Ersatzwert aus dem Modell genommen wird" VALUE 0x1DFA82 Kw_Ws16 250.0000 Temp_Cels -50.04000 199.9600 FORMAT "%8.4" EXTENDED_LIMITS -3549.940 3003.560 /end CHARACTERISTIC
/begin CHARACTERISTIC OTSCD_tDflWIV_C "Öltemperatur Vorgabewert für WIV3" VALUE 0x1DFA84 Kw_Ws16 250.0000 Temp_Cels -50.04000 199.9600 FORMAT "%8.4" EXTENDED_LIMITS -3549.940 3003.560 /end CHARACTERISTIC
/begin CHARACTERISTIC OTSCD_tFlCnsmpCor_CUR "Kennlinie zur Korrektur des Öltemperaturersatzwerts aus der verbrauchten Kraftstoffmenge" CURVE 0x1DFA86 Kl_Xs16_Ws16 250.0000 TempDiff_Kelv -50.00000 200.0000 FORMAT "%8.4" EXTENDED_LIMITS -3276.800 3276.700
 /begin AXIS_DESCR STD_AXIS CoEng_dvolFlConsumFlt FlConsum_l_h 5 0.00 327.6700 FORMAT "%8.4" EXTENDED_LIMITS -327.6800 327.6700 DEPOSIT ABSOLUTE /end AXIS_DESCR
/end CHARACTERISTIC
/begin CHARACTERISTIC OTSCD_tIATSCor_CUR "Kennlinie zur Korrektur des Öltemperaturersatzwerts aus IATS" CURVE 0x1DFA9C Kl_Xs16_Ws16 250.0000 TempDiff_Kelv -50.00000 200.0000 FORMAT "%8.4" EXTENDED_LIMITS -3276.800 3276.700
 /begin AXIS_DESCR STD_AXIS IATSCD_tAir Temp_Cels 5 -50.14000 199.8600 FORMAT "%8.4" EXTENDED_LIMITS -3549.940 3003.560 DEPOSIT ABSOLUTE /end AXIS_DESCR
/end CHARACTERISTIC
/begin CHARACTERISTIC OTSCD_tiOilMax_C "Maximalgrenzwert der Öltemperatur - Zeit" VALUE 0x1DFAB2 Kw_Wu16 8191.875 Time_HighRes 0.00 8191.875 FORMAT "%8.3" /end CHARACTERISTIC
/begin CHARACTERISTIC OTSCD_tiOilMin_C "Minimalgrenzwert der Öltemperatur - Zeit" VALUE 0x1DFAB4 Kw_Wu16 8191.875 Time_HighRes 0.00 8191.875 FORMAT "%8.3" /end CHARACTERISTIC
/begin CHARACTERISTIC OTSCD_tiPlausWIV_C "Zeit während der die Öltemperaturzeit - Plausibilisierung ausgeblendet wird" VALUE 0x1DFAB6 Kw_Wu16 655350.0 Time_ms 0.00 655350.0 FORMAT "%8.1" /end CHARACTERISTIC
/begin CHARACTERISTIC OTSCD_tOil_CUR "Kennlinie für die Öltemperatur über die Öltemperaturzeit" CURVE 0x1DFAB8 Kl_Xs16_Ws16 190.0000 Temp_Cels -40.04000 149.9600 FORMAT "%8.4" EXTENDED_LIMITS -3549.940 3003.560
 /begin AXIS_DESCR STD_AXIS FrmMng_tiTOSOilT Time_HighRes 13 0.00 127.0000 FORMAT "%8.4" EXTENDED_LIMITS 0.00 8191.875 DEPOSIT ABSOLUTE /end AXIS_DESCR
/end CHARACTERISTIC
/begin CHARACTERISTIC OTSCD_stSensIDWord_C "Geberkennwort OTF-Sensor" VALUE 0x1DFA7A Kw_Wu16 65535.00 OneToOne 0.00 65535.00 FORMAT "%8.2" /end CHARACTERISTIC
/begin CHARACTERISTIC OTSCD_tDfl_C "Öltemperatur Vorgabewert" VALUE 0x1DFA7C Kw_Ws16 250.0000 Temp_Cels -50.04000 199.9600 FORMAT "%8.4" EXTENDED_LIMITS -3549.940 3003.560 /end CHARACTERISTIC
/begin CHARACTERISTIC OvRMon_aMaxCrCtlP_C "Maximalwert für die Verzögerung bei der Cruise Control Plus Monitoring Funktion" VALUE 0x1C1360 Kw_Ws16 65.53500 Acc -32.76800 32.76700 FORMAT "%8.5" /end CHARACTERISTIC
/begin CHARACTERISTIC OvRMon_ctCrCtlPDwn_C "Abwärtszählschrittweite für die Cruise Control Plus Monitoring Funktion" VALUE 0x1C1362 Kw_Wu8 192.0 OneToOne 0.00 192.0 FORMAT "%5.1" EXTENDED_LIMITS 0.00 255.0 /end CHARACTERISTIC
/begin CHARACTERISTIC OvRMon_ctCrCtlPUp_C "Aufwärtszählschrittweite für die Cruise Control Plus Monitoring Funktion" VALUE 0x1C1363 Kw_Wu8 48.00 OneToOne 0.00 48.00 FORMAT "%5.2" EXTENDED_LIMITS 0.00 255.0 /end CHARACTERISTIC
/begin CHARACTERISTIC OvRMon_ctEngSpdGrad_C "Zähler zum Erkennen eines positiven Drehzahlgradients" VALUE 0x1C135A Kw_Ws16 65535.00 OneToOne -32768.00 32767.00 FORMAT "%8.2" /end CHARACTERISTIC
/begin CHARACTERISTIC OvRMon_ctQInjDefDwn_C "Defektfehlerzähler für die Schubüberwachung" VALUE 0x1C1285 Kw_Wu8 192.0 OneToOne 0.00 192.0 FORMAT "%5.1" EXTENDED_LIMITS 0.00 255.0 /end CHARACTERISTIC
/begin CHARACTERISTIC OvRMon_ctQInjDefUp_C "Zähler" VALUE 0x1C1286 Kw_Wu8 48.00 OneToOne 0.00 48.00 FORMAT "%5.2" EXTENDED_LIMITS 0.00 255.0 /end CHARACTERISTIC
/begin CHARACTERISTIC OvRMon_DebCrCtlPDef_C "Fehlerzählerabschaltwert für die Cruise Control Plus Monitoring Funktion" VALUE 0x1C1364 Kw_Wu16 65535.00 OneToOne 0.00 65535.00 FORMAT "%8.2" /end CHARACTERISTIC
/begin CHARACTERISTIC OvRMon_DebQInjDef_C "Fehlerentprellzeit bei Menge größer Schwelle" VALUE 0x1C1288 Kw_Wu16 65535.00 OneToOne 0.00 65535.00 FORMAT "%8.2" /end CHARACTERISTIC
/begin CHARACTERISTIC OvRMon_DebSigA0Def_C "Defekterkennungszeit für Drehzahlplausibilisierung in Schubüberwachung" VALUE 0x1C1380 Kw_Wu16 655350.0 TimeDeb 0.00 655350.0 FORMAT "%8.1" /end CHARACTERISTIC
/begin CHARACTERISTIC OvRMon_duBattJit_C "Glättungsparameter für die redundant eingelesene Batteriespannung" VALUE 0x1C1396 Kw_Ws16 5200.579 Volt_Batt 0.00 5200.579 FORMAT "%8.3" EXTENDED_LIMITS -665674.1 665653.8 /end CHARACTERISTIC
/begin CHARACTERISTIC OvRMon_duBrkJit_C "Glättungsparameter des redundant eingelesenen Hauptbremsschalters" VALUE 0x1C1370 Kw_Ws16 5200.391 Volt 0.00 5200.391 FORMAT "%8.3" EXTENDED_LIMITS -160156.4 160151.5 /end CHARACTERISTIC
/begin CHARACTERISTIC OvRMon_facBattCor_CUR "Kennfeld für die Berechnung des redundant eingelesenen Batteriespannungskorrekturfaktors" CURVE 0x1C1398 Kl_Xs16_Ws16 1.600098 Fact 0.1999512 1.800049 FORMAT "%8.6" EXTENDED_LIMITS -4.000000 3.999878
 /begin AXIS_DESCR STD_AXIS OvRMon_uBatt_mp Volt_Batt 4 0.00 20010.04 FORMAT "%8.2" EXTENDED_LIMITS -665674.1 665653.8 DEPOSIT ABSOLUTE /end AXIS_DESCR
/end CHARACTERISTIC
/begin CHARACTERISTIC OvRMon_facInjEff_MAP "Wirkungsfaktorkennfeld in der Schubüberwachung" MAP 0x1C13B6 Kf_Xs16_Ys16_Ws16 1.000000 Fact 0.00 1.000000 FORMAT "%8.6" EXTENDED_LIMITS -4.000000 3.999878
 /begin AXIS_DESCR STD_AXIS Eng_nAvrg EngN 16 0.00 6000.000 FORMAT "%8.3" EXTENDED_LIMITS -32768.00 32767.00 DEPOSIT ABSOLUTE /end AXIS_DESCR
 /begin AXIS_DESCR STD_AXIS OvRMon_phiInjAct_mp AngleCrS 16 -720.0000 720.0000 FORMAT "%8.4" EXTENDED_LIMITS -768.0000 767.9766 DEPOSIT ABSOLUTE /end AXIS_DESCR
/end CHARACTERISTIC
/begin CHARACTERISTIC OvRMon_nDiffMaxHi_C "maximale Drehzahlabweichung bei hohen Drehzahlen" VALUE 0x1C1382 Kw_Ws16 5960.000 EngN 40.00000 6000.000 FORMAT "%8.3" EXTENDED_LIMITS -32768.00 32767.00 /end CHARACTERISTIC
/begin CHARACTERISTIC OvRMon_nDiffMaxLo_C "maximale Drehzahlabweichung bei niedrigen Drehzahlen" VALUE 0x1C1384 Kw_Ws16 5960.000 EngN 40.00000 6000.000 FORMAT "%8.3" EXTENDED_LIMITS -32768.00 32767.00 /end CHARACTERISTIC
/begin CHARACTERISTIC OvRMon_nDiffThres_C "Drehzahlschwelle für maximale Drehzahldifferenz" VALUE 0x1C1386 Kw_Ws16 5960.000 EngN 40.00000 6000.000 FORMAT "%8.3" EXTENDED_LIMITS -32768.00 32767.00 /end CHARACTERISTIC
/begin CHARACTERISTIC OvRMon_nLIGovLim_C "Grenze Kurbelwellen Drehzahl für aktive Leerlaufregler Überwachung" VALUE 0x1C135C Kw_Ws16 6000.000 EngN 0.00 6000.000 FORMAT "%8.3" EXTENDED_LIMITS -32768.00 32767.00 /end CHARACTERISTIC
/begin CHARACTERISTIC OvRMon_nMon_C "Drehzahlschwelle für Überwachung aktiv" VALUE 0x1C128A Kw_Ws16 6000.000 EngN 0.00 6000.000 FORMAT "%8.3" EXTENDED_LIMITS -32768.00 32767.00 /end CHARACTERISTIC
/begin CHARACTERISTIC OvRMon_nSegMax_C "Ersatzwert für Segmentdrehzahl bei Unterschreitung der Mindestsegmentdauer" VALUE 0x1C1388 Kw_Ws16 5960.000 EngN 40.00000 6000.000 FORMAT "%8.3" EXTENDED_LIMITS -32768.00 32767.00 /end CHARACTERISTIC
/begin CHARACTERISTIC OvRMon_nSegMin_C "Mindestdrehzahl zur Aktivierung der Drehzahlplausibilisierung" VALUE 0x1C138A Kw_Ws16 5960.000 EngN 40.00000 6000.000 FORMAT "%8.3" EXTENDED_LIMITS -32768.00 32767.00 /end CHARACTERISTIC
/begin CHARACTERISTIC OvRMon_nStSysLim_C "Grenze Kurbelwellen Drehzahl für aktive Startsystem Überwachung" VALUE 0x1C128E Kw_Ws16 6000.000 EngN 0.00 6000.000 FORMAT "%8.3" EXTENDED_LIMITS -32768.00 32767.00 /end CHARACTERISTIC
/begin CHARACTERISTIC OvRMon_numCyl_C "Zylinderzahl in der Schubüberwachung" VALUE 0x1C128C Kw_Wu8 254.0 OneToOne 1.000 255.0 FORMAT "%5.1" EXTENDED_LIMITS 0.00 255.0 /end CHARACTERISTIC
/begin CHARACTERISTIC OvRMon_qLimEnh_CUR "erweiterte Schubkennlinie für Schubüberwachung (Mengenbasierend)" CURVE 0x1C12D2 Kl_Xs16_Ws16 50.00000 InjMass 0.00 50.00000 FORMAT "%8.5" EXTENDED_LIMITS -327.6800 327.6700
 /begin AXIS_DESCR STD_AXIS Eng_nAvrg EngN 25 0.00 6000.000 FORMAT "%8.3" EXTENDED_LIMITS -32768.00 32767.00 DEPOSIT ABSOLUTE /end AXIS_DESCR
/end CHARACTERISTIC
/begin CHARACTERISTIC OvRMon_rHighLimLowIdle_C "Obere Schwelle für gefiltertes Fahrpedalsignal" VALUE 0x1C1338 Kw_Ws16 100.0000 Prc 0.00 100.0000 FORMAT "%8.4" EXTENDED_LIMITS -327.6800 327.6700 /end CHARACTERISTIC
/begin CHARACTERISTIC OvRMon_stIntrInit_C "Kennung für Interruptstatus" VALUE 0x1C138C Kw_Wu8 255.0 OneToOne 0.00 255.0 FORMAT "%5.1" /end CHARACTERISTIC
/begin CHARACTERISTIC OvRMon_stInvLowIdle_C "Invertierung Leergasschalter (0: gleich  1: invertiert)" VALUE 0x1C133A Kw_Wu8 1.000 OneToOne 0.00 1.000 FORMAT "%5.3" EXTENDED_LIMITS 0.00 255.0 /end CHARACTERISTIC
/begin CHARACTERISTIC OvRMon_swtAST_C "Schalter für die Aktivierung des erhöhenden Getriebe3 - Eingriffs in der Ebene2" VALUE 0x1C13B2 Kw_Wu8 255.0 OneToOne 0.00 255.0 FORMAT "%5.1" /end CHARACTERISTIC
/begin CHARACTERISTIC OvRMon_swtEnaConv_C "Schalter zum aktivieren / deaktivieren der Aktiverungsbedingung Kupplung für die Schubüberwachung" VALUE 0x1C128D Kw_Wu8 255.0 OneToOne 0.00 255.0 FORMAT "%5.1" /end CHARACTERISTIC
/begin CHARACTERISTIC OvRMon_swtTSC3Ena_C "Schalter für die Aktivierung der Getriebe3 - Botschaft" VALUE 0x1C13B3 Kw_Wu8 255.0 OneToOne 0.00 255.0 FORMAT "%5.1" /end CHARACTERISTIC
/begin CHARACTERISTIC OvRMon_tiAPP1Flt_C "Wartezeit Fahrpedalfilterung, Führungsformung in der Schubüberwachung" VALUE 0x1C133C Kw_Wu16 655350.0 TimeDeb 0.00 655350.0 FORMAT "%8.1" /end CHARACTERISTIC
/begin CHARACTERISTIC OvRMon_tiAPPNpl_C "Verzögerungszeit für das Statusbit 2 der Plausibilitätsprüfung in der Schubüberwachung" VALUE 0x1C133E Kw_Wu16 655350.0 TimeDeb 0.00 655350.0 FORMAT "%8.1" /end CHARACTERISTIC
/begin CHARACTERISTIC OvRMon_tiDebACCActv_C "Entprellzeit adaptive Distanzregelungl high -> low" VALUE 0x1C1394 Kw_Wu16 655350.0 TimeDeb 0.00 655350.0 FORMAT "%8.1" /end CHARACTERISTIC
/begin CHARACTERISTIC OvRMon_tiDebAstAccsActv_C "Aktiv-Entprellzeit für AST Eingriff" VALUE 0x1C13B4 Kw_Wu16 655350.0 TimeDeb 0.00 655350.0 FORMAT "%8.1" /end CHARACTERISTIC
/begin CHARACTERISTIC OvRMon_tiDebBattSRCDef_C "Defektentprellzeit  SRC-Fehler redundant eingelesene Batteriespannung" VALUE 0x1C13AA Kw_Wu8 10200. Time_ms_40ms 0.00 10200. FORMAT "%5.0" /end CHARACTERISTIC
/begin CHARACTERISTIC OvRMon_tiDebBattSRCOk_C "Heilungsentprellzeit SRC Fehler der redundant eingelesenen Batteriespannung" VALUE 0x1C13AB Kw_Wu8 10200. Time_ms_40ms 0.00 10200. FORMAT "%5.0" /end CHARACTERISTIC
/begin CHARACTERISTIC OvRMon_tiDebBrkSRCDef_C "Defektentprellzeit für SRC-Fehler des redundant eingelesenen Hauptbremsschalters" VALUE 0x1C1372 Kw_Wu8 10200. Time_ms_40ms 0.00 10200. FORMAT "%5.0" /end CHARACTERISTIC
/begin CHARACTERISTIC OvRMon_tiDebBrkSRCOk_C "Heilungsentprellzeit bei SRC-Fehler des redundant eingelesenen Hauptbremsschalters" VALUE 0x1C1373 Kw_Wu8 10200. Time_ms_40ms 0.00 10200. FORMAT "%5.0" /end CHARACTERISTIC
/begin CHARACTERISTIC OvRMon_tiDebBrk_C "Entprellzeit für redundante Erfassung des Bremssignals" VALUE 0x1C1374 Kw_Wu8 10200. Time_ms_40ms 0.00 10200. FORMAT "%5.0" /end CHARACTERISTIC
/begin CHARACTERISTIC OvRMon_tiDebConv_C "Entprellzeit für redundante Erfassung des Kupplungssignals" VALUE 0x1C137C Kw_Wu8 10200. Time_ms_40ms 0.00 10200. FORMAT "%5.0" /end CHARACTERISTIC
/begin CHARACTERISTIC OvRMon_tiDebCrCtlActv_C "Entprellzeit Cruise Control low -> high" VALUE 0x1C135E Kw_Wu16 655350.0 TimeDeb 0.00 655350.0 FORMAT "%8.1" /end CHARACTERISTIC
/begin CHARACTERISTIC OvRMon_tiDebCrCtlPone_C "Entprellzeit für die Überwachung der Abschaltbedingung "" Allgemeine Überwachung"" für die Cruise Control Plus Monitoring Funktion" VALUE 0x1C1366 Kw_Wu16 655350.0 TimeDeb 0.00 655350.0 FORMAT "%8.1" /end CHARACTERISTIC
/begin CHARACTERISTIC OvRMon_tiDebCrCtlPtwo_C "Entprellzeit für die Überwachung der Abschaltbedingung "" Überreiten"" für die Cruise Control Plus Monitoring Funktion" VALUE 0x1C1368 Kw_Wu16 655350.0 TimeDeb 0.00 655350.0 FORMAT "%8.1" /end CHARACTERISTIC
/begin CHARACTERISTIC OvRMon_tiDebDrvActv_C "Einschaltverzögerung der ARD-SR Überwachung nach Schub" VALUE 0x1C1356 Kw_Wu16 655350.0 TimeDeb 0.00 655350.0 FORMAT "%8.1" /end CHARACTERISTIC
/begin CHARACTERISTIC OvRMon_tiDebLowIdlActv_C "Entprellzeit für selbsteingelesenen Leergasschalter in AccPed Überwachung - Übergang in den Status ""aktiv""" VALUE 0x1C1340 Kw_Wu16 655350.0 TimeDeb 0.00 655350.0 FORMAT "%8.1" /end CHARACTERISTIC
/begin CHARACTERISTIC OvRMon_tiDebStCtlActv_C "Entprellzeit Fahrdynamik low -> high" VALUE 0x1C136E Kw_Wu16 655350.0 TimeDeb 0.00 655350.0 FORMAT "%8.1" /end CHARACTERISTIC
/begin CHARACTERISTIC OvRMon_tiErrAPP_C "Fehlerentprellzeit für Fahrpedalüberwachung" VALUE 0x1C1342 Kw_Wu8 10200. Time_ms_40ms 0.00 10200. FORMAT "%5.0" /end CHARACTERISTIC
/begin CHARACTERISTIC OvRMon_tiLimET_CUR "Zulässige mittlere momentwirksame Ansteuerdauer in der Schubüberwachung" CURVE 0x1C1290 Kl_Xs16_Ws16 3000.000 InjTime_us 0.00 3000.000 FORMAT "%8.3" EXTENDED_LIMITS -32768.00 32767.00
 /begin AXIS_DESCR STD_AXIS Eng_nAvrg EngN 16 0.00 6000.000 FORMAT "%8.3" EXTENDED_LIMITS -32768.00 32767.00 DEPOSIT ABSOLUTE /end AXIS_DESCR
/end CHARACTERISTIC
/begin CHARACTERISTIC OvRMon_tiSegMin_C "Mindestsegmentdauer für Übernahme der Segmentdrehzahl aus Systemzeit" VALUE 0x1C1390 Kw_Wu32 4294967295.00 TimeUSResolution 0.00 4294967295.00 FORMAT "%13.2" /end CHARACTERISTIC
/begin CHARACTERISTIC OvRMon_trqMonASD_C "Bedingungsschwelle für CoEng_trqSetASDdc in AccPed Überwachung" VALUE 0x1C1344 Kw_Ws16 1000.000 Trq 0.00 1000.000 FORMAT "%8.3" EXTENDED_LIMITS -3276.800 3276.700 /end CHARACTERISTIC
/begin CHARACTERISTIC OvRMon_trqThresASDdc_C "Momentenschwelle für ARD Anforderung innerhalb der Schubüberwachung" VALUE 0x1C1358 Kw_Ws16 6553.500 Trq -3276.800 3276.700 FORMAT "%8.3" /end CHARACTERISTIC
/begin CHARACTERISTIC OvRMon_uAPP1LimPS_C "Spannungsgrenze für Poti/Schalter Pedalwertgeber zur Schuberkennung" VALUE 0x1C1346 Kw_Ws16 5200.391 Volt 0.00 5200.391 FORMAT "%8.3" EXTENDED_LIMITS -160156.4 160151.5 /end CHARACTERISTIC
/begin CHARACTERISTIC OvRMon_uAPP1Lim_C "Spannungsgrenze für Überwachung Pedalwertgeber, Leergasschwelle der Überwachung" VALUE 0x1C1348 Kw_Ws16 5200.391 Volt 0.00 5200.391 FORMAT "%8.3" EXTENDED_LIMITS -160156.4 160151.5 /end CHARACTERISTIC
/begin CHARACTERISTIC OvRMon_uAPP1Thresone_C "Spannungsschwelle für Überreiten bei Poti/Schalter für die Cruise Control Plus Monitoring Funktion" VALUE 0x1C136A Kw_Ws16 320307.9 Volt -160156.4 160151.5 FORMAT "%8.1" /end CHARACTERISTIC
/begin CHARACTERISTIC OvRMon_uAPP1Threstwo_C "Spannungsschwelle für Überreiten bei Doppelanalog PWG für die Cruise Control Plus Monitoring Funktion" VALUE 0x1C136C Kw_Ws16 320307.9 Volt -160156.4 160151.5 FORMAT "%8.1" /end CHARACTERISTIC
/begin CHARACTERISTIC OvRMon_uAPPFull_C "Spannungsgrenze für Fahrpedal im Volllastbereich" VALUE 0x1C134A Kw_Ws16 5200.391 Volt 0.00 5200.391 FORMAT "%8.3" EXTENDED_LIMITS -160156.4 160151.5 /end CHARACTERISTIC
/begin CHARACTERISTIC OvRMon_uBattDfl_C "Ersatzwert für die redundant eingelesene Batteriespannung bei endgültigem SRC Fehler" VALUE 0x1C13AC Kw_Ws16 1331328. Volt_Batt -665674.1 665653.8 FORMAT "%8.1" /end CHARACTERISTIC
/begin CHARACTERISTIC OvRMon_uBattSRCMax_C "Schwelle für SRC High Fehler der redundant eingelesenen Batteriespannung" VALUE 0x1C13AE Kw_Ws16 1331328. Volt_Batt -665674.1 665653.8 FORMAT "%8.1" /end CHARACTERISTIC
/begin CHARACTERISTIC OvRMon_uBattSRCMin_C "Schwelle SRC Low Fehler der redundant eingelesenen Batteriespannung" VALUE 0x1C13B0 Kw_Ws16 1331328. Volt_Batt -665674.1 665653.8 FORMAT "%8.1" /end CHARACTERISTIC
/begin CHARACTERISTIC OvRMon_uBrkA2DThres_C "Schwelle für die Analog-Digital Umwandlung des redundant eingelesenen Hauptbremsschalters" VALUE 0x1C1376 Kw_Ws16 320307.9 Volt -160156.4 160151.5 FORMAT "%8.1" /end CHARACTERISTIC
/begin CHARACTERISTIC OvRMon_uBrkSRCMax_C "Schwelle für SRC High-Fehler des redundant eingelesenen Hauptbremsschalters" VALUE 0x1C1378 Kw_Ws16 320307.9 Volt -160156.4 160151.5 FORMAT "%8.1" /end CHARACTERISTIC
/begin CHARACTERISTIC OvRMon_uBrkSRCMin_C "Schwelle für SRC Low Fehler des redundant eingelesenen Hauptbremsschalters" VALUE 0x1C137A Kw_Ws16 320307.9 Volt -160156.4 160151.5 FORMAT "%8.1" /end CHARACTERISTIC
/begin CHARACTERISTIC OvRMon_uHighLimLowIdle_C "Plausibilitätsschwelle Leergasschalter obere Schwelle" VALUE 0x1C134C Kw_Ws16 5200.391 Volt 0.00 5200.391 FORMAT "%8.3" EXTENDED_LIMITS -160156.4 160151.5 /end CHARACTERISTIC
/begin CHARACTERISTIC OvRMon_uLowIdlSwtA2DThres_C "Spannungsschwelle für die Analog-Digital Wandlung des Leergasschalters" VALUE 0x1C134E Kw_Ws16 5200.391 Volt 0.00 5200.391 FORMAT "%8.3" EXTENDED_LIMITS -160156.4 160151.5 /end CHARACTERISTIC
/begin CHARACTERISTIC OvRMon_uLowLimLowIdle_C "Plausibilitätsschwelle Leergasschalter obere Schwelle" VALUE 0x1C1350 Kw_Ws16 5200.391 Volt 0.00 5200.391 FORMAT "%8.3" EXTENDED_LIMITS -160156.4 160151.5 /end CHARACTERISTIC
/begin CHARACTERISTIC OvRMon_uPlaWinFull_C "Plausibilitätsfenster für Fahrpedal im Volllastbereich" VALUE 0x1C1352 Kw_Ws16 5200.391 Volt 0.00 5200.391 FORMAT "%8.3" EXTENDED_LIMITS -160156.4 160151.5 /end CHARACTERISTIC
/begin CHARACTERISTIC OvRMon_uPlaWinIdle_C "Plausibilitätsfenster für Fahpedal im Leerlaufbereich" VALUE 0x1C1354 Kw_Ws16 5200.391 Volt 0.00 5200.391 FORMAT "%8.3" EXTENDED_LIMITS -160156.4 160151.5 /end CHARACTERISTIC
/begin CHARACTERISTIC OxiCCD_uSRCMinTPre_C "Minimalwert SRC-Überwachung von OxiCCD_uRawTempPre" VALUE 0x1DFAF0 Kw_Ws16 5200.391 Volt 0.00 5200.391 FORMAT "%8.3" EXTENDED_LIMITS -160156.4 160151.5 /end CHARACTERISTIC
/begin CHARACTERISTIC OxiCCD_uSRCMaxTPre_C "Maximalwert SRC-Überwachung von OxiCCD_uRawTempPre" VALUE 0x1DFAF2 Kw_Ws16 5200.391 Volt 0.00 5200.391 FORMAT "%8.3" EXTENDED_LIMITS -160156.4 160151.5 /end CHARACTERISTIC
/begin CHARACTERISTIC OxiCCD_tLinPre1_CUR "Linearisierungskennlinie für Temperatur vor Abgasturbolader[deg C]" CURVE 0x1DFAF4 Kl_Xs16_Ws16 1095.000 Temp_Cels -45.04000 1049.960 FORMAT "%8.3" EXTENDED_LIMITS -3549.940 3003.560
 /begin AXIS_DESCR STD_AXIS OxiCCD_uRawTempPre Volt 25 0.00 160151.5 FORMAT "%8.1" EXTENDED_LIMITS -160156.4 160151.5 DEPOSIT ABSOLUTE /end AXIS_DESCR
/end CHARACTERISTIC
/begin CHARACTERISTIC OxiCCD_DebSRCHighDefTPre_C "Entprellzeit für Fehlererkennung SRC-high-Fehler für Dfp_OxiCCDTPre" VALUE 0x1DFB5A Kw_Wu16 655350.0 Time_ms 0.00 655350.0 FORMAT "%8.1" /end CHARACTERISTIC
/begin CHARACTERISTIC OxiCCD_DebSRCHighOkTPre_C "Entprellzeit für Fehlerheilung SRC-high-Fehler für Dfp_OxiCCDTPre" VALUE 0x1DFB5C Kw_Wu16 655350.0 Time_ms 0.00 655350.0 FORMAT "%8.1" /end CHARACTERISTIC
/begin CHARACTERISTIC OxiCCD_DebSRCLowDefTPre_C "Entprellzeit für Fehlererkennung SRC-low-Fehler für Dfp_OxiCCDTPre" VALUE 0x1DFB5E Kw_Wu16 655350.0 Time_ms 0.00 655350.0 FORMAT "%8.1" /end CHARACTERISTIC
/begin CHARACTERISTIC OxiCCD_DebSRCLowOkTPre_C "Entprellzeit für Fehlerheilung SRC-low-Fehler für Dfp_OxiCCDTPre" VALUE 0x1DFB60 Kw_Wu16 655350.0 Time_ms 0.00 655350.0 FORMAT "%8.1" /end CHARACTERISTIC
/begin CHARACTERISTIC OxiCCD_dtRmpSlpUpPre_C "Rampensteigung aufwärts für Komponententreiber Temperatur vor Oxidationskatalysator" VALUE 0x1DFB64 Kw_Wu32 6553599.99847 RmpTemp 0.00 6553599.99847 FORMAT "%13.5" /end CHARACTERISTIC
/begin CHARACTERISTIC OxiCCD_dtRmpSlpDwnPre_C "Rampensteigung abwärts für Komponententreiber Temperatur vor Oxidationskatalysator" VALUE 0x1DFB68 Kw_Wu32 6553599.99847 RmpTemp 0.00 6553599.99847 FORMAT "%13.5" /end CHARACTERISTIC
/begin CHARACTERISTIC OxiCCD_swtActvTPre_C "  Aktivierung/Deaktivierung  des Komponententreibers für Abgastemperatur vor Oxidationskatalysator." VALUE 0x1DFB6C Kw_Wu8 1.000 OneToOne 0.00 1.000 FORMAT "%5.3" EXTENDED_LIMITS 0.00 255.0 /end CHARACTERISTIC
/begin CHARACTERISTIC OxiCCD_stSensIDWordTPre_C "Sensor ID Word für Übergangsbedingungen Temperatursensor vor Oxidationskatalysator" VALUE 0x1DFB6E Kw_Wu16 65535.00 OneToOne 0.00 65535.00 FORMAT "%8.2" /end CHARACTERISTIC
/begin CHARACTERISTIC OxiCCD_tDflPre_C "Ersatzwert Temperatur vor Oxidationskatalysator im Fehlerfall" VALUE 0x1DFB70 Kw_Ws16 1095.000 Temp_Cels -45.04000 1049.960 FORMAT "%8.3" EXTENDED_LIMITS -3549.940 3003.560 /end CHARACTERISTIC
/begin CHARACTERISTIC PCR_BalGvnrIKi_C "Grundwert der I-Verstärkung des PI-Reglers bei Kleinsignalen" VALUE 0x1DFB74 Kw_Wu32 999.999999767 Ki_TurboN2Prc 0.00 999.999999767 FORMAT "%13.9" /end CHARACTERISTIC
/begin CHARACTERISTIC PCR_BalGvnrIKiPos_C "Grundwert der I-Verstärkung des PI-Reglers bei positiven Großsignalen" VALUE 0x1DFB78 Kw_Wu32 999.999999767 Ki_TurboN2Prc 0.00 999.999999767 FORMAT "%13.9" /end CHARACTERISTIC
/begin CHARACTERISTIC PCR_BalGvnrIKiNeg_C "Grundwert der I-Verstärkung des PI-Reglers bei negativen Großsignalen" VALUE 0x1DFB7C Kw_Wu32 999.999999767 Ki_TurboN2Prc 0.00 999.999999767 FORMAT "%13.9" /end CHARACTERISTIC
/begin CHARACTERISTIC PCR_rBalGvnrIWinPos_C "Positive Kleinsignalgrenze (I- Glied) Gleichstellungsregler" VALUE 0x1DFB80 Kw_Ws16 655350.0 TurboN -327680.0 327670.0 FORMAT "%8.1" /end CHARACTERISTIC
/begin CHARACTERISTIC PCR_rBalGvnrIWinNeg_C "Negative Kleinsignalgrenze (I- Glied) Gleichstellungsregler" VALUE 0x1DFB82 Kw_Ws16 655350.0 TurboN -327680.0 327670.0 FORMAT "%8.1" /end CHARACTERISTIC
/begin CHARACTERISTIC PCR_BalGvnrPKp_C "Grundwert der P-Verstärkung des PI-Reglers bei Kleinsignalen" VALUE 0x1DFB84 Kw_Wu32 65.5359999847 Kp_TurboN2Prc 0.00 65.5359999847 FORMAT "%13.10" /end CHARACTERISTIC
/begin CHARACTERISTIC PCR_BalGvnrPKpPos_C "Grundwert der P-Verstärkung des PI-Reglers bei positiven Großsignalen" VALUE 0x1DFB88 Kw_Wu32 65.5359999847 Kp_TurboN2Prc 0.00 65.5359999847 FORMAT "%13.10" /end CHARACTERISTIC
/begin CHARACTERISTIC PCR_BalGvnrPKpNeg_C "Grundwert der P-Verstärkung des PI-Reglers bei negativen Großsignalen" VALUE 0x1DFB8C Kw_Wu32 65.5359999847 Kp_TurboN2Prc 0.00 65.5359999847 FORMAT "%13.10" /end CHARACTERISTIC
/begin CHARACTERISTIC PCR_rBalGvnrPWinPos_C "Positive Kleinsignalgrenze (P- Glied) Gleichstellungsregler" VALUE 0x1DFB90 Kw_Ws16 655350.0 TurboN -327680.0 327670.0 FORMAT "%8.1" /end CHARACTERISTIC
/begin CHARACTERISTIC PCR_rBalGvnrPWinNeg_C "Negative Kleinsignalgrenze (P- Glied) Gleichstellungsregler" VALUE 0x1DFB92 Kw_Ws16 655350.0 TurboN -327680.0 327670.0 FORMAT "%8.1" /end CHARACTERISTIC
/begin CHARACTERISTIC PCR_CoDT1Neg_C "Verzögerungszeitkonstante für Sollwertbildung bei kalten Motor für neg. Ausgangsgröße" VALUE 0x1E184C Kw_Wu32 4294.9663 TimeDelay_s 0.0010000001 4294.9673 FORMAT "%9.4" EXTENDED_LIMITS 0.0000010000000 4294.9673 /end CHARACTERISTIC
/begin CHARACTERISTIC PCR_CoDT1Pos_C "Verzögerungszeitkonstante für Sollwertbildung bei kalten Motor für pos. Ausgangsgröße" VALUE 0x1E1850 Kw_Wu32 4294.9663 TimeDelay_s 0.0010000001 4294.9673 FORMAT "%9.4" EXTENDED_LIMITS 0.0000010000000 4294.9673 /end CHARACTERISTIC
/begin CHARACTERISTIC PCR_CoDKd_C "Kleinsignalverstärkung der dynamischen Sollwertbildung bei kaltem Motor" VALUE 0x1E1854 Kw_Ws32 65535.9999847 Kd -32768.0000000 32767.9999847 FORMAT "%13.7" /end CHARACTERISTIC
/begin CHARACTERISTIC PCR_CoDKdPos_C "Positive Großsignalverstärkung der dynamischen Sollwertbildung bei kaltem Motor" VALUE 0x1E1858 Kw_Ws32 65535.9999847 Kd -32768.0000000 32767.9999847 FORMAT "%13.7" /end CHARACTERISTIC
/begin CHARACTERISTIC PCR_CoDKdNeg_C "Negative Großsignalverstärkung der dynamischen Sollwertbildung bei kaltem Motor" VALUE 0x1E185C Kw_Ws32 65535.9999847 Kd -32768.0000000 32767.9999847 FORMAT "%13.7" /end CHARACTERISTIC
/begin CHARACTERISTIC PCR_dpCoDWinPos_C "Positive Kleinsignalgrenze bei kaltem Motor" VALUE 0x1E1860 Kw_Ws16 1638350. Pres_hPaPerSec_20ms 0.00 1638350. FORMAT "%8.0" EXTENDED_LIMITS -1638400. 1638350. /end CHARACTERISTIC
/begin CHARACTERISTIC PCR_dpCoDWinNeg_C "Negative Kleinsignalgrenze bei kaltem Motor" VALUE 0x1E1862 Kw_Ws16 1638400. Pres_hPaPerSec_20ms -1638400. 0.00 FORMAT "%8.0" EXTENDED_LIMITS -1638400. 1638350. /end CHARACTERISTIC
/begin CHARACTERISTIC PCR_DebSRCHighDef_C "Defektzeit SRC-high" VALUE 0x1E3264 Kw_Wu16 655350.0 Time_ms 0.00 655350.0 FORMAT "%8.1" /end CHARACTERISTIC
/begin CHARACTERISTIC PCR_DebSRCHighOk_C "Heilungszeit SRC-high" VALUE 0x1E3266 Kw_Wu16 655350.0 Time_ms 0.00 655350.0 FORMAT "%8.1" /end CHARACTERISTIC
/begin CHARACTERISTIC PCR_DebSRCLowDef_C "Defektzeit SRC-low" VALUE 0x1E3268 Kw_Wu16 655350.0 Time_ms 0.00 655350.0 FORMAT "%8.1" /end CHARACTERISTIC
/begin CHARACTERISTIC PCR_DebSRCLowOk_C "Heilungszeit SRC-low" VALUE 0x1E326A Kw_Wu16 655350.0 Time_ms 0.00 655350.0 FORMAT "%8.1" /end CHARACTERISTIC
/begin CHARACTERISTIC PCR_DKdNeg_C "Grundwert der D-Verstärkung des PIDT1-Reglers bei negativen Großsignalen" VALUE 0x1E297C Kw_Ws32 10.0000000000 Kd_Pres_hPa2Prc 0.00 10.0000000000 FORMAT "%13.10" EXTENDED_LIMITS -327.680000000 327.679999847 /end CHARACTERISTIC
/begin CHARACTERISTIC PCR_DKdPos_C "Grundwert der D-Verstärkung des PIDT1-Reglers bei positiven Großssignalen" VALUE 0x1E2980 Kw_Ws32 10.0000000000 Kd_Pres_hPa2Prc 0.00 10.0000000000 FORMAT "%13.10" EXTENDED_LIMITS -327.680000000 327.679999847 /end CHARACTERISTIC
/begin CHARACTERISTIC PCR_DKd_C "Grundwert der D-Verstärkung des PIDT1-Reglers bei Kleinsignalen" VALUE 0x1E2984 Kw_Ws32 10.0000000000 Kd_Pres_hPa2Prc 0.00 10.0000000000 FORMAT "%13.10" EXTENDED_LIMITS -327.680000000 327.679999847 /end CHARACTERISTIC
/begin CHARACTERISTIC PCR_tiPTBPGovFlt_C "PT1 Filterkonstante der Ladergeräuschunterdrückung" VALUE 0x1E2988 Kw_Wu32 4294.9663 TimeDelay_s 0.0010000001 4294.9673 FORMAT "%9.4" EXTENDED_LIMITS 0.0000010000000 4294.9673 /end CHARACTERISTIC
/begin CHARACTERISTIC PCR_dlyPT1TrbnFlt_C "Zeitkonstante für gefilterte Laderdrehzahl" VALUE 0x1E0068 Kw_Wu32 4294.9663 TimeDelay_s 0.0010000001 4294.9673 FORMAT "%9.4" EXTENDED_LIMITS 0.0000010000000 4294.9673 /end CHARACTERISTIC
/begin CHARACTERISTIC PCR_dlyPT1_C "Zeitkonstante der Sollwertverzögerung für I-Anteil" VALUE 0x1E298C Kw_Wu32 4294.9663 TimeDelay_s 0.0010000001 4294.9673 FORMAT "%9.4" EXTENDED_LIMITS 0.0000010000000 4294.9673 /end CHARACTERISTIC
/begin CHARACTERISTIC PCR_dpMinBPGovFlt_C "Minimale zeitliche Ableitung des Ladedrucksollwertes zur Aktivierung der Ladergeräuschunterdrückung" VALUE 0x1E2990 Kw_Ws16 1638350. Pres_hPaPerSec_20ms 0.00 1638350. FORMAT "%8.0" EXTENDED_LIMITS -1638400. 1638350. /end CHARACTERISTIC
/begin CHARACTERISTIC PCR_DT1_MAP "Kennfeld für Zeitkonstante des DT1-Glieds" MAP 0x1E2992 Kf_Xs16_Ys16_Ws16 5.5824070 TimeDelay_s_2 0.0099983409 5.5924053 FORMAT "%9.7" EXTENDED_LIMITS 0.00051201563 16.777216
 /begin AXIS_DESCR STD_AXIS Eng_nAvrg EngN 10 0.00 6000.000 FORMAT "%8.3" EXTENDED_LIMITS -32768.00 32767.00 DEPOSIT ABSOLUTE /end AXIS_DESCR
 /begin AXIS_DESCR STD_AXIS InjCtl_qCurr InjMass 10 0.00 327.6700 FORMAT "%8.4" EXTENDED_LIMITS -327.6800 327.6700 DEPOSIT ABSOLUTE /end AXIS_DESCR
/end CHARACTERISTIC
/begin CHARACTERISTIC PCR_facAT_CUR "Lufttemperaturabhängiger Faktor für Sollwertbildung" CURVE 0x1E1864 Kl_Xs16_Ws16 3.000000 Fact 0.00 3.000000 FORMAT "%8.6" EXTENDED_LIMITS -4.000000 3.999878
 /begin AXIS_DESCR STD_AXIS IATSCD_tAir Temp_Cels 16 -50.14000 199.8600 FORMAT "%8.4" EXTENDED_LIMITS -3549.940 3003.560 DEPOSIT ABSOLUTE /end AXIS_DESCR
/end CHARACTERISTIC
/begin CHARACTERISTIC PCR_facBalGvnrCorr_MAP "Kennfeld fuer den multiplikativen Korrekturfaktor des BiT TV" MAP 0x1DFB94 Kf_Xs16_Ys16_Ws16 100.0000 Fact1 0.00 100.0000 FORMAT "%8.4" EXTENDED_LIMITS -256.0000 255.9922
 /begin AXIS_DESCR STD_AXIS Eng_nAvrg EngN 9 0.00 6000.000 FORMAT "%8.3" EXTENDED_LIMITS -32768.00 32767.00 DEPOSIT ABSOLUTE /end AXIS_DESCR
 /begin AXIS_DESCR STD_AXIS PCR_qDes InjMass 9 0.00 327.6700 FORMAT "%8.4" EXTENDED_LIMITS -327.6800 327.6700 DEPOSIT ABSOLUTE /end AXIS_DESCR
/end CHARACTERISTIC
/begin CHARACTERISTIC PCR_facBalGvnrI_MAP "Kennfeld für Adaptionsfaktor der I- Verstärkung Gleichstellsregler" MAP 0x1DFC5E Kf_Xs16_Ys16_Ws16 100.0000 Fact1 0.00 100.0000 FORMAT "%8.4" EXTENDED_LIMITS -256.0000 255.9922
 /begin AXIS_DESCR STD_AXIS Eng_nAvrg EngN 9 0.00 6000.000 FORMAT "%8.3" EXTENDED_LIMITS -32768.00 32767.00 DEPOSIT ABSOLUTE /end AXIS_DESCR
 /begin AXIS_DESCR STD_AXIS PCR_qDes InjMass 9 0.00 327.6700 FORMAT "%8.4" EXTENDED_LIMITS -327.6800 327.6700 DEPOSIT ABSOLUTE /end AXIS_DESCR
/end CHARACTERISTIC
/begin CHARACTERISTIC PCR_facBalGvnrP_MAP "Kennfeld für Adaptionsfaktor der P- Verstärkung Gleichstellsregler" MAP 0x1DFD28 Kf_Xs16_Ys16_Ws16 100.0000 Fact1 0.00 100.0000 FORMAT "%8.4" EXTENDED_LIMITS -256.0000 255.9922
 /begin AXIS_DESCR STD_AXIS Eng_nAvrg EngN 9 0.00 6000.000 FORMAT "%8.3" EXTENDED_LIMITS -32768.00 32767.00 DEPOSIT ABSOLUTE /end AXIS_DESCR
 /begin AXIS_DESCR STD_AXIS PCR_qDes InjMass 9 0.00 327.6700 FORMAT "%8.4" EXTENDED_LIMITS -327.6800 327.6700 DEPOSIT ABSOLUTE /end AXIS_DESCR
/end CHARACTERISTIC
/begin CHARACTERISTIC PCR_facBPAltCorr2_MAP "Normierter Druckabfall über Ladeluftkühler 2" MAP 0x1E006C Kf_Xs16_Ys16_Ws16 6.000000 Fact -3.000000 3.000000 FORMAT "%8.6" EXTENDED_LIMITS -4.000000 3.999878
 /begin AXIS_DESCR STD_AXIS IATSCD_tAir Temp_Cels 10 -50.14000 199.8600 FORMAT "%8.4" EXTENDED_LIMITS -3549.940 3003.560 DEPOSIT ABSOLUTE /end AXIS_DESCR
 /begin AXIS_DESCR STD_AXIS AFSCD_dmAirPerTime2 AirMassPerTime 10 0.00 3000.000 FORMAT "%8.3" EXTENDED_LIMITS -3276.800 3276.700 DEPOSIT ABSOLUTE /end AXIS_DESCR
/end CHARACTERISTIC
/begin CHARACTERISTIC PCR_facBPAltCorr_MAP "Normierter Druckabfall über Ladeluftkühler 1" MAP 0x1E0160 Kf_Xs16_Ys16_Ws16 6.000000 Fact -3.000000 3.000000 FORMAT "%8.6" EXTENDED_LIMITS -4.000000 3.999878
 /begin AXIS_DESCR STD_AXIS IATSCD_tAir Temp_Cels 10 -50.14000 199.8600 FORMAT "%8.4" EXTENDED_LIMITS -3549.940 3003.560 DEPOSIT ABSOLUTE /end AXIS_DESCR
 /begin AXIS_DESCR STD_AXIS AFSCD_dmAirPerTime AirMassPerTime 10 0.00 3000.000 FORMAT "%8.3" EXTENDED_LIMITS -3276.800 3276.700 DEPOSIT ABSOLUTE /end AXIS_DESCR
/end CHARACTERISTIC
/begin CHARACTERISTIC PCR_facBPrdmCorr_MAP "Korrektur über Luftmassenverhältnis von Luftstrang1 und 2" MAP 0x1E0254 Kf_Xs16_Ys16_Ws16 6.000000 Fact -3.000000 3.000000 FORMAT "%8.6" EXTENDED_LIMITS -4.000000 3.999878
 /begin AXIS_DESCR STD_AXIS AFSCD_dmAirPerTime AirMassPerTime 10 0.00 3000.000 FORMAT "%8.3" EXTENDED_LIMITS -3276.800 3276.700 DEPOSIT ABSOLUTE /end AXIS_DESCR
 /begin AXIS_DESCR STD_AXIS AFSCD_dmAirPerTime2 AirMassPerTime 10 0.00 3000.000 FORMAT "%8.3" EXTENDED_LIMITS -3276.800 3276.700 DEPOSIT ABSOLUTE /end AXIS_DESCR
/end CHARACTERISTIC
/begin CHARACTERISTIC PCR_facCtlAT_CUR "Kennlinie für lufttemperaturabhängigen Korrekturfaktor für Ladedrucksteuerung" CURVE 0x1E098C Kl_Xs16_Ws16 3.000000 Fact 0.00 3.000000 FORMAT "%8.6" EXTENDED_LIMITS -4.000000 3.999878
 /begin AXIS_DESCR STD_AXIS IATSCD_tAir Temp_Cels 25 -100.1400 199.8600 FORMAT "%8.4" EXTENDED_LIMITS -3549.940 3003.560 DEPOSIT ABSOLUTE /end AXIS_DESCR
/end CHARACTERISTIC
/begin CHARACTERISTIC PCR_facCtlRgn1_CUR "Kurve für die Berechnung der Steuergröße im Regenerationsbetrieb 1" CURVE 0x1E09F2 Kl_Xs16_Ws16 4.000000 Fact 0.00 4.000000 FORMAT "%8.6" EXTENDED_LIMITS -4.000000 3.999878
 /begin AXIS_DESCR STD_AXIS APSCD_pVal Pres_hPa 16 0.00 3500.000 FORMAT "%8.3" EXTENDED_LIMITS -32768.00 32767.00 DEPOSIT ABSOLUTE /end AXIS_DESCR
/end CHARACTERISTIC
/begin CHARACTERISTIC PCR_facCtlRgn2_CUR "Kurve für die Berechnung der Steuergröße im Regenerationsbetrieb 2" CURVE 0x1E0A34 Kl_Xs16_Ws16 4.000000 Fact 0.00 4.000000 FORMAT "%8.6" EXTENDED_LIMITS -4.000000 3.999878
 /begin AXIS_DESCR STD_AXIS APSCD_pVal Pres_hPa 16 0.00 3500.000 FORMAT "%8.3" EXTENDED_LIMITS -32768.00 32767.00 DEPOSIT ABSOLUTE /end AXIS_DESCR
/end CHARACTERISTIC
/begin CHARACTERISTIC PCR_facCtlRgn3_CUR "atmosphärendruckabhängige Steuerwertauswahl Regenerationsstufe 3" CURVE 0x1E0A76 Kl_Xs16_Ws16 4.000000 Fact 0.00 4.000000 FORMAT "%8.6" EXTENDED_LIMITS -4.000000 3.999878
 /begin AXIS_DESCR STD_AXIS APSCD_pVal Pres_hPa 16 0.00 3500.000 FORMAT "%8.3" EXTENDED_LIMITS -32768.00 32767.00 DEPOSIT ABSOLUTE /end AXIS_DESCR
/end CHARACTERISTIC
/begin CHARACTERISTIC PCR_facCtlRgn4_CUR "atmosphärendruckabhängige Steuerwertauswahl Regenerationsstufe 4" CURVE 0x1E0AB8 Kl_Xs16_Ws16 4.000000 Fact 0.00 4.000000 FORMAT "%8.6" EXTENDED_LIMITS -4.000000 3.999878
 /begin AXIS_DESCR STD_AXIS APSCD_pVal Pres_hPa 16 0.00 3500.000 FORMAT "%8.3" EXTENDED_LIMITS -32768.00 32767.00 DEPOSIT ABSOLUTE /end AXIS_DESCR
/end CHARACTERISTIC
/begin CHARACTERISTIC PCR_facCtQ_MAP "Kennfeld für Kühlwassertemperaturkorrekturfaktor de Sollwertberechnung" MAP 0x1E18A6 Kf_Xs16_Ys16_Ws16 7.999878 Fact -4.000000 3.999878 FORMAT "%8.6"
 /begin AXIS_DESCR STD_AXIS CTSCD_tClnt Temp_Cels 8 -50.14000 149.8600 FORMAT "%8.4" EXTENDED_LIMITS -3549.940 3003.560 DEPOSIT ABSOLUTE /end AXIS_DESCR
 /begin AXIS_DESCR STD_AXIS PCR_qDes InjMass 8 0.00 327.6700 FORMAT "%8.4" EXTENDED_LIMITS -327.6800 327.6700 DEPOSIT ABSOLUTE /end AXIS_DESCR
/end CHARACTERISTIC
/begin CHARACTERISTIC PCR_facDesRgn1_CUR "Kurve für die Berechnung des Luftmassensollwertes im Regenerationsbetrieb 1" CURVE 0x1E194A Kl_Xs16_Ws16 4.000000 Fact 0.00 4.000000 FORMAT "%8.6" EXTENDED_LIMITS -4.000000 3.999878
 /begin AXIS_DESCR STD_AXIS APSCD_pVal Pres_hPa 16 0.00 3500.000 FORMAT "%8.3" EXTENDED_LIMITS -32768.00 32767.00 DEPOSIT ABSOLUTE /end AXIS_DESCR
/end CHARACTERISTIC
/begin CHARACTERISTIC PCR_facDesRgn2_CUR "Kurve für die Berechnung des Luftmassensollwertes im Regenerationsbetrieb 2" CURVE 0x1E198C Kl_Xs16_Ws16 4.000000 Fact 0.00 4.000000 FORMAT "%8.6" EXTENDED_LIMITS -4.000000 3.999878
 /begin AXIS_DESCR STD_AXIS APSCD_pVal Pres_hPa 16 0.00 3500.000 FORMAT "%8.3" EXTENDED_LIMITS -32768.00 32767.00 DEPOSIT ABSOLUTE /end AXIS_DESCR
/end CHARACTERISTIC
/begin CHARACTERISTIC PCR_facDesRgn3_CUR "atmosphärendruckabhängige Sollwertauswahl Regenerationsstufe 3" CURVE 0x1E19CE Kl_Xs16_Ws16 4.000000 Fact 0.00 4.000000 FORMAT "%8.6" EXTENDED_LIMITS -4.000000 3.999878
 /begin AXIS_DESCR STD_AXIS APSCD_pVal Pres_hPa 16 0.00 3500.000 FORMAT "%8.3" EXTENDED_LIMITS -32768.00 32767.00 DEPOSIT ABSOLUTE /end AXIS_DESCR
/end CHARACTERISTIC
/begin CHARACTERISTIC PCR_facDesRgn4_CUR "atmosphärendruckabhängige Sollwertauswahl Regenerationsstufe 4" CURVE 0x1E1A10 Kl_Xs16_Ws16 4.000000 Fact 0.00 4.000000 FORMAT "%8.6" EXTENDED_LIMITS -4.000000 3.999878
 /begin AXIS_DESCR STD_AXIS APSCD_pVal Pres_hPa 16 0.00 3500.000 FORMAT "%8.3" EXTENDED_LIMITS -32768.00 32767.00 DEPOSIT ABSOLUTE /end AXIS_DESCR
/end CHARACTERISTIC
/begin CHARACTERISTIC PCR_facD_MAP "Kennfeld für Adaptionsfaktor der D-Verstärkung" MAP 0x1E2A86 Kf_Xs16_Ys16_Ws16 3.989990 Fact 0.00 3.989990 FORMAT "%8.6" EXTENDED_LIMITS -4.000000 3.999878
 /begin AXIS_DESCR STD_AXIS Eng_nAvrg EngN 10 0.00 6000.000 FORMAT "%8.3" EXTENDED_LIMITS -32768.00 32767.00 DEPOSIT ABSOLUTE /end AXIS_DESCR
 /begin AXIS_DESCR STD_AXIS InjCtl_qCurr InjMass 10 0.00 327.6700 FORMAT "%8.4" EXTENDED_LIMITS -327.6800 327.6700 DEPOSIT ABSOLUTE /end AXIS_DESCR
/end CHARACTERISTIC
/begin CHARACTERISTIC PCR_facI_MAP "Kennfeld für Adaptionsfaktor der I-Verstärkung" MAP 0x1E2B7A Kf_Xs16_Ys16_Ws16 3.989990 Fact 0.00 3.989990 FORMAT "%8.6" EXTENDED_LIMITS -4.000000 3.999878
 /begin AXIS_DESCR STD_AXIS Eng_nAvrg EngN 10 0.00 6000.000 FORMAT "%8.3" EXTENDED_LIMITS -32768.00 32767.00 DEPOSIT ABSOLUTE /end AXIS_DESCR
 /begin AXIS_DESCR STD_AXIS InjCtl_qCurr InjMass 10 0.00 327.6700 FORMAT "%8.4" EXTENDED_LIMITS -327.6800 327.6700 DEPOSIT ABSOLUTE /end AXIS_DESCR
/end CHARACTERISTIC
/begin CHARACTERISTIC PCR_facPAltCorr2_MAP "Korrekturfaktor Luftdruck für Luftmassenkorrektur zweites Luftsystem" MAP 0x1E0348 Kf_Xs16_Ys16_Ws16 6.000000 Fact -3.000000 3.000000 FORMAT "%8.6" EXTENDED_LIMITS -4.000000 3.999878
 /begin AXIS_DESCR STD_AXIS EATSCD_tAir Temp_Cels 10 -50.14000 199.8600 FORMAT "%8.4" EXTENDED_LIMITS -3549.940 3003.560 DEPOSIT ABSOLUTE /end AXIS_DESCR
 /begin AXIS_DESCR STD_AXIS AFSCD_dmAirPerTime AirMassPerTime 10 0.00 3000.000 FORMAT "%8.3" EXTENDED_LIMITS -3276.800 3276.700 DEPOSIT ABSOLUTE /end AXIS_DESCR
/end CHARACTERISTIC
/begin CHARACTERISTIC PCR_facPAltCorr_MAP "Korrekturfaktor Luftdruck für Luftmassenkorrektur erstes Luftsystem" MAP 0x1E043C Kf_Xs16_Ys16_Ws16 6.000000 Fact -3.000000 3.000000 FORMAT "%8.6" EXTENDED_LIMITS -4.000000 3.999878
 /begin AXIS_DESCR STD_AXIS EATSCD_tAir Temp_Cels 10 -50.14000 199.8600 FORMAT "%8.4" EXTENDED_LIMITS -3549.940 3003.560 DEPOSIT ABSOLUTE /end AXIS_DESCR
 /begin AXIS_DESCR STD_AXIS AFSCD_dmAirPerTime AirMassPerTime 10 0.00 3000.000 FORMAT "%8.3" EXTENDED_LIMITS -3276.800 3276.700 DEPOSIT ABSOLUTE /end AXIS_DESCR
/end CHARACTERISTIC
/begin CHARACTERISTIC PCR_facP_MAP "Kennfeld für Adaptionsfaktor der P-Verstärkung" MAP 0x1E2C6E Kf_Xs16_Ys16_Ws16 3.989990 Fact 0.00 3.989990 FORMAT "%8.6" EXTENDED_LIMITS -4.000000 3.999878
 /begin AXIS_DESCR STD_AXIS Eng_nAvrg EngN 10 0.00 6000.000 FORMAT "%8.3" EXTENDED_LIMITS -32768.00 32767.00 DEPOSIT ABSOLUTE /end AXIS_DESCR
 /begin AXIS_DESCR STD_AXIS InjCtl_qCurr InjMass 10 0.00 327.6700 FORMAT "%8.4" EXTENDED_LIMITS -327.6800 327.6700 DEPOSIT ABSOLUTE /end AXIS_DESCR
/end CHARACTERISTIC
/begin CHARACTERISTIC PCR_facTAltCorr2_CUR "Korrekturfaktor Lufttemperatur für Luftmassenkorrektur zweites Luftsystem" CURVE 0x1E0530 Kl_Xs16_Ws16 3.999878 Fact 0.00 3.999878 FORMAT "%8.6" EXTENDED_LIMITS -4.000000 3.999878
 /begin AXIS_DESCR STD_AXIS AFSCD_dmAirPerTime2 AirMassPerTime 10 0.00 3000.000 FORMAT "%8.3" EXTENDED_LIMITS -3276.800 3276.700 DEPOSIT ABSOLUTE /end AXIS_DESCR
/end CHARACTERISTIC
/begin CHARACTERISTIC PCR_facTAltCorr_CUR "Korrekturfaktor Lufttemperatur für Luftmassenkorrektur erstes Luftsystem" CURVE 0x1E055A Kl_Xs16_Ws16 3.999878 Fact 0.00 3.999878 FORMAT "%8.6" EXTENDED_LIMITS -4.000000 3.999878
 /begin AXIS_DESCR STD_AXIS AFSCD_dmAirPerTime AirMassPerTime 10 0.00 3000.000 FORMAT "%8.3" EXTENDED_LIMITS -3276.800 3276.700 DEPOSIT ABSOLUTE /end AXIS_DESCR
/end CHARACTERISTIC
/begin CHARACTERISTIC PCR_IKi_C "Grundwert der I-Verstärkung des PIDT1-Reglers bei Kleinsignalen" VALUE 0x1E2D64 Kw_Wu32 100.000000093 Ki_Pres_hPa2Prc 0.00 100.000000093 FORMAT "%13.9" EXTENDED_LIMITS 0.00 9999.99999767 /end CHARACTERISTIC
/begin CHARACTERISTIC PCR_IKiPos_C "Grundwert der I-Verstärkung des PIDT1-Reglers bei positiven Großsignalen" VALUE 0x1E2D68 Kw_Wu32 100.000000093 Ki_Pres_hPa2Prc 0.00 100.000000093 FORMAT "%13.9" EXTENDED_LIMITS 0.00 9999.99999767 /end CHARACTERISTIC
/begin CHARACTERISTIC PCR_IKiNeg_C "Grundwert der I-Verstärkung des PIDT1-Reglers bei negativen Großsignalen" VALUE 0x1E2D6C Kw_Wu32 100.000000093 Ki_Pres_hPa2Prc 0.00 100.000000093 FORMAT "%13.9" EXTENDED_LIMITS 0.00 9999.99999767 /end CHARACTERISTIC
/begin CHARACTERISTIC PCR_pIWinPos_C "Obere Kleinsignalgrenze für das I-Glied des PIDT1-Reglers" VALUE 0x1E2D70 Kw_Ws16 65535.00 Pres_hPa -32768.00 32767.00 FORMAT "%8.2" /end CHARACTERISTIC
/begin CHARACTERISTIC PCR_pIWinNeg_C "Untere Kleinsignalgrenze für das I-Glied des PIDT1-Reglers" VALUE 0x1E2D72 Kw_Ws16 65535.00 Pres_hPa -32768.00 32767.00 FORMAT "%8.2" /end CHARACTERISTIC
/begin CHARACTERISTIC PCR_kdDT1BPAlt_C "Verstärkungskonstante des DT1 Vorfilters für Drehzahlbegrenzung in großer Höhe" VALUE 0x1E0584 Kw_Ws32 4.00000000000 Kd_TurboN2Prc 0.00 4.00000000000 FORMAT "%13.11" EXTENDED_LIMITS -32.7680000000 32.7679999847 /end CHARACTERISTIC
/begin CHARACTERISTIC PCR_nBalGovDevMax_CUR "Maximal erlaubte Regelabweichung beim Laderabgleich" CURVE 0x1DFDF2 Kl_Xs16_Ws16 250000.0 TurboN 0.00 250000.0 FORMAT "%8.1" EXTENDED_LIMITS -327680.0 327670.0
 /begin AXIS_DESCR STD_AXIS Eng_nAvrg EngN 2 0.00 6000.000 FORMAT "%8.3" EXTENDED_LIMITS -32768.00 32767.00 DEPOSIT ABSOLUTE /end AXIS_DESCR
/end CHARACTERISTIC
/begin CHARACTERISTIC PCR_nCoStart_C "untere Drehzahlgrenze für Kaltstarterkennung-Vorgabewert" VALUE 0x1E326C Kw_Ws16 65535.00 EngN -32768.00 32767.00 FORMAT "%8.2" /end CHARACTERISTIC
/begin CHARACTERISTIC PCR_nPlChkMin_C "Drehzahlschwelle für Überwachung der Regelabweichung" VALUE 0x1DFDFC Kw_Ws16 6000.000 EngN 0.00 6000.000 FORMAT "%8.3" EXTENDED_LIMITS -32768.00 32767.00 /end CHARACTERISTIC
/begin CHARACTERISTIC PCR_nTrbn2_MAP "Verdichterkennfeld" MAP 0x1E0588 Kf_Xs16_Ys16_Ws16 250000.0 TurboN 0.00 250000.0 FORMAT "%8.1" EXTENDED_LIMITS -327680.0 327670.0
 /begin AXIS_DESCR STD_AXIS PCR_rBPAltCorr2_mp Prc 10 0.00 400.0000 FORMAT "%8.4" EXTENDED_LIMITS -327.6800 327.6700 DEPOSIT ABSOLUTE /end AXIS_DESCR
 /begin AXIS_DESCR STD_AXIS PCR_dmAirAltCorr2_mp AirMassPerTime 10 0.00 3000.000 FORMAT "%8.3" EXTENDED_LIMITS -3276.800 3276.700 DEPOSIT ABSOLUTE /end AXIS_DESCR
/end CHARACTERISTIC
/begin CHARACTERISTIC PCR_nTrbnLim_C "Schwelle ab der Differenzierer  aktiv wird" VALUE 0x1E067C Kw_Ws16 170000.0 TurboN 80000.00 250000.0 FORMAT "%8.1" EXTENDED_LIMITS -327680.0 327670.0 /end CHARACTERISTIC
/begin CHARACTERISTIC PCR_nTrbnMax_CUR "maximale Laderdrehzahl" CURVE 0x1E067E Kl_Xs16_Ws16 250000.0 TurboN 0.00 250000.0 FORMAT "%8.1" EXTENDED_LIMITS -327680.0 327670.0
 /begin AXIS_DESCR STD_AXIS Eng_nAvrg EngN 8 0.00 5000.000 FORMAT "%8.3" EXTENDED_LIMITS -32768.00 32767.00 DEPOSIT ABSOLUTE /end AXIS_DESCR
/end CHARACTERISTIC
/begin CHARACTERISTIC PCR_nTrbn_MAP "Verdichterkennfeld zu Ermittlung der Laderdrehzahl" MAP 0x1E06A0 Kf_Xs16_Ys16_Ws16 250000.0 TurboN 0.00 250000.0 FORMAT "%8.1" EXTENDED_LIMITS -327680.0 327670.0
 /begin AXIS_DESCR STD_AXIS PCR_rBPAltCorr_mp Prc 10 0.00 400.0000 FORMAT "%8.4" EXTENDED_LIMITS -327.6800 327.6700 DEPOSIT ABSOLUTE /end AXIS_DESCR
 /begin AXIS_DESCR STD_AXIS PCR_dmAirAltCorr_mp AirMassPerTime 10 0.00 3000.000 FORMAT "%8.3" EXTENDED_LIMITS -3276.800 3276.700 DEPOSIT ABSOLUTE /end AXIS_DESCR
/end CHARACTERISTIC
/begin CHARACTERISTIC PCR_nWrkSph1_C "obere Drehzahlgrenze des Arbeitsbereiches 1" VALUE 0x1E326E Kw_Ws16 8000.000 EngN 0.00 8000.000 FORMAT "%8.3" EXTENDED_LIMITS -32768.00 32767.00 /end CHARACTERISTIC
/begin CHARACTERISTIC PCR_nWrkSph2_C "Drehzahlgrenze zwischen den Arbeitsbereichen 2 und 3" VALUE 0x1E3270 Kw_Ws16 8000.000 EngN 0.00 8000.000 FORMAT "%8.3" EXTENDED_LIMITS -32768.00 32767.00 /end CHARACTERISTIC
/begin CHARACTERISTIC PCR_nWrkSph3_C "Drehzahlgrenze zwischen den Arbeitsbereichen 3 und 4" VALUE 0x1E3272 Kw_Ws16 8000.000 EngN 0.00 8000.000 FORMAT "%8.3" EXTENDED_LIMITS -32768.00 32767.00 /end CHARACTERISTIC
/begin CHARACTERISTIC PCR_pAirAltCorr_C "Referenz Luftdruck" VALUE 0x1E0794 Kw_Ws16 3500.000 Pres_hPa 0.00 3500.000 FORMAT "%8.3" EXTENDED_LIMITS -32768.00 32767.00 /end CHARACTERISTIC
/begin CHARACTERISTIC PCR_pAPQCmpn_MAP "Kennfeld für atmosphärendruckabhängige Kompensation für Sollwertberechnung" MAP 0x1E1A52 Kf_Xs16_Ys16_Ws16 8000.000 Pres_hPa -4000.000 4000.000 FORMAT "%8.3" EXTENDED_LIMITS -32768.00 32767.00
 /begin AXIS_DESCR STD_AXIS APSCD_pVal Pres_hPa 9 0.00 3500.000 FORMAT "%8.3" EXTENDED_LIMITS -32768.00 32767.00 DEPOSIT ABSOLUTE /end AXIS_DESCR
 /begin AXIS_DESCR STD_AXIS PCR_qDes InjMass 9 0.00 327.6700 FORMAT "%8.4" EXTENDED_LIMITS -327.6800 327.6700 DEPOSIT ABSOLUTE /end AXIS_DESCR
/end CHARACTERISTIC
/begin CHARACTERISTIC PCR_pBDesBas_MAP "Kennfeld für die Grundwertbestimmung des Ladedruckbasissollwerts" MAP 0x1E1B1C Kf_Xs16_Ys16_Ws16 4000.000 Pres_hPa 0.00 4000.000 FORMAT "%8.3" EXTENDED_LIMITS -32768.00 32767.00
 /begin AXIS_DESCR STD_AXIS Eng_nAvrg EngN 16 0.00 6000.000 FORMAT "%8.3" EXTENDED_LIMITS -32768.00 32767.00 DEPOSIT ABSOLUTE /end AXIS_DESCR
 /begin AXIS_DESCR STD_AXIS PCR_qDes InjMass 10 0.00 327.6700 FORMAT "%8.4" EXTENDED_LIMITS -327.6800 327.6700 DEPOSIT ABSOLUTE /end AXIS_DESCR
/end CHARACTERISTIC
/begin CHARACTERISTIC PCR_pBDesMaxAP_MAP "Größter erlaubter Ladedrucksollwert in Abhängigkeit vom Luftdruck" MAP 0x1E1C94 Kf_Xs16_Ys16_Ws16 4000.000 Pres_hPa 0.00 4000.000 FORMAT "%8.3" EXTENDED_LIMITS -32768.00 32767.00
 /begin AXIS_DESCR STD_AXIS Eng_nAvrg EngN 16 0.00 6000.000 FORMAT "%8.3" EXTENDED_LIMITS -32768.00 32767.00 DEPOSIT ABSOLUTE /end AXIS_DESCR
 /begin AXIS_DESCR STD_AXIS APSCD_pVal Pres_hPa 10 0.00 3500.000 FORMAT "%8.3" EXTENDED_LIMITS -32768.00 32767.00 DEPOSIT ABSOLUTE /end AXIS_DESCR
/end CHARACTERISTIC
/begin CHARACTERISTIC PCR_pBDesMax_C "Größter erlaubter Ladedrucksollwert" VALUE 0x1E1E0C Kw_Ws16 4000.000 Pres_hPa 0.00 4000.000 FORMAT "%8.3" EXTENDED_LIMITS -32768.00 32767.00 /end CHARACTERISTIC
/begin CHARACTERISTIC PCR_pBDesMin_C "Kleinster erlaubter Ladedrucksollwert" VALUE 0x1E1E0E Kw_Ws16 4000.000 Pres_hPa 0.00 4000.000 FORMAT "%8.3" EXTENDED_LIMITS -32768.00 32767.00 /end CHARACTERISTIC
/begin CHARACTERISTIC PCR_pBDesRgn1a_MAP "Kennfeld für den Sollwert A der Partikelfilterregeneration 1" MAP 0x1E1E10 Kf_Xs16_Ys16_Ws16 4000.000 Pres_hPa 0.00 4000.000 FORMAT "%8.3" EXTENDED_LIMITS -32768.00 32767.00
 /begin AXIS_DESCR STD_AXIS Eng_nAvrg EngN 10 0.00 6000.000 FORMAT "%8.3" EXTENDED_LIMITS -32768.00 32767.00 DEPOSIT ABSOLUTE /end AXIS_DESCR
 /begin AXIS_DESCR STD_AXIS PCR_qDes InjMass 10 0.00 327.6700 FORMAT "%8.4" EXTENDED_LIMITS -327.6800 327.6700 DEPOSIT ABSOLUTE /end AXIS_DESCR
/end CHARACTERISTIC
/begin CHARACTERISTIC PCR_pBDesRgn1b_MAP "Kennfeld für den Sollwert B der Partikelfilterregeneration 1" MAP 0x1E1F04 Kf_Xs16_Ys16_Ws16 4000.000 Pres_hPa 0.00 4000.000 FORMAT "%8.3" EXTENDED_LIMITS -32768.00 32767.00
 /begin AXIS_DESCR STD_AXIS Eng_nAvrg EngN 10 0.00 6000.000 FORMAT "%8.3" EXTENDED_LIMITS -32768.00 32767.00 DEPOSIT ABSOLUTE /end AXIS_DESCR
 /begin AXIS_DESCR STD_AXIS PCR_qDes InjMass 10 0.00 327.6700 FORMAT "%8.4" EXTENDED_LIMITS -327.6800 327.6700 DEPOSIT ABSOLUTE /end AXIS_DESCR
/end CHARACTERISTIC
/begin CHARACTERISTIC PCR_pBDesRgn2a_MAP "Kennfeld für den Sollwert A der Partikelfilterregeneration 2" MAP 0x1E1FF8 Kf_Xs16_Ys16_Ws16 4000.000 Pres_hPa 0.00 4000.000 FORMAT "%8.3" EXTENDED_LIMITS -32768.00 32767.00
 /begin AXIS_DESCR STD_AXIS Eng_nAvrg EngN 10 0.00 6000.000 FORMAT "%8.3" EXTENDED_LIMITS -32768.00 32767.00 DEPOSIT ABSOLUTE /end AXIS_DESCR
 /begin AXIS_DESCR STD_AXIS PCR_qDes InjMass 10 0.00 327.6700 FORMAT "%8.4" EXTENDED_LIMITS -327.6800 327.6700 DEPOSIT ABSOLUTE /end AXIS_DESCR
/end CHARACTERISTIC
/begin CHARACTERISTIC PCR_pBDesRgn2b_MAP "Kennfeld für den Sollwert B der Partikelfilterregeneration 2" MAP 0x1E20EC Kf_Xs16_Ys16_Ws16 4000.000 Pres_hPa 0.00 4000.000 FORMAT "%8.3" EXTENDED_LIMITS -32768.00 32767.00
 /begin AXIS_DESCR STD_AXIS Eng_nAvrg EngN 10 0.00 6000.000 FORMAT "%8.3" EXTENDED_LIMITS -32768.00 32767.00 DEPOSIT ABSOLUTE /end AXIS_DESCR
 /begin AXIS_DESCR STD_AXIS PCR_qDes InjMass 10 0.00 327.6700 FORMAT "%8.4" EXTENDED_LIMITS -327.6800 327.6700 DEPOSIT ABSOLUTE /end AXIS_DESCR
/end CHARACTERISTIC
/begin CHARACTERISTIC PCR_pBDesRgn3a_MAP "Sollwert Regenerationsstufe 3 bei Atmosphärendruck ""a""" MAP 0x1E21E0 Kf_Xs16_Ys16_Ws16 4000.000 Pres_hPa 0.00 4000.000 FORMAT "%8.3" EXTENDED_LIMITS -32768.00 32767.00
 /begin AXIS_DESCR STD_AXIS Eng_nAvrg EngN 10 0.00 6000.000 FORMAT "%8.3" EXTENDED_LIMITS -32768.00 32767.00 DEPOSIT ABSOLUTE /end AXIS_DESCR
 /begin AXIS_DESCR STD_AXIS PCR_qDes InjMass 10 0.00 327.6700 FORMAT "%8.4" EXTENDED_LIMITS -327.6800 327.6700 DEPOSIT ABSOLUTE /end AXIS_DESCR
/end CHARACTERISTIC
/begin CHARACTERISTIC PCR_pBDesRgn3b_MAP "Sollwert Regenerationsstufe 3 bei Atmosphärendruck ""b""" MAP 0x1E22D4 Kf_Xs16_Ys16_Ws16 4000.000 Pres_hPa 0.00 4000.000 FORMAT "%8.3" EXTENDED_LIMITS -32768.00 32767.00
 /begin AXIS_DESCR STD_AXIS Eng_nAvrg EngN 10 0.00 6000.000 FORMAT "%8.3" EXTENDED_LIMITS -32768.00 32767.00 DEPOSIT ABSOLUTE /end AXIS_DESCR
 /begin AXIS_DESCR STD_AXIS PCR_qDes InjMass 10 0.00 327.6700 FORMAT "%8.4" EXTENDED_LIMITS -327.6800 327.6700 DEPOSIT ABSOLUTE /end AXIS_DESCR
/end CHARACTERISTIC
/begin CHARACTERISTIC PCR_pBDesRgn4a_MAP "Sollwert Regenerationsstufe 4 bei Atmosphärendruck ""a""" MAP 0x1E23C8 Kf_Xs16_Ys16_Ws16 4000.000 Pres_hPa 0.00 4000.000 FORMAT "%8.3" EXTENDED_LIMITS -32768.00 32767.00
 /begin AXIS_DESCR STD_AXIS Eng_nAvrg EngN 10 0.00 6000.000 FORMAT "%8.3" EXTENDED_LIMITS -32768.00 32767.00 DEPOSIT ABSOLUTE /end AXIS_DESCR
 /begin AXIS_DESCR STD_AXIS PCR_qDes InjMass 10 0.00 327.6700 FORMAT "%8.4" EXTENDED_LIMITS -327.6800 327.6700 DEPOSIT ABSOLUTE /end AXIS_DESCR
/end CHARACTERISTIC
/begin CHARACTERISTIC PCR_pBDesRgn4b_MAP "Sollwert Regenerationsstufe 4 bei Atmosphärendruck ""b""" MAP 0x1E24BC Kf_Xs16_Ys16_Ws16 4000.000 Pres_hPa 0.00 4000.000 FORMAT "%8.3" EXTENDED_LIMITS -32768.00 32767.00
 /begin AXIS_DESCR STD_AXIS Eng_nAvrg EngN 10 0.00 6000.000 FORMAT "%8.3" EXTENDED_LIMITS -32768.00 32767.00 DEPOSIT ABSOLUTE /end AXIS_DESCR
 /begin AXIS_DESCR STD_AXIS PCR_qDes InjMass 10 0.00 327.6700 FORMAT "%8.4" EXTENDED_LIMITS -327.6800 327.6700 DEPOSIT ABSOLUTE /end AXIS_DESCR
/end CHARACTERISTIC
/begin CHARACTERISTIC PCR_pBDesRgnCor1_MAP "Erstes Regenerationskennfeld zur Korrektur des Ladedruckbasissollwerts" MAP 0x1E25B0 Kf_Xs16_Ys16_Ws16 4000.000 Pres_hPa 0.00 4000.000 FORMAT "%8.3" EXTENDED_LIMITS -32768.00 32767.00
 /begin AXIS_DESCR STD_AXIS PCR_pBDes1_mp Pres_hPa 10 0.00 4000.000 FORMAT "%8.3" EXTENDED_LIMITS -32768.00 32767.00 DEPOSIT ABSOLUTE /end AXIS_DESCR
 /begin AXIS_DESCR STD_AXIS PFlt_pPre Pres_hPa 10 0.00 4000.000 FORMAT "%8.3" EXTENDED_LIMITS -32768.00 32767.00 DEPOSIT ABSOLUTE /end AXIS_DESCR
/end CHARACTERISTIC
/begin CHARACTERISTIC PCR_pBDesRgnCor2_MAP "Zweites Regenerationskennfeld zur Korrektur des Ladedruckbasissollwerts" MAP 0x1E26A4 Kf_Xs16_Ys16_Ws16 4000.000 Pres_hPa 0.00 4000.000 FORMAT "%8.3" EXTENDED_LIMITS -32768.00 32767.00
 /begin AXIS_DESCR STD_AXIS PCR_pBDes2_mp Pres_hPa 10 0.00 4000.000 FORMAT "%8.3" EXTENDED_LIMITS -32768.00 32767.00 DEPOSIT ABSOLUTE /end AXIS_DESCR
 /begin AXIS_DESCR STD_AXIS PFlt_pPre Pres_hPa 10 0.00 4000.000 FORMAT "%8.3" EXTENDED_LIMITS -32768.00 32767.00 DEPOSIT ABSOLUTE /end AXIS_DESCR
/end CHARACTERISTIC
/begin CHARACTERISTIC PCR_pBDesRgnCor3_MAP "Abgasdruck abhängiger Korrekturwert Regenerationsstufe 3" MAP 0x1E2798 Kf_Xs16_Ys16_Ws16 4000.000 Pres_hPa 0.00 4000.000 FORMAT "%8.3" EXTENDED_LIMITS -32768.00 32767.00
 /begin AXIS_DESCR STD_AXIS PCR_pBDes3_mp Pres_hPa 10 0.00 4000.000 FORMAT "%8.3" EXTENDED_LIMITS -32768.00 32767.00 DEPOSIT ABSOLUTE /end AXIS_DESCR
 /begin AXIS_DESCR STD_AXIS PFlt_pPre Pres_hPa 10 0.00 4000.000 FORMAT "%8.3" EXTENDED_LIMITS -32768.00 32767.00 DEPOSIT ABSOLUTE /end AXIS_DESCR
/end CHARACTERISTIC
/begin CHARACTERISTIC PCR_pBDesRgnCor4_MAP "Abgasdruck abhängiger Korrekturwert Regenerationsstufe 4" MAP 0x1E288C Kf_Xs16_Ys16_Ws16 4000.000 Pres_hPa 0.00 4000.000 FORMAT "%8.3" EXTENDED_LIMITS -32768.00 32767.00
 /begin AXIS_DESCR STD_AXIS PCR_pBDes4_mp Pres_hPa 2 0.00 4000.000 FORMAT "%8.3" EXTENDED_LIMITS -32768.00 32767.00 DEPOSIT ABSOLUTE /end AXIS_DESCR
 /begin AXIS_DESCR STD_AXIS PFlt_pPre Pres_hPa 2 0.00 4000.000 FORMAT "%8.3" EXTENDED_LIMITS -32768.00 32767.00 DEPOSIT ABSOLUTE /end AXIS_DESCR
/end CHARACTERISTIC
/begin CHARACTERISTIC PCR_pBDes_Vector "Bypass-Label für PCR_pBDes (Nicht verstellen!)" VALUE 0x1C0B2A Kw_Wu8 255.0 OneToOne 0.00 255.0 FORMAT "%5.1" /end CHARACTERISTIC
/begin CHARACTERISTIC PCR_pBDes_Channel "Bypass-Label für PCR_pBDes (Nicht verstellen!)" VALUE 0x1C0B2B Kw_Wu8 255.0 OneToOne 0.00 255.0 FORMAT "%5.1" /end CHARACTERISTIC
/begin CHARACTERISTIC PCR_pBGDevMax_CUR "maximale Regelabweichung, abhängig von Wasser- der Öltemperatur" CURVE 0x1E3274 Kl_Xs16_Ws16 3500.000 Pres_hPa 0.00 3500.000 FORMAT "%8.3" EXTENDED_LIMITS -32768.00 32767.00
 /begin AXIS_DESCR STD_AXIS PCR_tGDevMax_mp Temp_Cels 10 -50.14000 199.8600 FORMAT "%8.4" EXTENDED_LIMITS -3549.940 3003.560 DEPOSIT ABSOLUTE /end AXIS_DESCR
/end CHARACTERISTIC
/begin CHARACTERISTIC PCR_pBGDevMin_C "untere Grenze der erlaubten Regelabwichung" VALUE 0x1E329E Kw_Ws16 65535.00 Pres_hPa -32768.00 32767.00 FORMAT "%8.2" /end CHARACTERISTIC
/begin CHARACTERISTIC PCR_pDWinNeg_C "Untere Kleinsignalgrenze für das DT1-Glied des PIDT1-Reglers" VALUE 0x1E2D74 Kw_Ws16 10000.00 Pres_hPa -5000.000 5000.000 FORMAT "%8.3" EXTENDED_LIMITS -32768.00 32767.00 /end CHARACTERISTIC
/begin CHARACTERISTIC PCR_pDWinPos_C "Obere Kleinsignalgrenze für das DT1-Glied des PIDT1-Reglers" VALUE 0x1E2D76 Kw_Ws16 10000.00 Pres_hPa -5000.000 5000.000 FORMAT "%8.3" EXTENDED_LIMITS -32768.00 32767.00 /end CHARACTERISTIC
/begin CHARACTERISTIC PCR_pLim_C "Maximaler Ladedruck im Notfahrmodus" VALUE 0x1E0796 Kw_Ws16 3500.000 Pres_hPa 0.00 3500.000 FORMAT "%8.3" EXTENDED_LIMITS -32768.00 32767.00 /end CHARACTERISTIC
/begin CHARACTERISTIC PCR_pNQCtCmpn_MAP "Kennfeld für Kühlwassertemperaturkorrekturwert für Sollwertberechnung" MAP 0x1E28A0 Kf_Xs16_Ys16_Ws16 4000.000 Pres_hPa 0.00 4000.000 FORMAT "%8.3" EXTENDED_LIMITS -32768.00 32767.00
 /begin AXIS_DESCR STD_AXIS Eng_nAvrg EngN 8 0.00 6000.000 FORMAT "%8.3" EXTENDED_LIMITS -32768.00 32767.00 DEPOSIT ABSOLUTE /end AXIS_DESCR
 /begin AXIS_DESCR STD_AXIS PCR_qDes InjMass 8 0.00 327.6700 FORMAT "%8.4" EXTENDED_LIMITS -327.6800 327.6700 DEPOSIT ABSOLUTE /end AXIS_DESCR
/end CHARACTERISTIC
/begin CHARACTERISTIC PCR_PKp_C "Grundwert der P-Verstärkung des PIDT1-Reglers bei Kleinsignalen" VALUE 0x1E2D78 Kw_Wu32 100.000000000 Kp_Pres_hPa2Prc 0.00 100.000000000 FORMAT "%13.9" EXTENDED_LIMITS 0.00 655.359999847 /end CHARACTERISTIC
/begin CHARACTERISTIC PCR_PKpPos_C "Grundwert der P-Verstärkung des PIDT1-Reglers bei positiven Großsignalen" VALUE 0x1E2D7C Kw_Wu32 100.000000000 Kp_Pres_hPa2Prc 0.00 100.000000000 FORMAT "%13.9" EXTENDED_LIMITS 0.00 655.359999847 /end CHARACTERISTIC
/begin CHARACTERISTIC PCR_PKpNeg_C "Grundwert der P-Verstärkung des PIDT1-Reglers bei negativen Großsignalen" VALUE 0x1E2D80 Kw_Wu32 100.000000000 Kp_Pres_hPa2Prc 0.00 100.000000000 FORMAT "%13.9" EXTENDED_LIMITS 0.00 655.359999847 /end CHARACTERISTIC
/begin CHARACTERISTIC PCR_pPWinPos_C "Obere Kleinsignalgrenze für das P-Glied des PIDT1-Reglers" VALUE 0x1E2D84 Kw_Ws16 65535.00 Pres_hPa -32768.00 32767.00 FORMAT "%8.2" /end CHARACTERISTIC
/begin CHARACTERISTIC PCR_pPWinNeg_C "Untere Kleinsignalgrenze für das P-Glied des PIDT1-Reglers" VALUE 0x1E2D86 Kw_Ws16 65535.00 Pres_hPa -32768.00 32767.00 FORMAT "%8.2" /end CHARACTERISTIC
/begin CHARACTERISTIC PCR_qCtl_Vector "Konfigurationslabel für Bypass message" VALUE 0x1C0B26 Kw_Wu8 255.0 OneToOne 0.00 255.0 FORMAT "%5.1" /end CHARACTERISTIC
/begin CHARACTERISTIC PCR_qCtl_Channel "Konfigurationslabel für Bypass message" VALUE 0x1C0B27 Kw_Wu8 255.0 OneToOne 0.00 255.0 FORMAT "%5.1" /end CHARACTERISTIC
/begin CHARACTERISTIC PCR_qMinBPGovFlt_CUR "Minimale Einspritzmenge zur Aktivierung der Ladergeräuschunterdrückung" CURVE 0x1E2D88 Kl_Xs16_Ws16 327.6700 InjMass 0.00 327.6700 FORMAT "%8.4" EXTENDED_LIMITS -327.6800 327.6700
 /begin AXIS_DESCR STD_AXIS Eng_nAvrg EngN 5 0.00 6000.000 FORMAT "%8.3" EXTENDED_LIMITS -32768.00 32767.00 DEPOSIT ABSOLUTE /end AXIS_DESCR
/end CHARACTERISTIC
/begin CHARACTERISTIC PCR_qRgtOff1_CUR "Mengenkennlinie für Reglerabschaltschwelle in Abhängigkeit von der Drehzahl bei EGT-Status gleich Regenerationsmaske 1" CURVE 0x1E2D9E Kl_Xs16_Ws16 327.6700 InjMass 0.00 327.6700 FORMAT "%8.4" EXTENDED_LIMITS -327.6800 327.6700
 /begin AXIS_DESCR STD_AXIS Eng_nAvrg EngN 2 0.00 6000.000 FORMAT "%8.3" EXTENDED_LIMITS -32768.00 32767.00 DEPOSIT ABSOLUTE /end AXIS_DESCR
/end CHARACTERISTIC
/begin CHARACTERISTIC PCR_qRgtOff2_CUR "Mengenkennlinie für Reglerabschaltschwelle in Abhängigkeit von der Drehzahl bei EGT-Status gleich Regenerationsmaske 2" CURVE 0x1E2DA8 Kl_Xs16_Ws16 327.6700 InjMass 0.00 327.6700 FORMAT "%8.4" EXTENDED_LIMITS -327.6800 327.6700
 /begin AXIS_DESCR STD_AXIS Eng_nAvrg EngN 2 0.00 6000.000 FORMAT "%8.3" EXTENDED_LIMITS -32768.00 32767.00 DEPOSIT ABSOLUTE /end AXIS_DESCR
/end CHARACTERISTIC
/begin CHARACTERISTIC PCR_qRgtOff3_CUR "Mengenkennlinie für Reglerabschaltschwelle in Abhängigkeit von der Drehzahl bei EGT-Status gleich Regenerationsmaske 3" CURVE 0x1E2DB2 Kl_Xs16_Ws16 327.6700 InjMass 0.00 327.6700 FORMAT "%8.4" EXTENDED_LIMITS -327.6800 327.6700
 /begin AXIS_DESCR STD_AXIS Eng_nAvrg EngN 2 0.00 6000.000 FORMAT "%8.3" EXTENDED_LIMITS -32768.00 32767.00 DEPOSIT ABSOLUTE /end AXIS_DESCR
/end CHARACTERISTIC
/begin CHARACTERISTIC PCR_qRgtOff_CUR "Mengenkennlinie für Reglerabschaltschwelle in Abhängigkeit von der Drehzahl" CURVE 0x1E2DBC Kl_Xs16_Ws16 327.6700 InjMass 0.00 327.6700 FORMAT "%8.4" EXTENDED_LIMITS -327.6800 327.6700
 /begin AXIS_DESCR STD_AXIS Eng_nAvrg EngN 25 0.00 6000.000 FORMAT "%8.3" EXTENDED_LIMITS -32768.00 32767.00 DEPOSIT ABSOLUTE /end AXIS_DESCR
/end CHARACTERISTIC
/begin CHARACTERISTIC PCR_qRgtOn1_CUR "Mengenkennlinie für Reglereinschaltschwelle in Abhängigkeit von der Drehzahl bei EGT-Status gleich Regenerationsmaske 1" CURVE 0x1E2E22 Kl_Xs16_Ws16 327.6700 InjMass 0.00 327.6700 FORMAT "%8.4" EXTENDED_LIMITS -327.6800 327.6700
 /begin AXIS_DESCR STD_AXIS Eng_nAvrg EngN 2 0.00 6000.000 FORMAT "%8.3" EXTENDED_LIMITS -32768.00 32767.00 DEPOSIT ABSOLUTE /end AXIS_DESCR
/end CHARACTERISTIC
/begin CHARACTERISTIC PCR_qRgtOn2_CUR "Mengenkennlinie für Reglereinschaltschwelle in Abhängigkeit von der Drehzahl bei EGT-Status gleich Regenerationsmaske 2" CURVE 0x1E2E2C Kl_Xs16_Ws16 327.6700 InjMass 0.00 327.6700 FORMAT "%8.4" EXTENDED_LIMITS -327.6800 327.6700
 /begin AXIS_DESCR STD_AXIS Eng_nAvrg EngN 2 0.00 6000.000 FORMAT "%8.3" EXTENDED_LIMITS -32768.00 32767.00 DEPOSIT ABSOLUTE /end AXIS_DESCR
/end CHARACTERISTIC
/begin CHARACTERISTIC PCR_qRgtOn3_CUR "Mengenkennlinie für Reglereinschaltschwelle in Abhängigkeit von der Drehzahl bei EGT-Status gleich Regenerationsmaske 3" CURVE 0x1E2E36 Kl_Xs16_Ws16 327.6700 InjMass 0.00 327.6700 FORMAT "%8.4" EXTENDED_LIMITS -327.6800 327.6700
 /begin AXIS_DESCR STD_AXIS Eng_nAvrg EngN 2 0.00 6000.000 FORMAT "%8.3" EXTENDED_LIMITS -32768.00 32767.00 DEPOSIT ABSOLUTE /end AXIS_DESCR
/end CHARACTERISTIC
/begin CHARACTERISTIC PCR_qRgtOn_CUR "Mengenkennlinie für Reglereinschaltschwelle in Abhängigkeit von der Drehzahl" CURVE 0x1E2E40 Kl_Xs16_Ws16 327.6700 InjMass 0.00 327.6700 FORMAT "%8.4" EXTENDED_LIMITS -327.6800 327.6700
 /begin AXIS_DESCR STD_AXIS Eng_nAvrg EngN 25 0.00 6000.000 FORMAT "%8.3" EXTENDED_LIMITS -32768.00 32767.00 DEPOSIT ABSOLUTE /end AXIS_DESCR
/end CHARACTERISTIC
/begin CHARACTERISTIC PCR_qWrkSph2_C "obere Mengengrenze des Arbeitsbereichs 2" VALUE 0x1E32A0 Kw_Ws16 200.0000 InjMass 0.00 200.0000 FORMAT "%8.4" EXTENDED_LIMITS -327.6800 327.6700 /end CHARACTERISTIC
/begin CHARACTERISTIC PCR_qWrkSph3_C "Einspritzmengengrenze zwischen den Arbeitsbereichen 2 und 3" VALUE 0x1E32A2 Kw_Ws16 200.0000 InjMass 0.00 200.0000 FORMAT "%8.4" EXTENDED_LIMITS -327.6800 327.6700 /end CHARACTERISTIC
/begin CHARACTERISTIC PCR_rBalGvnrEgrMin_C "Unteregrenze der Reglerstellgroeße fuer Abgasrueckfuehrventil" VALUE 0x1DFDFE Kw_Ws16 100.0000 Prc 0.00 100.0000 FORMAT "%8.4" EXTENDED_LIMITS -327.6800 327.6700 /end CHARACTERISTIC
/begin CHARACTERISTIC PCR_rBalGvnrMax_MAP "Kennfeld Max- Begrenzung Tastverhältnis Gleichstellungsregler" MAP 0x1DFE00 Kf_Xs16_Ys16_Ws16 100.0000 Prc 0.00 100.0000 FORMAT "%8.4" EXTENDED_LIMITS -327.6800 327.6700
 /begin AXIS_DESCR STD_AXIS Eng_nAvrg EngN 9 0.00 6000.000 FORMAT "%8.3" EXTENDED_LIMITS -32768.00 32767.00 DEPOSIT ABSOLUTE /end AXIS_DESCR
 /begin AXIS_DESCR STD_AXIS PCR_qDes InjMass 9 0.00 327.6700 FORMAT "%8.4" EXTENDED_LIMITS -327.6800 327.6700 DEPOSIT ABSOLUTE /end AXIS_DESCR
/end CHARACTERISTIC
/begin CHARACTERISTIC PCR_rBalGvnrMin_MAP "Kennfeld Min- Begrenzung Tastverhältnis Gleichstellungsregler" MAP 0x1DFECA Kf_Xs16_Ys16_Ws16 200.0000 Prc -100.0000 100.0000 FORMAT "%8.4" EXTENDED_LIMITS -327.6800 327.6700
 /begin AXIS_DESCR STD_AXIS Eng_nAvrg EngN 9 0.00 6000.000 FORMAT "%8.3" EXTENDED_LIMITS -32768.00 32767.00 DEPOSIT ABSOLUTE /end AXIS_DESCR
 /begin AXIS_DESCR STD_AXIS PCR_qDes InjMass 9 0.00 327.6700 FORMAT "%8.4" EXTENDED_LIMITS -327.6800 327.6700 DEPOSIT ABSOLUTE /end AXIS_DESCR
/end CHARACTERISTIC
/begin CHARACTERISTIC PCR_rBalGvnrPreCtl_C "PI-Regler Precontrolwert Gleichstellungsregler" VALUE 0x1DFF94 Kw_Ws16 100.0000 Prc 0.00 100.0000 FORMAT "%8.4" EXTENDED_LIMITS -327.6800 327.6700 /end CHARACTERISTIC
/begin CHARACTERISTIC PCR_rBalGvnrSt_MAP "Kennfeld fuer die BiT Laderabgleich Umschaltung Regeln/Steuern" MAP 0x1DFF96 Kf_Xs16_Ys16_Ws16 100.0000 Prc 0.00 100.0000 FORMAT "%8.4" EXTENDED_LIMITS -327.6800 327.6700
 /begin AXIS_DESCR STD_AXIS Eng_nAvrg EngN 9 0.00 6000.000 FORMAT "%8.3" EXTENDED_LIMITS -32768.00 32767.00 DEPOSIT ABSOLUTE /end AXIS_DESCR
 /begin AXIS_DESCR STD_AXIS PCR_qDes InjMass 9 0.00 327.6700 FORMAT "%8.4" EXTENDED_LIMITS -327.6800 327.6700 DEPOSIT ABSOLUTE /end AXIS_DESCR
/end CHARACTERISTIC
/begin CHARACTERISTIC PCR_rBPACD_Vector "Bypass-Label für PCR_rBPACD (Nicht verstellen!)" VALUE 0x1C0B2E Kw_Wu8 255.0 OneToOne 0.00 255.0 FORMAT "%5.1" /end CHARACTERISTIC
/begin CHARACTERISTIC PCR_rBPACD_Channel "Bypass-Label für PCR_rBPACD (Nicht verstellen!)" VALUE 0x1C0B2F Kw_Wu8 255.0 OneToOne 0.00 255.0 FORMAT "%5.1" /end CHARACTERISTIC
/begin CHARACTERISTIC PCR_rBPAltDynMax_C "Maximales Ladedruckverhältnis des Vorfilters" VALUE 0x1E0798 Kw_Ws16 400.0000 Prc 0.00 400.0000 FORMAT "%8.4" EXTENDED_LIMITS -327.6800 327.6700 /end CHARACTERISTIC
/begin CHARACTERISTIC PCR_rBPAltMax2_MAP "Ladedruckverhältnis ohne Vorfilter in großen Höhe" MAP 0x1E079A Kf_Xs16_Ys16_Ws16 400.0000 Prc 0.00 400.0000 FORMAT "%8.4" EXTENDED_LIMITS -327.6800 327.6700
 /begin AXIS_DESCR STD_AXIS PCR_nTrbnMax_mp TurboN 10 10000.00 250000.0 FORMAT "%8.1" EXTENDED_LIMITS -327680.0 327670.0 DEPOSIT ABSOLUTE /end AXIS_DESCR
 /begin AXIS_DESCR STD_AXIS PCR_dmAirAltCorr2_mp AirMassPerTime 10 0.00 3000.000 FORMAT "%8.3" EXTENDED_LIMITS -3276.800 3276.700 DEPOSIT ABSOLUTE /end AXIS_DESCR
/end CHARACTERISTIC
/begin CHARACTERISTIC PCR_rBPAltMax_MAP "Ladedruckverhältnis ohne Vorfilter in großen Höhen" MAP 0x1E088E Kf_Xs16_Ys16_Ws16 400.0000 Prc 0.00 400.0000 FORMAT "%8.4" EXTENDED_LIMITS -327.6800 327.6700
 /begin AXIS_DESCR STD_AXIS PCR_nTrbnMax_mp TurboN 10 10000.00 250000.0 FORMAT "%8.1" EXTENDED_LIMITS -327680.0 327670.0 DEPOSIT ABSOLUTE /end AXIS_DESCR
 /begin AXIS_DESCR STD_AXIS PCR_dmAirAltCorr_mp AirMassPerTime 10 0.00 3000.000 FORMAT "%8.3" EXTENDED_LIMITS -3276.800 3276.700 DEPOSIT ABSOLUTE /end AXIS_DESCR
/end CHARACTERISTIC
/begin CHARACTERISTIC PCR_rBPCtlBas_MAP "Basissteuerkennfeld für Ladedruck" MAP 0x1E0AFA Kf_Xs16_Ys16_Ws16 300.0000 Prc -100.0000 200.0000 FORMAT "%8.4" EXTENDED_LIMITS -327.6800 327.6700
 /begin AXIS_DESCR STD_AXIS Eng_nAvrg EngN 16 0.00 8000.000 FORMAT "%8.3" EXTENDED_LIMITS -32768.00 32767.00 DEPOSIT ABSOLUTE /end AXIS_DESCR
 /begin AXIS_DESCR STD_AXIS PCR_qCtl InjMass 13 0.00 200.0000 FORMAT "%8.4" EXTENDED_LIMITS -327.6800 327.6700 DEPOSIT ABSOLUTE /end AXIS_DESCR
/end CHARACTERISTIC
/begin CHARACTERISTIC PCR_rBPCtlInit_C "Initialisierungswert für Steuersignal" VALUE 0x1E0CD8 Kw_Ws16 400.0000 Prc 0.00 400.0000 FORMAT "%8.4" EXTENDED_LIMITS -327.6800 327.6700 /end CHARACTERISTIC
/begin CHARACTERISTIC PCR_rBPCtlRgn1a_MAP "Kennfeld für Steuerwert bei Regenerationsbetrieb 1" MAP 0x1E0CDA Kf_Xs16_Ys16_Ws16 100.0000 Prc 0.00 100.0000 FORMAT "%8.4" EXTENDED_LIMITS -327.6800 327.6700
 /begin AXIS_DESCR STD_AXIS Eng_nAvrg EngN 10 0.00 6000.000 FORMAT "%8.3" EXTENDED_LIMITS -32768.00 32767.00 DEPOSIT ABSOLUTE /end AXIS_DESCR
 /begin AXIS_DESCR STD_AXIS PCR_qCtl InjMass 10 0.00 327.6700 FORMAT "%8.4" EXTENDED_LIMITS -327.6800 327.6700 DEPOSIT ABSOLUTE /end AXIS_DESCR
/end CHARACTERISTIC
/begin CHARACTERISTIC PCR_rBPCtlRgn1b_MAP "Kennfeld für Steuerwert bei Regenerationsbetrieb 1" MAP 0x1E0DCE Kf_Xs16_Ys16_Ws16 100.0000 Prc 0.00 100.0000 FORMAT "%8.4" EXTENDED_LIMITS -327.6800 327.6700
 /begin AXIS_DESCR STD_AXIS Eng_nAvrg EngN 10 0.00 6000.000 FORMAT "%8.3" EXTENDED_LIMITS -32768.00 32767.00 DEPOSIT ABSOLUTE /end AXIS_DESCR
 /begin AXIS_DESCR STD_AXIS PCR_qCtl InjMass 10 0.00 327.6700 FORMAT "%8.4" EXTENDED_LIMITS -327.6800 327.6700 DEPOSIT ABSOLUTE /end AXIS_DESCR
/end CHARACTERISTIC
/begin CHARACTERISTIC PCR_rBPCtlRgn2a_MAP "Kennfeld für Steuerwert bei Regenerationsbetrieb 2" MAP 0x1E0EC2 Kf_Xs16_Ys16_Ws16 100.0000 Prc 0.00 100.0000 FORMAT "%8.4" EXTENDED_LIMITS -327.6800 327.6700
 /begin AXIS_DESCR STD_AXIS Eng_nAvrg EngN 10 0.00 6000.000 FORMAT "%8.3" EXTENDED_LIMITS -32768.00 32767.00 DEPOSIT ABSOLUTE /end AXIS_DESCR
 /begin AXIS_DESCR STD_AXIS PCR_qCtl InjMass 10 0.00 327.6700 FORMAT "%8.4" EXTENDED_LIMITS -327.6800 327.6700 DEPOSIT ABSOLUTE /end AXIS_DESCR
/end CHARACTERISTIC
/begin CHARACTERISTIC PCR_rBPCtlRgn2b_MAP "Kennfeld für Steuerwert bei Regenerationsbetrieb 2" MAP 0x1E0FB6 Kf_Xs16_Ys16_Ws16 100.0000 Prc 0.00 100.0000 FORMAT "%8.4" EXTENDED_LIMITS -327.6800 327.6700
 /begin AXIS_DESCR STD_AXIS Eng_nAvrg EngN 10 0.00 6000.000 FORMAT "%8.3" EXTENDED_LIMITS -32768.00 32767.00 DEPOSIT ABSOLUTE /end AXIS_DESCR
 /begin AXIS_DESCR STD_AXIS PCR_qCtl InjMass 10 0.00 327.6700 FORMAT "%8.4" EXTENDED_LIMITS -327.6800 327.6700 DEPOSIT ABSOLUTE /end AXIS_DESCR
/end CHARACTERISTIC
/begin CHARACTERISTIC PCR_rBPCtlRgn3a_MAP "Steuerwert Regenerationsstufe 1 bei Atmosphärendruck ""a""" MAP 0x1E10AA Kf_Xs16_Ys16_Ws16 100.0000 Prc 0.00 100.0000 FORMAT "%8.4" EXTENDED_LIMITS -327.6800 327.6700
 /begin AXIS_DESCR STD_AXIS Eng_nAvrg EngN 10 0.00 6000.000 FORMAT "%8.3" EXTENDED_LIMITS -32768.00 32767.00 DEPOSIT ABSOLUTE /end AXIS_DESCR
 /begin AXIS_DESCR STD_AXIS PCR_qCtl InjMass 10 0.00 327.6700 FORMAT "%8.4" EXTENDED_LIMITS -327.6800 327.6700 DEPOSIT ABSOLUTE /end AXIS_DESCR
/end CHARACTERISTIC
/begin CHARACTERISTIC PCR_rBPCtlRgn3b_MAP "Steuerwert Regenerationsstufe 1 bei Atmosphärendruck ""b""" MAP 0x1E119E Kf_Xs16_Ys16_Ws16 100.0000 Prc 0.00 100.0000 FORMAT "%8.4" EXTENDED_LIMITS -327.6800 327.6700
 /begin AXIS_DESCR STD_AXIS Eng_nAvrg EngN 10 0.00 6000.000 FORMAT "%8.3" EXTENDED_LIMITS -32768.00 32767.00 DEPOSIT ABSOLUTE /end AXIS_DESCR
 /begin AXIS_DESCR STD_AXIS PCR_qCtl InjMass 10 0.00 327.6700 FORMAT "%8.4" EXTENDED_LIMITS -327.6800 327.6700 DEPOSIT ABSOLUTE /end AXIS_DESCR
/end CHARACTERISTIC
/begin CHARACTERISTIC PCR_rBPCtlRgn4a_MAP "Steuerwert Regenerationsstufe 1 bei Atmosphärendruck ""a""" MAP 0x1E1292 Kf_Xs16_Ys16_Ws16 100.0000 Prc 0.00 100.0000 FORMAT "%8.4" EXTENDED_LIMITS -327.6800 327.6700
 /begin AXIS_DESCR STD_AXIS Eng_nAvrg EngN 10 0.00 6000.000 FORMAT "%8.3" EXTENDED_LIMITS -32768.00 32767.00 DEPOSIT ABSOLUTE /end AXIS_DESCR
 /begin AXIS_DESCR STD_AXIS PCR_qCtl InjMass 10 0.00 327.6700 FORMAT "%8.4" EXTENDED_LIMITS -327.6800 327.6700 DEPOSIT ABSOLUTE /end AXIS_DESCR
/end CHARACTERISTIC
/begin CHARACTERISTIC PCR_rBPCtlRgn4b_MAP "Steuerwert Regenerationsstufe 1 bei Atmosphärendruck ""b""" MAP 0x1E1386 Kf_Xs16_Ys16_Ws16 100.0000 Prc 0.00 100.0000 FORMAT "%8.4" EXTENDED_LIMITS -327.6800 327.6700
 /begin AXIS_DESCR STD_AXIS Eng_nAvrg EngN 10 0.00 6000.000 FORMAT "%8.3" EXTENDED_LIMITS -32768.00 32767.00 DEPOSIT ABSOLUTE /end AXIS_DESCR
 /begin AXIS_DESCR STD_AXIS PCR_qCtl InjMass 10 0.00 327.6700 FORMAT "%8.4" EXTENDED_LIMITS -327.6800 327.6700 DEPOSIT ABSOLUTE /end AXIS_DESCR
/end CHARACTERISTIC
/begin CHARACTERISTIC PCR_rBPCtlRgnCor1_MAP "Erstes Regenerationskennfeld zur Korrektur des Ladedruckbasissteuerwertes" MAP 0x1E147A Kf_Xs16_Ys16_Ws16 100.0000 Prc 0.00 100.0000 FORMAT "%8.4" EXTENDED_LIMITS -327.6800 327.6700
 /begin AXIS_DESCR STD_AXIS PCR_rBPCtl1_mp Prc 10 0.00 100.0000 FORMAT "%8.4" EXTENDED_LIMITS -327.6800 327.6700 DEPOSIT ABSOLUTE /end AXIS_DESCR
 /begin AXIS_DESCR STD_AXIS PFlt_pPre Pres_hPa 10 0.00 4000.000 FORMAT "%8.3" EXTENDED_LIMITS -32768.00 32767.00 DEPOSIT ABSOLUTE /end AXIS_DESCR
/end CHARACTERISTIC
/begin CHARACTERISTIC PCR_rBPCtlRgnCor2_MAP "Zweites Regenerationskennfeld zur Korrektur des Ladedruckbasissteuerwertes" MAP 0x1E156E Kf_Xs16_Ys16_Ws16 100.0000 Prc 0.00 100.0000 FORMAT "%8.4" EXTENDED_LIMITS -327.6800 327.6700
 /begin AXIS_DESCR STD_AXIS PCR_rBPCtl2_mp Prc 10 0.00 100.0000 FORMAT "%8.4" EXTENDED_LIMITS -327.6800 327.6700 DEPOSIT ABSOLUTE /end AXIS_DESCR
 /begin AXIS_DESCR STD_AXIS PFlt_pPre Pres_hPa 10 0.00 4000.000 FORMAT "%8.3" EXTENDED_LIMITS -32768.00 32767.00 DEPOSIT ABSOLUTE /end AXIS_DESCR
/end CHARACTERISTIC
/begin CHARACTERISTIC PCR_rBPCtlRgnCor3_MAP "Korrektur abhängig von Druck vor Partikelfilter Regenerationsstufe 3" MAP 0x1E1662 Kf_Xs16_Ys16_Ws16 100.0000 Prc 0.00 100.0000 FORMAT "%8.4" EXTENDED_LIMITS -327.6800 327.6700
 /begin AXIS_DESCR STD_AXIS PCR_rBPCtl3_mp Prc 10 0.00 100.0000 FORMAT "%8.4" EXTENDED_LIMITS -327.6800 327.6700 DEPOSIT ABSOLUTE /end AXIS_DESCR
 /begin AXIS_DESCR STD_AXIS PFlt_pPre Pres_hPa 10 0.00 4000.000 FORMAT "%8.3" EXTENDED_LIMITS -32768.00 32767.00 DEPOSIT ABSOLUTE /end AXIS_DESCR
/end CHARACTERISTIC
/begin CHARACTERISTIC PCR_rBPCtlRgnCor4_MAP "Korrektur abhängig von Druck vor Partikelfilter Regenerationsstufe 4" MAP 0x1E1756 Kf_Xs16_Ys16_Ws16 100.0000 Prc 0.00 100.0000 FORMAT "%8.4" EXTENDED_LIMITS -327.6800 327.6700
 /begin AXIS_DESCR STD_AXIS PCR_rBPCtl4_mp Prc 2 0.00 100.0000 FORMAT "%8.4" EXTENDED_LIMITS -327.6800 327.6700 DEPOSIT ABSOLUTE /end AXIS_DESCR
 /begin AXIS_DESCR STD_AXIS PFlt_pPre Pres_hPa 2 0.00 4000.000 FORMAT "%8.3" EXTENDED_LIMITS -32768.00 32767.00 DEPOSIT ABSOLUTE /end AXIS_DESCR
/end CHARACTERISTIC
/begin CHARACTERISTIC PCR_rBPCtl_Vector "Konfigurationslabel für Bypass message" VALUE 0x1C0B28 Kw_Wu8 255.0 OneToOne 0.00 255.0 FORMAT "%5.1" /end CHARACTERISTIC
/begin CHARACTERISTIC PCR_rBPCtl_Channel "Konfigurationslabel für Bypass message" VALUE 0x1C0B29 Kw_Wu8 255.0 OneToOne 0.00 255.0 FORMAT "%5.1" /end CHARACTERISTIC
/begin CHARACTERISTIC PCR_rBPGovLin2_CUR "Tastverhätnis Linearisierung für Ladedruckregler2" CURVE 0x1E2EA6 Kl_Xs16_Ws16 100.0000 Prc 0.00 100.0000 FORMAT "%8.4" EXTENDED_LIMITS -327.6800 327.6700
 /begin AXIS_DESCR STD_AXIS PCR_rBPGovUnLin2_mp Prc 21 0.00 100.0000 FORMAT "%8.4" EXTENDED_LIMITS -327.6800 327.6700 DEPOSIT ABSOLUTE /end AXIS_DESCR
/end CHARACTERISTIC
/begin CHARACTERISTIC PCR_rBPGovLin_CUR "Tastverhätnis Linearisierung für Ladedruckregler" CURVE 0x1E2EFC Kl_Xs16_Ws16 100.0000 Prc 0.00 100.0000 FORMAT "%8.4" EXTENDED_LIMITS -327.6800 327.6700
 /begin AXIS_DESCR STD_AXIS PCR_rBPGovUnLin_mp Prc 21 0.00 100.0000 FORMAT "%8.4" EXTENDED_LIMITS -327.6800 327.6700 DEPOSIT ABSOLUTE /end AXIS_DESCR
/end CHARACTERISTIC
/begin CHARACTERISTIC PCR_rBPGovMax_MAP "Kennfeld zur Bestimmung der maximal zulässigen Stellgröße aus Drehzahl und Einspritzmenge" MAP 0x1E2F52 Kf_Xs16_Ys16_Ws16 300.0000 Prc -100.0000 200.0000 FORMAT "%8.4" EXTENDED_LIMITS -327.6800 327.6700
 /begin AXIS_DESCR STD_AXIS Eng_nAvrg EngN 16 0.00 6000.000 FORMAT "%8.3" EXTENDED_LIMITS -32768.00 32767.00 DEPOSIT ABSOLUTE /end AXIS_DESCR
 /begin AXIS_DESCR STD_AXIS InjCtl_qCurr InjMass 10 0.00 327.6700 FORMAT "%8.4" EXTENDED_LIMITS -327.6800 327.6700 DEPOSIT ABSOLUTE /end AXIS_DESCR
/end CHARACTERISTIC
/begin CHARACTERISTIC PCR_rBPGovMin_MAP "Kennfeld zur Bestimmung der minimal zulässigen Stellgröße aus Drehzahl und Einspritzmenge" MAP 0x1E30CA Kf_Xs16_Ys16_Ws16 300.0000 Prc -100.0000 200.0000 FORMAT "%8.4" EXTENDED_LIMITS -327.6800 327.6700
 /begin AXIS_DESCR STD_AXIS Eng_nAvrg EngN 16 0.00 6000.000 FORMAT "%8.3" EXTENDED_LIMITS -32768.00 32767.00 DEPOSIT ABSOLUTE /end AXIS_DESCR
 /begin AXIS_DESCR STD_AXIS InjCtl_qCurr InjMass 10 0.00 327.6700 FORMAT "%8.4" EXTENDED_LIMITS -327.6800 327.6700 DEPOSIT ABSOLUTE /end AXIS_DESCR
/end CHARACTERISTIC
/begin CHARACTERISTIC PCR_rBPGov_Vector "Konfigurationslabel für Bypass Freischnitt" VALUE 0x1C0B2C Kw_Wu8 255.0 OneToOne 0.00 255.0 FORMAT "%5.1" /end CHARACTERISTIC
/begin CHARACTERISTIC PCR_rBPGov_Channel "Konfigurationslabel für Bypass message" VALUE 0x1C0B2D Kw_Wu8 255.0 OneToOne 0.00 255.0 FORMAT "%5.1" /end CHARACTERISTIC
/begin CHARACTERISTIC PCR_rCtlAPCmpn_MAP "Kennfeld für atmosphärendruckabhängigen Korrekturwert für Ladedrucksteuerung" MAP 0x1E176A Kf_Xs16_Ys16_Ws16 200.0000 Prc -100.0000 100.0000 FORMAT "%8.4" EXTENDED_LIMITS -327.6800 327.6700
 /begin AXIS_DESCR STD_AXIS APSCD_pVal Pres_hPa 9 0.00 4000.000 FORMAT "%8.3" EXTENDED_LIMITS -32768.00 32767.00 DEPOSIT ABSOLUTE /end AXIS_DESCR
 /begin AXIS_DESCR STD_AXIS PCR_qCtl InjMass 9 0.00 200.0000 FORMAT "%8.4" EXTENDED_LIMITS -327.6800 327.6700 DEPOSIT ABSOLUTE /end AXIS_DESCR
/end CHARACTERISTIC
/begin CHARACTERISTIC PCR_rDflGvnrOff_C "Vorgabewert für Regelungsausgang zum Ladedrucksteller im Abschaltfall" VALUE 0x1E32A4 Kw_Ws16 655.3500 Prc -327.6800 327.6700 FORMAT "%8.4" /end CHARACTERISTIC
/begin CHARACTERISTIC PCR_rDflSysFault_C "Vorgabewert für Regelungsausgang zum Ladedrucksteller im Abschaltfall bei Systemfehler" VALUE 0x1E32A6 Kw_Ws16 655.3500 Prc -327.6800 327.6700 FORMAT "%8.4" /end CHARACTERISTIC
/begin CHARACTERISTIC PCR_stCtlRgnMsk1_C "Maske zur Umschaltung Steuergröße für Partikelfilter Regeneration 1" VALUE 0x1E1834 Kw_Wu32 4294967295.00 OneToOne 0.00 4294967295.00 FORMAT "%13.2" /end CHARACTERISTIC
/begin CHARACTERISTIC PCR_stCtlRgnMsk2_C "Maske zur Umschaltung Steuergröße für Partikelfilter Regeneration 2" VALUE 0x1E1838 Kw_Wu32 4294967295.00 OneToOne 0.00 4294967295.00 FORMAT "%13.2" /end CHARACTERISTIC
/begin CHARACTERISTIC PCR_stCtlRgnMsk3_C "applizierbare Bitmaske für 3. Regenerationsstufe" VALUE 0x1E183C Kw_Wu32 4294967295.00 OneToOne 0.00 4294967295.00 FORMAT "%13.2" /end CHARACTERISTIC
/begin CHARACTERISTIC PCR_stCtlRgnMsk4_C "applizierbare Bitmaske für 4. Regenerationsstufe" VALUE 0x1E1840 Kw_Wu32 4294967295.00 OneToOne 0.00 4294967295.00 FORMAT "%13.2" /end CHARACTERISTIC
/begin CHARACTERISTIC PCR_stDesRgnMsk1_C "Maske zur Umschaltung Sollwert für Partikelfilter Regeneration 1" VALUE 0x1E2944 Kw_Wu32 4294967295.00 OneToOne 0.00 4294967295.00 FORMAT "%13.2" /end CHARACTERISTIC
/begin CHARACTERISTIC PCR_stDesRgnMsk2_C "Maske zur Umschaltung Sollwert für Partikelfilter Regeneration 2" VALUE 0x1E2948 Kw_Wu32 4294967295.00 OneToOne 0.00 4294967295.00 FORMAT "%13.2" /end CHARACTERISTIC
/begin CHARACTERISTIC PCR_stDesRgnMsk3_C "Bitmaske für 3. Regenerationsstufe" VALUE 0x1E294C Kw_Wu32 4294967295.00 OneToOne 0.00 4294967295.00 FORMAT "%13.2" /end CHARACTERISTIC
/begin CHARACTERISTIC PCR_stDesRgnMsk4_C "Bitmaske für 4. Regenerationsstufe" VALUE 0x1E2950 Kw_Wu32 4294967295.00 OneToOne 0.00 4294967295.00 FORMAT "%13.2" /end CHARACTERISTIC
/begin CHARACTERISTIC PCR_stRgtOffMsk1_C "Bitmaske 1 für Regenerationsanforderung für Hysterese" VALUE 0x1E3244 Kw_Wu32 4294967295.00 OneToOne 0.00 4294967295.00 FORMAT "%13.2" /end CHARACTERISTIC
/begin CHARACTERISTIC PCR_stRgtOffMsk2_C "Bitmaske 2 für Regenerationsanforderung für Hysterese" VALUE 0x1E3248 Kw_Wu32 4294967295.00 OneToOne 0.00 4294967295.00 FORMAT "%13.2" /end CHARACTERISTIC
/begin CHARACTERISTIC PCR_stRgtOffMsk3_C "Bitmaske 3 für Regenerationsanforderung für Hysterese" VALUE 0x1E324C Kw_Wu32 4294967295.00 OneToOne 0.00 4294967295.00 FORMAT "%13.2" /end CHARACTERISTIC
/begin CHARACTERISTIC PCR_stRgtOnMsk1_C "Bitmaske 1 für Regenerationsanforderung für Hysterese" VALUE 0x1E3250 Kw_Wu32 4294967295.00 OneToOne 0.00 4294967295.00 FORMAT "%13.2" /end CHARACTERISTIC
/begin CHARACTERISTIC PCR_stRgtOnMsk2_C "Bitmaske 2 für Regenerationsanforderung für Hysterese" VALUE 0x1E3254 Kw_Wu32 4294967295.00 OneToOne 0.00 4294967295.00 FORMAT "%13.2" /end CHARACTERISTIC
/begin CHARACTERISTIC PCR_stRgtOnMsk3_C "Bitmaske 3 für Regenerationsanforderung für Hysterese" VALUE 0x1E3258 Kw_Wu32 4294967295.00 OneToOne 0.00 4294967295.00 FORMAT "%13.2" /end CHARACTERISTIC
/begin CHARACTERISTIC PCR_swtAirAlt_C "Schalter Luftmassenkorrektur zur Auswahl Einlaß- (0) oder Umgebebungsluft-Temperatur (1)" VALUE 0x1E0982 Kw_Wu8 1.000 OneToOne 0.00 1.000 FORMAT "%5.3" EXTENDED_LIMITS 0.00 255.0 /end CHARACTERISTIC
/begin CHARACTERISTIC PCR_swtCorrActv_C "Umschalter zum Wechseln der Korrekturstrategie" VALUE 0x1E2954 Kw_Wu8 1.000 OneToOne 0.00 1.000 FORMAT "%5.3" EXTENDED_LIMITS 0.00 255.0 /end CHARACTERISTIC
/begin CHARACTERISTIC PCR_swtGDevMax_C "Variantenschalter zwischen Wasser- oder Öltemperatur für maximale Regelabweichung" VALUE 0x1E32A8 Kw_Wu8 1.000 OneToOne 0.00 1.000 FORMAT "%5.3" EXTENDED_LIMITS 0.00 255.0 /end CHARACTERISTIC
/begin CHARACTERISTIC PCR_swtLimMpCrVal_C "Schalterwert zur Auswahl der Größen, aus denen der zulässige Stellgrößenbereich bestimmt wird (P263:bei Initialisierung gelesen)" VALUE 0x1E325C Kw_Wu8 0.00 OneToOne 1.000 1.000 FORMAT "%5.3" EXTENDED_LIMITS 0.00 255.0 READ_ONLY /end CHARACTERISTIC
/begin CHARACTERISTIC PCR_swtLimMpCrType_C "Schaltertyp zur Auswahl der Größen, aus denen der zulässige Stellgrößenbereich bestimmt wird" VALUE 0x1E325D Kw_Wu8 0.00 OneToOne 0.00 0.00 FORMAT "%5.2" EXTENDED_LIMITS 0.00 255.0 READ_ONLY /end CHARACTERISTIC
/begin CHARACTERISTIC PCR_swtQCtlVal_C "Schalterwert zur Auswahl der für Steuerung verwendeten Einspritzmenge" VALUE 0x1E1844 Kw_Wu8 1.000 OneToOne 0.00 1.000 FORMAT "%5.3" EXTENDED_LIMITS 0.00 255.0 /end CHARACTERISTIC
/begin CHARACTERISTIC PCR_swtQCtlType_C "Schaltertyp zur Auswahl der für Steuerung verwendeten Einspritzmenge" VALUE 0x1E1845 Kw_Wu8 1.000 OneToOne 1.000 2.000 FORMAT "%5.3" EXTENDED_LIMITS 0.00 255.0 /end CHARACTERISTIC
/begin CHARACTERISTIC PCR_swtQDesVal_C "Schalterwert für Mengeneingangswunsch bei der Sollwertberechnung" VALUE 0x1E2955 Kw_Wu8 1.000 OneToOne 0.00 1.000 FORMAT "%5.3" EXTENDED_LIMITS 0.00 255.0 /end CHARACTERISTIC
/begin CHARACTERISTIC PCR_swtQDesType_C "Schaltertyp für Mengeneingangswunsch bei der Sollwertberechnung" VALUE 0x1E2956 Kw_Wu8 1.000 OneToOne 1.000 2.000 FORMAT "%5.3" EXTENDED_LIMITS 0.00 255.0 /end CHARACTERISTIC
/begin CHARACTERISTIC PCR_swtRelAbsVal_C "Schalterwert zur  Auswahl zwischen Absolut- und Relativdruckregelung" VALUE 0x1E325E Kw_Wu8 1.000 OneToOne 0.00 1.000 FORMAT "%5.3" EXTENDED_LIMITS 0.00 255.0 /end CHARACTERISTIC
/begin CHARACTERISTIC PCR_swtRelAbsType_C "Softwareschalter Typ zur  Auswahl zwischen Absolut- und Relativdruckregelung" VALUE 0x1E325F Kw_Wu8 1.000 OneToOne 1.000 2.000 FORMAT "%5.3" EXTENDED_LIMITS 0.00 255.0 /end CHARACTERISTIC
/begin CHARACTERISTIC PCR_swtTmpAir_C "Schalter für Auswahl der für die additiven Korrektur verwendeten Temperatur" VALUE 0x1E2958 Kw_Ws16 1.000000 OneToOne 0.00 1.000000 FORMAT "%8.6" EXTENDED_LIMITS -32768.00 32767.00 /end CHARACTERISTIC
/begin CHARACTERISTIC PCR_swtTrbnMod_C "Schalter ein/aus Laderdrehzahlbegrenzung in der Höhe" VALUE 0x1E295A Kw_Wu8 1.000 OneToOne 0.00 1.000 FORMAT "%5.3" EXTENDED_LIMITS 0.00 255.0 /end CHARACTERISTIC
/begin CHARACTERISTIC PCR_tAirAltCorr_C "Referenz Temperatur" VALUE 0x1E0984 Kw_Ws16 250.0000 Temp_Cels -50.14000 199.8600 FORMAT "%8.4" EXTENDED_LIMITS -3549.940 3003.560 /end CHARACTERISTIC
/begin CHARACTERISTIC PCR_tCThreshold_C "Kühlwassertemperaturschwelle für Parameterumschaltung der dynamischen Sollwertbildung" VALUE 0x1E295C Kw_Ws16 6553.500 Temp_Cels -3549.940 3003.560 FORMAT "%8.3" /end CHARACTERISTIC
/begin CHARACTERISTIC PCR_tiBalGovDevDef_C "Fehlerentprellzeit für Regelabweichung beim Laderabgleich" VALUE 0x1E0060 Kw_Wu16 655350.0 Time_ms 0.00 655350.0 FORMAT "%8.1" /end CHARACTERISTIC
/begin CHARACTERISTIC PCR_tiBalGovDevOk_C "Heilzeit für Regelabweichung beim Laderabgleich" VALUE 0x1E0062 Kw_Wu16 655350.0 Time_ms 0.00 655350.0 FORMAT "%8.1" /end CHARACTERISTIC
/begin CHARACTERISTIC PCR_tiCoStrt_CUR "Kennlinie für die Zeit, die die Regelung nach Startabwurf abgeschaltet bleibt" CURVE 0x1E32AA Kl_Xs16_Ws16 33000.00 Time_ms 0.00 33000.00 FORMAT "%8.2" EXTENDED_LIMITS -327680.0 327670.0
 /begin AXIS_DESCR STD_AXIS CTSCD_tClnt Temp_Cels 30 -100.1400 199.8600 FORMAT "%8.4" EXTENDED_LIMITS -3549.940 3003.560 DEPOSIT ABSOLUTE /end AXIS_DESCR
/end CHARACTERISTIC
/begin CHARACTERISTIC PCR_tiCtlRgnRmp_C "Rampenzeit für die Umschaltung der Steuergröße für Partikelfilter Regeneration" VALUE 0x1E1848 Kw_Wu32 31.775030303030302 TimeEGTRmp 0.99296969696969695 32.768000000000001 FORMAT "%19.16" EXTENDED_LIMITS 0.000000015258789066052715 65.536000000000001 /end CHARACTERISTIC
/begin CHARACTERISTIC PCR_tiDebswtRgt_C "Zeitverzögerung für Umschaltung von Regel- in Steuerbetrieb des PCR" VALUE 0x1E3260 Kw_Wu16 20.00000 Time_s 0.00 20.00000 FORMAT "%8.5" EXTENDED_LIMITS 0.00 655.3500 /end CHARACTERISTIC
/begin CHARACTERISTIC PCR_tiDelBPGovFlt_C "Auschaltverzögerungszeit der Ladergeräuschunterdrückung" VALUE 0x1E3262 Kw_Wu16 60000.00 Time_ms 0.00 60000.00 FORMAT "%8.2" EXTENDED_LIMITS 0.00 655350.0 /end CHARACTERISTIC
/begin CHARACTERISTIC PCR_tiDesRgnRmp_C "Rampenzeit für die Umschaltung des Sollwertes für Partikelfilter Regeneration" VALUE 0x1E2960 Kw_Wu32 31.775030303030302 TimeEGTRmp 0.99296969696969695 32.768000000000001 FORMAT "%19.16" EXTENDED_LIMITS 0.000000015258789066052715 65.536000000000001 /end CHARACTERISTIC
/begin CHARACTERISTIC PCR_tiDT1BPAlt_C "Zeitkonstante des DT1 Vorfilters in großen Höhen" VALUE 0x1E0988 Kw_Wu32 4294.9663 TimeDelay_s 0.0010000001 4294.9673 FORMAT "%9.4" EXTENDED_LIMITS 0.0000010000000 4294.9673 /end CHARACTERISTIC
/begin CHARACTERISTIC PCR_tiStrtDelayInit_C "Inititalisierungswert der Zeit, die der PCR nach dem Startabfall abgeschaltet bleibt" VALUE 0x1E3324 Kw_Wu16 655350.0 Time_ms 0.00 655350.0 FORMAT "%8.1" /end CHARACTERISTIC
/begin CHARACTERISTIC PCR_trqInrMin_C "Drehmomentschwelle für Überwachung der Regelabweichung" VALUE 0x1E0064 Kw_Ws16 1000.000 Trq 0.00 1000.000 FORMAT "%8.3" EXTENDED_LIMITS -3276.800 3276.700 /end CHARACTERISTIC
/begin CHARACTERISTIC PCR_WmDT1Neg_C "Verzögerungszeitkonstante der dynamischen Sollwertbildung bei warmem Motor für neg. Ausgang" VALUE 0x1E2964 Kw_Wu32 4294.9663 TimeDelay_s 0.0010000001 4294.9673 FORMAT "%9.4" EXTENDED_LIMITS 0.0000010000000 4294.9673 /end CHARACTERISTIC
/begin CHARACTERISTIC PCR_WmDT1Pos_C "Verzögerungszeitkonstante der dynamischen Sollwertbildung bei warmem Motor für pos. Ausgang" VALUE 0x1E2968 Kw_Wu32 4294.9663 TimeDelay_s 0.0010000001 4294.9673 FORMAT "%9.4" EXTENDED_LIMITS 0.0000010000000 4294.9673 /end CHARACTERISTIC
/begin CHARACTERISTIC PCR_WmDKd_C "Kleinsignalverstärkung der dynamischen Sollwertbildung bei warmem Motor" VALUE 0x1E296C Kw_Ws32 65535.9999847 Kd -32768.0000000 32767.9999847 FORMAT "%13.7" /end CHARACTERISTIC
/begin CHARACTERISTIC PCR_WmDKdPos_C "Positive Großsignalverstärkung der dynamischen Sollwertbildung bei warmem Motor" VALUE 0x1E2970 Kw_Ws32 65535.9999847 Kd -32768.0000000 32767.9999847 FORMAT "%13.7" /end CHARACTERISTIC
/begin CHARACTERISTIC PCR_WmDKdNeg_C "Negative Großsignalverstärkung der dynamischen Sollwertbildung bei warmem Motor" VALUE 0x1E2974 Kw_Ws32 65535.9999847 Kd -32768.0000000 32767.9999847 FORMAT "%13.7" /end CHARACTERISTIC
/begin CHARACTERISTIC PCR_dpWmDWinPos_C "Positive Kleinsignalgrenze bei warmem Motor" VALUE 0x1E2978 Kw_Ws16 1638350. Pres_hPaPerSec_20ms 0.00 1638350. FORMAT "%8.0" EXTENDED_LIMITS -1638400. 1638350. /end CHARACTERISTIC
/begin CHARACTERISTIC PCR_dpWmDWinNeg_C "Negative Kleinsignalgrenze bei warmem Motor" VALUE 0x1E297A Kw_Ws16 1638400. Pres_hPaPerSec_20ms -1638400. 0.00 FORMAT "%8.0" EXTENDED_LIMITS -1638400. 1638350. /end CHARACTERISTIC
/begin CHARACTERISTIC PCVCD_uSRCMin_C "Signal Range Check Min-Wert" VALUE 0x1E336C Kw_Ws16 5200.391 Volt 0.00 5200.391 FORMAT "%8.3" EXTENDED_LIMITS -160156.4 160151.5 /end CHARACTERISTIC
/begin CHARACTERISTIC PCVCD_uSRCMax_C "Signal Range Check Max-Wert" VALUE 0x1E336E Kw_Ws16 5200.391 Volt 0.00 5200.391 FORMAT "%8.3" EXTENDED_LIMITS -160156.4 160151.5 /end CHARACTERISTIC
/begin CHARACTERISTIC PCVCD_iLin_CUR "Analogeingang, Linearisierungskennlinie" CURVE 0x1E3370 Kl_Xs16_Ws16 5000.000 Curr 0.00 5000.000 FORMAT "%8.3" EXTENDED_LIMITS -32768.00 32767.00
 /begin AXIS_DESCR STD_AXIS PCVCD_uRawVal_mp Volt 2 0.00 5200.391 FORMAT "%8.3" EXTENDED_LIMITS -160156.4 160151.5 DEPOSIT ABSOLUTE /end AXIS_DESCR
/end CHARACTERISTIC
/begin CHARACTERISTIC PCVCD_dcycMax_C "Max-Wert, Ausgangstastverhältnis" VALUE 0x1E337A Kw_Ws16 100.0000 DtyCyc 0.00 100.0000 FORMAT "%8.4" EXTENDED_LIMITS -327.6800 327.6700 /end CHARACTERISTIC
/begin CHARACTERISTIC PCVCD_dcycMin_C "Min-Wert, Ausgangstastverhältnis" VALUE 0x1E337C Kw_Ws16 100.0000 DtyCyc 0.00 100.0000 FORMAT "%8.4" EXTENDED_LIMITS -327.6800 327.6700 /end CHARACTERISTIC
/begin CHARACTERISTIC PCVCD_dcycTst_C "Tastverhältnis, das im Fehlerfall zyklisch ausgegeben wird" VALUE 0x1E337E Kw_Ws16 100.0000 DtyCyc 0.00 100.0000 FORMAT "%8.4" EXTENDED_LIMITS -327.6800 327.6700 /end CHARACTERISTIC
/begin CHARACTERISTIC PCVCD_DebExcTempDef_C "Fehlerentprellzeit Uebertemperatur" VALUE 0x1E3380 Kw_Wu16 655350.0 Time_ms 0.00 655350.0 FORMAT "%8.1" /end CHARACTERISTIC
/begin CHARACTERISTIC PCVCD_DebExcTempOk_C "Heilungsentprellzeit Uebertemperatur" VALUE 0x1E3382 Kw_Wu16 655350.0 Time_ms 0.00 655350.0 FORMAT "%8.1" /end CHARACTERISTIC
/begin CHARACTERISTIC PCVCD_DebNoLoadDef_C "Fehlerentprellzeit Leerlauf" VALUE 0x1E3384 Kw_Wu16 655350.0 Time_ms 0.00 655350.0 FORMAT "%8.1" /end CHARACTERISTIC
/begin CHARACTERISTIC PCVCD_DebNoLoadOk_C "Heilungszeit Leerlauf" VALUE 0x1E3386 Kw_Wu16 655350.0 Time_ms 0.00 655350.0 FORMAT "%8.1" /end CHARACTERISTIC
/begin CHARACTERISTIC PCVCD_DebShortCircBatDef_C "Fehlerentprellzeit Kurzschluss Batterie" VALUE 0x1E3388 Kw_Wu16 655350.0 Time_ms 0.00 655350.0 FORMAT "%8.1" /end CHARACTERISTIC
/begin CHARACTERISTIC PCVCD_DebShortCircBatOk_C "Heilungsentprellzeit Kurzschluss Batterie" VALUE 0x1E338A Kw_Wu16 655350.0 Time_ms 0.00 655350.0 FORMAT "%8.1" /end CHARACTERISTIC
/begin CHARACTERISTIC PCVCD_DebShortCircGndDef_C "Fehlerentprellzeit Kurzschluss Masse" VALUE 0x1E338C Kw_Wu16 655350.0 Time_ms 0.00 655350.0 FORMAT "%8.1" /end CHARACTERISTIC
/begin CHARACTERISTIC PCVCD_DebShortCircGndOk_C "Heilungsentprellzeit Kurzschluss Masse" VALUE 0x1E338E Kw_Wu16 655350.0 Time_ms 0.00 655350.0 FORMAT "%8.1" /end CHARACTERISTIC
/begin CHARACTERISTIC PCVCD_DebSRCHighDef_C "Fehlerentprellzeit für Analogeingang SRC-High Fehler" VALUE 0x1E3390 Kw_Wu16 655350.0 Time_ms 0.00 655350.0 FORMAT "%8.1" /end CHARACTERISTIC
/begin CHARACTERISTIC PCVCD_DebSRCHighOk_C "Heilungsentprellzeit für Analogeingang SRC-High Fehler" VALUE 0x1E3392 Kw_Wu16 655350.0 Time_ms 0.00 655350.0 FORMAT "%8.1" /end CHARACTERISTIC
/begin CHARACTERISTIC PCVCD_DebSRCLowDef_C "Fehlerentprellzeit Analogeingang SRC-Low Fehler" VALUE 0x1E3394 Kw_Wu16 655350.0 Time_ms 0.00 655350.0 FORMAT "%8.1" /end CHARACTERISTIC
/begin CHARACTERISTIC PCVCD_DebSRCLowOk_C "Heilungsentprellzeit für Analogeingang SRC-Low Fehler" VALUE 0x1E3396 Kw_Wu16 655350.0 Time_ms 0.00 655350.0 FORMAT "%8.1" /end CHARACTERISTIC
/begin CHARACTERISTIC PCVCD_facIGovInit_CUR "Initialisierungsfaktor für I-Anteil des Stromreglers als Funktion der Systemtemperatur" CURVE 0x1E3398 Kl_Xs16_Ws16 2.000000 Fact 0.00 2.000000 FORMAT "%8.6" EXTENDED_LIMITS -4.000000 3.999878
 /begin AXIS_DESCR STD_AXIS FlSys_t Temp_Cels 6 -50.14000 149.8600 FORMAT "%8.4" EXTENDED_LIMITS -3549.940 3003.560 DEPOSIT ABSOLUTE /end AXIS_DESCR
/end CHARACTERISTIC
/begin CHARACTERISTIC PCVCD_facIGovMax_C "maximaler I-Anteil" VALUE 0x1E33B2 Kw_Ws16 1.000000 Fact 1.000000 2.000000 FORMAT "%8.6" EXTENDED_LIMITS -4.000000 3.999878 /end CHARACTERISTIC
/begin CHARACTERISTIC PCVCD_facIGovMin_C "minimaler I-Anteil" VALUE 0x1E33B4 Kw_Ws16 0.5000000 Fact 0.5000000 1.000000 FORMAT "%8.6" EXTENDED_LIMITS -4.000000 3.999878 /end CHARACTERISTIC
/begin CHARACTERISTIC PCVCD_tiFlt1PT1_C "PT1 Filterzeitkonstante für Strom-Istwert" VALUE 0x1E33B8 Kw_Wu32 4294.9673 TimeDelay_s 0.0000010000000 4294.9673 FORMAT "%9.4" /end CHARACTERISTIC
/begin CHARACTERISTIC PCVCD_tiFlt2PT1_C "PT1 Filterzeitkonstante für Strom-Sollwert" VALUE 0x1E33BC Kw_Wu32 4294.9673 TimeDelay_s 0.0000010000000 4294.9673 FORMAT "%9.4" /end CHARACTERISTIC
/begin CHARACTERISTIC PCVCD_tiIGovDT1_C "DT1 Zeitkonstante" VALUE 0x1E33C0 Kw_Wu32 4294.9673 TimeDelay_s 0.0000010000000 4294.9673 FORMAT "%9.4" /end CHARACTERISTIC
/begin CHARACTERISTIC PCVCD_IGovDKd_C "DT1 Differenziationsfaktor" VALUE 0x1E33C4 Kw_Ws32 65535.9999847 Kd -32768.0000000 32767.9999847 FORMAT "%13.7" /end CHARACTERISTIC
/begin CHARACTERISTIC PCVCD_IGovIKi_C "I-Glied, Kleinsignalverstärkung" VALUE 0x1E33C8 Kw_Wu32 122.070312472 Ki_curr2fact 0.00 122.070312472 FORMAT "%13.9" /end CHARACTERISTIC
/begin CHARACTERISTIC PCVCD_IGovIKiPos_C "I-Glied, Verstärkung für positive Großsignale" VALUE 0x1E33CC Kw_Wu32 122.070312472 Ki_curr2fact 0.00 122.070312472 FORMAT "%13.9" /end CHARACTERISTIC
/begin CHARACTERISTIC PCVCD_IGovIKiNeg_C "I_Glied, Verstärkung für negative Großsignale" VALUE 0x1E33D0 Kw_Wu32 122.070312472 Ki_curr2fact 0.00 122.070312472 FORMAT "%13.9" /end CHARACTERISTIC
/begin CHARACTERISTIC PCVCD_iIGovIWinPos_C "I-Glied, Kleinsignalfenster positiv" VALUE 0x1E33D4 Kw_Ws16 65535.00 Curr -32768.00 32767.00 FORMAT "%8.2" /end CHARACTERISTIC
/begin CHARACTERISTIC PCVCD_iIGovIWinNeg_C "I_Glied, Kleinsignalfenster negativ" VALUE 0x1E33D6 Kw_Ws16 65535.00 Curr -32768.00 32767.00 FORMAT "%8.2" /end CHARACTERISTIC
/begin CHARACTERISTIC PCVCD_tiFltPT1Init_C "PT1 Filterzeitkonstante während Initialisierungsphase des Stromreglers" VALUE 0x1E33D8 Kw_Wu32 4294.9673 TimeDelay_s 0.0000010000000 4294.9673 FORMAT "%9.4" /end CHARACTERISTIC
/begin CHARACTERISTIC PCVCD_numAdc_C "Parameter für die Auswahl des Analogkanals für das Druckregelventil" VALUE 0x1E33DC Kw_Wu8 74.0000000000 NumPinAdc 0.00 74.0000000000 FORMAT "%13.10" /end CHARACTERISTIC
/begin CHARACTERISTIC PCVCD_numDia1_C "Parameter für Zuordnung der Diagnose zur 1. Endstufe des Druckregelventils" VALUE 0x1E33DD Kw_Wu8 42.0000000000 NumPinDia 0.00 42.0000000000 FORMAT "%13.10" /end CHARACTERISTIC
/begin CHARACTERISTIC PCVCD_numDia2_C "Parameter für Zuordnung der Diagnose zur 2. Endstufe des Druckregelventils" VALUE 0x1E33DE Kw_Wu8 42.0000000000 NumPinDia 0.00 42.0000000000 FORMAT "%13.10" /end CHARACTERISTIC
/begin CHARACTERISTIC PCVCD_numPwmOut_C "Parameter für die Auswahl des Hardware-Pins für das Druckregelventil" VALUE 0x1E33DF Kw_Wu8 13.0000000000 NumPinPwmOut 0.00 13.0000000000 FORMAT "%13.10" /end CHARACTERISTIC
/begin CHARACTERISTIC PCVCD_stInvOut_C "Invertierungsparameter der PWM Endstufe" VALUE 0x1E33E0 Kw_Wu8 1.000 OneToOne 0.00 1.000 FORMAT "%5.3" EXTENDED_LIMITS 0.00 255.0 /end CHARACTERISTIC
/begin CHARACTERISTIC PCVCD_tiPer_C "Periodendauer der PWM-Endstufe" VALUE 0x1E33E2 Kw_Ws16 9.900000 Period 0.1000000 10.00000 FORMAT "%8.5" EXTENDED_LIMITS -3276.800 3276.700 /end CHARACTERISTIC
/begin CHARACTERISTIC PCVCD_resCoil_C "Widerstandswert der DRV-Spule" VALUE 0x1E33E4 Kw_Ws16 5000.000 Resist_1 0.00 5000.000 FORMAT "%8.3" EXTENDED_LIMITS -32768.00 32767.00 /end CHARACTERISTIC
/begin CHARACTERISTIC PCVCD_stPwrStgDia_C "Statuswort zur Spezifikation des Abschaltverhaltens der Endstufenfehlerdiagnose Druckregelventil" VALUE 0x1E33E6 Kw_Wu8 255.0 OneToOne 0.00 255.0 FORMAT "%5.1" /end CHARACTERISTIC
/begin CHARACTERISTIC PCVCD_swtCtlStateVal_C "CP1: 0: konstant Stromregelung, 1: nur wenn Raildruckregler im gesteuerten Betrieb ist" VALUE 0x1E33E7 Kw_Wu8 0.00 OneToOne 0.00 0.00 FORMAT "%5.2" EXTENDED_LIMITS 0.00 255.0 /end CHARACTERISTIC
/begin CHARACTERISTIC PCVCD_swtCtlStateType_C "CP1: Auswahl, Schalterwert aus Datensatz oder EEPROM" VALUE 0x1E33E8 Kw_Wu8 1.000 OneToOne 1.000 2.000 FORMAT "%5.3" EXTENDED_LIMITS 0.00 255.0 /end CHARACTERISTIC
/begin CHARACTERISTIC PCVCD_swt_C "allgemeine Schalterfunktionen der Endstufe Druckregelventil" VALUE 0x1E33E9 Kw_Wu8 255.0 OneToOne 0.00 255.0 FORMAT "%5.1" /end CHARACTERISTIC
/begin CHARACTERISTIC PCVCD_tiBtwTst_C "Zeitabstand, in dem im Fehlerfall die Endstufe getestet wird" VALUE 0x1E33EA Kw_Wu16 29990.00 Time_ms 10.00000 30000.00 FORMAT "%8.2" EXTENDED_LIMITS 0.00 655350.0 /end CHARACTERISTIC
/begin CHARACTERISTIC PCVCD_tiIGovInit_C "maximale Zeitdauer der Initialisierungsphase für den Stromregler" VALUE 0x1E33EC Kw_Wu16 655350.0 Time_ms 0.00 655350.0 FORMAT "%8.1" /end CHARACTERISTIC
/begin CHARACTERISTIC PCV_dvolLeak_CUR "Leckage des Druckregelventils" CURVE 0x1E3326 Kl_Xs16_Ws16 150000.0 Qp_mm3_sec 0.00 150000.0 FORMAT "%8.1" EXTENDED_LIMITS -327680.0 327670.0
 /begin AXIS_DESCR STD_AXIS Rail_pSetPoint Pres_Rail 6 0.00 1800000. FORMAT "%8.0" EXTENDED_LIMITS -3276800. 3276700. DEPOSIT ABSOLUTE /end AXIS_DESCR
/end CHARACTERISTIC
/begin CHARACTERISTIC PCV_iCnvPress_CUR "Kennlinie zur Umrechnung von Raildruck in elektrischen Strom" CURVE 0x1E3340 Kl_Xs16_Ws16 5000.000 Curr 0.00 5000.000 FORMAT "%8.3" EXTENDED_LIMITS -32768.00 32767.00
 /begin AXIS_DESCR STD_AXIS Rail_pPCVSet Pres_Rail 10 0.00 1800000. FORMAT "%8.0" EXTENDED_LIMITS -3276800. 3276700. DEPOSIT ABSOLUTE /end AXIS_DESCR
/end CHARACTERISTIC
/begin CHARACTERISTIC PCV_iSetMin_C "Sollstrom bei elektrischer Abschaltung des Druckregelventils" VALUE 0x1E336A Kw_Ws16 65535.00 Curr -32768.00 32767.00 FORMAT "%8.2" /end CHARACTERISTIC
/begin CHARACTERISTIC PCV_iSet_Vector "Bypass-Label für PCV_iSet (Nicht verstellen!)" VALUE 0x1C0B30 Kw_Wu8 255.0 OneToOne 0.00 255.0 FORMAT "%5.1" /end CHARACTERISTIC
/begin CHARACTERISTIC PCV_iSet_Channel "Bypass-Label für PCV_iSet, nicht editieren!" VALUE 0x1C0B31 Kw_Wu8 255.0 OneToOne 0.00 255.0 FORMAT "%5.1" /end CHARACTERISTIC
/begin CHARACTERISTIC PFltCD_uSRCMinPDiff_C "Spannungsrohwert SRC-Min für Differenzdruck über Partikelfilter" VALUE 0x1E48F4 Kw_Ws16 5200.391 Volt 0.00 5200.391 FORMAT "%8.3" EXTENDED_LIMITS -160156.4 160151.5 /end CHARACTERISTIC
/begin CHARACTERISTIC PFltCD_uSRCMaxPDiff_C "Spannungsrohwert SRC_Max für Differenzdruck über Partikelfilter" VALUE 0x1E48F6 Kw_Ws16 5200.391 Volt 0.00 5200.391 FORMAT "%8.3" EXTENDED_LIMITS -160156.4 160151.5 /end CHARACTERISTIC
/begin CHARACTERISTIC PFltCD_pLinDiff1_CUR "Linearisierungskennlinie für Differenzdruck über Partikelfilter eins [hPa]" CURVE 0x1E48F8 Kl_Xs16_Ws16 1000.000 Pres_hPa 0.00 1000.000 FORMAT "%8.3" EXTENDED_LIMITS -32768.00 32767.00
 /begin AXIS_DESCR STD_AXIS PFltCD_uRawPresDiff Volt 25 0.00 5200.391 FORMAT "%8.3" EXTENDED_LIMITS -160156.4 160151.5 DEPOSIT ABSOLUTE /end AXIS_DESCR
/end CHARACTERISTIC
/begin CHARACTERISTIC PFltCD_uSRCMinTempPre_C "Spannungsrohwert SRC-Min der Abgastemperatur vor dem Partikelfilter [mV]" VALUE 0x1E497C Kw_Ws16 5200.391 Volt 0.00 5200.391 FORMAT "%8.3" EXTENDED_LIMITS -160156.4 160151.5 /end CHARACTERISTIC
/begin CHARACTERISTIC PFltCD_uSRCMaxTempPre_C "Spannungsrohwert SRC-Max der Abgastemperatur vor dem Partikelfilter [mV]" VALUE 0x1E497E Kw_Ws16 5200.391 Volt 0.00 5200.391 FORMAT "%8.3" EXTENDED_LIMITS -160156.4 160151.5 /end CHARACTERISTIC
/begin CHARACTERISTIC PFltCD_tLinPre1_CUR "Linearisierungskennlinie für Temperatur vor Partikelfilter [deg C]" CURVE 0x1E4980 Kl_Xs16_Ws16 1050.000 Temp_Cels -50.14000 999.8600 FORMAT "%8.4" EXTENDED_LIMITS -3549.940 3003.560
 /begin AXIS_DESCR STD_AXIS PFltCD_uRawTempPre Volt 40 0.00 5200.391 FORMAT "%8.3" EXTENDED_LIMITS -160156.4 160151.5 DEPOSIT ABSOLUTE /end AXIS_DESCR
/end CHARACTERISTIC
/begin CHARACTERISTIC PFltCD_DebSigPDiffDef_C "Fehlerentprellzeit Signal-Fehler über CAN für Differenzdruck über Partikelfilter" VALUE 0x1E495E Kw_Wu16 655350.0 Time_ms 0.00 655350.0 FORMAT "%8.1" /end CHARACTERISTIC
/begin CHARACTERISTIC PFltCD_DebSigPDiffOk_C "Heilungsentprellzeit Signal-Fehler über CAN für Differenzdruck über Partikelfilter" VALUE 0x1E4960 Kw_Wu16 655350.0 Time_ms 0.00 655350.0 FORMAT "%8.1" /end CHARACTERISTIC
/begin CHARACTERISTIC PFltCD_DebSRCHighPDiffDef_C "Fehlerentprellzeit SRC_High-Fehler für Differenzdruck über Partikelfilter [ms]" VALUE 0x1E4962 Kw_Wu16 655350.0 Time_ms 0.00 655350.0 FORMAT "%8.1" /end CHARACTERISTIC
/begin CHARACTERISTIC PFltCD_DebSRCHighPDiffOk_C "Heilungsentprellzeit SRC_High für Differenzdruck über Partikelfilter [ms]" VALUE 0x1E4964 Kw_Wu16 655350.0 Time_ms 0.00 655350.0 FORMAT "%8.1" /end CHARACTERISTIC
/begin CHARACTERISTIC PFltCD_DebSRCHighDefTPre_C "Fehlerentprellzeit SRC-High-Fehler für die Abgastemperatur vor dem Partikelfilter [ms]" VALUE 0x1E4A22 Kw_Wu16 655350.0 Time_ms 0.00 655350.0 FORMAT "%8.1" /end CHARACTERISTIC
/begin CHARACTERISTIC PFltCD_DebSRCHighOkTPre_C "Heilungsentprellzeit SRC-High für die Abgastemperatur vor dem Partikelfilter [ms]" VALUE 0x1E4A24 Kw_Wu16 655350.0 Time_ms 0.00 655350.0 FORMAT "%8.1" /end CHARACTERISTIC
/begin CHARACTERISTIC PFltCD_DebSRCLowPDiffDef_C "Fehlerentprellzeit SRC-Low-Fehler für Differenzdruck über Partikelfilter [ms]" VALUE 0x1E4966 Kw_Wu16 655350.0 Time_ms 0.00 655350.0 FORMAT "%8.1" /end CHARACTERISTIC
/begin CHARACTERISTIC PFltCD_DebSRCLowPDiffOk_C "Heilungsentprellzeit SRC-Low für Differenzdruck über Partikelfilter [ms]" VALUE 0x1E4968 Kw_Wu16 655350.0 Time_ms 0.00 655350.0 FORMAT "%8.1" /end CHARACTERISTIC
/begin CHARACTERISTIC PFltCD_DebSRCLowDefTPre_C "Fehlerentprellzeit SRC-Low-Fehler für die Abgastemperatur vor dem Partikelfilter [ms]" VALUE 0x1E4A26 Kw_Wu16 655350.0 Time_ms 0.00 655350.0 FORMAT "%8.1" /end CHARACTERISTIC
/begin CHARACTERISTIC PFltCD_DebSRCLowOkTPre_C "Heilungsentprellzeit SRC-Low für die Abgastemperatur vor dem Partikelfilter [ms]" VALUE 0x1E4A28 Kw_Wu16 655350.0 Time_ms 0.00 655350.0 FORMAT "%8.1" /end CHARACTERISTIC
/begin CHARACTERISTIC PFltCD_dtRmpSlpUpPDiff_C "Aufw.-Schritt für Rampe für Differenzdruck über Partikelfilter [kPa/s]" VALUE 0x1E496C Kw_Wu32 65535999.9847 RmpPres_hPa 0.00 65535999.9847 FORMAT "%13.4" /end CHARACTERISTIC
/begin CHARACTERISTIC PFltCD_dtRmpSlpDwnPDiff_C "Abw.-Schritt für Rampe für Differenzdruck über Partikelfilter [kPa/s]" VALUE 0x1E4970 Kw_Wu32 65535999.9847 RmpPres_hPa 0.00 65535999.9847 FORMAT "%13.4" /end CHARACTERISTIC
/begin CHARACTERISTIC PFltCD_dtRmpSlpUpPre_C "Aufw.-Schritt für Rampe der Abgastemperatur vor dem Partikelfilter [K/s]" VALUE 0x1E4A2C Kw_Wu32 6553599.99847 RmpTemp 0.00 6553599.99847 FORMAT "%13.5" /end CHARACTERISTIC
/begin CHARACTERISTIC PFltCD_dtRmpSlpDwnPre_C "Abw.-Schritt für Rampe der Abgastemperatur vor dem Partikelfilter [K/s]" VALUE 0x1E4A30 Kw_Wu32 6553599.99847 RmpTemp 0.00 6553599.99847 FORMAT "%13.5" /end CHARACTERISTIC
/begin CHARACTERISTIC PFltCD_numSSpPDiff_C "Wahlschalter für Sensorversorgungsspannungsmonitor" VALUE 0x1E4974 Kw_Wu8 2.000 OneToOne 1.000 3.000 FORMAT "%5.3" EXTENDED_LIMITS 0.00 255.0 /end CHARACTERISTIC
/begin CHARACTERISTIC PFltCD_rThresHtg_C "Schwellwert der Partikelfilterheizung" VALUE 0x1E4A38 Kw_Ws16 100.0000 Prc 0.00 100.0000 FORMAT "%8.4" EXTENDED_LIMITS -327.6800 327.6700 /end CHARACTERISTIC
/begin CHARACTERISTIC PFltCD_stInvOutHtg_C "Invertiertes Signal der Partikelfilterheizung" VALUE 0x1E4A3A Kw_Wu8 1.000 OneToOne 0.00 1.000 FORMAT "%5.3" EXTENDED_LIMITS 0.00 255.0 /end CHARACTERISTIC
/begin CHARACTERISTIC PFltCD_stPwrStgActvHtg_C "Abschaltbedingungen der Partikelfilterheizung" VALUE 0x1E4A3B Kw_Wu8 255.0 OneToOne 0.00 255.0 FORMAT "%5.1" /end CHARACTERISTIC
/begin CHARACTERISTIC PFltCD_stPwrStgDiaHtg_C "Abschaltbedingungen der Partikelfilterheizung" VALUE 0x1E4A3C Kw_Wu8 255.0 OneToOne 0.00 255.0 FORMAT "%5.1" /end CHARACTERISTIC
/begin CHARACTERISTIC PFltCD_swtSigPDiff_C "Wahlschalter für Eingangssignal des Differenzdrucksensors" VALUE 0x1E4975 Kw_Wu8 1.000 OneToOne 0.00 1.000 FORMAT "%5.3" EXTENDED_LIMITS 0.00 255.0 /end CHARACTERISTIC
/begin CHARACTERISTIC PFltCD_tiDebExcTmpHtgDef_C "Fehlerentprellzeit für Übertemperatur der Partikelfilterheizung [ms]" VALUE 0x1E4A3E Kw_Wu16 655350.0 Time_ms 0.00 655350.0 FORMAT "%8.1" /end CHARACTERISTIC
/begin CHARACTERISTIC PFltCD_tiDebExcTmpHtgOk_C "Heilungsentprellzeit für Übertemperatur der Partikelfilterheizung [ms]" VALUE 0x1E4A40 Kw_Wu16 655350.0 Time_ms 0.00 655350.0 FORMAT "%8.1" /end CHARACTERISTIC
/begin CHARACTERISTIC PFltCD_tiDebNoLoadHtgDef_C "Fehlerentprellzeit für Leerlauf der Partikelfilterheizung [ms]" VALUE 0x1E4A42 Kw_Wu16 655350.0 Time_ms 0.00 655350.0 FORMAT "%8.1" /end CHARACTERISTIC
/begin CHARACTERISTIC PFltCD_tiDebNoLoadHtgOk_C "Heilungsentprellzeit für Leerlauf der Partikelfilterheizung [ms]" VALUE 0x1E4A44 Kw_Wu16 655350.0 Time_ms 0.00 655350.0 FORMAT "%8.1" /end CHARACTERISTIC
/begin CHARACTERISTIC PFltCD_tiDebShrtBatHtgDef_C "Fehlerentprellzeit für Kurzschluß nach U-Batt der Partikelfilterheizung [ms]" VALUE 0x1E4A46 Kw_Wu16 655350.0 Time_ms 0.00 655350.0 FORMAT "%8.1" /end CHARACTERISTIC
/begin CHARACTERISTIC PFltCD_tiDebShrtBatHtgOk_C "Heilungsentprellzeit für Kurzschluß nach U-Batt der Partikelfilterheizung [ms]" VALUE 0x1E4A48 Kw_Wu16 655350.0 Time_ms 0.00 655350.0 FORMAT "%8.1" /end CHARACTERISTIC
/begin CHARACTERISTIC PFltCD_tiDebShrtGndHtgDef_C "Fehlerentprellzeit für Kurzschluß nach Masse der Partikelfilterheizung [ms]" VALUE 0x1E4A4A Kw_Wu16 655350.0 Time_ms 0.00 655350.0 FORMAT "%8.1" /end CHARACTERISTIC
/begin CHARACTERISTIC PFltCD_tiDebShrtGndHtgOk_C "Heilungsentprellzeit für Kurzschluß nach Masse der Partikelfilterheizung [ms]" VALUE 0x1E4A4C Kw_Wu16 655350.0 Time_ms 0.00 655350.0 FORMAT "%8.1" /end CHARACTERISTIC
/begin CHARACTERISTIC PFltCD_stSensIDWordPDiff_C "Geberkennwort für Differenzdruck über PFlt" VALUE 0x1E4976 Kw_Wu16 65535.00 OneToOne 0.00 65535.00 FORMAT "%8.2" /end CHARACTERISTIC
/begin CHARACTERISTIC PFltCD_pDflDiff_C "Vorgabewert für Diffenenzdruck über Partikelfilter [kPa]" VALUE 0x1E4978 Kw_Ws16 3500.000 Pres_hPa 0.00 3500.000 FORMAT "%8.3" EXTENDED_LIMITS -32768.00 32767.00 /end CHARACTERISTIC
/begin CHARACTERISTIC PFltCD_stSensIDWordTPre_C "Geberkennwort für Abgastemperatur vor dem Partikelfilter" VALUE 0x1E4A34 Kw_Wu16 65535.00 OneToOne 0.00 65535.00 FORMAT "%8.2" /end CHARACTERISTIC
/begin CHARACTERISTIC PFltCD_tDflPre_C "Vorgabewert für die Abgastemperatur vor dem Partikelfilter [K]" VALUE 0x1E4A36 Kw_Ws16 1050.000 Temp_Cels -50.14000 999.8600 FORMAT "%8.4" EXTENDED_LIMITS -3549.940 3003.560 /end CHARACTERISTIC
/begin MEASUREMENT OTSCD_stCanSndTemp "Status Öltemperatur  für CAN" UBYTE OneToOne 1 100 0.00 255.0 FORMAT "%5.1" ECU_ADDRESS 0x7F94D4 /end MEASUREMENT
/begin MEASUREMENT OTSCD_stClntThres_mp "Status der Kühlmitteltemperatur, bei welchem die Öltemperatur auf den aus dem Modell berechneten Ersatzwet schaltet" UBYTE OneToOne 1 100 0.00 255.0 FORMAT "%5.1" ECU_ADDRESS 0x803488 /end MEASUREMENT
/begin MEASUREMENT OTSCD_stOilTErr "Zustand des Öltemperatur - Errors" UBYTE OneToOne 1 100 0.00 255.0 FORMAT "%5.1" ECU_ADDRESS 0x7F94D5 /end MEASUREMENT
/begin MEASUREMENT OTSCD_stPlaus "status der Plausibilitaetspruefung OTF/WTF" UBYTE OneToOne 1 100 0.00 255.0 FORMAT "%5.1" ECU_ADDRESS 0x7F94D6 /end MEASUREMENT
/begin MEASUREMENT OTSCD_stPlausWIV "Status Plausibilitätstimers ( 0: gestopp t ,1: läuft)" UBYTE OneToOne 1 100 0.00 255.0 FORMAT "%5.1" ECU_ADDRESS 0x7F94D7 /end MEASUREMENT
/begin MEASUREMENT OTSCD_swtSig "Signalquelle Schalter ADC/CAN" UBYTE OneToOne 1 100 0.00 255.0 FORMAT "%5.1" ECU_ADDRESS 0x7F94D8 /end MEASUREMENT
/begin MEASUREMENT OTSCD_tEngOil "Motoröltemperatur" SWORD Temp_Cels 1 100 -3549.940 3003.560 FORMAT "%8.3" ECU_ADDRESS 0x7F9AAC /end MEASUREMENT
/begin MEASUREMENT OTSCD_tEngOilCur_mp "Die Öltemperatur wird über eine Kennlinie berechnet, wenn das Empfangen der Information über CAN appliziert ist." SWORD Temp_Cels 1 100 -3549.940 3003.560 FORMAT "%8.3" ECU_ADDRESS 0x80348A /end MEASUREMENT
/begin MEASUREMENT OTSCD_tEngOilLin "linearisierter Wert aus HWK vorm Aufruf der Übergangsfunktion" SWORD Temp_Cels 1 100 -3549.940 3003.560 FORMAT "%8.3" ECU_ADDRESS 0x7F9AAE /end MEASUREMENT
/begin MEASUREMENT OTSCD_tEngOilWIV "Motoröltemperatur für WIV3" SWORD Temp_Cels 1 100 -3549.940 3003.560 FORMAT "%8.3" ECU_ADDRESS 0x7F9AB0 /end MEASUREMENT
/begin MEASUREMENT OTSCD_tOilModel_mp "Öltemperatur - Ersatzwert aus dem Modell" SWORD Temp_Cels 1 100 -3549.940 3003.560 FORMAT "%8.3" ECU_ADDRESS 0x80348C /end MEASUREMENT
/begin MEASUREMENT OTSCD_uRaw "Rohwert des OTF-Sensors" SWORD Volt 1 100 -160156.4 160151.5 FORMAT "%8.1" ECU_ADDRESS 0x7F9AB2 /end MEASUREMENT
/begin MEASUREMENT OvRMon_ct10MS "In der 10ms Scheibe inkrementierter Zähler, welcher zur Zeitlichen Steuerung von OvRMon_Co verwendet wird." UWORD OneToOne 1 100 0.00 65535.00 FORMAT "%8.2" ECU_ADDRESS 0x7FAD0A /end MEASUREMENT
/begin MEASUREMENT OvRMon_ctCrCtlPDef_mp "Entprellzählerwert für die Cruise Control Plus" UWORD OneToOne 1 100 0.00 65535.00 FORMAT "%8.2" ECU_ADDRESS 0x80349E /end MEASUREMENT
/begin MEASUREMENT OvRMon_ctQInjDef_mp "Zählerstand für die Fehlerentprellung der red. Schubübrwachung" UWORD OneToOne 1 100 0.00 65535.00 FORMAT "%8.2" ECU_ADDRESS 0x8034B4 /end MEASUREMENT
/begin MEASUREMENT OvRMon_facBattCor_mp "Redundant eingelesener Battieriespannungskorrekturfaktor" SWORD Fact 1 100 -4.000000 3.999878 FORMAT "%8.6" ECU_ADDRESS 0x8034B6 /end MEASUREMENT
/begin MEASUREMENT OvRMon_nAvrg "Redundante mittlere Drehzahl in der Schubüberwachung" SWORD EngN 1 100 -32768.00 32767.00 FORMAT "%8.2" ECU_ADDRESS 0x7FAD0C /end MEASUREMENT
/begin MEASUREMENT OvRMon_nSeg_mp "Mittlere Segmentdrehzahl in der Schubüberwachung" SWORD EngN 1 100 -32768.00 32767.00 FORMAT "%8.2" ECU_ADDRESS 0x8034A2 /end MEASUREMENT
/begin MEASUREMENT OvRMon_phiInjAct_mp "Winkel der zuletzt bearbeiteten Einspritzung" SWORD AngleCrS 1 100 -768.0000 767.9766 FORMAT "%8.4" ECU_ADDRESS 0x8034A6 /end MEASUREMENT
/begin MEASUREMENT OvRMon_qLimEnh_mp "erweiterter Schubkennlinienausgang für OvR-Überwachung (mengenbasiert)" SWORD InjMass 1 100 -327.6800 327.6700 FORMAT "%8.4" ECU_ADDRESS 0x803490 /end MEASUREMENT
/begin MEASUREMENT OvRMon_stAccPed_mp "Status der Fahrpedal - Schubüberwachung" UBYTE OneToOne 1 100 0.00 255.0 FORMAT "%5.1" ECU_ADDRESS 0x803492 /end MEASUREMENT
/begin MEASUREMENT OvRMon_stACC_mp "Meßpunkt des OvRMon ACC Überwachungsstatus" UBYTE OneToOne 1 100 0.00 255.0 FORMAT "%5.1" ECU_ADDRESS 0x80348E /end MEASUREMENT
/begin MEASUREMENT OvRMon_stAPPDiff_mp "Status der Fahrpedalüberwachung" UBYTE OneToOne 1 100 0.00 255.0 FORMAT "%5.1" ECU_ADDRESS 0x803493 /end MEASUREMENT
/begin MEASUREMENT OvRMon_stAstAccs_mp "Status der Überwachung bei AST Eingriff" UBYTE OneToOne 1 100 0.00 255.0 FORMAT "%5.1" ECU_ADDRESS 0x80349C /end MEASUREMENT
/begin MEASUREMENT OvRMon_stBattSRCErr_mp "Status der SRC-Überprüfung der redundant eingelesenen Batteriespannung" UBYTE OneToOne 1 100 0.00 255.0 FORMAT "%5.1" ECU_ADDRESS 0x8034B8 /end MEASUREMENT
/begin MEASUREMENT OvRMon_stBrkMnRed_mp "Status des redundant eingelesenen Hauptbremsschalters und redundanten Bremsschalters" UBYTE OneToOne 1 100 0.00 255.0 FORMAT "%5.1" ECU_ADDRESS 0x8034B9 /end MEASUREMENT
/begin MEASUREMENT OvRMon_stBrkPressed "Brake state in a bit coded form whether Surely pressed or May have been pressed" UBYTE OneToOne 1 100 0.00 255.0 FORMAT "%5.1" ECU_ADDRESS 0x7F94D9 /end MEASUREMENT
/begin MEASUREMENT OvRMon_stBrkPressed_mp "Meldung Bremse betätigt in der Schubüberwachung" UBYTE OneToOne 1 100 0.00 255.0 FORMAT "%5.1" ECU_ADDRESS 0x8034BA /end MEASUREMENT
/begin MEASUREMENT OvRMon_stBrkSRCErr_mp "Status der SRC-Überprüfung des redundant eingelesenen Hauptbremsschalters" UBYTE OneToOne 1 100 0.00 255.0 FORMAT "%5.1" ECU_ADDRESS 0x8034BB /end MEASUREMENT
/begin MEASUREMENT OvRMon_stConvDebVal_mp "entprelltes Kupplungssignal in der Schubüberwachung" UBYTE OneToOne 1 100 0.00 255.0 FORMAT "%5.1" ECU_ADDRESS 0x8034BC /end MEASUREMENT
/begin MEASUREMENT OvRMon_stCrCtlP_mp "Staus der Cruise Control Plus Monitoring Funktion" UBYTE OneToOne 1 100 0.00 255.0 FORMAT "%5.1" ECU_ADDRESS 0x8034A0 /end MEASUREMENT
/begin MEASUREMENT OvRMon_stCrCtl_mp "Status der Fahrgeschwindigkeitsregelung - Schubüberwachung" UBYTE OneToOne 1 100 0.00 255.0 FORMAT "%5.1" ECU_ADDRESS 0x80349D /end MEASUREMENT
/begin MEASUREMENT OvRMon_stEnhOvRMode "Status der erweiterten Schubkennlinie" UBYTE OneToOne 1 100 0.00 255.0 FORMAT "%5.1" ECU_ADDRESS 0x7FACC6 /end MEASUREMENT
/begin MEASUREMENT OvRMon_stIntr "Interrupt-Status der operativen Ebene" UBYTE OneToOne 1 100 0.00 255.0 FORMAT "%5.1" ECU_ADDRESS 0x7FC56C /end MEASUREMENT
/begin MEASUREMENT OvRMon_stIntrInactv_mp "Status der Interruptkennung" UBYTE OneToOne 1 100 0.00 255.0 FORMAT "%5.1" ECU_ADDRESS 0x8034A4 /end MEASUREMENT
/begin MEASUREMENT OvRMon_stLowIdlValflt "Status des Leergasschalters - über OvRMon eingelesen" UBYTE OneToOne 1 100 0.00 255.0 FORMAT "%5.1" ECU_ADDRESS 0x7FACCA /end MEASUREMENT
/begin MEASUREMENT OvRMon_stLowIdlValRaw_mp "Redundant eingelesener Rohwert des Leergasschalters" UBYTE OneToOne 1 100 0.00 255.0 FORMAT "%5.1" ECU_ADDRESS 0x803494 /end MEASUREMENT
/begin MEASUREMENT OvRMon_stOvR "Freigabestatus der Schubüberwachung zur Übertragung vom Master zum Slave" UBYTE OneToOne 1 100 0.00 255.0 FORMAT "%5.1" ECU_ADDRESS 0x7FACC7 /end MEASUREMENT
/begin MEASUREMENT OvRMon_stOvRCpl "Komplement des Freigabestatus der Schubüberwachung zur Übertragung vom Master zum Slave" UBYTE OneToOne 1 100 0.00 255.0 FORMAT "%5.1" ECU_ADDRESS 0x801611 /end MEASUREMENT
/begin MEASUREMENT OvRMon_stRls_mp "Status aller Freigabe Bits für die Schubüberwachung" UWORD OneToOne 1 100 0.00 65535.00 FORMAT "%8.2" ECU_ADDRESS 0x8034BE /end MEASUREMENT
/begin MEASUREMENT OvRMon_stStCtl_mp "Status der Stabilitätskontrolle (Fahrdynamikregelung) - Schubüberwachung" UBYTE OneToOne 1 100 0.00 255.0 FORMAT "%5.1" ECU_ADDRESS 0x8034AC /end MEASUREMENT
/begin MEASUREMENT OvRMon_tiInjAct_mp "Ansteuerdauer der zuletzt bearbeiteten Einspritzung" UWORD InjTime_us 1 100 0.00 65535.00 FORMAT "%8.2" ECU_ADDRESS 0x8034A8 /end MEASUREMENT
/begin MEASUREMENT OvRMon_tiIntrSysAct "Systemzeit vom aktuellen Main-Interrupt" ULONG OneToOne 1 100 0.00 4294967295.00 FORMAT "%13.2" ECU_ADDRESS 0x7FC564 /end MEASUREMENT
/begin MEASUREMENT OvRMon_tiIntrSysLst "Systemzeit vom vorhergehenden Main-Interrupt" ULONG OneToOne 1 100 0.00 4294967295.00 FORMAT "%13.2" ECU_ADDRESS 0x7FC568 /end MEASUREMENT
/begin MEASUREMENT OvRMon_tiLimET_mp "Obergrenze der Ansteuerdauer der Schubüberwachung" SLONG InjTime_us 1 100 -2147483648.00 2147483647.00 FORMAT "%13.2" ECU_ADDRESS 0x8034B0 /end MEASUREMENT
/begin MEASUREMENT OvRMon_tiTDCAvrg "Mittlere momentwirksame Ansteuerdauer pro Zylinder in der Schubüberwachung" UWORD InjTime_us 1 100 0.00 65535.00 FORMAT "%8.2" ECU_ADDRESS 0x7FC570 /end MEASUREMENT
/begin MEASUREMENT OvRMon_tiTDCAvrgCpl "Komplement der mittleren momentwirksamen Ansteuerdauer pro Zylinder in der Schubüberwachung" UWORD InjTime_us 1 100 0.00 65535.00 FORMAT "%8.2" ECU_ADDRESS 0x7FC572 /end MEASUREMENT
/begin MEASUREMENT OvRMon_tiTDCSumET_mp "Summe der momentwirksamen Ansteuerdauern eines Zylinders" UWORD InjTime_us 1 100 0.00 65535.00 FORMAT "%8.2" ECU_ADDRESS 0x8034AA /end MEASUREMENT
/begin MEASUREMENT OvRMon_uBatt_mp "Geglätterter Wert der redundant eingelesenen Batteriespannung" SWORD Volt_Batt 1 100 -665674.1 665653.8 FORMAT "%8.1" ECU_ADDRESS 0x8034C0 /end MEASUREMENT
/begin MEASUREMENT OvRMon_uBrkMnSwtCor_mp "Batteriespannungskorrigierter Wert des redundant eingelesenen Hauptbremsschalters" SWORD Volt 1 100 -160156.4 160151.5 FORMAT "%8.1" ECU_ADDRESS 0x8034C2 /end MEASUREMENT
/begin MEASUREMENT OvRMon_uBrkMnSwtRaw_mp "Redundant eingelesener Spannungsrohwert des Hauptbremsschalters vom ADC" SWORD Volt 1 100 -160156.4 160151.5 FORMAT "%8.1" ECU_ADDRESS 0x8034C4 /end MEASUREMENT
/begin MEASUREMENT OvRMon_uBrkMnSwt_mp "Geglätterter Spannungswert des redundant eingelesenen Hauptbremsschalters" SWORD Volt 1 100 -160156.4 160151.5 FORMAT "%8.1" ECU_ADDRESS 0x8034C6 /end MEASUREMENT
/begin MEASUREMENT OvRMon_uRawAPP1 "Spannungswert (Fahrervorgabe - PWG) aus Ebene2 für die Cruise Control Plus Monitoring Funktion" SWORD Volt 1 100 -160156.4 160151.5 FORMAT "%8.1" ECU_ADDRESS 0x7FACC8 /end MEASUREMENT
/begin MEASUREMENT OvRMon_uRawBatt_mp "redundant eingelesener Batteriespannungsrohwert" SWORD Volt_Batt 1 100 -665674.1 665653.8 FORMAT "%8.1" ECU_ADDRESS 0x8034C8 /end MEASUREMENT
/begin MEASUREMENT OvRMon_uRawLowIdle_mp "Spannungsrohwert des redundant eingelesenen Leergasschalters" SWORD Volt 1 100 -160156.4 160151.5 FORMAT "%8.1" ECU_ADDRESS 0x803496 /end MEASUREMENT
/begin MEASUREMENT OvRMon_uRegAPP1_mp "ADC-Registerwert der Position von Fahrpedal 1" SWORD Volt 1 100 -160156.4 160151.5 FORMAT "%8.1" ECU_ADDRESS 0x803498 /end MEASUREMENT
/begin MEASUREMENT OvRMon_uRegAPP2_mp "ADC-Registerwert der Position von Fahrpedal 2" SWORD Volt 1 100 -160156.4 160151.5 FORMAT "%8.1" ECU_ADDRESS 0x80349A /end MEASUREMENT
/begin MEASUREMENT OxiCCD_tLinPre "linearisierter Wert Abgastemperatur vor Oxidationskatalysator" SWORD Temp_Cels 1 100 -3549.940 3003.560 FORMAT "%8.3" ECU_ADDRESS 0x7F9AB4 /end MEASUREMENT
/begin MEASUREMENT OxiCCD_tPre "Abgastemperatur vor Oxidationskatalysator" SWORD Temp_Cels 1 100 -3549.940 3003.560 FORMAT "%8.3" ECU_ADDRESS 0x7F9AB6 /end MEASUREMENT
/begin MEASUREMENT OxiCCD_uRawTempPre "Abgastemperatur vor Oxidationskatalysator Rohwert" SWORD Volt 1 100 0.00 5000.000 FORMAT "%8.3" ECU_ADDRESS 0x7F9AB8 /end MEASUREMENT
/begin MEASUREMENT PCR_dmAirAltCorr2_mp "Korrigierte Luftmasse in großer Höhe, zweites Luftsystem" SWORD AirMassPerTime 1 100 -3276.800 3276.700 FORMAT "%8.3" ECU_ADDRESS 0x8034DE /end MEASUREMENT
/begin MEASUREMENT PCR_dmAirAltCorr_mp "Korrigierte Luftmasse in großer Höhe, erstes Luftsystem" SWORD AirMassPerTime 1 100 -3276.800 3276.700 FORMAT "%8.3" ECU_ADDRESS 0x8034E0 /end MEASUREMENT
/begin MEASUREMENT PCR_dmAirPerTimeTstVal_mp "Luftmasse pro Zeiteinheit zur Korrektur" SWORD AirMassPerTime 1 100 -3276.800 3276.700 FORMAT "%8.3" ECU_ADDRESS 0x8034E2 /end MEASUREMENT
/begin MEASUREMENT PCR_dpBPDesStat_mp "Zeitliche Ableitung des Ladedrucksollwertes" SWORD Pres_hPaPerSec_20ms 1 100 -1638400. 1638350. FORMAT "%8.0" ECU_ADDRESS 0x80357C /end MEASUREMENT
/begin MEASUREMENT PCR_DT1_mp "Zeitkonstante für DT1-Glied" ULONG TimeDelay_s 1 100 0.0000010000000 4294.9673 FORMAT "%9.4" ECU_ADDRESS 0x803580 /end MEASUREMENT
/begin MEASUREMENT PCR_facAT_mp "Lufttemperaturabhängiger Faktor für Sollwertberechnung" SWORD Fact 1 100 -4.000000 3.999878 FORMAT "%8.6" ECU_ADDRESS 0x80354A /end MEASUREMENT
/begin MEASUREMENT PCR_facBalGvnrCorr_mp "Multiplikativen Korrekturfaktor des BiT Tastverhaeltnis" SWORD Fact1 1 100 -256.0000 255.9922 FORMAT "%8.4" ECU_ADDRESS 0x8034CA /end MEASUREMENT
/begin MEASUREMENT PCR_facBalGvnrI_mp "Adaptionsfaktor für Regler- I- Verstärkung" SWORD Fact1 1 100 -256.0000 255.9922 FORMAT "%8.4" ECU_ADDRESS 0x8034CC /end MEASUREMENT
/begin MEASUREMENT PCR_facBalGvnrP_mp "Adaptionsfaktor für Regler- P- Verstärkung" SWORD Fact1 1 100 -256.0000 255.9922 FORMAT "%8.4" ECU_ADDRESS 0x8034CE /end MEASUREMENT
/begin MEASUREMENT PCR_facBPAltCorr2_mp "Umrechnungsfaktor für Ladedruck in großer Höhe, zweites Luftsystem" SWORD Fact 1 100 -4.000000 3.999878 FORMAT "%8.6" ECU_ADDRESS 0x8034E4 /end MEASUREMENT
/begin MEASUREMENT PCR_facBPAltCorr_mp "Umrechnungsfaktor für Ladedruck in großer Höhe, erstes Luftsystem" SWORD Fact 1 100 -4.000000 3.999878 FORMAT "%8.6" ECU_ADDRESS 0x8034E6 /end MEASUREMENT
/begin MEASUREMENT PCR_facBPrdmCorr_mp "Korrekturwert des Luftmassenstroms" SWORD Fact 1 100 -4.000000 3.999878 FORMAT "%8.6" ECU_ADDRESS 0x8034E8 /end MEASUREMENT
/begin MEASUREMENT PCR_facCtlAT_mp "lufttemperaturabhängiger Korrekturfaktor für Ladedrucksteuerung" SWORD Fact 1 100 -4.000000 3.999878 FORMAT "%8.6" ECU_ADDRESS 0x803526 /end MEASUREMENT
/begin MEASUREMENT PCR_facCtQ_mp "Kühltemperaturabhängiger Faktor für Sollwertberechnung" SWORD Fact 1 100 -4.000000 3.999878 FORMAT "%8.6" ECU_ADDRESS 0x80354C /end MEASUREMENT
/begin MEASUREMENT PCR_facD_mp "Adaptionsfaktor für Regler-D-Verstärkung" SWORD Fact 1 100 -4.000000 3.999878 FORMAT "%8.6" ECU_ADDRESS 0x803584 /end MEASUREMENT
/begin MEASUREMENT PCR_facI_mp "Adaptionsfaktor für Regler-I-Verstärkung" SWORD Fact 1 100 -4.000000 3.999878 FORMAT "%8.6" ECU_ADDRESS 0x803586 /end MEASUREMENT
/begin MEASUREMENT PCR_facPAltCorr2_mp "Umrechnungsfaktor Umgebungsdruck in Druck vor Verdichter, zweites Luftsystem" SWORD Fact 1 100 -4.000000 3.999878 FORMAT "%8.6" ECU_ADDRESS 0x8034EA /end MEASUREMENT
/begin MEASUREMENT PCR_facPAltCorr_mp "Umrechnungsfaktor Umgebungsdruck in Druck vor Verdichter, erstes Luftsystem" SWORD Fact 1 100 -4.000000 3.999878 FORMAT "%8.6" ECU_ADDRESS 0x8034EC /end MEASUREMENT
/begin MEASUREMENT PCR_facP_mp "Adaptionsfaktor für Regler-P-Verstärkung" SWORD Fact 1 100 -4.000000 3.999878 FORMAT "%8.6" ECU_ADDRESS 0x803588 /end MEASUREMENT
/begin MEASUREMENT PCR_facTAltCorr2_mp "Umrechnungsfaktor Umgebungstemperatur in Temperatur vor Verdichter, zweites Luftsystem" SWORD Fact 1 100 -4.000000 3.999878 FORMAT "%8.6" ECU_ADDRESS 0x8034EE /end MEASUREMENT
/begin MEASUREMENT PCR_facTAltCorr_mp "Umrechnungsfaktor Umgebungstemperatur in Temperatur vor Verdichter, erstes Luftsystem" SWORD Fact 1 100 -4.000000 3.999878 FORMAT "%8.6" ECU_ADDRESS 0x8034F0 /end MEASUREMENT
/begin MEASUREMENT PCR_facTrbnRed_mp "Korrekturfaktor für aktuelle Laderdrehzahl" SWORD Fact 1 100 -4.000000 3.999878 FORMAT "%8.6" ECU_ADDRESS 0x8034F2 /end MEASUREMENT
/begin MEASUREMENT PCR_nBalGovDev_mp "Regelabweichung des Bi-Turboreglers" SWORD TurboN 1 100 -327680.0 327670.0 FORMAT "%8.1" ECU_ADDRESS 0x8034D0 /end MEASUREMENT
/begin MEASUREMENT PCR_nTrbn "Laderdrehzahl linkes System" SWORD TurboN 1 100 -327680.0 327670.0 FORMAT "%8.1" ECU_ADDRESS 0x7F9ABA /end MEASUREMENT
/begin MEASUREMENT PCR_nTrbn2 "Laderdrehzahl rechtes Sytem" SWORD TurboN 1 100 -327680.0 327670.0 FORMAT "%8.1" ECU_ADDRESS 0x7F9ABC /end MEASUREMENT
/begin MEASUREMENT PCR_nTrbnFlt2_mp "gefilterte Laderdrehzahl Luftsystem 2" SWORD TurboN 1 100 -327680.0 327670.0 FORMAT "%8.1" ECU_ADDRESS 0x8034F4 /end MEASUREMENT
/begin MEASUREMENT PCR_nTrbnFlt_mp "gefilterte Laderdrehzahl" SWORD TurboN 1 100 -327680.0 327670.0 FORMAT "%8.1" ECU_ADDRESS 0x8034F6 /end MEASUREMENT
/begin MEASUREMENT PCR_nTrbnMax_mp "maximale Laderdrehzahl" SWORD TurboN 1 100 -327680.0 327670.0 FORMAT "%8.1" ECU_ADDRESS 0x8034F8 /end MEASUREMENT
/begin MEASUREMENT PCR_nTrbnRed2_mp "reduzierte Laderdrehzahl Luftsystem 2" SWORD TurboN 1 100 -327680.0 327670.0 FORMAT "%8.1" ECU_ADDRESS 0x8034FA /end MEASUREMENT
/begin MEASUREMENT PCR_nTrbnRedMax_mp "maximale reduzierte Laderdrehzahl" SWORD TurboN 1 100 -327680.0 327670.0 FORMAT "%8.1" ECU_ADDRESS 0x8034FC /end MEASUREMENT
/begin MEASUREMENT PCR_nTrbnRed_mp "reduzierte Laderdrehzahl" SWORD TurboN 1 100 -327680.0 327670.0 FORMAT "%8.1" ECU_ADDRESS 0x8034FE /end MEASUREMENT
/begin MEASUREMENT PCR_pAirAltCorr2_mp "Druck vor Verdichter, zweites Luftsystem" SWORD Pres_hPa 1 100 -32768.00 32767.00 FORMAT "%8.2" ECU_ADDRESS 0x803500 /end MEASUREMENT
/begin MEASUREMENT PCR_pAirAltCorr_mp "Druck vor Verdichter, erstes Luftsystem" SWORD Pres_hPa 1 100 -32768.00 32767.00 FORMAT "%8.2" ECU_ADDRESS 0x803502 /end MEASUREMENT
/begin MEASUREMENT PCR_pAPQCmpn_mp "luftdruckabhängige Kompensation für Sollwertbildung" SWORD Pres_hPa 1 100 -32768.00 32767.00 FORMAT "%8.2" ECU_ADDRESS 0x80354E /end MEASUREMENT
/begin MEASUREMENT PCR_pBDes "Ladedrucksollwert" SWORD Pres_hPa 1 100 -32768.00 32767.00 FORMAT "%8.2" ECU_ADDRESS 0x7F9ABE /end MEASUREMENT
/begin MEASUREMENT PCR_pBDes1_mp "stationärer Ladedruck für Partikelfilter Regeneration 1 vor Korrektur" SWORD Pres_hPa 1 100 -32768.00 32767.00 FORMAT "%8.2" ECU_ADDRESS 0x803550 /end MEASUREMENT
/begin MEASUREMENT PCR_pBDes2_mp "stationärer Ladedruck für Partikelfilter Regeneration 2 vor Korrektur" SWORD Pres_hPa 1 100 -32768.00 32767.00 FORMAT "%8.2" ECU_ADDRESS 0x803552 /end MEASUREMENT
/begin MEASUREMENT PCR_pBDes3_mp "Ladedrucksollwert im Regenerationsbetrieb 3 vor Abgasdruckkorrektur" SWORD Pres_hPa 1 100 -32768.00 32767.00 FORMAT "%8.2" ECU_ADDRESS 0x803554 /end MEASUREMENT
/begin MEASUREMENT PCR_pBDes4_mp "Ladedrucksollwert im Regenerationsbetrieb 4 vor Abgasdruckkorrektur" SWORD Pres_hPa 1 100 -32768.00 32767.00 FORMAT "%8.2" ECU_ADDRESS 0x803556 /end MEASUREMENT
/begin MEASUREMENT PCR_pBDesAPCorr_mp "Luftdruckabhängige Korrektur des Ladedrucksollwerts" SWORD Pres_hPa 1 100 -32768.00 32767.00 FORMAT "%8.2" ECU_ADDRESS 0x803558 /end MEASUREMENT
/begin MEASUREMENT PCR_pBDesATCorr_mp "Bezüglich Lufttemperatur korrigierter Ladedrucksollwert" SWORD Pres_hPa 1 100 -32768.00 32767.00 FORMAT "%8.2" ECU_ADDRESS 0x80355A /end MEASUREMENT
/begin MEASUREMENT PCR_pBDesBas_mp "Grundwert des Ladedrucksollwertes" SWORD Pres_hPa 1 100 -32768.00 32767.00 FORMAT "%8.2" ECU_ADDRESS 0x80355C /end MEASUREMENT
/begin MEASUREMENT PCR_pBDesByp_mp "Bypass-Label, Kopie von PCR_pBDes" SWORD Pres_hPa 1 100 -32768.00 32767.00 FORMAT "%8.2" ECU_ADDRESS 0x80355E /end MEASUREMENT
/begin MEASUREMENT PCR_pBDesCorr_mp "korrigierter Ladedrucksollwert" SWORD Pres_hPa 1 100 -32768.00 32767.00 FORMAT "%8.2" ECU_ADDRESS 0x803560 /end MEASUREMENT
/begin MEASUREMENT PCR_pBDesCtCorr_mp "Kühltemperaturkorrigierter Wert des Ladedrucksollwerts" SWORD Pres_hPa 1 100 -32768.00 32767.00 FORMAT "%8.2" ECU_ADDRESS 0x803562 /end MEASUREMENT
/begin MEASUREMENT PCR_pBDesDyn_mp "Dynamischer Teil des Ladedrucksollwerts" SWORD Pres_hPa 1 100 -32768.00 32767.00 FORMAT "%8.2" ECU_ADDRESS 0x803564 /end MEASUREMENT
/begin MEASUREMENT PCR_pBDesMaxAP_mp "Größter erlaubter Ladedrucksollwert in Abhängigkeit vom Luftdruck" SWORD Pres_hPa 1 100 -32768.00 32767.00 FORMAT "%8.2" ECU_ADDRESS 0x803566 /end MEASUREMENT
/begin MEASUREMENT PCR_pBDesRaw_mp "Unbegrenzter Ladedrucksollwert mit Vorsteuerung" SWORD Pres_hPa 1 100 -32768.00 32767.00 FORMAT "%8.2" ECU_ADDRESS 0x803568 /end MEASUREMENT
/begin MEASUREMENT PCR_pBDesRgn0_mp "stationärer Basissollwert für den Ladedruck im Standardbetrieb" SWORD Pres_hPa 1 100 -32768.00 32767.00 FORMAT "%8.2" ECU_ADDRESS 0x80356A /end MEASUREMENT
/begin MEASUREMENT PCR_pBDesRgn1_mp "stationärer Ladedruck für Partikelfilter Regeneration 1" SWORD Pres_hPa 1 100 -32768.00 32767.00 FORMAT "%8.2" ECU_ADDRESS 0x80356C /end MEASUREMENT
/begin MEASUREMENT PCR_pBDesRgn2_mp "stationärer Ladedruck für Partikelfilter Regeneration 2" SWORD Pres_hPa 1 100 -32768.00 32767.00 FORMAT "%8.2" ECU_ADDRESS 0x80356E /end MEASUREMENT
/begin MEASUREMENT PCR_pBDesRgn3_mp "Ladedrucksollwert im Regenerationsbetrieb 3" SWORD Pres_hPa 1 100 -32768.00 32767.00 FORMAT "%8.2" ECU_ADDRESS 0x803570 /end MEASUREMENT
/begin MEASUREMENT PCR_pBDesRgn4_mp "Ladedrucksollwert im Regenerationsbetrieb 4" SWORD Pres_hPa 1 100 -32768.00 32767.00 FORMAT "%8.2" ECU_ADDRESS 0x803572 /end MEASUREMENT
/begin MEASUREMENT PCR_pBDesVal_mp "Ladedrucksollwert vor Korrektur" SWORD Pres_hPa 1 100 -32768.00 32767.00 FORMAT "%8.2" ECU_ADDRESS 0x803574 /end MEASUREMENT
/begin MEASUREMENT PCR_pBDes_mp "gewälter unbegrenzerter Ladedrucksollwert" SWORD Pres_hPa 1 100 -32768.00 32767.00 FORMAT "%8.2" ECU_ADDRESS 0x803576 /end MEASUREMENT
/begin MEASUREMENT PCR_pBGDev "Regelabweichung" SWORD Pres_hPa 1 100 -32768.00 32767.00 FORMAT "%8.2" ECU_ADDRESS 0x7F9AC0 /end MEASUREMENT
/begin MEASUREMENT PCR_pBGDevI_mp "Regelabweichung für I-Anteil" SWORD Pres_hPa 1 100 -32768.00 32767.00 FORMAT "%8.2" ECU_ADDRESS 0x80358A /end MEASUREMENT
/begin MEASUREMENT PCR_pBGDevMax_mp "Maximale Reglerabweichung" SWORD Pres_hPa 1 100 -32768.00 32767.00 FORMAT "%8.2" ECU_ADDRESS 0x8035AE /end MEASUREMENT
/begin MEASUREMENT PCR_pBPAltDesMax2_mp "Laderdrehzahllimit in großer Höhe ohne Luftmassenkorrektur rechtes System" SWORD Pres_hPa 1 100 -32768.00 32767.00 FORMAT "%8.2" ECU_ADDRESS 0x803504 /end MEASUREMENT
/begin MEASUREMENT PCR_pBPAltDesMaxCorr "korrigierter erlaubter Ladedruck" SWORD Pres_hPa 1 100 -32768.00 32767.00 FORMAT "%8.2" ECU_ADDRESS 0x7F9AC2 /end MEASUREMENT
/begin MEASUREMENT PCR_pBPAltDesMaxCorr2 "korrigierter erlaubter Ladedruck Luftsytem 2" SWORD Pres_hPa 1 100 -32768.00 32767.00 FORMAT "%8.2" ECU_ADDRESS 0x7F9AC4 /end MEASUREMENT
/begin MEASUREMENT PCR_pBPAltDesMax_mp "Laderdrehzahllimit in großer Höhe ohne Luftmassenkorrektur linkes System" SWORD Pres_hPa 1 100 -32768.00 32767.00 FORMAT "%8.2" ECU_ADDRESS 0x803506 /end MEASUREMENT
/begin MEASUREMENT PCR_pBPDesStat "stationärer Anteil des Ladedrucksollwertes" SWORD Pres_hPa 1 100 -32768.00 32767.00 FORMAT "%8.2" ECU_ADDRESS 0x7F9AC6 /end MEASUREMENT
/begin MEASUREMENT PCR_pBPIntValCorr2_mp "s" SWORD Pres_hPa 1 100 -32768.00 32767.00 FORMAT "%8.2" ECU_ADDRESS 0x803508 /end MEASUREMENT
/begin MEASUREMENT PCR_pBPIntValCorr_mp "Druck nach Verdichter (vor Ladeluftkühler 1" SWORD Pres_hPa 1 100 -32768.00 32767.00 FORMAT "%8.2" ECU_ADDRESS 0x80350A /end MEASUREMENT
/begin MEASUREMENT PCR_pNQCtCmpn_mp "Korrekturwert für Kühlwassertemperaturkorrektur für Sollwertberechnung" SWORD Pres_hPa 1 100 -32768.00 32767.00 FORMAT "%8.2" ECU_ADDRESS 0x803578 /end MEASUREMENT
/begin MEASUREMENT PCR_qCtl "für die Steuerung benutztes Einspritzmengensignal" SWORD InjMass 1 100 -327.6800 327.6700 FORMAT "%8.4" ECU_ADDRESS 0x7F9AC8 /end MEASUREMENT
/begin MEASUREMENT PCR_qCtlByp_mp "Bypass message für PCR_qCtl" SWORD InjMass 1 100 -327.6800 327.6700 FORMAT "%8.4" ECU_ADDRESS 0x803528 /end MEASUREMENT
/begin MEASUREMENT PCR_qDes "Einspritzmenge für Sollwertbildung" SWORD InjMass 1 100 -327.6800 327.6700 FORMAT "%8.4" ECU_ADDRESS 0x7F9ACA /end MEASUREMENT
/begin MEASUREMENT PCR_qMinBPGovFlt_mp "Minimale Einspritzmenge zur Aktivierung der Ladergeräuschunterdrückung" SWORD InjMass 1 100 -327.6800 327.6700 FORMAT "%8.4" ECU_ADDRESS 0x80358C /end MEASUREMENT
/begin MEASUREMENT PCR_qMonOff_mp "untere Schwelle der Abschalthysterese" SWORD InjMass 1 100 -327.6800 327.6700 FORMAT "%8.4" ECU_ADDRESS 0x80358E /end MEASUREMENT
/begin MEASUREMENT PCR_qMonOn_mp "obere Schwelle der Abschalthysterese" SWORD InjMass 1 100 -327.6800 327.6700 FORMAT "%8.4" ECU_ADDRESS 0x803590 /end MEASUREMENT
/begin MEASUREMENT PCR_rBalGvnrDiff "Tastverhältnis Gleichstellungsregler" SWORD Prc 1 100 -327.6800 327.6700 FORMAT "%8.4" ECU_ADDRESS 0x7F9AD6 /end MEASUREMENT
/begin MEASUREMENT PCR_rBalGvnrMax_mp "Max - Begrenzung Tastverhältnis Gleichstellungsregler" SWORD Prc 1 100 -327.6800 327.6700 FORMAT "%8.4" ECU_ADDRESS 0x8034D2 /end MEASUREMENT
/begin MEASUREMENT PCR_rBalGvnrMin_mp "Min- Begrenzung Tastverhältnis Gleichstellungsregler" SWORD Prc 1 100 -327.6800 327.6700 FORMAT "%8.4" ECU_ADDRESS 0x8034D4 /end MEASUREMENT
/begin MEASUREMENT PCR_rBalGvnrOutI_mp "I- Anteil des PI- Gleichstellungsregler" SWORD Prc 1 100 -327.6800 327.6700 FORMAT "%8.4" ECU_ADDRESS 0x8034D6 /end MEASUREMENT
/begin MEASUREMENT PCR_rBalGvnrOutP_mp "P- Anteil des PI- Gleichstellungsregler" SWORD Prc 1 100 -327.6800 327.6700 FORMAT "%8.4" ECU_ADDRESS 0x8034D8 /end MEASUREMENT
/begin MEASUREMENT PCR_rBalGvnrOut_mp "Tastverhältnis Gleichstellungsregler unkorrigiert" SWORD Prc 1 100 -327.6800 327.6700 FORMAT "%8.4" ECU_ADDRESS 0x8034DA /end MEASUREMENT
/begin MEASUREMENT PCR_rBalGvnrSt_mp "BiT Laderabgleich Umschaltung Regeln/Steuern" SWORD Prc 1 100 -327.6800 327.6700 FORMAT "%8.4" ECU_ADDRESS 0x8034DC /end MEASUREMENT
/begin MEASUREMENT PCR_rBPACD "Stellgröße für den Ladedrucksteller" SWORD Prc 1 100 -327.6800 327.6700 FORMAT "%8.4" ECU_ADDRESS 0x7F9ACC /end MEASUREMENT
/begin MEASUREMENT PCR_rBPACD2 "Stellgröße für den zweiten Ladedrucksteller" SWORD Prc 1 100 -327.6800 327.6700 FORMAT "%8.4" ECU_ADDRESS 0x7F9ACE /end MEASUREMENT
/begin MEASUREMENT PCR_rBPACDByp_mp "Bypass-Label, Kopie von PCR_rBPACD" SWORD Prc 1 100 -327.6800 327.6700 FORMAT "%8.4" ECU_ADDRESS 0x8035B0 /end MEASUREMENT
/begin MEASUREMENT PCR_rBPAltCorr2_mp "Druckverhältnis aus Lade- und korrigiertem Ansaugdruck rechtes System" SWORD Prc 1 100 -327.6800 327.6700 FORMAT "%8.4" ECU_ADDRESS 0x80350C /end MEASUREMENT
/begin MEASUREMENT PCR_rBPAltCorr_mp "Druckverhältnis aus Lade- und korrigiertem Ansaugdruck linkes System" SWORD Prc 1 100 -327.6800 327.6700 FORMAT "%8.4" ECU_ADDRESS 0x80350E /end MEASUREMENT
/begin MEASUREMENT PCR_rBPAltDesMax2_mp "Vorgesteuertes Ladedruckverhältnis für große Höhen rechtes System" SWORD Prc 1 100 -327.6800 327.6700 FORMAT "%8.4" ECU_ADDRESS 0x803510 /end MEASUREMENT
/begin MEASUREMENT PCR_rBPAltDesMax_mp "Vorgesteuertes Ladedruckverhältnis für große Höhen linkes System" SWORD Prc 1 100 -327.6800 327.6700 FORMAT "%8.4" ECU_ADDRESS 0x803512 /end MEASUREMENT
/begin MEASUREMENT PCR_rBPAltDyn2_mp "Ladedruckverhältnis des Vorfilters in großen Höhen rechtes System" SWORD Prc 1 100 -327.6800 327.6700 FORMAT "%8.4" ECU_ADDRESS 0x803514 /end MEASUREMENT
/begin MEASUREMENT PCR_rBPAltDynLim2_mp "Limitiertes Ladedruckverhältnis des Vorfilter in großen Höhen rechtes System" SWORD Prc 1 100 -327.6800 327.6700 FORMAT "%8.4" ECU_ADDRESS 0x803516 /end MEASUREMENT
/begin MEASUREMENT PCR_rBPAltDynLim_mp "Limitiertes Ladedruckverhältnis des Vorfilter in großen Höhen linkes System" SWORD Prc 1 100 -327.6800 327.6700 FORMAT "%8.4" ECU_ADDRESS 0x803518 /end MEASUREMENT
/begin MEASUREMENT PCR_rBPAltDyn_mp "Ladedruckverhältnis des Vorfilters in großen Höhen linkes System" SWORD Prc 1 100 -327.6800 327.6700 FORMAT "%8.4" ECU_ADDRESS 0x80351A /end MEASUREMENT
/begin MEASUREMENT PCR_rBPAltMax2_mp "Ladedruckverhältnis ohne Vorfilter in großen Höhen rechtes System" SWORD Prc 1 100 -327.6800 327.6700 FORMAT "%8.4" ECU_ADDRESS 0x80351C /end MEASUREMENT
/begin MEASUREMENT PCR_rBPAltMax_mp "Ladedruckverhältnis ohne Vorfilter in großen Höhen linkes System" SWORD Prc 1 100 -327.6800 327.6700 FORMAT "%8.4" ECU_ADDRESS 0x80351E /end MEASUREMENT
/begin MEASUREMENT PCR_rBPCtl "Ladedruck Steueranteil der Stellgrösse" SWORD Prc 1 100 -327.6800 327.6700 FORMAT "%8.4" ECU_ADDRESS 0x7F9AD0 /end MEASUREMENT
/begin MEASUREMENT PCR_rBPCtl1_mp "gesteuerter Ladedruck für Partikelfilter Regeneration 1 vor Korrektur" SWORD Prc 1 100 -327.6800 327.6700 FORMAT "%8.4" ECU_ADDRESS 0x80352A /end MEASUREMENT
/begin MEASUREMENT PCR_rBPCtl2_mp "gesteuerter Ladedruck für Partikelfilter Regeneration 2 vor Korrektur" SWORD Prc 1 100 -327.6800 327.6700 FORMAT "%8.4" ECU_ADDRESS 0x80352C /end MEASUREMENT
/begin MEASUREMENT PCR_rBPCtl3_mp "Steuerwert im Regenerationsbetrieb 3 vor Abgasdruckkorrektur" SWORD Prc 1 100 -327.6800 327.6700 FORMAT "%8.4" ECU_ADDRESS 0x80352E /end MEASUREMENT
/begin MEASUREMENT PCR_rBPCtl4_mp "Steuerwert im Regenerationsbetrieb 4 vor Abgasdruckkorrektur" SWORD Prc 1 100 -327.6800 327.6700 FORMAT "%8.4" ECU_ADDRESS 0x803530 /end MEASUREMENT
/begin MEASUREMENT PCR_rBPCtlAPCorr_mp "in Abhängigkeit des Atmosphärendrucks korrigierter Steuerwert" SWORD Prc 1 100 -327.6800 327.6700 FORMAT "%8.4" ECU_ADDRESS 0x803532 /end MEASUREMENT
/begin MEASUREMENT PCR_rBPCtlBas_mp "Basissteuerwert für Ladedruck" SWORD Prc 1 100 -327.6800 327.6700 FORMAT "%8.4" ECU_ADDRESS 0x803534 /end MEASUREMENT
/begin MEASUREMENT PCR_rBPCtlByp_mp "Bypass message für PCR_rBPCtl" SWORD Prc 1 100 -327.6800 327.6700 FORMAT "%8.4" ECU_ADDRESS 0x803536 /end MEASUREMENT
/begin MEASUREMENT PCR_rBPCtlCorr_mp "korrigierter Steuerwert für Ladedruck" SWORD Prc 1 100 -327.6800 327.6700 FORMAT "%8.4" ECU_ADDRESS 0x803538 /end MEASUREMENT
/begin MEASUREMENT PCR_rBPCtlRaw_mp "Rohwert des Steuerwertes für Ladedruck" SWORD Prc 1 100 -327.6800 327.6700 FORMAT "%8.4" ECU_ADDRESS 0x80353A /end MEASUREMENT
/begin MEASUREMENT PCR_rBPCtlRgn0_mp "Basissteuerwert für Ladedruck" SWORD Prc 1 100 -327.6800 327.6700 FORMAT "%8.4" ECU_ADDRESS 0x80353C /end MEASUREMENT
/begin MEASUREMENT PCR_rBPCtlRgn1_mp "gesteuerter Ladedruck für Partikelfilter Regeneration 1" SWORD Prc 1 100 -327.6800 327.6700 FORMAT "%8.4" ECU_ADDRESS 0x80353E /end MEASUREMENT
/begin MEASUREMENT PCR_rBPCtlRgn2_mp "gesteuerter Ladedruck für Partikelfilter Regeneration 2" SWORD Prc 1 100 -327.6800 327.6700 FORMAT "%8.4" ECU_ADDRESS 0x803540 /end MEASUREMENT
/begin MEASUREMENT PCR_rBPCtlRgn3_mp "Steuerwert im Regenerationsbetrieb 3" SWORD Prc 1 100 -327.6800 327.6700 FORMAT "%8.4" ECU_ADDRESS 0x803542 /end MEASUREMENT
/begin MEASUREMENT PCR_rBPCtlRgn4_mp "Steuerwert im Regenerationsbetrieb 4" SWORD Prc 1 100 -327.6800 327.6700 FORMAT "%8.4" ECU_ADDRESS 0x803544 /end MEASUREMENT
/begin MEASUREMENT PCR_rBPCtlVal_mp "Steuerwert vor Korrektur" SWORD Prc 1 100 -327.6800 327.6700 FORMAT "%8.4" ECU_ADDRESS 0x803546 /end MEASUREMENT
/begin MEASUREMENT PCR_rBPGov "Reglerstellgröße für den Ladedruck" SWORD Prc 1 100 -327.6800 327.6700 FORMAT "%8.4" ECU_ADDRESS 0x7F9AD2 /end MEASUREMENT
/begin MEASUREMENT PCR_rBPGov2 "Reglerstellgröße für den Ladedruck 2" SWORD Prc 1 100 -327.6800 327.6700 FORMAT "%8.4" ECU_ADDRESS 0x7F9AD4 /end MEASUREMENT
/begin MEASUREMENT PCR_rBPGovByp_mp "Meßpunkt für Bypass Freischnitt" SWORD Prc 1 100 -327.6800 327.6700 FORMAT "%8.4" ECU_ADDRESS 0x803592 /end MEASUREMENT
/begin MEASUREMENT PCR_rBPGovFlt_mp "PT1 gefilterter Reglerausgang im Falle einer aktiven Ladergeräuschunterdrückung" SWORD Prc 1 100 -327.6800 327.6700 FORMAT "%8.4" ECU_ADDRESS 0x803594 /end MEASUREMENT
/begin MEASUREMENT PCR_rBPGovMax_mp "Maximal zulässige Reglerstellgröße" SWORD Prc 1 100 -327.6800 327.6700 FORMAT "%8.4" ECU_ADDRESS 0x803596 /end MEASUREMENT
/begin MEASUREMENT PCR_rBPGovMin_mp "Minimal zulässige Reglerstellgröße" SWORD Prc 1 100 -327.6800 327.6700 FORMAT "%8.4" ECU_ADDRESS 0x803598 /end MEASUREMENT
/begin MEASUREMENT PCR_rBPGovUnLin2_mp "Rohwert Tastverhätnis für Ladedruckregler2" SWORD Prc 1 100 -327.6800 327.6700 FORMAT "%8.4" ECU_ADDRESS 0x80359A /end MEASUREMENT
/begin MEASUREMENT PCR_rBPGovUnLin_mp "Rohwert Tastverhätnis für Ladedruckregler" SWORD Prc 1 100 -327.6800 327.6700 FORMAT "%8.4" ECU_ADDRESS 0x80359C /end MEASUREMENT
/begin MEASUREMENT PCR_rOutDT1_mp "DT1-Anteil des PIDT1 Reglers" SWORD Prc 1 100 -327.6800 327.6700 FORMAT "%8.4" ECU_ADDRESS 0x80359E /end MEASUREMENT
/begin MEASUREMENT PCR_rOutI_mp "I-Anteil des PIDT1 Reglers" SWORD Prc 1 100 -327.6800 327.6700 FORMAT "%8.4" ECU_ADDRESS 0x8035A0 /end MEASUREMENT
/begin MEASUREMENT PCR_rOutP_mp "P-Anteil des PIDT1 Reglers" SWORD Prc 1 100 -327.6800 327.6700 FORMAT "%8.4" ECU_ADDRESS 0x8035A2 /end MEASUREMENT
/begin MEASUREMENT PCR_rPICtl_mp "P+I+Steueranteil der Stellgröße (vor ARW)" SWORD Prc 1 100 -327.6800 327.6700 FORMAT "%8.4" ECU_ADDRESS 0x8035A8 /end MEASUREMENT
/begin MEASUREMENT PCR_rPIDCtl_mp "Regel- und Steueranteil der Stellgrösse des Ladedruckreglers" SWORD Prc 1 100 -327.6800 327.6700 FORMAT "%8.4" ECU_ADDRESS 0x8035AA /end MEASUREMENT
/begin MEASUREMENT PCR_rstI_mp "Integratorzustand in Basisvariante" SWORD Prc 1 100 -327.6800 327.6700 FORMAT "%8.4" ECU_ADDRESS 0x8035AC /end MEASUREMENT
/begin MEASUREMENT PCR_rTrbnRed_mp "Korrekturverhältnis Laderdrehzahl" SWORD Fact 1 100 -4.000000 3.999878 FORMAT "%8.6" ECU_ADDRESS 0x803520 /end MEASUREMENT
/begin MEASUREMENT PCR_stBalGvnr "Zustand Gleichstellungsregelung" UBYTE OneToOne 1 100 0.00 255.0 FORMAT "%5.1" ECU_ADDRESS 0x7F94DA /end MEASUREMENT
/begin MEASUREMENT PCR_stBPCtlCurrRgn_mp "Aktive Eingänge des Rampenschalters" UBYTE OneToOne 1 100 0.00 255.0 FORMAT "%5.1" ECU_ADDRESS 0x803548 /end MEASUREMENT
/begin MEASUREMENT PCR_stBPGovFlt_mp "Status der Ladergeräuschunterdrückung" UBYTE OneToOne 1 100 0.00 255.0 FORMAT "%5.1" ECU_ADDRESS 0x8035A4 /end MEASUREMENT
/begin MEASUREMENT PCR_stCtlRgnMsk_mp "Status des Eingriffs der Partikelfilter Regeneration" UBYTE OneToOne 1 100 0.00 255.0 FORMAT "%5.1" ECU_ADDRESS 0x803549 /end MEASUREMENT
/begin MEASUREMENT PCR_stDesCurrRgn_mp "Aktive Eingänge des Rampenschalters" UBYTE OneToOne 1 100 0.00 255.0 FORMAT "%5.1" ECU_ADDRESS 0x80357A /end MEASUREMENT
/begin MEASUREMENT PCR_stDesRgnMsk_mp "Status des Eingriffs der Partikelfilter Regeneration" UBYTE OneToOne 1 100 0.00 255.0 FORMAT "%5.1" ECU_ADDRESS 0x80357B /end MEASUREMENT
/begin MEASUREMENT PCR_stMonitor "Statusangabe bei Abschaltung der Regelung" UBYTE OneToOne 1 100 0.00 255.0 FORMAT "%5.1" ECU_ADDRESS 0x7F94DB /end MEASUREMENT
/begin MEASUREMENT PCR_stPCR "Status der Ladedruckregelung" UWORD OneToOne 1 100 0.00 65535.00 FORMAT "%8.2" ECU_ADDRESS 0x7F9AD8 /end MEASUREMENT
/begin MEASUREMENT PCR_stPCR_mp "Status der Ladedruckregelung" UWORD OneToOne 1 100 0.00 65535.00 FORMAT "%8.2" ECU_ADDRESS 0x8035B2 /end MEASUREMENT
/begin MEASUREMENT PCR_stRgtOffMsk_mp "Zustand EGT-Status gleich Maske Ausschalten" UBYTE OneToOne 1 100 0.00 255.0 FORMAT "%5.1" ECU_ADDRESS 0x8035A5 /end MEASUREMENT
/begin MEASUREMENT PCR_stRgtOnMsk_mp "Zustand EGT-Status gleich Maske Einschalten" UBYTE OneToOne 1 100 0.00 255.0 FORMAT "%5.1" ECU_ADDRESS 0x8035A6 /end MEASUREMENT
/begin MEASUREMENT PCR_stWorkSph "present working sphere" UBYTE OneToOne 1 100 0.00 255.0 FORMAT "%5.1" ECU_ADDRESS 0x7F94DC /end MEASUREMENT
/begin MEASUREMENT PCR_swtLimMpCr "Schalter zur Auswahl der Größen, aus denen der zulässige Stellgrößenbereich bestimmt wird" UBYTE OneToOne 1 100 0.00 255.0 FORMAT "%5.1" ECU_ADDRESS 0x7F94DD /end MEASUREMENT
/begin MEASUREMENT PCR_swtNoDeb_mp "Schalter Regler ein/aus ohne Zeitverzögerung" UBYTE OneToOne 1 100 0.00 255.0 FORMAT "%5.1" ECU_ADDRESS 0x8035A7 /end MEASUREMENT
/begin MEASUREMENT PCR_swtQCtl "Schalterwertmessage zur Auswahl der für Steuerung verwendeten Einspritzmenge" UBYTE OneToOne 1 100 0.00 255.0 FORMAT "%5.1" ECU_ADDRESS 0x7F94DE /end MEASUREMENT
/begin MEASUREMENT PCR_swtQDes "Schalter für Mengeneingangswunsch bei der Sollwertberechnung" UBYTE OneToOne 1 100 0.00 255.0 FORMAT "%5.1" ECU_ADDRESS 0x7F94DF /end MEASUREMENT
/begin MEASUREMENT PCR_swtRelAbs "Schalter zur Auswahl zwischen Absolut- und Relativdruckregelung" UBYTE OneToOne 1 100 0.00 255.0 FORMAT "%5.1" ECU_ADDRESS 0x7F94E0 /end MEASUREMENT
/begin MEASUREMENT PCR_swtRgt "Schalter: Regler ein/aus" UBYTE OneToOne 1 100 0.00 255.0 FORMAT "%5.1" ECU_ADDRESS 0x7F94E1 /end MEASUREMENT
/begin MEASUREMENT PCR_tAirAltCorr2_mp "Temperatur vor Verdichter, zweites Luftsystem" SWORD Temp_Cels 1 100 -3549.940 3003.560 FORMAT "%8.3" ECU_ADDRESS 0x803522 /end MEASUREMENT
/begin MEASUREMENT PCR_tAirAltCorr_mp "Temperatur vor Verdichter, erstes Luftsystem" SWORD Temp_Cels 1 100 -3549.940 3003.560 FORMAT "%8.3" ECU_ADDRESS 0x803524 /end MEASUREMENT
/begin MEASUREMENT PCR_tGDevMax_mp "Temperatur für Berechnung der maximalen Regelabweichung" SWORD Temp_Cels 1 100 -3549.940 3003.560 FORMAT "%8.3" ECU_ADDRESS 0x8035B4 /end MEASUREMENT
/begin MEASUREMENT PCR_tiStrtDelay_mp "Zeit, in der die Regelung nach Startabwurf abgeschaltet bleibt" UWORD Time_ms 1 100 0.00 655350.0 FORMAT "%8.1" ECU_ADDRESS 0x8035B6 /end MEASUREMENT
/begin MEASUREMENT PCVCD_dcycDT1_mp "Sollwert Tastverhältnis mit DT1-Anteil" SWORD DtyCyc 1 100 -327.6800 327.6700 FORMAT "%8.4" ECU_ADDRESS 0x8035BE /end MEASUREMENT
/begin MEASUREMENT PCVCD_dcycOut_mp "Ausgangstastverhältnis" SWORD DtyCyc 1 100 -327.6800 327.6700 FORMAT "%8.4" ECU_ADDRESS 0x7FD046 /end MEASUREMENT
/begin MEASUREMENT PCVCD_dcycSetVal_mp "Sollwert Tastverhältnis für Druckregelventil" SWORD DtyCyc 1 100 -327.6800 327.6700 FORMAT "%8.4" ECU_ADDRESS 0x8035C0 /end MEASUREMENT
/begin MEASUREMENT PCVCD_facIGov_mp "Stromregler I-Anteil" SWORD Fact 1 100 -4.000000 3.999878 FORMAT "%8.6" ECU_ADDRESS 0x8035C2 /end MEASUREMENT
/begin MEASUREMENT PCVCD_iActFlt_mp "PT1 gefilterter Strom Istwert" SWORD Curr 1 100 -32768.00 32767.00 FORMAT "%8.2" ECU_ADDRESS 0x8035C4 /end MEASUREMENT
/begin MEASUREMENT PCVCD_iActVal "Analogeingang Strom-Istwert" SWORD Curr 1 100 -32768.00 32767.00 FORMAT "%8.2" ECU_ADDRESS 0x7F9ADA /end MEASUREMENT
/begin MEASUREMENT PCVCD_iDvt_mp "Stromregler Regelabweichung" SWORD Curr 1 100 -32768.00 32767.00 FORMAT "%8.2" ECU_ADDRESS 0x8035C6 /end MEASUREMENT
/begin MEASUREMENT PCVCD_iGovActVal_mp "Isttrom nach Eingriff des Raildruckreglers" SWORD Curr 1 100 -32768.00 32767.00 FORMAT "%8.2" ECU_ADDRESS 0x8035C8 /end MEASUREMENT
/begin MEASUREMENT PCVCD_iSetFlt_mp "PT1 gefilterter Stromistwert" SWORD Curr 1 100 -32768.00 32767.00 FORMAT "%8.2" ECU_ADDRESS 0x8035CA /end MEASUREMENT
/begin MEASUREMENT PCVCD_swtCtlState "geschlossener Regelkreis für Stromregler konstant oder in Abhängigkeit vom Raildruckregler" UBYTE OneToOne 1 100 0.00 255.0 FORMAT "%5.1" ECU_ADDRESS 0x7F94E2 /end MEASUREMENT
/begin MEASUREMENT PCVCD_uRawVal_mp "Analogeingang Spannungsrohwert" SWORD Volt 1 100 -160156.4 160151.5 FORMAT "%8.1" ECU_ADDRESS 0x8035CC /end MEASUREMENT
/begin MEASUREMENT PCV_dvolLeak_mp "Leckage des Druckregelventils" SWORD Qp_mm3_sec 1 100 -327680.0 327670.0 FORMAT "%8.1" ECU_ADDRESS 0x8035B8 /end MEASUREMENT
/begin MEASUREMENT PCV_iSet_mp "Sollstrom fuer das Druckregelventil" SWORD Curr 1 100 -32768.00 32767.00 FORMAT "%8.2" ECU_ADDRESS 0x8035BA /end MEASUREMENT
/begin MEASUREMENT PCV_stActrCtl_mp "Zustand der Stellwertsteuerung fuer das Druckregelventil" UBYTE OneToOne 1 100 0.00 255.0 FORMAT "%5.1" ECU_ADDRESS 0x8035BC /end MEASUREMENT
/begin MEASUREMENT PFltCD_pDiff "Differenzdruck über Partikelfilter" SWORD Pres_hPa 1 100 -32768.00 32767.00 FORMAT "%8.2" ECU_ADDRESS 0x7F9ADC /end MEASUREMENT
/begin MEASUREMENT PFltCD_pLinDiff "Linearisierter Wert des Differenzdrucks über Partikelfilter" SWORD Pres_hPa 1 100 -32768.00 32767.00 FORMAT "%8.2" ECU_ADDRESS 0x7F9ADE /end MEASUREMENT
/begin MEASUREMENT PFltCD_stActrDSMTst_mp "Endstufenstatus" UBYTE OneToOne 1 100 0.00 255.0 FORMAT "%5.1" ECU_ADDRESS 0x8036BC /end MEASUREMENT
/begin MEASUREMENT PFltCD_stOutHtg_mp "Ausgangszustand der Partikelfilterheizung" UBYTE OneToOne 1 100 0.00 255.0 FORMAT "%5.1" ECU_ADDRESS 0x8036BD /end MEASUREMENT
/begin MEASUREMENT PFltCD_swtSigPDiff "Schalterwert ob ADC oder CAN" UBYTE OneToOne 1 100 0.00 255.0 FORMAT "%5.1" ECU_ADDRESS 0x7F94E3 /end MEASUREMENT
/begin MEASUREMENT PFltCD_tLinPre "Linearisierter Wert der Abgastemperatur vor dem Partikelfilter" SWORD Temp_Cels 1 100 -3549.940 3003.560 FORMAT "%8.3" ECU_ADDRESS 0x7F9AE2 /end MEASUREMENT
/begin MEASUREMENT PFltCD_tPre "Abgastemp. vor Partikelfilter erster Sensor" SWORD Temp_Cels 1 100 -3549.940 3003.560 FORMAT "%8.3" ECU_ADDRESS 0x7F9AE4 /end MEASUREMENT
/begin MEASUREMENT PFltCD_uRawPresDiff "Spannungsrohwert des Differenzdrucksensors" SWORD Volt 1 100 -160156.4 160151.5 FORMAT "%8.1" ECU_ADDRESS 0x7F9AE8 /end MEASUREMENT
/begin MEASUREMENT PFltCD_uRawTempPre "Spannungsrohwert der Abgastemperatur vor dem Partikelfilter" SWORD Volt 1 100 -160156.4 160151.5 FORMAT "%8.1" ECU_ADDRESS 0x7F9AEA /end MEASUREMENT
/begin FUNCTION otscd "Öltemperaturfühler"
 /begin DEF_CHARACTERISTIC OTSCD_uSRCMin_C OTSCD_uSRCMax_C OTSCD_tLin_CUR OTSCD_DebCanDefDef_C OTSCD_DebCanDefOk_C OTSCD_DebCanInacDef_C OTSCD_DebCanInacOk_C OTSCD_DebCanNotImplDef_C OTSCD_DebCanNotImplOk_C OTSCD_DebNplDef_C OTSCD_DebNplOk_C OTSCD_DebSRCHighDef_C OTSCD_DebSRCHighOk_C OTSCD_DebSRCLowDef_C OTSCD_DebSRCLowOk_C OTSCD_tiStrtOilClntPlaus_C OTSCD_tiDelOilClntPlaus_C OTSCD_tThresOilClntPlaus_C OTSCD_tLimOilClntPlaus_C OTSCD_dtRmpSlpUp_C OTSCD_dtRmpSlpDwn_C OTSCD_swtSigVal_C OTSCD_swtSigType_C OTSCD_stSensIDWord_C OTSCD_tDfl_C /end DEF_CHARACTERISTIC
 /begin IN_MEASUREMENT OTSCD_uRaw /end IN_MEASUREMENT
/end FUNCTION
/begin FUNCTION otscd_msg ""
 /begin OUT_MEASUREMENT OTSCD_stPlaus OTSCD_swtSig OTSCD_tEngOil OTSCD_tEngOilLin OTSCD_uRaw /end OUT_MEASUREMENT
/end FUNCTION
/begin FUNCTION otscd_uic ""
 /begin OUT_MEASUREMENT OTSCD_stClntThres_mp OTSCD_tEngOilCur_mp OTSCD_tOilModel_mp /end OUT_MEASUREMENT
/end FUNCTION
/begin FUNCTION otscd_var ""
 /begin DEF_CHARACTERISTIC OTSCD_swtDflVal_C OTSCD_tClntThres_C OTSCD_tDflWIV_C OTSCD_tFlCnsmpCor_CUR OTSCD_tIATSCor_CUR OTSCD_tiOilMax_C OTSCD_tiOilMin_C OTSCD_tiPlausWIV_C OTSCD_tOil_CUR /end DEF_CHARACTERISTIC
 /begin IN_MEASUREMENT CoEng_dvolFlConsumFlt FrmMng_tiTOSOilT IATSCD_tAir /end IN_MEASUREMENT
/end FUNCTION
/begin FUNCTION otscd_var_msg ""
 /begin OUT_MEASUREMENT OTSCD_stCanSndTemp OTSCD_stOilTErr OTSCD_stPlausWIV OTSCD_tEngOilWIV /end OUT_MEASUREMENT
/end FUNCTION
/begin FUNCTION ovrmon "Funktionsüberwachung auf Systemebene"
 /begin DEF_CHARACTERISTIC ExeMon_stEnaTst_C OvRMon_ctQInjDefDwn_C OvRMon_ctQInjDefUp_C OvRMon_DebQInjDef_C OvRMon_nMon_C OvRMon_numCyl_C OvRMon_swtEnaConv_C /end DEF_CHARACTERISTIC
/end FUNCTION
/begin FUNCTION ovrmon_10msctr "Zähler zur zeitlichen Koordination der Schubüberwachung" /end FUNCTION
/begin FUNCTION ovrmon_10msctr_msg "" /begin OUT_MEASUREMENT OvRMon_ct10MS /end OUT_MEASUREMENT /end FUNCTION
/begin FUNCTION ovrmon_acc "" /begin DEF_CHARACTERISTIC OvRMon_tiDebACCActv_C /end DEF_CHARACTERISTIC /end FUNCTION
/begin FUNCTION ovrmon_accped ""
 /begin DEF_CHARACTERISTIC OvRMon_qLimEnh_CUR OvRMon_rHighLimLowIdle_C OvRMon_stInvLowIdle_C OvRMon_tiAPP1Flt_C OvRMon_tiAPPNpl_C OvRMon_tiDebLowIdlActv_C OvRMon_tiErrAPP_C OvRMon_trqMonASD_C OvRMon_uAPP1LimPS_C OvRMon_uAPP1Lim_C OvRMon_uAPPFull_C OvRMon_uHighLimLowIdle_C OvRMon_uLowIdlSwtA2DThres_C OvRMon_uLowLimLowIdle_C OvRMon_uPlaWinFull_C OvRMon_uPlaWinIdle_C /end DEF_CHARACTERISTIC
 /begin IN_MEASUREMENT Eng_nAvrg /end IN_MEASUREMENT
/end FUNCTION
/begin FUNCTION ovrmon_accped_uic ""
 /begin OUT_MEASUREMENT OvRMon_qLimEnh_mp OvRMon_stAccPed_mp OvRMon_stAPPDiff_mp OvRMon_stLowIdlValRaw_mp OvRMon_uRawLowIdle_mp OvRMon_uRegAPP1_mp OvRMon_uRegAPP2_mp /end OUT_MEASUREMENT
/end FUNCTION
/begin FUNCTION ovrmon_acc_uic "" /begin OUT_MEASUREMENT OvRMon_stACC_mp /end OUT_MEASUREMENT /end FUNCTION
/begin FUNCTION ovrmon_asddc "" /begin DEF_CHARACTERISTIC OvRMon_tiDebDrvActv_C OvRMon_trqThresASDdc_C /end DEF_CHARACTERISTIC /end FUNCTION
/begin FUNCTION ovrmon_astaccs ""
 /begin DEF_CHARACTERISTIC OvRMon_swtAST_C OvRMon_swtTSC3Ena_C OvRMon_tiDebAstAccsActv_C /end DEF_CHARACTERISTIC
/end FUNCTION
/begin FUNCTION ovrmon_astaccs_uic "" /begin OUT_MEASUREMENT OvRMon_stAstAccs_mp /end OUT_MEASUREMENT /end FUNCTION
/begin FUNCTION ovrmon_battsens ""
 /begin DEF_CHARACTERISTIC OvRMon_duBattJit_C OvRMon_facBattCor_CUR OvRMon_tiDebBattSRCDef_C OvRMon_tiDebBattSRCOk_C OvRMon_uBattDfl_C OvRMon_uBattSRCMax_C OvRMon_uBattSRCMin_C /end DEF_CHARACTERISTIC
 /begin IN_MEASUREMENT OvRMon_uBatt_mp /end IN_MEASUREMENT
/end FUNCTION
/begin FUNCTION ovrmon_brksens ""
 /begin DEF_CHARACTERISTIC OvRMon_duBrkJit_C OvRMon_tiDebBrkSRCDef_C OvRMon_tiDebBrkSRCOk_C OvRMon_tiDebBrk_C OvRMon_uBrkA2DThres_C OvRMon_uBrkSRCMax_C OvRMon_uBrkSRCMin_C /end DEF_CHARACTERISTIC
/end FUNCTION
/begin FUNCTION ovrmon_convsens "" /begin DEF_CHARACTERISTIC OvRMon_tiDebConv_C /end DEF_CHARACTERISTIC /end FUNCTION
/begin FUNCTION ovrmon_crctl "" /begin DEF_CHARACTERISTIC OvRMon_tiDebCrCtlActv_C /end DEF_CHARACTERISTIC /end FUNCTION
/begin FUNCTION ovrmon_crctlplus "Schubüberwachung des Fahrgeschwindigkeitsreglers-Plus"
 /begin DEF_CHARACTERISTIC OvRMon_aMaxCrCtlP_C OvRMon_ctCrCtlPDwn_C OvRMon_ctCrCtlPUp_C OvRMon_DebCrCtlPDef_C OvRMon_tiDebCrCtlPone_C OvRMon_tiDebCrCtlPtwo_C OvRMon_uAPP1Thresone_C OvRMon_uAPP1Threstwo_C /end DEF_CHARACTERISTIC
/end FUNCTION
/begin FUNCTION ovrmon_crctlplus_uic "" /begin OUT_MEASUREMENT OvRMon_ctCrCtlPDef_mp OvRMon_stCrCtlP_mp /end OUT_MEASUREMENT /end FUNCTION
/begin FUNCTION ovrmon_crctl_uic "" /begin OUT_MEASUREMENT OvRMon_stCrCtl_mp /end OUT_MEASUREMENT /end FUNCTION
/begin FUNCTION ovrmon_engspdsens "Drehzahlüberwachung für die Schubüberwachung"
 /begin DEF_CHARACTERISTIC OvRMon_DebSigA0Def_C OvRMon_nDiffMaxHi_C OvRMon_nDiffMaxLo_C OvRMon_nDiffThres_C OvRMon_nSegMax_C OvRMon_nSegMin_C OvRMon_stIntrInit_C OvRMon_tiSegMin_C /end DEF_CHARACTERISTIC
/end FUNCTION
/begin FUNCTION ovrmon_engspdsens_msg ""
 /begin OUT_MEASUREMENT OvRMon_nAvrg OvRMon_stIntr OvRMon_tiIntrSysAct OvRMon_tiIntrSysLst /end OUT_MEASUREMENT
/end FUNCTION
/begin FUNCTION ovrmon_engspdsens_uic "" /begin OUT_MEASUREMENT OvRMon_nSeg_mp OvRMon_stIntrInactv_mp /end OUT_MEASUREMENT /end FUNCTION
/begin FUNCTION ovrmon_getsuminj "Berechnung des Drehmoments zur Schubüberwachung" /begin DEF_CHARACTERISTIC OvRMon_facInjEff_MAP /end DEF_CHARACTERISTIC /begin IN_MEASUREMENT Eng_nAvrg OvRMon_phiInjAct_mp /end IN_MEASUREMENT /end FUNCTION
/begin FUNCTION ovrmon_getsuminj_msg "" /begin OUT_MEASUREMENT OvRMon_tiTDCAvrg OvRMon_tiTDCAvrgCpl /end OUT_MEASUREMENT /end FUNCTION
/begin FUNCTION ovrmon_getsuminj_uic ""
 /begin OUT_MEASUREMENT OvRMon_phiInjAct_mp OvRMon_tiInjAct_mp OvRMon_tiTDCSumET_mp /end OUT_MEASUREMENT
/end FUNCTION
/begin FUNCTION ovrmon_ligov "" /begin DEF_CHARACTERISTIC OvRMon_ctEngSpdGrad_C OvRMon_nLIGovLim_C /end DEF_CHARACTERISTIC /end FUNCTION
/begin FUNCTION ovrmon_msg ""
 /begin OUT_MEASUREMENT OvRMon_stBrkPressed OvRMon_stEnhOvRMode OvRMon_stLowIdlValflt OvRMon_stOvR OvRMon_stOvRCpl OvRMon_uRawAPP1 /end OUT_MEASUREMENT
/end FUNCTION
/begin FUNCTION ovrmon_stctl "" /begin DEF_CHARACTERISTIC OvRMon_tiDebStCtlActv_C /end DEF_CHARACTERISTIC /end FUNCTION
/begin FUNCTION ovrmon_stctl_uic "" /begin OUT_MEASUREMENT OvRMon_stStCtl_mp /end OUT_MEASUREMENT /end FUNCTION
/begin FUNCTION ovrmon_stsys "" /begin DEF_CHARACTERISTIC OvRMon_nStSysLim_C /end DEF_CHARACTERISTIC /end FUNCTION
/begin FUNCTION ovrmon_trqlim "" /begin DEF_CHARACTERISTIC OvRMon_tiLimET_CUR /end DEF_CHARACTERISTIC /begin IN_MEASUREMENT Eng_nAvrg /end IN_MEASUREMENT /end FUNCTION
/begin FUNCTION ovrmon_trqlim_uic "" /begin OUT_MEASUREMENT OvRMon_tiLimET_mp /end OUT_MEASUREMENT /end FUNCTION
/begin FUNCTION ovrmon_uic ""
 /begin OUT_MEASUREMENT OvRMon_ctQInjDef_mp OvRMon_facBattCor_mp OvRMon_stBattSRCErr_mp OvRMon_stBrkMnRed_mp OvRMon_stBrkPressed_mp OvRMon_stBrkSRCErr_mp OvRMon_stConvDebVal_mp OvRMon_stRls_mp OvRMon_uBatt_mp OvRMon_uBrkMnSwtCor_mp OvRMon_uBrkMnSwtRaw_mp OvRMon_uBrkMnSwt_mp OvRMon_uRawBatt_mp /end OUT_MEASUREMENT
/end FUNCTION
/begin FUNCTION oxiccd_gettpre_1 ""
 /begin DEF_CHARACTERISTIC OxiCCD_uSRCMinTPre_C OxiCCD_uSRCMaxTPre_C OxiCCD_tLinPre1_CUR OxiCCD_DebSRCHighDefTPre_C OxiCCD_DebSRCHighOkTPre_C OxiCCD_DebSRCLowDefTPre_C OxiCCD_DebSRCLowOkTPre_C OxiCCD_dtRmpSlpUpPre_C OxiCCD_dtRmpSlpDwnPre_C OxiCCD_swtActvTPre_C OxiCCD_stSensIDWordTPre_C OxiCCD_tDflPre_C /end DEF_CHARACTERISTIC
 /begin IN_MEASUREMENT OxiCCD_uRawTempPre /end IN_MEASUREMENT
/end FUNCTION
/begin FUNCTION oxiccd_gettpre_1_msg "" /begin OUT_MEASUREMENT OxiCCD_tLinPre OxiCCD_tPre OxiCCD_uRawTempPre /end OUT_MEASUREMENT /end FUNCTION
/begin FUNCTION oxiccd_gettpre_1_uic "" /end FUNCTION
/begin FUNCTION oxiccd_gettpre_1_var "" /end FUNCTION
/begin FUNCTION oxiccd_gettpre_1_var_msg "" /end FUNCTION
/begin FUNCTION oxiccd_gettpre_1_var_uic "" /end FUNCTION
/begin FUNCTION pcr_balgvnr "Gleichstellungsregler"
 /begin DEF_CHARACTERISTIC PCR_BalGvnrIKi_C PCR_BalGvnrIKiPos_C PCR_BalGvnrIKiNeg_C PCR_rBalGvnrIWinPos_C PCR_rBalGvnrIWinNeg_C PCR_BalGvnrPKp_C PCR_BalGvnrPKpPos_C PCR_BalGvnrPKpNeg_C PCR_rBalGvnrPWinPos_C PCR_rBalGvnrPWinNeg_C PCR_facBalGvnrCorr_MAP PCR_facBalGvnrI_MAP PCR_facBalGvnrP_MAP PCR_nBalGovDevMax_CUR PCR_nPlChkMin_C PCR_rBalGvnrEgrMin_C PCR_rBalGvnrMax_MAP PCR_rBalGvnrMin_MAP PCR_rBalGvnrPreCtl_C PCR_rBalGvnrSt_MAP PCR_tiBalGovDevDef_C PCR_tiBalGovDevOk_C PCR_trqInrMin_C /end DEF_CHARACTERISTIC
 /begin IN_MEASUREMENT Eng_nAvrg PCR_qDes /end IN_MEASUREMENT
/end FUNCTION
/begin FUNCTION pcr_balgvnr_msg "" /begin OUT_MEASUREMENT PCR_rBalGvnrDiff PCR_stBalGvnr /end OUT_MEASUREMENT /end FUNCTION
/begin FUNCTION pcr_balgvnr_uic ""
 /begin OUT_MEASUREMENT PCR_facBalGvnrCorr_mp PCR_facBalGvnrI_mp PCR_facBalGvnrP_mp PCR_nBalGovDev_mp PCR_rBalGvnrMax_mp PCR_rBalGvnrMin_mp PCR_rBalGvnrOutI_mp PCR_rBalGvnrOutP_mp PCR_rBalGvnrOut_mp PCR_rBalGvnrSt_mp /end OUT_MEASUREMENT
/end FUNCTION
/begin FUNCTION pcr_cmpr "Basisstruktur für die Berechnung der Turboladergeschwindigkeit und des erlaubten Ladedruckes"
 /begin DEF_CHARACTERISTIC PCR_dlyPT1TrbnFlt_C PCR_facBPAltCorr2_MAP PCR_facBPAltCorr_MAP PCR_facBPrdmCorr_MAP PCR_facPAltCorr2_MAP PCR_facPAltCorr_MAP PCR_facTAltCorr2_CUR PCR_facTAltCorr_CUR PCR_kdDT1BPAlt_C PCR_nTrbn2_MAP PCR_nTrbnLim_C PCR_nTrbnMax_CUR PCR_nTrbn_MAP PCR_pAirAltCorr_C PCR_pLim_C PCR_rBPAltDynMax_C PCR_rBPAltMax2_MAP PCR_rBPAltMax_MAP PCR_swtAirAlt_C PCR_tAirAltCorr_C PCR_tiDT1BPAlt_C /end DEF_CHARACTERISTIC
 /begin IN_MEASUREMENT AFSCD_dmAirPerTime AFSCD_dmAirPerTime2 EATSCD_tAir Eng_nAvrg IATSCD_tAir PCR_dmAirAltCorr2_mp PCR_dmAirAltCorr_mp PCR_nTrbnMax_mp PCR_rBPAltCorr2_mp PCR_rBPAltCorr_mp /end IN_MEASUREMENT
/end FUNCTION
/begin FUNCTION pcr_cmpr_msg ""
 /begin OUT_MEASUREMENT PCR_nTrbn PCR_nTrbn2 PCR_pBPAltDesMaxCorr PCR_pBPAltDesMaxCorr2 /end OUT_MEASUREMENT
/end FUNCTION
/begin FUNCTION pcr_cmpr_uic ""
 /begin OUT_MEASUREMENT PCR_dmAirAltCorr2_mp PCR_dmAirAltCorr_mp PCR_dmAirPerTimeTstVal_mp PCR_facBPAltCorr2_mp PCR_facBPAltCorr_mp PCR_facBPrdmCorr_mp PCR_facPAltCorr2_mp PCR_facPAltCorr_mp PCR_facTAltCorr2_mp PCR_facTAltCorr_mp PCR_facTrbnRed_mp PCR_nTrbnFlt2_mp PCR_nTrbnFlt_mp PCR_nTrbnMax_mp PCR_nTrbnRed2_mp PCR_nTrbnRedMax_mp PCR_nTrbnRed_mp PCR_pAirAltCorr2_mp PCR_pAirAltCorr_mp PCR_pBPAltDesMax2_mp PCR_pBPAltDesMax_mp PCR_pBPIntValCorr2_mp PCR_pBPIntValCorr_mp PCR_rBPAltCorr2_mp PCR_rBPAltCorr_mp PCR_rBPAltDesMax2_mp PCR_rBPAltDesMax_mp PCR_rBPAltDyn2_mp PCR_rBPAltDynLim2_mp PCR_rBPAltDynLim_mp PCR_rBPAltDyn_mp PCR_rBPAltMax2_mp PCR_rBPAltMax_mp PCR_rTrbnRed_mp PCR_tAirAltCorr2_mp PCR_tAirAltCorr_mp /end OUT_MEASUREMENT
/end FUNCTION
/begin FUNCTION pcr_ctlvalcalc "Ladedruck-Steuerung"
 /begin DEF_CHARACTERISTIC PCR_facCtlAT_CUR PCR_facCtlRgn1_CUR PCR_facCtlRgn2_CUR PCR_facCtlRgn3_CUR PCR_facCtlRgn4_CUR PCR_rBPCtlBas_MAP PCR_rBPCtlInit_C PCR_rBPCtlRgn1a_MAP PCR_rBPCtlRgn1b_MAP PCR_rBPCtlRgn2a_MAP PCR_rBPCtlRgn2b_MAP PCR_rBPCtlRgn3a_MAP PCR_rBPCtlRgn3b_MAP PCR_rBPCtlRgn4a_MAP PCR_rBPCtlRgn4b_MAP PCR_rBPCtlRgnCor1_MAP PCR_rBPCtlRgnCor2_MAP PCR_rBPCtlRgnCor3_MAP PCR_rBPCtlRgnCor4_MAP PCR_rCtlAPCmpn_MAP PCR_stCtlRgnMsk1_C PCR_stCtlRgnMsk2_C PCR_stCtlRgnMsk3_C PCR_stCtlRgnMsk4_C PCR_swtQCtlVal_C PCR_swtQCtlType_C PCR_tiCtlRgnRmp_C /end DEF_CHARACTERISTIC
 /begin IN_MEASUREMENT APSCD_pVal Eng_nAvrg IATSCD_tAir PCR_qCtl PCR_rBPCtl1_mp PCR_rBPCtl2_mp PCR_rBPCtl3_mp PCR_rBPCtl4_mp PFlt_pPre /end IN_MEASUREMENT
/end FUNCTION
/begin FUNCTION pcr_ctlvalcalc_msg "" /begin OUT_MEASUREMENT PCR_qCtl PCR_rBPCtl PCR_swtQCtl /end OUT_MEASUREMENT /end FUNCTION
/begin FUNCTION pcr_ctlvalcalc_uic ""
 /begin DEF_CHARACTERISTIC PCR_qCtl_Vector PCR_qCtl_Channel PCR_rBPCtl_Vector PCR_rBPCtl_Channel /end DEF_CHARACTERISTIC
 /begin OUT_MEASUREMENT PCR_facCtlAT_mp PCR_qCtlByp_mp PCR_rBPCtl1_mp PCR_rBPCtl2_mp PCR_rBPCtl3_mp PCR_rBPCtl4_mp PCR_rBPCtlAPCorr_mp PCR_rBPCtlBas_mp PCR_rBPCtlByp_mp PCR_rBPCtlCorr_mp PCR_rBPCtlRaw_mp PCR_rBPCtlRgn0_mp PCR_rBPCtlRgn1_mp PCR_rBPCtlRgn2_mp PCR_rBPCtlRgn3_mp PCR_rBPCtlRgn4_mp PCR_rBPCtlVal_mp PCR_stBPCtlCurrRgn_mp PCR_stCtlRgnMsk_mp /end OUT_MEASUREMENT
/end FUNCTION
/begin FUNCTION pcr_desvalcalc "Ladedruck Sollwertbildung"
 /begin DEF_CHARACTERISTIC PCR_CoDT1Neg_C PCR_CoDT1Pos_C PCR_CoDKd_C PCR_CoDKdPos_C PCR_CoDKdNeg_C PCR_dpCoDWinPos_C PCR_dpCoDWinNeg_C PCR_facAT_CUR PCR_facCtQ_MAP PCR_facDesRgn1_CUR PCR_facDesRgn2_CUR PCR_facDesRgn3_CUR PCR_facDesRgn4_CUR PCR_pAPQCmpn_MAP PCR_pBDesBas_MAP PCR_pBDesMaxAP_MAP PCR_pBDesMax_C PCR_pBDesMin_C PCR_pBDesRgn1a_MAP PCR_pBDesRgn1b_MAP PCR_pBDesRgn2a_MAP PCR_pBDesRgn2b_MAP PCR_pBDesRgn3a_MAP PCR_pBDesRgn3b_MAP PCR_pBDesRgn4a_MAP PCR_pBDesRgn4b_MAP PCR_pBDesRgnCor1_MAP PCR_pBDesRgnCor2_MAP PCR_pBDesRgnCor3_MAP PCR_pBDesRgnCor4_MAP PCR_pNQCtCmpn_MAP PCR_stDesRgnMsk1_C PCR_stDesRgnMsk2_C PCR_stDesRgnMsk3_C PCR_stDesRgnMsk4_C PCR_swtCorrActv_C PCR_swtQDesVal_C PCR_swtQDesType_C PCR_swtTmpAir_C PCR_swtTrbnMod_C PCR_tCThreshold_C PCR_tiDesRgnRmp_C PCR_WmDT1Neg_C PCR_WmDT1Pos_C PCR_WmDKd_C PCR_WmDKdPos_C PCR_WmDKdNeg_C PCR_dpWmDWinPos_C PCR_dpWmDWinNeg_C /end DEF_CHARACTERISTIC
 /begin IN_MEASUREMENT APSCD_pVal CTSCD_tClnt Eng_nAvrg IATSCD_tAir PCR_pBDes1_mp PCR_pBDes2_mp PCR_pBDes3_mp PCR_pBDes4_mp PCR_qDes PFlt_pPre /end IN_MEASUREMENT
/end FUNCTION
/begin FUNCTION pcr_desvalcalc_msg "" /begin OUT_MEASUREMENT PCR_pBDes PCR_pBPDesStat PCR_qDes PCR_swtQDes /end OUT_MEASUREMENT /end FUNCTION
/begin FUNCTION pcr_desvalcalc_uic "" /begin DEF_CHARACTERISTIC PCR_pBDes_Vector PCR_pBDes_Channel /end DEF_CHARACTERISTIC
 /begin OUT_MEASUREMENT PCR_facAT_mp PCR_facCtQ_mp PCR_pAPQCmpn_mp PCR_pBDes1_mp PCR_pBDes2_mp PCR_pBDes3_mp PCR_pBDes4_mp PCR_pBDesAPCorr_mp PCR_pBDesATCorr_mp PCR_pBDesBas_mp PCR_pBDesByp_mp PCR_pBDesCorr_mp PCR_pBDesCtCorr_mp PCR_pBDesDyn_mp PCR_pBDesMaxAP_mp PCR_pBDesRaw_mp PCR_pBDesRgn0_mp PCR_pBDesRgn1_mp PCR_pBDesRgn2_mp PCR_pBDesRgn3_mp PCR_pBDesRgn4_mp PCR_pBDesVal_mp PCR_pBDes_mp PCR_pNQCtCmpn_mp PCR_stDesCurrRgn_mp PCR_stDesRgnMsk_mp /end OUT_MEASUREMENT
/end FUNCTION
/begin FUNCTION pcr_governor "Adaptiver Ladedruckregler"
 /begin DEF_CHARACTERISTIC PCR_DKdNeg_C PCR_DKdPos_C PCR_DKd_C PCR_tiPTBPGovFlt_C PCR_dlyPT1_C PCR_dpMinBPGovFlt_C PCR_DT1_MAP PCR_facD_MAP PCR_facI_MAP PCR_facP_MAP PCR_IKi_C PCR_IKiPos_C PCR_IKiNeg_C PCR_pIWinPos_C PCR_pIWinNeg_C PCR_pDWinNeg_C PCR_pDWinPos_C PCR_PKp_C PCR_PKpPos_C PCR_PKpNeg_C PCR_pPWinPos_C PCR_pPWinNeg_C PCR_qMinBPGovFlt_CUR PCR_qRgtOff1_CUR PCR_qRgtOff2_CUR PCR_qRgtOff3_CUR PCR_qRgtOff_CUR PCR_qRgtOn1_CUR PCR_qRgtOn2_CUR PCR_qRgtOn3_CUR PCR_qRgtOn_CUR PCR_rBPGovLin2_CUR PCR_rBPGovLin_CUR PCR_rBPGovMax_MAP PCR_rBPGovMin_MAP PCR_stRgtOffMsk1_C PCR_stRgtOffMsk2_C PCR_stRgtOffMsk3_C PCR_stRgtOnMsk1_C PCR_stRgtOnMsk2_C PCR_stRgtOnMsk3_C PCR_swtLimMpCrVal_C PCR_swtLimMpCrType_C PCR_swtRelAbsVal_C PCR_swtRelAbsType_C PCR_tiDebswtRgt_C PCR_tiDelBPGovFlt_C /end DEF_CHARACTERISTIC
 /begin IN_MEASUREMENT Eng_nAvrg InjCtl_qCurr PCR_rBPGovUnLin2_mp PCR_rBPGovUnLin_mp /end IN_MEASUREMENT
/end FUNCTION
/begin FUNCTION pcr_governor_msg ""
 /begin OUT_MEASUREMENT PCR_pBGDev PCR_rBPGov PCR_rBPGov2 PCR_swtLimMpCr PCR_swtRelAbs PCR_swtRgt /end OUT_MEASUREMENT
/end FUNCTION
/begin FUNCTION pcr_governor_uic "" /begin DEF_CHARACTERISTIC PCR_rBPGov_Vector PCR_rBPGov_Channel /end DEF_CHARACTERISTIC
 /begin OUT_MEASUREMENT PCR_dpBPDesStat_mp PCR_DT1_mp PCR_facD_mp PCR_facI_mp PCR_facP_mp PCR_pBGDevI_mp PCR_qMinBPGovFlt_mp PCR_qMonOff_mp PCR_qMonOn_mp PCR_rBPGovByp_mp PCR_rBPGovFlt_mp PCR_rBPGovMax_mp PCR_rBPGovMin_mp PCR_rBPGovUnLin2_mp PCR_rBPGovUnLin_mp PCR_rOutDT1_mp PCR_rOutI_mp PCR_rOutP_mp PCR_stBPGovFlt_mp PCR_stRgtOffMsk_mp PCR_stRgtOnMsk_mp PCR_swtNoDeb_mp /end OUT_MEASUREMENT
/end FUNCTION
/begin FUNCTION pcr_governor_var "" /end FUNCTION
/begin FUNCTION pcr_governor_var_msg "" /end FUNCTION
/begin FUNCTION pcr_governor_var_uic "" /begin OUT_MEASUREMENT PCR_rPICtl_mp PCR_rPIDCtl_mp PCR_rstI_mp /end OUT_MEASUREMENT /end FUNCTION
/begin FUNCTION pcr_monitor "Ladedruckregelung - Überwachung und Abschaltung"
 /begin DEF_CHARACTERISTIC PCR_DebSRCHighDef_C PCR_DebSRCHighOk_C PCR_DebSRCLowDef_C PCR_DebSRCLowOk_C PCR_nCoStart_C PCR_nWrkSph1_C PCR_nWrkSph2_C PCR_nWrkSph3_C PCR_pBGDevMax_CUR PCR_pBGDevMin_C PCR_qWrkSph2_C PCR_qWrkSph3_C PCR_rDflGvnrOff_C PCR_rDflSysFault_C PCR_swtGDevMax_C PCR_tiCoStrt_CUR PCR_tiStrtDelayInit_C /end DEF_CHARACTERISTIC
 /begin IN_MEASUREMENT CTSCD_tClnt PCR_tGDevMax_mp /end IN_MEASUREMENT
/end FUNCTION
/begin FUNCTION pcr_monitor_msg ""
 /begin OUT_MEASUREMENT PCR_rBPACD PCR_rBPACD2 PCR_stMonitor PCR_stPCR PCR_stWorkSph /end OUT_MEASUREMENT
/end FUNCTION
/begin FUNCTION pcr_monitor_uic "" /begin DEF_CHARACTERISTIC PCR_rBPACD_Vector PCR_rBPACD_Channel /end DEF_CHARACTERISTIC
 /begin OUT_MEASUREMENT PCR_pBGDevMax_mp PCR_rBPACDByp_mp PCR_stPCR_mp PCR_tGDevMax_mp PCR_tiStrtDelay_mp /end OUT_MEASUREMENT
/end FUNCTION
/begin FUNCTION pcr_monitor_var "" /end FUNCTION
/begin FUNCTION pcr_monitor_var_msg "" /end FUNCTION
/begin FUNCTION pcr_monitor_var_uic "" /end FUNCTION
/begin FUNCTION pcvcd_co "Druckregelventil Komponententreiber"
 /begin DEF_CHARACTERISTIC PCVCD_uSRCMin_C PCVCD_uSRCMax_C PCVCD_iLin_CUR PCVCD_dcycMax_C PCVCD_dcycMin_C PCVCD_dcycTst_C PCVCD_DebExcTempDef_C PCVCD_DebExcTempOk_C PCVCD_DebNoLoadDef_C PCVCD_DebNoLoadOk_C PCVCD_DebShortCircBatDef_C PCVCD_DebShortCircBatOk_C PCVCD_DebShortCircGndDef_C PCVCD_DebShortCircGndOk_C PCVCD_DebSRCHighDef_C PCVCD_DebSRCHighOk_C PCVCD_DebSRCLowDef_C PCVCD_DebSRCLowOk_C PCVCD_facIGovInit_CUR PCVCD_facIGovMax_C PCVCD_facIGovMin_C PCVCD_tiFlt1PT1_C PCVCD_tiFlt2PT1_C PCVCD_tiIGovDT1_C PCVCD_IGovDKd_C PCVCD_IGovIKi_C PCVCD_IGovIKiPos_C PCVCD_IGovIKiNeg_C PCVCD_iIGovIWinPos_C PCVCD_iIGovIWinNeg_C PCVCD_tiFltPT1Init_C PCVCD_numAdc_C PCVCD_numDia1_C PCVCD_numDia2_C PCVCD_numPwmOut_C PCVCD_stInvOut_C PCVCD_tiPer_C PCVCD_resCoil_C PCVCD_stPwrStgDia_C PCVCD_swtCtlStateVal_C PCVCD_swtCtlStateType_C PCVCD_swt_C PCVCD_tiBtwTst_C PCVCD_tiIGovInit_C /end DEF_CHARACTERISTIC
 /begin IN_MEASUREMENT FlSys_t PCVCD_uRawVal_mp /end IN_MEASUREMENT
/end FUNCTION
/begin FUNCTION pcvcd_co_msg "" /begin OUT_MEASUREMENT PCVCD_iActVal PCVCD_swtCtlState /end OUT_MEASUREMENT /end FUNCTION
/begin FUNCTION pcvcd_co_uic ""
 /begin OUT_MEASUREMENT PCVCD_dcycDT1_mp PCVCD_dcycOut_mp PCVCD_dcycSetVal_mp PCVCD_facIGov_mp PCVCD_iActFlt_mp PCVCD_iDvt_mp PCVCD_iGovActVal_mp PCVCD_iSetFlt_mp PCVCD_uRawVal_mp /end OUT_MEASUREMENT
/end FUNCTION
/begin FUNCTION pcv_leak "Leckage des Druckregelventils" /begin DEF_CHARACTERISTIC PCV_dvolLeak_CUR /end DEF_CHARACTERISTIC /begin IN_MEASUREMENT Rail_pSetPoint /end IN_MEASUREMENT /end FUNCTION
/begin FUNCTION pcv_leak_uic "" /begin OUT_MEASUREMENT PCV_dvolLeak_mp /end OUT_MEASUREMENT /end FUNCTION
/begin FUNCTION pcv_msg "" /end FUNCTION
/begin FUNCTION pcv_setcurr "Berechnung elektrischer Sollstrom für das Druckregelventil" /begin DEF_CHARACTERISTIC PCV_iCnvPress_CUR PCV_iSetMin_C /end DEF_CHARACTERISTIC /begin IN_MEASUREMENT Rail_pPCVSet /end IN_MEASUREMENT /end FUNCTION
/begin FUNCTION pcv_setcurr_uic "" /begin DEF_CHARACTERISTIC PCV_iSet_Vector PCV_iSet_Channel /end DEF_CHARACTERISTIC /begin OUT_MEASUREMENT PCV_iSet_mp PCV_stActrCtl_mp /end OUT_MEASUREMENT /end FUNCTION
/begin FUNCTION pfltcd_getpdiff_1 ""
 /begin DEF_CHARACTERISTIC PFltCD_uSRCMinPDiff_C PFltCD_uSRCMaxPDiff_C PFltCD_pLinDiff1_CUR PFltCD_DebSigPDiffDef_C PFltCD_DebSigPDiffOk_C PFltCD_DebSRCHighPDiffDef_C PFltCD_DebSRCHighPDiffOk_C PFltCD_DebSRCLowPDiffDef_C PFltCD_DebSRCLowPDiffOk_C PFltCD_dtRmpSlpUpPDiff_C PFltCD_dtRmpSlpDwnPDiff_C PFltCD_numSSpPDiff_C PFltCD_swtSigPDiff_C PFltCD_stSensIDWordPDiff_C PFltCD_pDflDiff_C /end DEF_CHARACTERISTIC
 /begin IN_MEASUREMENT PFltCD_uRawPresDiff /end IN_MEASUREMENT
/end FUNCTION
/begin FUNCTION pfltcd_getpdiff_1_msg ""
 /begin OUT_MEASUREMENT PFltCD_pDiff PFltCD_pLinDiff PFltCD_swtSigPDiff PFltCD_uRawPresDiff /end OUT_MEASUREMENT
/end FUNCTION
/begin FUNCTION pfltcd_getpdiff_1_uic "" /end FUNCTION
/begin FUNCTION pfltcd_getpdiff_1_var "" /end FUNCTION
/begin FUNCTION pfltcd_getpdiff_1_var_msg "" /end FUNCTION
/begin FUNCTION pfltcd_getpdiff_1_var_uic "" /end FUNCTION
/begin FUNCTION pfltcd_gettpre_1 ""
 /begin DEF_CHARACTERISTIC PFltCD_uSRCMinTempPre_C PFltCD_uSRCMaxTempPre_C PFltCD_tLinPre1_CUR PFltCD_DebSRCHighDefTPre_C PFltCD_DebSRCHighOkTPre_C PFltCD_DebSRCLowDefTPre_C PFltCD_DebSRCLowOkTPre_C PFltCD_dtRmpSlpUpPre_C PFltCD_dtRmpSlpDwnPre_C PFltCD_stSensIDWordTPre_C PFltCD_tDflPre_C /end DEF_CHARACTERISTIC
 /begin IN_MEASUREMENT PFltCD_uRawTempPre /end IN_MEASUREMENT
/end FUNCTION
/begin FUNCTION pfltcd_gettpre_1_msg "" /begin OUT_MEASUREMENT PFltCD_tLinPre PFltCD_tPre PFltCD_uRawTempPre /end OUT_MEASUREMENT /end FUNCTION
/begin FUNCTION pfltcd_gettpre_1_uic "" /end FUNCTION
/begin FUNCTION pfltcd_gettpre_1_var "" /end FUNCTION
/begin FUNCTION pfltcd_gettpre_1_var_msg "" /end FUNCTION
/begin FUNCTION pfltcd_gettpre_1_var_uic "" /end FUNCTION
/begin FUNCTION pfltcd_htg_1 ""
 /begin DEF_CHARACTERISTIC PFltCD_rThresHtg_C PFltCD_stInvOutHtg_C PFltCD_stPwrStgActvHtg_C PFltCD_stPwrStgDiaHtg_C PFltCD_tiDebExcTmpHtgDef_C PFltCD_tiDebExcTmpHtgOk_C PFltCD_tiDebNoLoadHtgDef_C PFltCD_tiDebNoLoadHtgOk_C PFltCD_tiDebShrtBatHtgDef_C PFltCD_tiDebShrtBatHtgOk_C PFltCD_tiDebShrtGndHtgDef_C PFltCD_tiDebShrtGndHtgOk_C /end DEF_CHARACTERISTIC
/end FUNCTION
/begin FUNCTION pfltcd_htg_1_msg "" /end FUNCTION
/begin FUNCTION pfltcd_htg_1_uic "" /begin OUT_MEASUREMENT PFltCD_stActrDSMTst_mp PFltCD_stOutHtg_mp /end OUT_MEASUREMENT /end FUNCTION
/begin FUNCTION pfltcd_htg_1_var "" /end FUNCTION
/begin FUNCTION pfltcd_htg_1_var_msg "" /end FUNCTION
/begin FUNCTION pfltcd_htg_1_var_uic "" /end FUNCTION
/begin COMPU_METHOD Acc "Fahrzeugbeschleunigung" RAT_FUNC "%6.5" "[m/s^2]" COEFFS 0 1000 0 0 0 1 /end COMPU_METHOD
/begin COMPU_METHOD AirMassPerTime "Luftmasse pro Zeit" RAT_FUNC "%6.3" "[Kg/h Luft]" COEFFS 0 10 0 0 0 1 /end COMPU_METHOD
/begin COMPU_METHOD AngleCrS "Winkel Kurbelwelle" RAT_FUNC "%6.4" "[deg CrS]" COEFFS 0 42.6666666666667 0 0 0 1 /end COMPU_METHOD
/begin COMPU_METHOD Curr "Strom" RAT_FUNC "%6.2" "[mA]" COEFFS 0 1 0 0 0 1 /end COMPU_METHOD
/begin COMPU_METHOD DtyCyc "Tastverhaeltnis" RAT_FUNC "%6.4" "[%]" COEFFS 0 100 0 0 0 1 /end COMPU_METHOD
/begin COMPU_METHOD EngN "Motordrehzahl" RAT_FUNC "%6.2" "[rpm]" COEFFS 0 1 0 0 0 1 /end COMPU_METHOD
/begin COMPU_METHOD Fact "Faktor mit Auflösung 1 / 8192, hauptsächlich für einen Faktorenbereich 0...1 verwendet" RAT_FUNC "%6.5" "[-]" COEFFS 0 8192 0 0 0 1 /end COMPU_METHOD
/begin COMPU_METHOD Fact1 "Faktor mit Auflösung 0,01 (100 mal höherer Bereich als Fact)" RAT_FUNC "%6.4" "[-]" COEFFS 0 128 0 0 0 1 /end COMPU_METHOD
/begin COMPU_METHOD FlConsum_l_h "Kraftstoffverbrauch" RAT_FUNC "%6.4" "[l/h]" COEFFS 0 100 0 0 0 1 /end COMPU_METHOD
/begin COMPU_METHOD InjMass "Einspritzmenge" RAT_FUNC "%6.4" "[mg/hub]" COEFFS 0 100 0 0 0 1 /end COMPU_METHOD
/begin COMPU_METHOD InjTime_us "Zeit in Microsekunden für das Einspritztiming" RAT_FUNC "%6.2" "[us]" COEFFS 0 1 0 0 0 1 /end COMPU_METHOD
/begin COMPU_METHOD Kd "Differentialverstärkung Kd (gleiche Einheit/Umrechnungsformel an Ein- und Ausgang)" RAT_FUNC "%7.6" "[1/1]" COEFFS 0 65536 0 0 0 1 /end COMPU_METHOD
/begin COMPU_METHOD Kd_Pres_hPa2Prc "Differentialverstärkung Kd (Druck Pres_hPa zu Prozent Prc)" RAT_FUNC "%9.8" "[%/hPa]" COEFFS 0 6553600 0 0 0 1 /end COMPU_METHOD
/begin COMPU_METHOD Kd_TurboN2Prc "Verstärkungskonstante des DT1 Filters (Turboladerdrehzahl zu Prozent)" RAT_FUNC "%10.9" "[%/rpm/s]" COEFFS 0 65536000 0 0 0 1 /end COMPU_METHOD
/begin COMPU_METHOD Ki_curr2fact "Integralverstärkung (Strom Curr zu Faktor Fact)" RAT_FUNC "%10.9" "1/mA*s" COEFFS 0 35184372.088832 0 0 0 1 /end COMPU_METHOD
/begin COMPU_METHOD Ki_Pres_hPa2Prc "Integralverstärkung (Druck Pres_hPa zu Prozent Prc)" RAT_FUNC "%8.7" "[%/(hPa*s)]" COEFFS 0 429496.7296 0 0 0 1 /end COMPU_METHOD
/begin COMPU_METHOD Ki_TurboN2Prc "Verstärkungskonstante des Integrators (Turboladerdrehzahl zu Prozent)" RAT_FUNC "%9.8" "[%/rpm/s]" COEFFS 0 4294967.296 0 0 0 1 /end COMPU_METHOD
/begin COMPU_METHOD Kp_Pres_hPa2Prc "Proportionale Verstärkung (Druck Pres_hPa zu Prozent Prc)" RAT_FUNC "%9.8" "[%/hPa]" COEFFS 0 6553600 0 0 0 1 /end COMPU_METHOD
/begin COMPU_METHOD Kp_TurboN2Prc "Proportionalverstärkung (Turboladerdrehzahl zu Prozent)" RAT_FUNC "%10.9" "[%/rpm]" COEFFS 0 65536000 0 0 0 1 /end COMPU_METHOD
/begin COMPU_METHOD NumPinAdc "verbale Umrechnung für ADC Signale" TAB_VERB "%6.3" "" COMPU_TAB_REF NumPinAdc /end COMPU_METHOD
/begin COMPU_VTAB NumPinAdc "verbale Umrechnung für ADC Signale" TAB_VERB 75 0 "Dummy_0" 1 "Dummy_1" 2 "Kick_Down_Switch" 3 "EGR_Actuator_Sensor" 4 "Intake_Air_Temperature_Sensor" 5 "Variable_Swirl_Position_1" 6 "Dummy_2" 7 "Terminal_50_Signal" 8 "Atmospheric_Pressure_Sensor" 9 "Starter_Sensor_1" 10 "Terminal_15_Signal" 11 "Dummy_3" 12 "Engine_Oil_Temperature_Sensor" 13 "Internal_Temperature_ECU" 14 "Variable_Swirl_Position_2" 15 "Dummy_4" 16 "Brake_Pedal_Switch" 17 "Empty_Tank_Switch" 18 "Dummy_5" 19 "Rhaps_Methyl_Sensor" 20 "Fuel_Level_Additive_Pump" 21 "Dummy_6" 22 "Interlock_Switch" 23 "Fuel_Temperature_Sensor" 24 "Fuel_Low_Pressure_Sensor" 25 "Dummy_7" 26 "Throttle_Valve_Position" 27 "Terminal_50_redundant_Signal" 28 "Water_Temperature_Sensor_2" 29 "Starter_Sensor_2" 30 "Boost_Pressure_Sensor" 31 "Rail_Pressure_Sensor_Peak" 32 "Rail_Pressure_Sensor_Actual" 33 "Lambda_Sensor_NLamda" 34 "Lambda_Sensor_RLamda" 35 "Exhaust_Gas_contra_Pressure_Sensor_1" 36 "Exhaust_Gas_contra_Pressure_Sensor_2" 37 "Engine_Temperature_Sensor" 38 "Air_Mass_Sensor_HFM5" 39 "1st_APP_Sensor" 40 "2nd_APP_Sensor" 41 "Exhaust_Gas_Temperature_Sensor_1_1" 42 "Exhaust_Gas_Temperature_Sensor_2_1" 43 "Exhaust_Gas_Temperature_Sensor_3_1" 44 "Exhaust_Gas_Temperature_Sensor_1_2" 45 "Exhaust_Gas_Temperature_Sensor_2_2" 46 "Reference_Voltage" 47 "Current_MeUn_Sensor" 48 "Current_PCV_Sensor" 49 "Battery_Voltage" 50 "Charge_Actuator_Event_1" 51 "Voltage_Piezo_Actuator_Bank_1_Event_1" 52 "Voltage_Piezo_Actuator_Bank_2_Event_1" 53 "Charge_Actuator_Event_2" 54 "Voltage_Piezo_Actuator_Bank_1_Event_2" 55 "Voltage_Piezo_Actuator_Bank_2_Event_2" 56 "Charge_Actuator_Event_3" 57 "Voltage_Piezo_Actuator_Bank_1_Event_3" 58 "Voltage_Piezo_Actuator_Bank_2_Event_3" 59 "Voltage_Buffer_Entry_1" 60 "Voltage_Buffer_Entry_2" 61 "Voltage_Buffer_Entry_3" 62 "Voltage_Buffer_Entry_4" 63 "Voltage_Buffer_Entry_5" 64 "Voltage_Buffer_Entry_6" 65 "Voltage_Buffer_Entry_7" 66 "Voltage_Buffer_Entry_8" 67 "Voltage_Buffer_Entry_9" 68 "Voltage_Buffer_Entry_10" 69 "Voltage_Buffer_Entry_11" 70 "Voltage_Buffer_Entry_12" 71 "Voltage_Buffer_Entry_13" 72 "Voltage_Buffer_Entry_14" 73 "Voltage_Buffer_Entry_15" 74 "Booster_Voltage_Piezo" /end COMPU_VTAB
/begin COMPU_METHOD NumPinDia "Verbale Umrechnung für Diagnose Signale" TAB_VERB "%6.3" "" COMPU_TAB_REF NumPinDia /end COMPU_METHOD
/begin COMPU_VTAB NumPinDia "Verbale Umrechnung für Diagnose Signale" TAB_VERB 43 0 "Fuel_Cooling_DiaSig" 1 "Engine_Mount_1_DiaSig" 2 "Additive_Pump_DiaSig" 3 "Intercooler_Fan_DiaSig" 4 "Electric_Tank_Pump_DiaSig" 5 "Gearbox_Mount_2_DiaSig" 6 "TLE_State_DiaSig" 7 "Variable_Swirl_1_DiaSig" 8 "Engine_Mount_2_DiaSig" 9 "Variable_Swirl_2_DiaSig" 10 "Water_Pump_Relais_DiaSig" 11 "Boost_Pressure_Actuator_DiaSig" 12 "Throttle_Valve_Actuator_DiaSig" 13 "Fan_Control_2_DiaSig" 14 "Fan_Control_1_DiaSig" 15 "Gearbox_Mount_1_DiaSig" 16 "Glow_Relais_DiaSig" 17 "Alternator_Shut_Off_DiaSig" 18 "Exhaust_Gas_Recirculation_DiaSig" 19 "1st_Metering_Unit_DiaSig" 20 "2nd_Metering_Unit_DiaSig" 21 "1st_Pressure_Control_Valve_DiaSig" 22 "2nd_Pressure_Control_Valve_DiaSig" 23 "Exhaust_Gas_Recirculation_Cooling_Bypass_DiaSig" 24 "Snow_Valve_DiaSig" 25 "CJ945_State_DiaSig" 26 "1st_Sensor_Supply_Voltage_DiaSig" 27 "2nd_Sensor_Supply_Voltage_DiaSig" 28 "3rd_Sensor_Supply_Voltage_DiaSig" 29 "Glow_Control_3_DiaSig" 30 "CJ315_State_DiaSig" 31 "Lambda_VM_DiaSig" 32 "Lambda_UN_DiaSig" 33 "Lambda_IA_DiaSig" 34 "Lambda_Heater_DiaSig" 35 "Lambda_CJ120_DiaSig" 36 "Dummy_FELA_DiaSig" 37 "Dummy_K15NAB_DiaSig" 38 "Dummy_MIL_DiaSig" 39 "Dummy_KOS_DiaSig" 40 "Dummy_ZHSG_DiaSig" 41 "Dummy_GAZ_DiaSig" 42 "Dummy_ETR_DiaSig" /end COMPU_VTAB
/begin COMPU_METHOD NumPinPwmOut "Verbale Umrechnung für PWM-Ausgang Signale" TAB_VERB "%6.3" "" COMPU_TAB_REF NumPinPwmOut /end COMPU_METHOD
/begin COMPU_VTAB NumPinPwmOut "Verbale Umrechnung für PWM-Ausgang Signale" TAB_VERB 14 0 "Dummy_1" 1 "Lambda_Probe_Internal_Use" 2 "Variable_Swirl_Actuator_1" 3 "Variable_Swirl_Actuator_2" 4 "Fan_Control_1" 5 "Fan_Control_2" 6 "Boost_Pressure_Actuator_1" 7 "Boost_Pressure_Actuator_2" 8 "Throttle_Valve_Actuator" 9 "Additive_Pump_Diagnosis" 10 "Exhaust_Gas_Recirculation_Actuator" 11 "Glow_Control_3" 12 "PCV_Actuator" 13 "MeUn_Actuator" /end COMPU_VTAB
/begin COMPU_METHOD OneToOne "eins zu eins (physikalischer Wert ist gleich dem internen Wert)" RAT_FUNC "%6.2" "[-]" COEFFS 0 1 0 0 0 1 /end COMPU_METHOD
/begin COMPU_METHOD Period "Periodendauer" RAT_FUNC "%6.3" "[ms]" COEFFS 0 10 0 0 0 1 /end COMPU_METHOD
/begin COMPU_METHOD Prc "Prozent, gleiche interne Auflösung wie Fact, aber Darstellung in Prozent (0...100%)" RAT_FUNC "%6.4" "[%]" COEFFS 0 100 0 0 0 1 /end COMPU_METHOD
/begin COMPU_METHOD Pres_hPa "Druck (angezeigt in [hPa])" RAT_FUNC "%6.2" "[hPa]" COEFFS 0 1 0 0 0 1 /end COMPU_METHOD
/begin COMPU_METHOD Pres_hPaPerSec_20ms "Druck pro Sekunde [hPa/s]" RAT_FUNC "%6.1" "[hPa/s]" COEFFS 0 0.02 0 0 0 1 /end COMPU_METHOD
/begin COMPU_METHOD Pres_Rail "Raildruck in hPa" RAT_FUNC "%6.0" "[hPa]" COEFFS 0 0.01 0 0 0 1 /end COMPU_METHOD
/begin COMPU_METHOD Qp_mm3_sec "Umrechnung für Volumenstrom" RAT_FUNC "%6.1" "mm3/s" COEFFS 0 0.1 0 0 0 1 /end COMPU_METHOD
/begin COMPU_METHOD Resist_1 "1. Widerstandsvariante" RAT_FUNC "%6.2" "mOhm" COEFFS 0 1 0 0 0 1 /end COMPU_METHOD
/begin COMPU_METHOD RmpPres_hPa "Rampengradient für Druck angezeigt in [hPa/s]" RAT_FUNC "%6.4" "[hPa/s]" COEFFS 0 65.536 0 0 0 1 /end COMPU_METHOD
/begin COMPU_METHOD RmpTemp "Rampengradient für Temperatur" RAT_FUNC "%6.4" "[deg C/s]" COEFFS 0 655.36 0 0 0 1 /end COMPU_METHOD
/begin COMPU_METHOD TempDiff_Kelv "Offsettemperatur dargestellt in [K]" RAT_FUNC "%6.3" "[ deg C ]" COEFFS 0 10 0 0 0 1 /end COMPU_METHOD
/begin COMPU_METHOD Temp_Cels "Temperatur dargestellt in °C (gleiche interne Darstellung wie Temp_Kelv)" RAT_FUNC "%6.1" "[deg C]" COEFFS 0 10 2731.4 0 0 1 /end COMPU_METHOD
/begin COMPU_METHOD TimeDeb "Entprellzeit in Millisekunden für Libraryfunktion Debounce" RAT_FUNC "%6.1" "[ms]" COEFFS 0 0.1 0 0 0 1 /end COMPU_METHOD
/begin COMPU_METHOD TimeDelay_s "Zeitkonstante T1 (in s) für PT1, DT1, etc." RAT_FUNC "%9.3" "[s]" COEFFS 0 0 1 0 0.00023283064365387 0 /end COMPU_METHOD
/begin COMPU_METHOD TimeDelay_s_2 "Zeitkonstante T1 (in s) für PT1, DT1, etc. normiert auf 16 bit" RAT_FUNC "%9.4" "[s]" COEFFS 0 0 1 0 0.0596046447753906 0 /end COMPU_METHOD
/begin COMPU_METHOD TimeEGTRmp "Umrechnung  Zeit in Rampensteigung,  Verwendet in EGT-Bibliothek" RAT_FUNC "%6.3" "[s]" COEFFS 0 0 1 0 0.0152587890625 0 /end COMPU_METHOD
/begin COMPU_METHOD TimeEngSpdFlt_s "Umrechnungsregel für Zeit in Sekunden für Zeitkonstanten der PT1-Drehzahlfilter" RAT_FUNC "%6.3" "[s]" COEFFS 0 10 0 0 0 1 /end COMPU_METHOD
/begin COMPU_METHOD TimeUSResolution "Zeit in Mikrosekunden für TPU Zeiten, Auflösung 1 us" RAT_FUNC "%6.2" "[us]" COEFFS 0 1 0 0 0 1 /end COMPU_METHOD
/begin COMPU_METHOD Time_HighRes "Höhere Auflösung für Zeit in Sekunden" RAT_FUNC "%6.3" "[ms]" COEFFS 0 8 0 0 0 1 /end COMPU_METHOD
/begin COMPU_METHOD Time_ms "Zeit in ms für Fehlerentprellung (DSM) und SW-Timer" RAT_FUNC "%6.1" "[ms]" COEFFS 0 0.1 0 0 0 1 /end COMPU_METHOD
/begin COMPU_METHOD Time_ms_100ms "time" RAT_FUNC "%6.0" "ms" COEFFS 0 0.01 0 0 0 1 /end COMPU_METHOD
/begin COMPU_METHOD Time_ms_40ms "Aktuelle Zaehler in 40 ms Takt" RAT_FUNC "%6.1" "ms" COEFFS 0 0.025 0 0 0 1 /end COMPU_METHOD
/begin COMPU_METHOD Time_s "Zeit in s für Fehlerentprellung (DSM) und SW-Timer" RAT_FUNC "%6.4" "[s]" COEFFS 0 100 0 0 0 1 /end COMPU_METHOD
/begin COMPU_METHOD Trq "Motormoment" RAT_FUNC "%6.3" "[Nm]" COEFFS 0 10 0 0 0 1 /end COMPU_METHOD
/begin COMPU_METHOD TurboN "Turboladerdrehzahl" RAT_FUNC "%6.1" "[rpm]" COEFFS 0 1 0 0 0 10 /end COMPU_METHOD
/begin COMPU_METHOD Volt "Spannung in V (von ADC)" RAT_FUNC "%6.2" "[mV]" COEFFS 0 0.2046 0 0 0 1 /end COMPU_METHOD
/begin COMPU_METHOD Volt_Batt "Batteriespannung" RAT_FUNC "%6.1" "[mV]" COEFFS 0 0.0492252911173131 0 0 0 1 /end COMPU_METHOD
/begin RECORD_LAYOUT Kf_Xs16_Ys16_Ws16 NO_AXIS_PTS_X 1 SWORD NO_AXIS_PTS_Y 2 SWORD AXIS_PTS_X 3 SWORD INDEX_INCR DIRECT AXIS_PTS_Y 4 SWORD INDEX_INCR DIRECT FNC_VALUES 5 SWORD COLUMN_DIR DIRECT /end RECORD_LAYOUT
/begin RECORD_LAYOUT Kl_Xs16_Ws16 NO_AXIS_PTS_X 1 SWORD AXIS_PTS_X 2 SWORD INDEX_INCR DIRECT FNC_VALUES 3 SWORD COLUMN_DIR DIRECT /end RECORD_LAYOUT
/begin RECORD_LAYOUT Kw_Ws16 FNC_VALUES 1 SWORD COLUMN_DIR DIRECT /end RECORD_LAYOUT
/begin RECORD_LAYOUT Kw_Ws32 FNC_VALUES 1 SLONG COLUMN_DIR DIRECT /end RECORD_LAYOUT
/begin RECORD_LAYOUT Kw_Wu16 FNC_VALUES 1 UWORD COLUMN_DIR DIRECT /end RECORD_LAYOUT
/begin RECORD_LAYOUT Kw_Wu32 FNC_VALUES 1 ULONG COLUMN_DIR DIRECT /end RECORD_LAYOUT
/begin RECORD_LAYOUT Kw_Wu8 FNC_VALUES 1 UBYTE COLUMN_DIR DIRECT /end RECORD_LAYOUT
/end MODULE
/end PROJECT
