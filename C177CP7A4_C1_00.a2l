ASAP2_VERSION 1 3
/begin PROJECT C177 "EDC16CP"
/begin HEADER "" VERSION "VCP7A3" PROJECT_NO C177 /end HEADER
/begin MODULE DIM ""
/begin MOD_COMMON "" BYTE_ORDER MSB_FIRST ALIGNMENT_BYTE 1 ALIGNMENT_WORD 2 ALIGNMENT_LONG 4 ALIGNMENT_FLOAT32_IEEE 4 /end MOD_COMMON
/begin CHARACTERISTIC CrSCD_numGlFilter_C "Wert Glitch Filter (MCy315)" VALUE 0x1C0F8D Kw_Wu8 3.000 OneToOne 0.00 3.000 FORMAT "%5.3" EXTENDED_LIMITS 0.00 255.0 /end CHARACTERISTIC
/begin CHARACTERISTIC CrSCD_numThresCtlHigh_C "obere Schwelle (MCy315)" VALUE 0x1C0F8E Kw_Wu8 7.000 OneToOne 0.00 7.000 FORMAT "%5.3" EXTENDED_LIMITS 0.00 255.0 /end CHARACTERISTIC
/begin CHARACTERISTIC CrSCD_numThresCtlLow_C "untere Schwelle (MCy315)" VALUE 0x1C0F8F Kw_Wu8 7.000 OneToOne 0.00 7.000 FORMAT "%5.3" EXTENDED_LIMITS 0.00 255.0 /end CHARACTERISTIC
/begin CHARACTERISTIC IVCtl_IKi_C "Integrationsbeiwert Ki für Kleinsignale" VALUE 0x1DEFD4 Kw_Wu32 999999.999767 Ki 0.00 999999.999767 FORMAT "%13.6" /end CHARACTERISTIC
/begin CHARACTERISTIC IVCtl_IKiPos_C "Integrationsbeiwert für positive Großsignale" VALUE 0x1DEFD8 Kw_Wu32 999999.999767 Ki 0.00 999999.999767 FORMAT "%13.6" /end CHARACTERISTIC
/begin CHARACTERISTIC IVCtl_IKiNeg_C "Integrationsbeiwert für negative Großsignale" VALUE 0x1DEFDC Kw_Wu32 999999.999767 Ki 0.00 999999.999767 FORMAT "%13.6" /end CHARACTERISTIC
/begin CHARACTERISTIC IVCtl_uIWinPos_C "Obere Grenze Kleinsignal zu Großsignal I-Regler" VALUE 0x1DEFE0 Kw_Ws16 655.3500 Volt_PA -327.6800 327.6700 FORMAT "%8.4" /end CHARACTERISTIC
/begin CHARACTERISTIC IVCtl_uIWinNeg_C "Untere Grenze Kleinsignal zu Großsignal I-Regler" VALUE 0x1DEFE2 Kw_Ws16 655.3500 Volt_PA -327.6800 327.6700 FORMAT "%8.4" /end CHARACTERISTIC
/begin CHARACTERISTIC IVCtl_PKp_C "Verstärkung Kleinsignal" VALUE 0x1DEFE4 Kw_Wu32 65535.9999847 Kp 0.00 65535.9999847 FORMAT "%13.7" /end CHARACTERISTIC
/begin CHARACTERISTIC IVCtl_PKpPos_C "Verstärkung positives Großsignal" VALUE 0x1DEFE8 Kw_Wu32 65535.9999847 Kp 0.00 65535.9999847 FORMAT "%13.7" /end CHARACTERISTIC
/begin CHARACTERISTIC IVCtl_PKpNeg_C "Verstärkung negatives Großsignal" VALUE 0x1DEFEC Kw_Wu32 65535.9999847 Kp 0.00 65535.9999847 FORMAT "%13.7" /end CHARACTERISTIC
/begin CHARACTERISTIC IVCtl_uPWinPos_C "Obere Grenze Kleinsignal zu Großsignal P-Regler" VALUE 0x1DEFF0 Kw_Ws16 655.3500 Volt_PA -327.6800 327.6700 FORMAT "%8.4" /end CHARACTERISTIC
/begin CHARACTERISTIC IVCtl_uPWinNeg_C "Untere Grenze Kleinsignal zu Großsignal P-Regler" VALUE 0x1DEFF2 Kw_Ws16 655.3500 Volt_PA -327.6800 327.6700 FORMAT "%8.4" /end CHARACTERISTIC
/begin CHARACTERISTIC IVCtl_swtUUpMinMaxActr_C "Schalter zur Aktivierung der Berechnung von Min.-/Max.-Regelabweichung der Spannung  (aktorspezifisch)" VALUE 0x1DEFF4 Kw_Wu8 1.000 OneToOne 0.00 1.000 FORMAT "%5.3" EXTENDED_LIMITS 0.00 255.0 /end CHARACTERISTIC
/begin CHARACTERISTIC IVCtl_swtUUpMinMaxRst_C "Schalter zum Rücksetzen der Berechnung Min.-/Max.-Regelabweichung der Spannung" VALUE 0x1DEFF5 Kw_Wu8 1.000 OneToOne 0.00 1.000 FORMAT "%5.3" EXTENDED_LIMITS 0.00 255.0 /end CHARACTERISTIC
/begin CHARACTERISTIC IVCtl_swtUUpMinMax_C "Schalter zur Aktivierung der Berechnung von Min.-/Max.-Regelabweichung der Spannung  (gemittelt)" VALUE 0x1DEFF6 Kw_Wu8 1.000 OneToOne 0.00 1.000 FORMAT "%5.3" EXTENDED_LIMITS 0.00 255.0 /end CHARACTERISTIC
/begin CHARACTERISTIC IVCtl_uClsActrUp_C "Sollspannung für den Piezoaktor während der Klassifizierung im Steuergerätenachlauf" VALUE 0x1DEFF8 Kw_Ws16 500.0000 Volt_PA -250.0000 250.0000 FORMAT "%8.4" EXTENDED_LIMITS -327.6800 327.6700 /end CHARACTERISTIC
/begin CHARACTERISTIC IVCtl_uMaxSetUp_C "Obere Begrenzung  des korrigierten Spannungssollwertes (up-level)" VALUE 0x1DEFFA Kw_Ws16 250.0000 Volt_PA 0.00 250.0000 FORMAT "%8.4" EXTENDED_LIMITS -327.6800 327.6700 /end CHARACTERISTIC
/begin CHARACTERISTIC IVCtl_uMinSetUp_C "Untere Begrenzung  des korrigierten Spannungssollwertes (up-level)" VALUE 0x1DEFFC Kw_Ws16 250.0000 Volt_PA 0.00 250.0000 FORMAT "%8.4" EXTENDED_LIMITS -327.6800 327.6700 /end CHARACTERISTIC
/begin CHARACTERISTIC IVCtl_uPIMax_C "Maximaler Reglerausgang Spannungssollwert" VALUE 0x1DEFFE Kw_Ws16 500.0000 Volt_PA -250.0000 250.0000 FORMAT "%8.4" EXTENDED_LIMITS -327.6800 327.6700 /end CHARACTERISTIC
/begin CHARACTERISTIC IVCtl_uPIMin_C "Minimaler Reglerausgang Spannungssollwert" VALUE 0x1DF000 Kw_Ws16 500.0000 Volt_PA -250.0000 250.0000 FORMAT "%8.4" EXTENDED_LIMITS -327.6800 327.6700 /end CHARACTERISTIC
/begin CHARACTERISTIC IVCtl_uSetUpPreCtl_CUR "Vorsteuerkennlinie für Spannungssollwertberechnung" CURVE 0x1DF002 Kl_Xs16_Ws16 250.0000 Volt_PA 0.00 250.0000 FORMAT "%8.4" EXTENDED_LIMITS -327.6800 327.6700
 /begin AXIS_DESCR STD_AXIS InjVlv_pCalcVolt Pres_Rail 20 -3276800. 3276700. FORMAT "%8.0" DEPOSIT ABSOLUTE /end AXIS_DESCR
/end CHARACTERISTIC
/begin CHARACTERISTIC IVCtl_uUpInitI_C "Initialisierungswert für PI-Regler (up-Niveau)" VALUE 0x1DF054 Kw_Ws16 500.0000 Volt_PA -250.0000 250.0000 FORMAT "%8.4" EXTENDED_LIMITS -327.6800 327.6700 /end CHARACTERISTIC
/begin CHARACTERISTIC K2rffd_FrzFrEnv_Idx_C "FreezeFrame-Index für Umweltbedingungen" VAL_BLK 0x1DF058 Kwb_Wu8 10.00 OneToOne 0.00 10.00 FORMAT "%5.2" EXTENDED_LIMITS 0.00 255.0 NUMBER 3 /end CHARACTERISTIC
/begin CHARACTERISTIC LIGov_tiCldCltchDT1_C "Koeffizient D-Glied (T)" VALUE 0x1DF05C Kw_Wu32 4294.9673 TimeDelay_s 0.0000010000000 4294.9673 FORMAT "%9.4" /end CHARACTERISTIC
/begin CHARACTERISTIC LIGov_CldCltchDKd_C "Koeffizient D-Glied (K)" VALUE 0x1DF060 Kw_Ws32 6553.59999847 Kd_rpm2Nm -3276.80000000 3276.79999847 FORMAT "%13.8" /end CHARACTERISTIC
/begin CHARACTERISTIC LIGov_CldCltchIKi_C "Kleinsignalverstärkung" VALUE 0x1DF064 Kw_Wu32 99999.9999767 Ki_rpm2Nm 0.00 99999.9999767 FORMAT "%13.7" /end CHARACTERISTIC
/begin CHARACTERISTIC LIGov_CldCltchIKiPos_C "Verstärkung für positive Großsignale" VALUE 0x1DF068 Kw_Wu32 99999.9999767 Ki_rpm2Nm 0.00 99999.9999767 FORMAT "%13.7" /end CHARACTERISTIC
/begin CHARACTERISTIC LIGov_CldCltchIKiNeg_C "Verstärkung für negative Großsignale" VALUE 0x1DF06C Kw_Wu32 99999.9999767 Ki_rpm2Nm 0.00 99999.9999767 FORMAT "%13.7" /end CHARACTERISTIC
/begin CHARACTERISTIC LIGov_CldCltchIWinPos_C "Kleinsignalfenster positiv" VALUE 0x1DF070 Kw_Ws16 65535.00 EngN -32768.00 32767.00 FORMAT "%8.2" /end CHARACTERISTIC
/begin CHARACTERISTIC LIGov_CldCltchIWinNeg_C "Kleinsignalfenster negativ" VALUE 0x1DF072 Kw_Ws16 65535.00 EngN -32768.00 32767.00 FORMAT "%8.2" /end CHARACTERISTIC
/begin CHARACTERISTIC LIGov_CldCltchPredef_C "Einschrittmoment Vorsteuerung" VALUE 0x1DF074 Kw_Ws16 6553.500 Trq -3276.800 3276.700 FORMAT "%8.3" /end CHARACTERISTIC
/begin CHARACTERISTIC LIGov_CldCltchPKp_C "Kleinsignalverstärkung" VALUE 0x1DF078 Kw_Wu32 6553.59999847 Kp_rpm2Nm 0.00 6553.59999847 FORMAT "%13.8" /end CHARACTERISTIC
/begin CHARACTERISTIC LIGov_CldCltchPKpPos_C "Verstärkung für positive Großsignale" VALUE 0x1DF07C Kw_Wu32 6553.59999847 Kp_rpm2Nm 0.00 6553.59999847 FORMAT "%13.8" /end CHARACTERISTIC
/begin CHARACTERISTIC LIGov_CldCltchPKpNeg_C "Verstärkung für negative Großsignale" VALUE 0x1DF080 Kw_Wu32 6553.59999847 Kp_rpm2Nm 0.00 6553.59999847 FORMAT "%13.8" /end CHARACTERISTIC
/begin CHARACTERISTIC LIGov_CldCltchPWinPos_C "Kleinsignalfenster positiv" VALUE 0x1DF084 Kw_Ws16 65535.00 EngN -32768.00 32767.00 FORMAT "%8.2" /end CHARACTERISTIC
/begin CHARACTERISTIC LIGov_CldCltchPWinNeg_C "Kleinsignalfenster negativ" VALUE 0x1DF086 Kw_Ws16 65535.00 EngN -32768.00 32767.00 FORMAT "%8.2" /end CHARACTERISTIC
/begin CHARACTERISTIC LIGov_tiCldGearDT1_C "Koeffizient D-Glied (T)" VALUE 0x1DF088 Kw_Wu32 4294.9673 TimeDelay_s 0.0000010000000 4294.9673 FORMAT "%9.4" /end CHARACTERISTIC
/begin CHARACTERISTIC LIGov_CldGearDKd_C "Koeffizient D-Glied (K)" VALUE 0x1DF08C Kw_Ws32 6553.59999847 Kd_rpm2Nm -3276.80000000 3276.79999847 FORMAT "%13.8" /end CHARACTERISTIC
/begin CHARACTERISTIC LIGov_CldGearIKi_C "Kleinsignalverstärkung" VALUE 0x1DF090 Kw_Wu32 99999.9999767 Ki_rpm2Nm 0.00 99999.9999767 FORMAT "%13.7" /end CHARACTERISTIC
/begin CHARACTERISTIC LIGov_CldGearIKiPos_C "Verstärkung für positive Großsignale" VALUE 0x1DF094 Kw_Wu32 99999.9999767 Ki_rpm2Nm 0.00 99999.9999767 FORMAT "%13.7" /end CHARACTERISTIC
/begin CHARACTERISTIC LIGov_CldGearIKiNeg_C "Verstärkung für negative Großsignale" VALUE 0x1DF098 Kw_Wu32 99999.9999767 Ki_rpm2Nm 0.00 99999.9999767 FORMAT "%13.7" /end CHARACTERISTIC
/begin CHARACTERISTIC LIGov_CldGearIWinPos_C "Kleinsignalfenster positiv" VALUE 0x1DF09C Kw_Ws16 65535.00 EngN -32768.00 32767.00 FORMAT "%8.2" /end CHARACTERISTIC
/begin CHARACTERISTIC LIGov_CldGearIWinNeg_C "Kleinsignalfenster negativ" VALUE 0x1DF09E Kw_Ws16 65535.00 EngN -32768.00 32767.00 FORMAT "%8.2" /end CHARACTERISTIC
/begin CHARACTERISTIC LIGov_CldGearPredef_C "Einschrittmoment Vorsteuerung" VALUE 0x1DF0A0 Kw_Ws16 6553.500 Trq -3276.800 3276.700 FORMAT "%8.3" /end CHARACTERISTIC
/begin CHARACTERISTIC LIGov_CldGearPKp_C "Kleinsignalverstärkung" VALUE 0x1DF0A4 Kw_Wu32 6553.59999847 Kp_rpm2Nm 0.00 6553.59999847 FORMAT "%13.8" /end CHARACTERISTIC
/begin CHARACTERISTIC LIGov_CldGearPKpPos_C "Verstärkung für positive Großsignale" VALUE 0x1DF0A8 Kw_Wu32 6553.59999847 Kp_rpm2Nm 0.00 6553.59999847 FORMAT "%13.8" /end CHARACTERISTIC
/begin CHARACTERISTIC LIGov_CldGearPKpNeg_C "Verstärkung für negative Großsignale" VALUE 0x1DF0AC Kw_Wu32 6553.59999847 Kp_rpm2Nm 0.00 6553.59999847 FORMAT "%13.8" /end CHARACTERISTIC
/begin CHARACTERISTIC LIGov_CldGearPWinPos_C "Kleinsignalfenster positiv" VALUE 0x1DF0B0 Kw_Ws16 65535.00 EngN -32768.00 32767.00 FORMAT "%8.2" /end CHARACTERISTIC
/begin CHARACTERISTIC LIGov_CldGearPWinNeg_C "Kleinsignalfenster negativ" VALUE 0x1DF0B2 Kw_Ws16 65535.00 EngN -32768.00 32767.00 FORMAT "%8.2" /end CHARACTERISTIC
/begin CHARACTERISTIC LIGov_dnLimHighTrm_C "obere dn-Grenze für Abgleich" VALUE 0x1DF0B4 Kw_Ws16 65535.00 EngN -32768.00 32767.00 FORMAT "%8.2" /end CHARACTERISTIC
/begin CHARACTERISTIC LIGov_dnLimLowTrm_C "untere dn-Grenze für Abgleich" VALUE 0x1DF0B6 Kw_Ws16 65535.00 EngN -32768.00 32767.00 FORMAT "%8.2" /end CHARACTERISTIC
/begin CHARACTERISTIC LIGov_tiDriveoffDT1_C "Koeffizient D-Glied (T) Anfahren" VALUE 0x1DF2E8 Kw_Wu32 4294.9673 TimeDelay_s 0.0000010000000 4294.9673 FORMAT "%9.4" /end CHARACTERISTIC
/begin CHARACTERISTIC LIGov_DriveoffDKd_C "Anfahren Koeffizient D-Glied (K)" VALUE 0x1DF2EC Kw_Ws32 6553.59999847 Kd_rpm2Nm -3276.80000000 3276.79999847 FORMAT "%13.8" /end CHARACTERISTIC
/begin CHARACTERISTIC LIGov_DriveoffIKi_C "Kleinsignalverstärkung Anfahren" VALUE 0x1DF2F0 Kw_Wu32 99999.9999767 Ki_rpm2Nm 0.00 99999.9999767 FORMAT "%13.7" /end CHARACTERISTIC
/begin CHARACTERISTIC LIGov_DriveoffIKiPos_C "Verstärkung für positive Großsignale Anfahren" VALUE 0x1DF2F4 Kw_Wu32 99999.9999767 Ki_rpm2Nm 0.00 99999.9999767 FORMAT "%13.7" /end CHARACTERISTIC
/begin CHARACTERISTIC LIGov_DriveoffIKiNeg_C "Verstärkung für negative Großsignale Anfahren" VALUE 0x1DF2F8 Kw_Wu32 99999.9999767 Ki_rpm2Nm 0.00 99999.9999767 FORMAT "%13.7" /end CHARACTERISTIC
/begin CHARACTERISTIC LIGov_DriveoffIWinPos_C "Kleinsignalfenster positiv Anfahren" VALUE 0x1DF2FC Kw_Ws16 65535.00 EngN -32768.00 32767.00 FORMAT "%8.2" /end CHARACTERISTIC
/begin CHARACTERISTIC LIGov_DriveoffIWinNeg_C "Kleinsignalfenster negativ Anfahren" VALUE 0x1DF2FE Kw_Ws16 65535.00 EngN -32768.00 32767.00 FORMAT "%8.2" /end CHARACTERISTIC
/begin CHARACTERISTIC LIGov_DriveoffPredef_C "Einschrittmoment Vorsteuerung Anfahren" VALUE 0x1DF300 Kw_Ws16 6553.500 Trq -3276.800 3276.700 FORMAT "%8.3" /end CHARACTERISTIC
/begin CHARACTERISTIC LIGov_DriveoffPKp_C "Kleinsignalverstärkung" VALUE 0x1DF304 Kw_Wu32 6553.59999847 Kp_rpm2Nm 0.00 6553.59999847 FORMAT "%13.8" /end CHARACTERISTIC
/begin CHARACTERISTIC LIGov_DriveoffPKpPos_C "Verstärkung für positive Großsignale" VALUE 0x1DF308 Kw_Wu32 6553.59999847 Kp_rpm2Nm 0.00 6553.59999847 FORMAT "%13.8" /end CHARACTERISTIC
/begin CHARACTERISTIC LIGov_DriveoffPKpNeg_C "Verstärkung für negative Großsignale" VALUE 0x1DF30C Kw_Wu32 6553.59999847 Kp_rpm2Nm 0.00 6553.59999847 FORMAT "%13.8" /end CHARACTERISTIC
/begin CHARACTERISTIC LIGov_DriveoffPWinPos_C "Kleinsignalfenster positiv" VALUE 0x1DF310 Kw_Ws16 65535.00 EngN -32768.00 32767.00 FORMAT "%8.2" /end CHARACTERISTIC
/begin CHARACTERISTIC LIGov_DriveoffPWinNeg_C "Kleinsignalfenster negativ" VALUE 0x1DF312 Kw_Ws16 65535.00 EngN -32768.00 32767.00 FORMAT "%8.2" /end CHARACTERISTIC
/begin CHARACTERISTIC LIGov_tiGear1DT1_C "Koeffizient D-Glied (T)" VALUE 0x1DF0B8 Kw_Wu32 4294.9673 TimeDelay_s 0.0000010000000 4294.9673 FORMAT "%9.4" /end CHARACTERISTIC
/begin CHARACTERISTIC LIGov_Gear1DKd_C "Koeffizient D-Glied (K)" VALUE 0x1DF0BC Kw_Ws32 6553.59999847 Kd_rpm2Nm -3276.80000000 3276.79999847 FORMAT "%13.8" /end CHARACTERISTIC
/begin CHARACTERISTIC LIGov_Gear1IKi_C "Kleinsignalverstärkung" VALUE 0x1DF0C0 Kw_Wu32 99999.9999767 Ki_rpm2Nm 0.00 99999.9999767 FORMAT "%13.7" /end CHARACTERISTIC
/begin CHARACTERISTIC LIGov_Gear1IKiPos_C "Verstärkung für positive Großsignale" VALUE 0x1DF0C4 Kw_Wu32 99999.9999767 Ki_rpm2Nm 0.00 99999.9999767 FORMAT "%13.7" /end CHARACTERISTIC
/begin CHARACTERISTIC LIGov_Gear1IKiNeg_C "Verstärkung für negative Großsignale" VALUE 0x1DF0C8 Kw_Wu32 99999.9999767 Ki_rpm2Nm 0.00 99999.9999767 FORMAT "%13.7" /end CHARACTERISTIC
/begin CHARACTERISTIC LIGov_Gear1IWinPos_C "Kleinsignalfenster positiv" VALUE 0x1DF0CC Kw_Ws16 65535.00 EngN -32768.00 32767.00 FORMAT "%8.2" /end CHARACTERISTIC
/begin CHARACTERISTIC LIGov_Gear1IWinNeg_C "Kleinsignalfenster negativ" VALUE 0x1DF0CE Kw_Ws16 65535.00 EngN -32768.00 32767.00 FORMAT "%8.2" /end CHARACTERISTIC
/begin CHARACTERISTIC LIGov_Gear1Predef_C "Einschrittmoment Vorsteuerung" VALUE 0x1DF0D0 Kw_Ws16 6553.500 Trq -3276.800 3276.700 FORMAT "%8.3" /end CHARACTERISTIC
/begin CHARACTERISTIC LIGov_Gear1PKp_C "Kleinsignalverstärkung" VALUE 0x1DF0D4 Kw_Wu32 6553.59999847 Kp_rpm2Nm 0.00 6553.59999847 FORMAT "%13.8" /end CHARACTERISTIC
/begin CHARACTERISTIC LIGov_Gear1PKpPos_C "Verstärkung für positive Großsignale" VALUE 0x1DF0D8 Kw_Wu32 6553.59999847 Kp_rpm2Nm 0.00 6553.59999847 FORMAT "%13.8" /end CHARACTERISTIC
/begin CHARACTERISTIC LIGov_Gear1PKpNeg_C "Verstärkung für negative Großsignale" VALUE 0x1DF0DC Kw_Wu32 6553.59999847 Kp_rpm2Nm 0.00 6553.59999847 FORMAT "%13.8" /end CHARACTERISTIC
/begin CHARACTERISTIC LIGov_Gear1PWinPos_C "Kleinsignalfenster positiv" VALUE 0x1DF0E0 Kw_Ws16 65535.00 EngN -32768.00 32767.00 FORMAT "%8.2" /end CHARACTERISTIC
/begin CHARACTERISTIC LIGov_Gear1PWinNeg_C "Kleinsignalfenster negativ" VALUE 0x1DF0E2 Kw_Ws16 65535.00 EngN -32768.00 32767.00 FORMAT "%8.2" /end CHARACTERISTIC
/begin CHARACTERISTIC LIGov_tiGear2DT1_C "Koeffizient D-Glied (T)" VALUE 0x1DF0E4 Kw_Wu32 4294.9673 TimeDelay_s 0.0000010000000 4294.9673 FORMAT "%9.4" /end CHARACTERISTIC
/begin CHARACTERISTIC LIGov_Gear2DKd_C "Koeffizient D-Glied (K)" VALUE 0x1DF0E8 Kw_Ws32 6553.59999847 Kd_rpm2Nm -3276.80000000 3276.79999847 FORMAT "%13.8" /end CHARACTERISTIC
/begin CHARACTERISTIC LIGov_Gear2IKi_C "Kleinsignalverstärkung" VALUE 0x1DF0EC Kw_Wu32 99999.9999767 Ki_rpm2Nm 0.00 99999.9999767 FORMAT "%13.7" /end CHARACTERISTIC
/begin CHARACTERISTIC LIGov_Gear2IKiPos_C "Verstärkung für positive Großsignale" VALUE 0x1DF0F0 Kw_Wu32 99999.9999767 Ki_rpm2Nm 0.00 99999.9999767 FORMAT "%13.7" /end CHARACTERISTIC
/begin CHARACTERISTIC LIGov_Gear2IKiNeg_C "Verstärkung für negative Großsignale" VALUE 0x1DF0F4 Kw_Wu32 99999.9999767 Ki_rpm2Nm 0.00 99999.9999767 FORMAT "%13.7" /end CHARACTERISTIC
/begin CHARACTERISTIC LIGov_Gear2IWinPos_C "Kleinsignalfenster positiv" VALUE 0x1DF0F8 Kw_Ws16 65535.00 EngN -32768.00 32767.00 FORMAT "%8.2" /end CHARACTERISTIC
/begin CHARACTERISTIC LIGov_Gear2IWinNeg_C "Kleinsignalfenster negativ" VALUE 0x1DF0FA Kw_Ws16 65535.00 EngN -32768.00 32767.00 FORMAT "%8.2" /end CHARACTERISTIC
/begin CHARACTERISTIC LIGov_Gear2Predef_C "Einschrittmoment Vorsteuerung" VALUE 0x1DF0FC Kw_Ws16 6553.500 Trq -3276.800 3276.700 FORMAT "%8.3" /end CHARACTERISTIC
/begin CHARACTERISTIC LIGov_Gear2PKp_C "Kleinsignalverstärkung" VALUE 0x1DF100 Kw_Wu32 6553.59999847 Kp_rpm2Nm 0.00 6553.59999847 FORMAT "%13.8" /end CHARACTERISTIC
/begin CHARACTERISTIC LIGov_Gear2PKpPos_C "Verstärkung für positive Großsignale" VALUE 0x1DF104 Kw_Wu32 6553.59999847 Kp_rpm2Nm 0.00 6553.59999847 FORMAT "%13.8" /end CHARACTERISTIC
/begin CHARACTERISTIC LIGov_Gear2PKpNeg_C "Verstärkung für negative Großsignale" VALUE 0x1DF108 Kw_Wu32 6553.59999847 Kp_rpm2Nm 0.00 6553.59999847 FORMAT "%13.8" /end CHARACTERISTIC
/begin CHARACTERISTIC LIGov_Gear2PWinPos_C "Kleinsignalfenster positiv" VALUE 0x1DF10C Kw_Ws16 65535.00 EngN -32768.00 32767.00 FORMAT "%8.2" /end CHARACTERISTIC
/begin CHARACTERISTIC LIGov_Gear2PWinNeg_C "Kleinsignalfenster negativ" VALUE 0x1DF10E Kw_Ws16 65535.00 EngN -32768.00 32767.00 FORMAT "%8.2" /end CHARACTERISTIC
/begin CHARACTERISTIC LIGov_tiGear3DT1_C "Koeffizient D-Glied (T)" VALUE 0x1DF110 Kw_Wu32 4294.9673 TimeDelay_s 0.0000010000000 4294.9673 FORMAT "%9.4" /end CHARACTERISTIC
/begin CHARACTERISTIC LIGov_Gear3DKd_C "Koeffizient D-Glied (K)" VALUE 0x1DF114 Kw_Ws32 6553.59999847 Kd_rpm2Nm -3276.80000000 3276.79999847 FORMAT "%13.8" /end CHARACTERISTIC
/begin CHARACTERISTIC LIGov_Gear3IKi_C "Kleinsignalverstärkung" VALUE 0x1DF118 Kw_Wu32 99999.9999767 Ki_rpm2Nm 0.00 99999.9999767 FORMAT "%13.7" /end CHARACTERISTIC
/begin CHARACTERISTIC LIGov_Gear3IKiPos_C "Verstärkung für positive Großsignale" VALUE 0x1DF11C Kw_Wu32 99999.9999767 Ki_rpm2Nm 0.00 99999.9999767 FORMAT "%13.7" /end CHARACTERISTIC
/begin CHARACTERISTIC LIGov_Gear3IKiNeg_C "Verstärkung für negative Großsignale" VALUE 0x1DF120 Kw_Wu32 99999.9999767 Ki_rpm2Nm 0.00 99999.9999767 FORMAT "%13.7" /end CHARACTERISTIC
/begin CHARACTERISTIC LIGov_Gear3IWinPos_C "Kleinsignalfenster positiv" VALUE 0x1DF124 Kw_Ws16 65535.00 EngN -32768.00 32767.00 FORMAT "%8.2" /end CHARACTERISTIC
/begin CHARACTERISTIC LIGov_Gear3IWinNeg_C "Kleinsignalfenster negativ" VALUE 0x1DF126 Kw_Ws16 65535.00 EngN -32768.00 32767.00 FORMAT "%8.2" /end CHARACTERISTIC
/begin CHARACTERISTIC LIGov_Gear3Predef_C "Einschrittmoment Vorsteuerung" VALUE 0x1DF128 Kw_Ws16 6553.500 Trq -3276.800 3276.700 FORMAT "%8.3" /end CHARACTERISTIC
/begin CHARACTERISTIC LIGov_Gear3PKp_C "Kleinsignalverstärkung" VALUE 0x1DF12C Kw_Wu32 6553.59999847 Kp_rpm2Nm 0.00 6553.59999847 FORMAT "%13.8" /end CHARACTERISTIC
/begin CHARACTERISTIC LIGov_Gear3PKpPos_C "Verstärkung für positive Großsignale" VALUE 0x1DF130 Kw_Wu32 6553.59999847 Kp_rpm2Nm 0.00 6553.59999847 FORMAT "%13.8" /end CHARACTERISTIC
/begin CHARACTERISTIC LIGov_Gear3PKpNeg_C "Verstärkung für negative Großsignale" VALUE 0x1DF134 Kw_Wu32 6553.59999847 Kp_rpm2Nm 0.00 6553.59999847 FORMAT "%13.8" /end CHARACTERISTIC
/begin CHARACTERISTIC LIGov_Gear3PWinPos_C "Kleinsignalfenster positiv" VALUE 0x1DF138 Kw_Ws16 65535.00 EngN -32768.00 32767.00 FORMAT "%8.2" /end CHARACTERISTIC
/begin CHARACTERISTIC LIGov_Gear3PWinNeg_C "Kleinsignalfenster negativ" VALUE 0x1DF13A Kw_Ws16 65535.00 EngN -32768.00 32767.00 FORMAT "%8.2" /end CHARACTERISTIC
/begin CHARACTERISTIC LIGov_tiGear4DT1_C "Koeffizient D-Glied (T)" VALUE 0x1DF13C Kw_Wu32 4294.9673 TimeDelay_s 0.0000010000000 4294.9673 FORMAT "%9.4" /end CHARACTERISTIC
/begin CHARACTERISTIC LIGov_Gear4DKd_C "Koeffizient D-Glied (K)" VALUE 0x1DF140 Kw_Ws32 6553.59999847 Kd_rpm2Nm -3276.80000000 3276.79999847 FORMAT "%13.8" /end CHARACTERISTIC
/begin CHARACTERISTIC LIGov_Gear4IKi_C "Kleinsignalverstärkung" VALUE 0x1DF144 Kw_Wu32 99999.9999767 Ki_rpm2Nm 0.00 99999.9999767 FORMAT "%13.7" /end CHARACTERISTIC
/begin CHARACTERISTIC LIGov_Gear4IKiPos_C "Verstärkung für positive Großsignale" VALUE 0x1DF148 Kw_Wu32 99999.9999767 Ki_rpm2Nm 0.00 99999.9999767 FORMAT "%13.7" /end CHARACTERISTIC
/begin CHARACTERISTIC LIGov_Gear4IKiNeg_C "Verstärkung für negative Großsignale" VALUE 0x1DF14C Kw_Wu32 99999.9999767 Ki_rpm2Nm 0.00 99999.9999767 FORMAT "%13.7" /end CHARACTERISTIC
/begin CHARACTERISTIC LIGov_Gear4IWinPos_C "Kleinsignalfenster positiv" VALUE 0x1DF150 Kw_Ws16 65535.00 EngN -32768.00 32767.00 FORMAT "%8.2" /end CHARACTERISTIC
/begin CHARACTERISTIC LIGov_Gear4IWinNeg_C "Kleinsignalfenster negativ" VALUE 0x1DF152 Kw_Ws16 65535.00 EngN -32768.00 32767.00 FORMAT "%8.2" /end CHARACTERISTIC
/begin CHARACTERISTIC LIGov_Gear4Predef_C "Einschrittmoment Vorsteuerung" VALUE 0x1DF154 Kw_Ws16 6553.500 Trq -3276.800 3276.700 FORMAT "%8.3" /end CHARACTERISTIC
/begin CHARACTERISTIC LIGov_Gear4PKp_C "Kleinsignalverstärkung" VALUE 0x1DF158 Kw_Wu32 6553.59999847 Kp_rpm2Nm 0.00 6553.59999847 FORMAT "%13.8" /end CHARACTERISTIC
/begin CHARACTERISTIC LIGov_Gear4PKpPos_C "Verstärkung für positive Großsignale" VALUE 0x1DF15C Kw_Wu32 6553.59999847 Kp_rpm2Nm 0.00 6553.59999847 FORMAT "%13.8" /end CHARACTERISTIC
/begin CHARACTERISTIC LIGov_Gear4PKpNeg_C "Verstärkung für negative Großsignale" VALUE 0x1DF160 Kw_Wu32 6553.59999847 Kp_rpm2Nm 0.00 6553.59999847 FORMAT "%13.8" /end CHARACTERISTIC
/begin CHARACTERISTIC LIGov_Gear4PWinPos_C "Kleinsignalfenster positiv" VALUE 0x1DF164 Kw_Ws16 65535.00 EngN -32768.00 32767.00 FORMAT "%8.2" /end CHARACTERISTIC
/begin CHARACTERISTIC LIGov_Gear4PWinNeg_C "Kleinsignalfenster negativ" VALUE 0x1DF166 Kw_Ws16 65535.00 EngN -32768.00 32767.00 FORMAT "%8.2" /end CHARACTERISTIC
/begin CHARACTERISTIC LIGov_tiGear5DT1_C "Koeffizient D-Glied (T)" VALUE 0x1DF168 Kw_Wu32 4294.9673 TimeDelay_s 0.0000010000000 4294.9673 FORMAT "%9.4" /end CHARACTERISTIC
/begin CHARACTERISTIC LIGov_Gear5DKd_C "Koeffizient D-Glied (K)" VALUE 0x1DF16C Kw_Ws32 6553.59999847 Kd_rpm2Nm -3276.80000000 3276.79999847 FORMAT "%13.8" /end CHARACTERISTIC
/begin CHARACTERISTIC LIGov_Gear5IKi_C "Kleinsignalverstärkung" VALUE 0x1DF170 Kw_Wu32 99999.9999767 Ki_rpm2Nm 0.00 99999.9999767 FORMAT "%13.7" /end CHARACTERISTIC
/begin CHARACTERISTIC LIGov_Gear5IKiPos_C "Verstärkung für positive Großsignale" VALUE 0x1DF174 Kw_Wu32 99999.9999767 Ki_rpm2Nm 0.00 99999.9999767 FORMAT "%13.7" /end CHARACTERISTIC
/begin CHARACTERISTIC LIGov_Gear5IKiNeg_C "Verstärkung für negative Großsignale" VALUE 0x1DF178 Kw_Wu32 99999.9999767 Ki_rpm2Nm 0.00 99999.9999767 FORMAT "%13.7" /end CHARACTERISTIC
/begin CHARACTERISTIC LIGov_Gear5IWinPos_C "Kleinsignalfenster positiv" VALUE 0x1DF17C Kw_Ws16 65535.00 EngN -32768.00 32767.00 FORMAT "%8.2" /end CHARACTERISTIC
/begin CHARACTERISTIC LIGov_Gear5IWinNeg_C "Kleinsignalfenster negativ" VALUE 0x1DF17E Kw_Ws16 65535.00 EngN -32768.00 32767.00 FORMAT "%8.2" /end CHARACTERISTIC
/begin CHARACTERISTIC LIGov_Gear5Predef_C "Einschrittmoment Vorsteuerung" VALUE 0x1DF180 Kw_Ws16 6553.500 Trq -3276.800 3276.700 FORMAT "%8.3" /end CHARACTERISTIC
/begin CHARACTERISTIC LIGov_Gear5PKp_C "Kleinsignalverstärkung" VALUE 0x1DF184 Kw_Wu32 6553.59999847 Kp_rpm2Nm 0.00 6553.59999847 FORMAT "%13.8" /end CHARACTERISTIC
/begin CHARACTERISTIC LIGov_Gear5PKpPos_C "Verstärkung für positive Großsignale" VALUE 0x1DF188 Kw_Wu32 6553.59999847 Kp_rpm2Nm 0.00 6553.59999847 FORMAT "%13.8" /end CHARACTERISTIC
/begin CHARACTERISTIC LIGov_Gear5PKpNeg_C "Verstärkung für negative Großsignale" VALUE 0x1DF18C Kw_Wu32 6553.59999847 Kp_rpm2Nm 0.00 6553.59999847 FORMAT "%13.8" /end CHARACTERISTIC
/begin CHARACTERISTIC LIGov_Gear5PWinPos_C "Kleinsignalfenster positiv" VALUE 0x1DF190 Kw_Ws16 65535.00 EngN -32768.00 32767.00 FORMAT "%8.2" /end CHARACTERISTIC
/begin CHARACTERISTIC LIGov_Gear5PWinNeg_C "Kleinsignalfenster negativ" VALUE 0x1DF192 Kw_Ws16 65535.00 EngN -32768.00 32767.00 FORMAT "%8.2" /end CHARACTERISTIC
/begin CHARACTERISTIC LIGov_nCltAirP_MAP "Wasser und Luftdruckabhängiger Leerlaufsollwert" MAP 0x1DF314 Kf_Xs16_Ys16_Ws16 3000.000 EngN 0.00 3000.000 FORMAT "%8.3" EXTENDED_LIMITS -32768.00 32767.00
 /begin AXIS_DESCR STD_AXIS Eng_tEng Temp_Cels 5 -273.1400 149.8600 FORMAT "%8.4" EXTENDED_LIMITS -3549.940 3003.560 DEPOSIT ABSOLUTE /end AXIS_DESCR
 /begin AXIS_DESCR STD_AXIS APSCD_pVal Pres_hPa 4 0.00 2000.000 FORMAT "%8.3" EXTENDED_LIMITS -32768.00 32767.00 DEPOSIT ABSOLUTE /end AXIS_DESCR
/end CHARACTERISTIC
/begin CHARACTERISTIC LIGov_nDHypDenomCold_C "Nennerparameter für Hyperbel zur Aufschaltung LLR D-Anteil bei kaltem Motor" VALUE 0x1DF352 Kw_Ws16 32766.00 EngN 1.000000 32767.00 FORMAT "%8.2" EXTENDED_LIMITS -32768.00 32767.00 /end CHARACTERISTIC
/begin CHARACTERISTIC LIGov_nDHypDenom_C "Nennerparameter für Hyperbel zur Aufschaltung LLR D-Anteil" VALUE 0x1DF194 Kw_Ws16 32766.00 EngN 1.000000 32767.00 FORMAT "%8.2" EXTENDED_LIMITS -32768.00 32767.00 /end CHARACTERISTIC
/begin CHARACTERISTIC LIGov_nDHypNumCold_C "Zählerparameter für Hyperbel zur Aufschaltung LLR D-Anteil bei kaltem Motor" VALUE 0x1DF354 Kw_Ws16 65535.00 EngN -32768.00 32767.00 FORMAT "%8.2" /end CHARACTERISTIC
/begin CHARACTERISTIC LIGov_nDHypNum_C "Zählerparameter für Hyperbel zur Aufschaltung LLR D-Anteil" VALUE 0x1DF196 Kw_Ws16 65535.00 EngN -32768.00 32767.00 FORMAT "%8.2" /end CHARACTERISTIC
/begin CHARACTERISTIC LIGov_nEngOffset_C "Drehzahloffset für Übernahme der Solldrehzahlanforderung durch AccPed" VALUE 0x1DF356 Kw_Ws16 6000.000 EngN 0.00 6000.000 FORMAT "%8.3" EXTENDED_LIMITS -32768.00 32767.00 /end CHARACTERISTIC
/begin CHARACTERISTIC LIGov_nLimHigh_C "obere Drehzahlgrenze für LLR" VALUE 0x1DF198 Kw_Ws16 34968.00 EngN -32768.00 2200.000 FORMAT "%8.2" EXTENDED_LIMITS -32768.00 32767.00 /end CHARACTERISTIC
/begin CHARACTERISTIC LIGov_nLimLow_C "untere Drehzahlgrenze für LLR" VALUE 0x1DF19A Kw_Ws16 65535.00 EngN -32768.00 32767.00 FORMAT "%8.2" /end CHARACTERISTIC
/begin CHARACTERISTIC LIGov_nLim_C "Maximale Drehzahl für Leerlaufanhebung mittels LIGov_nTemp2_CUR" VALUE 0x1DF358 Kw_Ws16 65535.00 EngN -32768.00 32767.00 FORMAT "%8.2" /end CHARACTERISTIC
/begin CHARACTERISTIC LIGov_nOffsetPreCtrlCold_C "Vorsteuerung aktiv n-Offset auf Basisdrehzahl (kalter Motor)" VALUE 0x1DF19C Kw_Ws16 65535.00 EngN -32768.00 32767.00 FORMAT "%8.2" /end CHARACTERISTIC
/begin CHARACTERISTIC LIGov_nOffsetPreCtrltrqDem_C "Vorsteuerung aktiv n-Offset auf Basisdrehzahl und Momentenwunsch" VALUE 0x1DF19E Kw_Ws16 65535.00 EngN -32768.00 32767.00 FORMAT "%8.2" /end CHARACTERISTIC
/begin CHARACTERISTIC LIGov_nOffsetPreCtrlWarm_C "Vorsteuerung aktiv n-Offset auf Basisdrehzahl (warmer Motor)" VALUE 0x1DF1A0 Kw_Ws16 65535.00 EngN -32768.00 32767.00 FORMAT "%8.2" /end CHARACTERISTIC
/begin CHARACTERISTIC LIGov_nOffsetPredef_C "Einschrittmoment aktiv n-Offset auf Basisdrehzahl" VALUE 0x1DF1A2 Kw_Ws16 65535.00 EngN -32768.00 32767.00 FORMAT "%8.2" /end CHARACTERISTIC
/begin CHARACTERISTIC LIGov_nRev_CUR "Umdrehungen nach Start für Leerlaufanhebung mittels LIGov_nCltAirP_MAP" CURVE 0x1DF35A Kl_Xs16_Ws16 32000.00 OneToOne 0.00 32000.00 FORMAT "%8.2" EXTENDED_LIMITS -32768.00 32767.00
 /begin AXIS_DESCR STD_AXIS Eng_tEng Temp_Cels 25 -273.1400 149.8600 FORMAT "%8.4" EXTENDED_LIMITS -3549.940 3003.560 DEPOSIT ABSOLUTE /end AXIS_DESCR
/end CHARACTERISTIC
/begin CHARACTERISTIC LIGov_nRgnIdleOffset_C "Offset für LL-Solldrehzahl bei Regeneration." VALUE 0x1DF1A4 Kw_Ws16 6000.000 EngN 0.00 6000.000 FORMAT "%8.3" EXTENDED_LIMITS -32768.00 32767.00 /end CHARACTERISTIC
/begin CHARACTERISTIC LIGov_nSetpointDriveAway_CUR "LL-Solldrehzahl Fahrzeug fährt (V > 0) (Atmosphärendruck -abhängige)" CURVE 0x1DF1A6 Kl_Xs16_Ws16 3000.000 EngN 0.00 3000.000 FORMAT "%8.3" EXTENDED_LIMITS -32768.00 32767.00
 /begin AXIS_DESCR STD_AXIS APSCD_pVal Pres_hPa 4 0.00 3500.000 FORMAT "%8.3" EXTENDED_LIMITS -32768.00 32767.00 DEPOSIT ABSOLUTE /end AXIS_DESCR
/end CHARACTERISTIC
/begin CHARACTERISTIC LIGov_nSetPointErr_C "Leerlaufsolldrehzahl für Notfahren auf der Nockenwelle" VALUE 0x1DF1B8 Kw_Ws16 6000.000 EngN 0.00 6000.000 FORMAT "%8.3" EXTENDED_LIMITS -32768.00 32767.00 /end CHARACTERISTIC
/begin CHARACTERISTIC LIGov_nSetpointWarm_CUR "LL-Solldrehzahl Fahrzeug steht / warmer Motor (Atmosphärendruck -abhängige)" CURVE 0x1DF3C0 Kl_Xs16_Ws16 3000.000 EngN 0.00 3000.000 FORMAT "%8.3" EXTENDED_LIMITS -32768.00 32767.00
 /begin AXIS_DESCR STD_AXIS APSCD_pVal Pres_hPa 4 0.00 3500.000 FORMAT "%8.3" EXTENDED_LIMITS -32768.00 32767.00 DEPOSIT ABSOLUTE /end AXIS_DESCR
/end CHARACTERISTIC
/begin CHARACTERISTIC LIGov_nSetpoint_Vector "Bypass label, nicht editieren" VALUE 0x1C0B20 Kw_Wu8 255.0 OneToOne 0.00 255.0 FORMAT "%5.1" /end CHARACTERISTIC
/begin CHARACTERISTIC LIGov_nSetpoint_Channel "Bypass Label, nicht editieren!" VALUE 0x1C0B21 Kw_Wu8 255.0 OneToOne 0.00 255.0 FORMAT "%5.1" /end CHARACTERISTIC
/begin CHARACTERISTIC LIGov_nTemp1_MAP "Kennfeld für Wassertemperatur und Atmosphärendruck - abhängige Leerlauferhöhung" MAP 0x1DF3D2 Kf_Xs16_Ys16_Ws16 6000.000 EngN 0.00 6000.000 FORMAT "%8.3" EXTENDED_LIMITS -32768.00 32767.00
 /begin AXIS_DESCR STD_AXIS Eng_tEng Temp_Cels 2 -50.14000 149.8600 FORMAT "%8.4" EXTENDED_LIMITS -3549.940 3003.560 DEPOSIT ABSOLUTE /end AXIS_DESCR
 /begin AXIS_DESCR STD_AXIS APSCD_pVal Pres_hPa 4 0.00 3500.000 FORMAT "%8.3" EXTENDED_LIMITS -32768.00 32767.00 DEPOSIT ABSOLUTE /end AXIS_DESCR
/end CHARACTERISTIC
/begin CHARACTERISTIC LIGov_nTemp2Rgn1_CUR "2.Kennlinie bei Regenerationsstufe 1 für Wassertemperaturabhängige Leerlauferhöhung" CURVE 0x1DF3F2 Kl_Xs16_Ws16 3000.000 EngN 0.00 3000.000 FORMAT "%8.3" EXTENDED_LIMITS -32768.00 32767.00
 /begin AXIS_DESCR STD_AXIS Eng_tEng Temp_Cels 15 -0.04000000 422.9600 FORMAT "%8.4" EXTENDED_LIMITS -3549.940 3003.560 DEPOSIT ABSOLUTE /end AXIS_DESCR
/end CHARACTERISTIC
/begin CHARACTERISTIC LIGov_nTemp2Rgn2_CUR "2.Kennlinie bei Regenerationsstufe 2 für Wassertemperaturabhängige Leerlauferhöhung" CURVE 0x1DF430 Kl_Xs16_Ws16 3000.000 EngN 0.00 3000.000 FORMAT "%8.3" EXTENDED_LIMITS -32768.00 32767.00
 /begin AXIS_DESCR STD_AXIS Eng_tEng Temp_Cels 15 -0.04000000 422.9600 FORMAT "%8.4" EXTENDED_LIMITS -3549.940 3003.560 DEPOSIT ABSOLUTE /end AXIS_DESCR
/end CHARACTERISTIC
/begin CHARACTERISTIC LIGov_nTemp2_CUR "2.Kennlinie für Wassertemperaturabhängige Leerlauferhöhung" CURVE 0x1DF46E Kl_Xs16_Ws16 3000.000 EngN 0.00 3000.000 FORMAT "%8.3" EXTENDED_LIMITS -32768.00 32767.00
 /begin AXIS_DESCR STD_AXIS Eng_tEng Temp_Cels 25 -273.1400 149.8600 FORMAT "%8.4" EXTENDED_LIMITS -3549.940 3003.560 DEPOSIT ABSOLUTE /end AXIS_DESCR
/end CHARACTERISTIC
/begin CHARACTERISTIC LIGov_rThresDriveoff_C "Prozentschwelle für PWG bei State Anfahren" VALUE 0x1DF1BA Kw_Ws16 100.0000 Prc 0.00 100.0000 FORMAT "%8.4" EXTENDED_LIMITS -327.6800 327.6700 /end CHARACTERISTIC
/begin CHARACTERISTIC LIGov_rThresTrqDem_C "Prozentschwelle für PWG bei State Momentenanforderung" VALUE 0x1DF1BC Kw_Ws16 100.0000 Prc 0.00 100.0000 FORMAT "%8.4" EXTENDED_LIMITS -327.6800 327.6700 /end CHARACTERISTIC
/begin CHARACTERISTIC LIGov_nRmpSlpUpSetPoint_C "Schrittweite der Rampe bei Erhöhung Solldrehzahl" VALUE 0x1DF1C0 Kw_Wu32 9362278.57317 RmpEngN_LIGov 7.13893345424 9362285.71211 FORMAT "%13.5" EXTENDED_LIMITS 0.00 9362285.71211 /end CHARACTERISTIC
/begin CHARACTERISTIC LIGov_nRmpSlpDwnSetPoint_C "Schrittweite der Rampe bei Erniedrigung Solldrehzahl" VALUE 0x1DF1C4 Kw_Wu32 9362278.57317 RmpEngN_LIGov 7.13893345424 9362285.71211 FORMAT "%13.5" EXTENDED_LIMITS 0.00 9362285.71211 /end CHARACTERISTIC
/begin CHARACTERISTIC LIGov_stCalcRgnMsk1_C "applizierbare Bitmaske für Regenerationsstufe 1" VALUE 0x1DF4D4 Kw_Wu32 4294967295.00 OneToOne 0.00 4294967295.00 FORMAT "%13.2" /end CHARACTERISTIC
/begin CHARACTERISTIC LIGov_stCalcRgnMsk2_C "applizierbare Bitmaske für Regenerationsstufe 2" VALUE 0x1DF4D8 Kw_Wu32 4294967295.00 OneToOne 0.00 4294967295.00 FORMAT "%13.2" /end CHARACTERISTIC
/begin CHARACTERISTIC LIGov_stPsRev_C "Wählt Paramtersatz für Rückwärtsgang (1 entspricht PS 1.Gang, 2 entspricht PS 2.Gang)" VALUE 0x1DF1C8 Kw_Ws8 1.000 OneToOne 1.000 2.000 FORMAT "%5.3" EXTENDED_LIMITS -128.0 127.0 /end CHARACTERISTIC
/begin CHARACTERISTIC LIGov_vThresPointLow_C "untere Schwelle der v-Hysterese" VALUE 0x1DF4DC Kw_Ws16 299.0000 Vel 1.000000 300.0000 FORMAT "%8.4" EXTENDED_LIMITS -327.6800 327.6700 /end CHARACTERISTIC
/begin CHARACTERISTIC LIGov_vThresPointHigh_C "obere Schwelle der v-Hysterese" VALUE 0x1DF4DE Kw_Ws16 299.0000 Vel 1.000000 300.0000 FORMAT "%8.4" EXTENDED_LIMITS -327.6800 327.6700 /end CHARACTERISTIC
/begin CHARACTERISTIC LIGov_YLow_C "LOW Ausgang der v-Hysterese" VALUE 0x1DF4E0 Kw_Ws16 0.00 OneToOne 0.00 0.00 FORMAT "%8.2" EXTENDED_LIMITS -32768.00 32767.00 READ_ONLY /end CHARACTERISTIC
/begin CHARACTERISTIC LIGov_YHigh_C "HIGH Ausgang der v-Hysterese" VALUE 0x1DF4E2 Kw_Ws16 0.00 OneToOne 1.000000 1.000000 FORMAT "%8.6" EXTENDED_LIMITS -32768.00 32767.00 READ_ONLY /end CHARACTERISTIC
/begin CHARACTERISTIC LIGov_swtParDriveoffVal_C "Auswahl der gewünschten Größe für Anfahren" VALUE 0x1DF4E4 Kw_Wu8 1.000 OneToOne 0.00 1.000 FORMAT "%5.3" EXTENDED_LIMITS 0.00 255.0 READ_ONLY /end CHARACTERISTIC
/begin CHARACTERISTIC LIGov_swtParDriveoffType_C "Auswahl ob Wert des SW-Schalters vom Datensatz oder vom EEPROM für Anfahren gewaehlt wird" VALUE 0x1DF4E5 Kw_Wu8 0.00 OneToOne 0.00 0.00 FORMAT "%5.2" EXTENDED_LIMITS 0.00 255.0 READ_ONLY /end CHARACTERISTIC
/begin CHARACTERISTIC LIGov_swtTempHys_C "Schalter der Temperaturwert des Arrays auswählt" VALUE 0x1DF1C9 Kw_Wu8 4.00000000000 EngTempFldSel 0.00 4.00000000000 FORMAT "%13.11" /end CHARACTERISTIC
/begin CHARACTERISTIC LIGov_swtTempTrqInit_C "Schalter der Temperaturwert des Arrays auswählt" VALUE 0x1DF1CA Kw_Wu8 4.00000000000 EngTempFldSel 0.00 4.00000000000 FORMAT "%13.11" /end CHARACTERISTIC
/begin CHARACTERISTIC LIGov_tClntXLow_C "Schwelle 1 für Wassertemperaturhysterese" VALUE 0x1DF1CC Kw_Ws16 200.0000 Temp_Cels -50.14000 149.8600 FORMAT "%8.4" EXTENDED_LIMITS -3549.940 3003.560 /end CHARACTERISTIC
/begin CHARACTERISTIC LIGov_tClntXHigh_C "Schwelle 2 für Wassertemperaturhysterese" VALUE 0x1DF1CE Kw_Ws16 200.0000 Temp_Cels -50.14000 149.8600 FORMAT "%8.4" EXTENDED_LIMITS -3549.940 3003.560 /end CHARACTERISTIC
/begin CHARACTERISTIC LIGov_stCold_C "Konstante für LiGov Status kalt" VALUE 0x1DF1D0 Kw_Ws16 65535.00 OneToOne -32768.00 32767.00 FORMAT "%8.2" READ_ONLY /end CHARACTERISTIC
/begin CHARACTERISTIC LIGov_stWarm_C "Konstante für LIGov Status warm" VALUE 0x1DF1D2 Kw_Ws16 65535.00 OneToOne -32768.00 32767.00 FORMAT "%8.2" READ_ONLY /end CHARACTERISTIC
/begin CHARACTERISTIC LIGov_tEngLim_C "Maximale Motortemperatur für die Leerlauferhöhung durch LIGov_nTemp1_CUR" VALUE 0x1DF4E6 Kw_Ws16 6553.500 Temp_Cels -3549.940 3003.560 FORMAT "%8.3" /end CHARACTERISTIC
/begin CHARACTERISTIC LIGov_tiPT1_CUR "Kennlinie der Zeitkonstanten für die PT1 Flterung über der Drehzahl" CURVE 0x1DF1D4 Kl_Xs16_Ws16 5.000000 TimeDelay_s_Lin_16 0.00 5.000000 FORMAT "%8.6" EXTENDED_LIMITS -5.000153 5.000000
 /begin AXIS_DESCR STD_AXIS LIGov_nDiff_mp EngN 25 -5000.000 1000.000 FORMAT "%8.3" EXTENDED_LIMITS -32768.00 32767.00 DEPOSIT ABSOLUTE /end AXIS_DESCR
/end CHARACTERISTIC
/begin CHARACTERISTIC LIGov_tiST_C "Zeit nach Start für LL-Solldrehzahlerhöhung nach Start" VALUE 0x1DF4E8 Kw_Ws32 42949672.9500 Time_s -21474836.4800 21474836.4700 FORMAT "%13.4" /end CHARACTERISTIC
/begin CHARACTERISTIC LIGov_tiTW_C "Zeit nach Start für T_W-abh. LL-Solldrehzahl" VALUE 0x1DF4EC Kw_Ws32 42949672.9500 Time_s -21474836.4800 21474836.4700 FORMAT "%13.4" /end CHARACTERISTIC
/begin CHARACTERISTIC LIGov_trqInitI_CUR "Kennlinie zur Initialisierung des Integrators" CURVE 0x1DF23A Kl_Xs16_Ws16 400.0000 Trq 0.00 400.0000 FORMAT "%8.4" EXTENDED_LIMITS -3276.800 3276.700
 /begin AXIS_DESCR STD_AXIS LIGov_tEngTrqInit_mp Temp_Cels 25 -273.1400 149.8600 FORMAT "%8.4" EXTENDED_LIMITS -3549.940 3003.560 DEPOSIT ABSOLUTE /end AXIS_DESCR
/end CHARACTERISTIC
/begin CHARACTERISTIC LIGov_trqMaxCold_C "maximale Moment aus LL-Regelung für kalten Motor" VALUE 0x1DF2A0 Kw_Ws16 6553.500 Trq -3276.800 3276.700 FORMAT "%8.3" /end CHARACTERISTIC
/begin CHARACTERISTIC LIGov_trqMaxWarm_C "maximale Moment aus LL-Regelung für warmen Motor" VALUE 0x1DF2A2 Kw_Ws16 6553.500 Trq -3276.800 3276.700 FORMAT "%8.3" /end CHARACTERISTIC
/begin CHARACTERISTIC LIGov_trqThresDefrostI_C "Mengenschwelle Integrator einfrieren/auftauen" VALUE 0x1DF2A4 Kw_Ws16 6553.500 Trq -3276.800 3276.700 FORMAT "%8.3" /end CHARACTERISTIC
/begin CHARACTERISTIC LIGov_trq_Vector "Bypasslabel, nicht editieren!" VALUE 0x1C0B22 Kw_Wu8 255.0 OneToOne 0.00 255.0 FORMAT "%5.1" /end CHARACTERISTIC
/begin CHARACTERISTIC LIGov_trq_Channel "Bypasslabel, nicht editieren!" VALUE 0x1C0B23 Kw_Wu8 255.0 OneToOne 0.00 255.0 FORMAT "%5.1" /end CHARACTERISTIC
/begin CHARACTERISTIC LIGov_tiUbrDT1_C "Koeffizient D-Glied (T) Unterbremsen" VALUE 0x1DF4F0 Kw_Wu32 4294.9673 TimeDelay_s 0.0000010000000 4294.9673 FORMAT "%9.4" /end CHARACTERISTIC
/begin CHARACTERISTIC LIGov_UbrDKd_C "Unterbremsen Koeffizient D-Glied (K)" VALUE 0x1DF4F4 Kw_Ws32 6553.59999847 Kd_rpm2Nm -3276.80000000 3276.79999847 FORMAT "%13.8" /end CHARACTERISTIC
/begin CHARACTERISTIC LIGov_UbrIKi_C "Kleinsignalverstärkung Unterbremsen" VALUE 0x1DF4F8 Kw_Wu32 99999.9999767 Ki_rpm2Nm 0.00 99999.9999767 FORMAT "%13.7" /end CHARACTERISTIC
/begin CHARACTERISTIC LIGov_UbrIKiPos_C "Verstärkung für positive Großsignale Unterbremsen" VALUE 0x1DF4FC Kw_Wu32 99999.9999767 Ki_rpm2Nm 0.00 99999.9999767 FORMAT "%13.7" /end CHARACTERISTIC
/begin CHARACTERISTIC LIGov_UbrIKiNeg_C "Verstärkung für negative Großsignale Unterbremsen" VALUE 0x1DF500 Kw_Wu32 99999.9999767 Ki_rpm2Nm 0.00 99999.9999767 FORMAT "%13.7" /end CHARACTERISTIC
/begin CHARACTERISTIC LIGov_UbrIWinPos_C "Kleinsignalfenster positiv Unterbremsen" VALUE 0x1DF504 Kw_Ws16 65535.00 EngN -32768.00 32767.00 FORMAT "%8.2" /end CHARACTERISTIC
/begin CHARACTERISTIC LIGov_UbrIWinNeg_C "Kleinsignalfenster negativ Unterbremsen" VALUE 0x1DF506 Kw_Ws16 65535.00 EngN -32768.00 32767.00 FORMAT "%8.2" /end CHARACTERISTIC
/begin CHARACTERISTIC LIGov_UbrPredef_C "Einschrittmoment Vorsteuerung Unterbremsen" VALUE 0x1DF508 Kw_Ws16 6553.500 Trq -3276.800 3276.700 FORMAT "%8.3" /end CHARACTERISTIC
/begin CHARACTERISTIC LIGov_UbrPKp_C "Kleinsignalverstärkung" VALUE 0x1DF2A8 Kw_Wu32 6553.59999847 Kp_rpm2Nm 0.00 6553.59999847 FORMAT "%13.8" /end CHARACTERISTIC
/begin CHARACTERISTIC LIGov_UbrPKpPos_C "Verstärkung für positive Großsignale" VALUE 0x1DF2AC Kw_Wu32 6553.59999847 Kp_rpm2Nm 0.00 6553.59999847 FORMAT "%13.8" /end CHARACTERISTIC
/begin CHARACTERISTIC LIGov_UbrPKpNeg_C "Verstärkung für negative Großsignale" VALUE 0x1DF2B0 Kw_Wu32 6553.59999847 Kp_rpm2Nm 0.00 6553.59999847 FORMAT "%13.8" /end CHARACTERISTIC
/begin CHARACTERISTIC LIGov_UbrPWinPos_C "Kleinsignalfenster positiv" VALUE 0x1DF2B4 Kw_Ws16 65535.00 EngN -32768.00 32767.00 FORMAT "%8.2" /end CHARACTERISTIC
/begin CHARACTERISTIC LIGov_UbrPWinNeg_C "Kleinsignalfenster negativ" VALUE 0x1DF2B6 Kw_Ws16 65535.00 EngN -32768.00 32767.00 FORMAT "%8.2" /end CHARACTERISTIC
/begin CHARACTERISTIC LIGov_vThreshUbr_C "Schwellgeschwindigkeit bei Unterbremsen" VALUE 0x1DF2B8 Kw_Ws16 655.3500 Vel -327.6800 327.6700 FORMAT "%8.4" /end CHARACTERISTIC
/begin CHARACTERISTIC LIGov_tiWrmCltchDT1_C "Koeffizient D-Glied (T)" VALUE 0x1DF2BC Kw_Wu32 4294.9673 TimeDelay_s 0.0000010000000 4294.9673 FORMAT "%9.4" /end CHARACTERISTIC
/begin CHARACTERISTIC LIGov_WrmCltchDKd_C "Koeffizient D-Glied (K)" VALUE 0x1DF2C0 Kw_Ws32 6553.59999847 Kd_rpm2Nm -3276.80000000 3276.79999847 FORMAT "%13.8" /end CHARACTERISTIC
/begin CHARACTERISTIC LIGov_WrmCltchIKi_C "Kleinsignalverstärkung" VALUE 0x1DF2C4 Kw_Wu32 99999.9999767 Ki_rpm2Nm 0.00 99999.9999767 FORMAT "%13.7" /end CHARACTERISTIC
/begin CHARACTERISTIC LIGov_WrmCltchIKiPos_C "Verstärkung für positive Großsignale" VALUE 0x1DF2C8 Kw_Wu32 99999.9999767 Ki_rpm2Nm 0.00 99999.9999767 FORMAT "%13.7" /end CHARACTERISTIC
/begin CHARACTERISTIC LIGov_WrmCltchIKiNeg_C "Verstärkung für negative Großsignale" VALUE 0x1DF2CC Kw_Wu32 99999.9999767 Ki_rpm2Nm 0.00 99999.9999767 FORMAT "%13.7" /end CHARACTERISTIC
/begin CHARACTERISTIC LIGov_WrmCltchIWinPos_C "Kleinsignalfenster positiv" VALUE 0x1DF2D0 Kw_Ws16 65535.00 EngN -32768.00 32767.00 FORMAT "%8.2" /end CHARACTERISTIC
/begin CHARACTERISTIC LIGov_WrmCltchIWinNeg_C "Kleinsignalfenster negativ" VALUE 0x1DF2D2 Kw_Ws16 65535.00 EngN -32768.00 32767.00 FORMAT "%8.2" /end CHARACTERISTIC
/begin CHARACTERISTIC LIGov_WrmCltchPredef_C "Einschrittmoment Vorsteuerung" VALUE 0x1DF2D4 Kw_Ws16 6553.500 Trq -3276.800 3276.700 FORMAT "%8.3" /end CHARACTERISTIC
/begin CHARACTERISTIC LIGov_WrmCltchPKp_C "Kleinsignalverstärkung" VALUE 0x1DF2D8 Kw_Wu32 6553.59999847 Kp_rpm2Nm 0.00 6553.59999847 FORMAT "%13.8" /end CHARACTERISTIC
/begin CHARACTERISTIC LIGov_WrmCltchPKpPos_C "Verstärkung für positive Großsignale" VALUE 0x1DF2DC Kw_Wu32 6553.59999847 Kp_rpm2Nm 0.00 6553.59999847 FORMAT "%13.8" /end CHARACTERISTIC
/begin CHARACTERISTIC LIGov_WrmCltchPKpNeg_C "Verstärkung für negative Großsignale" VALUE 0x1DF2E0 Kw_Wu32 6553.59999847 Kp_rpm2Nm 0.00 6553.59999847 FORMAT "%13.8" /end CHARACTERISTIC
/begin CHARACTERISTIC LIGov_WrmCltchPWinPos_C "Kleinsignalfenster positiv" VALUE 0x1DF2E4 Kw_Ws16 65535.00 EngN -32768.00 32767.00 FORMAT "%8.2" /end CHARACTERISTIC
/begin CHARACTERISTIC LIGov_WrmCltchPWinNeg_C "Kleinsignalfenster negativ" VALUE 0x1DF2E6 Kw_Ws16 65535.00 EngN -32768.00 32767.00 FORMAT "%8.2" /end CHARACTERISTIC
/begin CHARACTERISTIC LockCnt_tiOneMinute_C "Dieses Labe stellt die Zeit in Sekunden dar, welche der Sperrzähler für eine Minute interpretiert." VALUE 0x1DF50C Kw_Wu16 655.1400 Time_s 0.00 655.1400 FORMAT "%8.4" EXTENDED_LIMITS 0.00 655.3500 /end CHARACTERISTIC
/begin CHARACTERISTIC LSUCD_tiAdptFltInit_C "Zeitkonstante Adaptionsfilter für nicht adaptierten Zustand" VALUE 0x1DF5E4 Kw_Wu32 4294.9673 TimeDelay_s 0.0000010000000 4294.9673 FORMAT "%9.4" /end CHARACTERISTIC
/begin CHARACTERISTIC LSUCD_tiAdptFlt_C "Zeitkonstante Adaptionsfilter für adaptierten Zustand" VALUE 0x1DF5E8 Kw_Wu32 4294.9673 TimeDelay_s 0.0000010000000 4294.9673 FORMAT "%9.4" /end CHARACTERISTIC
/begin CHARACTERISTIC LSUCD_d2rInit_C "Initialisierungswert Bewertungsfilter" VALUE 0x1DF5EC Kw_Ws16 0.6553500 O2 -0.3276800 0.3276700 FORMAT "%9.7" /end CHARACTERISTIC
/begin CHARACTERISTIC LSUCD_dcycMinGrad_C "Minimale Änderung des Tastverhältnisses zur Freigabe der Diagnose der Heizungskopplung" VALUE 0x1DF758 Kw_Ws16 655.3500 DtyCyc -327.6800 327.6700 FORMAT "%8.4" /end CHARACTERISTIC
/begin CHARACTERISTIC LSUCD_DebHtCoupDef_C "Fehlerentprellzeit für Heizungskopplung" VALUE 0x1DF75A Kw_Wu16 65535.00 OneToOne 0.00 65535.00 FORMAT "%8.2" /end CHARACTERISTIC
/begin CHARACTERISTIC LSUCD_DebHtCoupOk_C "Fehlerheilungszeit für Heizungskopplung" VALUE 0x1DF75C Kw_Wu16 65535.00 OneToOne 0.00 65535.00 FORMAT "%8.2" /end CHARACTERISTIC
/begin CHARACTERISTIC LSUCD_dmAirIKi_C "Verstärkung I-Regler bei Kleinsignalen" VALUE 0x1DF5F0 Kw_Wu32 5.00003807247 Ki 0.00 5.00003807247 FORMAT "%13.11" EXTENDED_LIMITS 0.00 999999.999767 READ_ONLY /end CHARACTERISTIC
/begin CHARACTERISTIC LSUCD_dmAirIKiPos_C "Verstärkung I-Regler bei positiven Großsignalen" VALUE 0x1DF5F4 Kw_Wu32 5.00003807247 Ki 0.00 5.00003807247 FORMAT "%13.11" EXTENDED_LIMITS 0.00 999999.999767 READ_ONLY /end CHARACTERISTIC
/begin CHARACTERISTIC LSUCD_dmAirIKiNeg_C "Verstärkung I-Regler bei negativen Großsignalen" VALUE 0x1DF5F8 Kw_Wu32 5.00003807247 Ki 0.00 5.00003807247 FORMAT "%13.11" EXTENDED_LIMITS 0.00 999999.999767 READ_ONLY /end CHARACTERISTIC
/begin CHARACTERISTIC LSUCD_dmAirIWinPos_C "Obere Kleinsignalgrenze für  den I-Regler" VALUE 0x1DF5FC Kw_Ws16 250.0000 AirMassPerTime 223.0000 473.0000 FORMAT "%8.4" EXTENDED_LIMITS -3276.800 3276.700 READ_ONLY /end CHARACTERISTIC
/begin CHARACTERISTIC LSUCD_dmAirIWinNeg_C "Untere Kleinsignalgrenze für den I-Regler" VALUE 0x1DF5FE Kw_Ws16 250.0000 AirMassPerTime 223.0000 473.0000 FORMAT "%8.4" EXTENDED_LIMITS -3276.800 3276.700 READ_ONLY /end CHARACTERISTIC
/begin CHARACTERISTIC LSUCD_dNumHtCoup_C "Anzahl der für ein signifikantes Resultat notwendigen Aktivierungen der Heizungskoplungsprüfung" VALUE 0x1DF75E Kw_Wu16 65535.00 OneToOne 0.00 65535.00 FORMAT "%8.2" /end CHARACTERISTIC
/begin CHARACTERISTIC LSUCD_EvalMaxVal_C "Oberer Grenzwert für Lernfortschrittsbewertung" VALUE 0x1DF600 Kw_Ws16 0.6553500 O2 -0.3276800 0.3276700 FORMAT "%9.7" /end CHARACTERISTIC
/begin CHARACTERISTIC LSUCD_EvalMinVal_C "Unterer Grenzwert für Lernfortschrittsbewertung" VALUE 0x1DF602 Kw_Ws16 0.6553500 O2 -0.3276800 0.3276700 FORMAT "%9.7" /end CHARACTERISTIC
/begin CHARACTERISTIC LSUCD_tiEvalFltInit_C "Zeitkonstante Bewertungsfilter für nicht adaptierten Zustand" VALUE 0x1DF604 Kw_Wu32 4294.9673 TimeDelay_s 0.0000010000000 4294.9673 FORMAT "%9.4" /end CHARACTERISTIC
/begin CHARACTERISTIC LSUCD_tiEvalFlt_C "Zeitkonstante Bewertungsfilter für adaptierten Zustand" VALUE 0x1DF608 Kw_Wu32 4294.9673 TimeDelay_s 0.0000010000000 4294.9673 FORMAT "%9.4" /end CHARACTERISTIC
/begin CHARACTERISTIC LSUCD_facPresCompLean_CUR "Kennlinie für Druckkorrekturfaktor bei magerem Luft-Kraftstoff-Gemisch" CURVE 0x1DF698 Kl_Xs16_Ws16 7.999878 Fact -4.000000 3.999878 FORMAT "%8.6"
 /begin AXIS_DESCR STD_AXIS LSUCD_pExhGasLstVal_mp Pres_hPa 10 -32768.00 32767.00 FORMAT "%8.2" DEPOSIT ABSOLUTE /end AXIS_DESCR
/end CHARACTERISTIC
/begin CHARACTERISTIC LSUCD_facPresCompRich_CUR "Kennlinie für Druckkorrekturfaktor bei fettem Luft-Kraftstoff-Gemisch" CURVE 0x1DF6C2 Kl_Xs16_Ws16 7.999878 Fact -4.000000 3.999878 FORMAT "%8.6"
 /begin AXIS_DESCR STD_AXIS LSUCD_pExhGasLstVal_mp Pres_hPa 10 -32768.00 32767.00 FORMAT "%8.2" DEPOSIT ABSOLUTE /end AXIS_DESCR
/end CHARACTERISTIC
/begin CHARACTERISTIC LSUCD_mAirAdptActv_C "Minimalwert für Integral über Luftmassenstrom seit Schubbeginn für Aktivierung der Adaption" VAL_BLK 0x1DF60C Kwb_Ws16 6553.500 AirMass_2 -3276.800 3276.700 FORMAT "%8.3" NUMBER 1 /end CHARACTERISTIC
/begin CHARACTERISTIC LSUCD_stHtInvOut_C "Lambdas Sensor Heizerendstufe Invertierungsstatus" VALUE 0x1DF614 Kw_Wu8 1.000 OneToOne 0.00 1.000 FORMAT "%5.3" EXTENDED_LIMITS 0.00 255.0 /end CHARACTERISTIC
/begin CHARACTERISTIC LSUCD_tiHtPer_C "Periodendauer PWM Signal Heizwiderstand Ansteuerung" VALUE 0x1DF616 Kw_Ws16 6553.500 Period -3276.800 3276.700 FORMAT "%8.3" /end CHARACTERISTIC
/begin CHARACTERISTIC LSUCD_resRiMaxGrad_C "Maximale Änderung des Innenwiderstands zur Freigabe der Diagnose der Heizungskopplung" VALUE 0x1DF760 Kw_Ws16 6553.500 Resist -3276.800 3276.700 FORMAT "%8.3" /end CHARACTERISTIC
/begin CHARACTERISTIC LSUCD_rO2IsolChkMax_C "Maximal zulässige Sauerstoffanzeige für kalte Sonde" VALUE 0x1DF762 Kw_Ws16 0.6553500 O2 -0.3276800 0.3276700 FORMAT "%9.7" /end CHARACTERISTIC
/begin CHARACTERISTIC LSUCD_rO2IsolChkMin_C "Minimal zulässige Sauerstoffanzeige für kalte Sonde" VALUE 0x1DF764 Kw_Ws16 0.6553500 O2 -0.3276800 0.3276700 FORMAT "%9.7" /end CHARACTERISTIC
/begin CHARACTERISTIC LSUCD_rO2SwtPresComp_C "Sauerstoffkonzentrationsgrenzwert für Umschaltung zwischen Druckkompensation für mageres und fettes Luft-Ktraftstoff-Gemisch" VALUE 0x1DF6EC Kw_Ws16 0.6553500 O2 -0.3276800 0.3276700 FORMAT "%9.7" /end CHARACTERISTIC
/begin CHARACTERISTIC LSUCD_rO2_CUR "Kennlinie zur Umrechnung von Spannung in Sauerstoffkonzentration" CURVE 0x1DF634 Kl_Xs16_Ws16 0.6000000 O2 -0.3000000 0.3000000 FORMAT "%9.7" EXTENDED_LIMITS -0.3276800 0.3276700
 /begin AXIS_DESCR STD_AXIS LSUCD_uO2OfsCor_mp Volt 15 -1598.240 3998.045 FORMAT "%8.3" EXTENDED_LIMITS -160156.4 160151.5 DEPOSIT ABSOLUTE /end AXIS_DESCR
/end CHARACTERISTIC
/begin CHARACTERISTIC LSUCD_stCJChpSel_C "Applikationskonstante zur Auswahl von CJ120 (=0) oder CJ125 (=1)" VALUE 0x1DF534 Kw_Wu16 1.000000 OneToOne 0.00 1.000000 FORMAT "%8.6" EXTENDED_LIMITS 0.00 65535.00 /end CHARACTERISTIC
/begin CHARACTERISTIC LSUCD_stPresCompActv_C "Schalter für Druckkompensation der Lambda-Sonde" VALUE 0x1DF6EE Kw_Wu8 1.000 OneToOne 0.00 1.000 FORMAT "%5.3" EXTENDED_LIMITS 0.00 255.0 /end CHARACTERISTIC
/begin CHARACTERISTIC LSUCD_stPumpCtlDis_C "Maske zur Auswahl der Betriebsart abhängigen Abschaltbedingungen für den Pumpstromregler" VALUE 0x1DF6F0 Kw_Wu8 255.0 OneToOne 0.00 255.0 FORMAT "%5.1" /end CHARACTERISTIC
/begin CHARACTERISTIC LSUCD_stRefCurHigh_C "Applikationskonstante zur Konfiguration des hohen Referenzpumpstroms von 0 bis 150uA" VALUE 0x1DF754 Kw_Wu8 15.0000000000 CurRefPump 0.00 15.0000000000 FORMAT "%13.10" /end CHARACTERISTIC
/begin CHARACTERISTIC LSUCD_stRefCurNormal_C "Applikationskonstante zur Konfiguration des normalen Referenzpumpstroms von 0 bis 150uA" VALUE 0x1DF755 Kw_Wu8 15.0000000000 CurRefPump 0.00 15.0000000000 FORMAT "%13.10" /end CHARACTERISTIC
/begin CHARACTERISTIC LSUCD_stRgnEna_C "Applikationskonstante zur Aktivierung oder Deaktivierung der Regeneration" VALUE 0x1DF536 Kw_Wu8 1.000 OneToOne 0.00 1.000 FORMAT "%5.3" EXTENDED_LIMITS 0.00 255.0 /end CHARACTERISTIC
/begin CHARACTERISTIC LSUCD_stWireDiaActv_C "Ansteuerungsflags für Diagnoseroutinen" VALUE 0x1DF766 Kw_Wu16 65535.00 OneToOne 0.00 65535.00 FORMAT "%8.2" /end CHARACTERISTIC
/begin CHARACTERISTIC LSUCD_swtAdptVal_C "Schalterwert für Adaption der Lambda-Sonde (0= keine Adaption/ 1=Adaption)" VALUE 0x1DF60E Kw_Wu8 1.000 OneToOne 0.00 1.000 FORMAT "%5.3" EXTENDED_LIMITS 0.00 255.0 /end CHARACTERISTIC
/begin CHARACTERISTIC LSUCD_swtAdptType_C "SW-Schaltertyp für Adaption der Lambda-Sonde (0=Datensatzwert, nicht applizierbar/1=EEPROM-Wert/2=Datensatzwert)" VALUE 0x1DF60F Kw_Wu8 0.00 OneToOne 2.000 2.000 FORMAT "%5.3" EXTENDED_LIMITS 0.00 255.0 /end CHARACTERISTIC
/begin CHARACTERISTIC LSUCD_tAirAdptActv_C "Maximale Lufttemperatur für Aktivierung der Adaption" VALUE 0x1DF610 Kw_Ws16 6553.500 Temp_Cels -3549.940 3003.560 FORMAT "%8.3" /end CHARACTERISTIC
/begin CHARACTERISTIC LSUCD_tiHtCoupChk_C "Zeitdauer der Heizungsabschaltung für Diagnose der Heizungskopplung" VALUE 0x1DF768 Kw_Wu16 655.3500 Time_s 0.00 655.3500 FORMAT "%8.4" /end CHARACTERISTIC
/begin CHARACTERISTIC LSUCD_tiHtCoupPer_C "Zeitspanne zur Ansteuerung der Diagnose der Heizungskopplung" VALUE 0x1DF76A Kw_Wu16 655.3500 Time_s 0.00 655.3500 FORMAT "%8.4" /end CHARACTERISTIC
/begin CHARACTERISTIC LSUCD_tiIsolChkErr_C "Maximale Abkühlzeit LSU" VALUE 0x1DF76C Kw_Wu16 655.3500 Time_s 0.00 655.3500 FORMAT "%8.4" /end CHARACTERISTIC
/begin CHARACTERISTIC LSUCD_tiIsolChkPer_C "Periodendauer zur Einschaltung des Pumpstroms zur Nebenschlusserkennung" VALUE 0x1DF76E Kw_Wu16 655.3500 Time_s 0.00 655.3500 FORMAT "%8.4" /end CHARACTERISTIC
/begin CHARACTERISTIC LSUCD_tiIsolChkPump_C "Einschaltdauer für Pumpstrom bei Nebenschlusserkennung" VALUE 0x1DF770 Kw_Wu16 655.3500 Time_s 0.00 655.3500 FORMAT "%8.4" /end CHARACTERISTIC
/begin CHARACTERISTIC LSUCD_tiO2ClbPT1_C "Filterzeitkonstante für Lernen Abgleichwert" VALUE 0x1DF674 Kw_Wu32 4294.9673 TimeDelay_s 0.0000010000000 4294.9673 FORMAT "%9.4" /end CHARACTERISTIC
/begin CHARACTERISTIC LSUCD_tiO2PT1_C "Filterzeitkonstante für O2 Rohwertfilterung" VALUE 0x1DF678 Kw_Wu32 4294.9673 TimeDelay_s 0.0000010000000 4294.9673 FORMAT "%9.4" /end CHARACTERISTIC
/begin CHARACTERISTIC LSUCD_tiOpnLdTstActv_C "Zeitdauer der Kabelunterbrechungsdiagnose am Anschluss Nernst-Zelle(UN) und virtuelle Masse(VM)" VALUE 0x1DF77C Kw_Wu16 655.3500 Time_s 0.00 655.3500 FORMAT "%8.4" /end CHARACTERISTIC
/begin CHARACTERISTIC LSUCD_tiRiClbPT1_C "Zeitkonstante Ri Abgleichfilter" VALUE 0x1DF6F4 Kw_Wu32 4294.9673 TimeDelay_s 0.0000010000000 4294.9673 FORMAT "%9.4" /end CHARACTERISTIC
/begin CHARACTERISTIC LSUCD_tiRiMeasDisa_C "Zeitdauer der Abschaltung der Ri-Messfrequenz" VALUE 0x1DF77E Kw_Wu16 655.3500 Time_s 0.00 655.3500 FORMAT "%8.4" /end CHARACTERISTIC
/begin CHARACTERISTIC LSUCD_tiRiPT1_C "Zeitkonstante Ri Filter" VALUE 0x1DF6F8 Kw_Wu32 4294.9673 TimeDelay_s 0.0000010000000 4294.9673 FORMAT "%9.4" /end CHARACTERISTIC
/begin CHARACTERISTIC LSUCD_tRi_CUR "Kennlinie zur Umrechnung des Innenwiderstands auf Äquivalenztemperatur" CURVE 0x1DF6FC Kl_Xs16_Ws16 1200.000 Temp_Cels 99.96000 1299.960 FORMAT "%8.3" EXTENDED_LIMITS -3549.940 3003.560
 /begin AXIS_DESCR STD_AXIS LSUCD_resRi_mp Resist 16 0.00 3000.000 FORMAT "%8.3" EXTENDED_LIMITS -3276.800 3276.700 DEPOSIT ABSOLUTE /end AXIS_DESCR
/end CHARACTERISTIC
/begin CHARACTERISTIC LSUCD_tiHtCoupFlt_C "Zeitkonstante Glättungsfilter in Diagnose der Heizungskopplung" VALUE 0x1DF774 Kw_Wu32 4294.9673 TimeDelay_s 0.0000010000000 4294.9673 FORMAT "%9.4" /end CHARACTERISTIC
/begin CHARACTERISTIC LSUCD_uO2MaxGrad_C "Maximale Änderung des Sauerstoff-Spannungssignals zur Freigabe der Diagnose der Heizungskopplung" VALUE 0x1DF778 Kw_Ws16 320307.9 Volt -160156.4 160151.5 FORMAT "%8.1" /end CHARACTERISTIC
/begin CHARACTERISTIC LSUCD_uO2MaxRippel_C "Maximal zulässige Änderung des Sauerstoff-Spannungssignals zur Abschaltung der Heizung" VALUE 0x1DF77A Kw_Ws16 320307.9 Volt -160156.4 160151.5 FORMAT "%8.1" /end CHARACTERISTIC
/begin CHARACTERISTIC LSUCD_uO2OpnLdNernstMax_C "Maximalspannung der Kabelunterbrechungsdiagnose am Anschluss Nerns-Zelle (UN)" VALUE 0x1DF780 Kw_Ws16 5000.000 Volt 0.00 5000.000 FORMAT "%8.3" EXTENDED_LIMITS -160156.4 160151.5 /end CHARACTERISTIC
/begin CHARACTERISTIC LSUCD_uO2OpnLdNernstMin_C "Minimalspannung der Kabelunterbrechungsdiagnose am Anschluss Nerns-Zelle (UN)" VALUE 0x1DF782 Kw_Ws16 6999.022 Volt -1999.022 5000.000 FORMAT "%8.3" EXTENDED_LIMITS -160156.4 160151.5 /end CHARACTERISTIC
/begin CHARACTERISTIC LSUCD_uO2OpnLdVirtGndMax_C "SRC-Maximalwert der Kabelunterbrechungsdiagnose am Anschluss virtuelle Masse (VM)" VALUE 0x1DF784 Kw_Ws16 5097.752 Volt -97.75171 5000.000 FORMAT "%8.3" EXTENDED_LIMITS -160156.4 160151.5 /end CHARACTERISTIC
/begin CHARACTERISTIC LSUCD_uO2OpnLdVirtGndMin_C "SRC-Minimalwert der Kabelunterbrechungsdiagnose am Anschluss virtuelle Masse (VM)" VALUE 0x1DF786 Kw_Ws16 5498.534 Volt -498.5337 5000.000 FORMAT "%8.3" EXTENDED_LIMITS -160156.4 160151.5 /end CHARACTERISTIC
/begin CHARACTERISTIC LSUCD_uRiOpnLdTstMax_C "Maximalwert der Ri-Spannung für Kabelunterbrechungsdiagnose am Anschluss Nernst-Zelle und virtuelle Masse" VALUE 0x1DF788 Kw_Ws16 5200.391 Volt 0.00 5200.391 FORMAT "%8.3" EXTENDED_LIMITS -160156.4 160151.5 /end CHARACTERISTIC
/begin CHARACTERISTIC LSUCtl_tUpLim_C "Obere Widerstandsgrenze für eingeregelten Zustand" VALUE 0x1DF7A0 Kw_Ws16 1200.000 Temp_Cels 99.96000 1299.960 FORMAT "%8.3" EXTENDED_LIMITS -3549.940 3003.560 /end CHARACTERISTIC
/begin CHARACTERISTIC LSUCtl_tLowLim_C "Untere Widerstandsgrenze für eingeregelten Zustand" VALUE 0x1DF7A2 Kw_Ws16 1200.000 Temp_Cels 99.96000 1299.960 FORMAT "%8.3" EXTENDED_LIMITS -3549.940 3003.560 /end CHARACTERISTIC
/begin CHARACTERISTIC LSUCtl_tRiSetPoint_C "Sollwert der LSU-Heizungsregelung" VALUE 0x1DF7A4 Kw_Ws16 1200.000 Temp_Cels 99.96000 1299.960 FORMAT "%8.3" EXTENDED_LIMITS -3549.940 3003.560 /end CHARACTERISTIC
/begin CHARACTERISTIC LSUCtl_tHtCtlEna_C "Temperaturminimalwert für Freigabe der Regelung" VALUE 0x1DF7A6 Kw_Ws16 1200.000 Temp_Cels 99.96000 1299.960 FORMAT "%8.3" EXTENDED_LIMITS -3549.940 3003.560 /end CHARACTERISTIC
/begin CHARACTERISTIC LSUCtl_nHtCtlEna_C "Mindestdrehzahl für Freigabe Aufheizrampe" VALUE 0x1DF7A8 Kw_Ws16 32767.00 EngN 0.00 32767.00 FORMAT "%8.2" EXTENDED_LIMITS -32768.00 32767.00 /end CHARACTERISTIC
/begin CHARACTERISTIC LSUCtl_dcycHtMin_C "Tastverhältnis Heizeransteuerung vor Taupunktende (Vorwärmen)" VALUE 0x1DF7AA Kw_Ws16 100.0000 DtyCyc 0.00 100.0000 FORMAT "%8.4" EXTENDED_LIMITS -327.6800 327.6700 /end CHARACTERISTIC
/begin CHARACTERISTIC LSUCtl_tExcMax_C "Grenzwert zur Erkennung von ""obere Schwelle bleibend überschritten""" VALUE 0x1DF7AC Kw_Ws16 1200.000 Temp_Cels 99.96000 1299.960 FORMAT "%8.3" EXTENDED_LIMITS -3549.940 3003.560 /end CHARACTERISTIC
/begin CHARACTERISTIC LSUCtl_tExcMin_C "Grenzwert zur Erkennung von ""untere Schwelle bleibend nicht erreicht""" VALUE 0x1DF7AE Kw_Ws16 1200.000 Temp_Cels 99.96000 1299.960 FORMAT "%8.3" EXTENDED_LIMITS -3549.940 3003.560 /end CHARACTERISTIC
/begin CHARACTERISTIC LSUCtl_tiDelIniVal_C "Verzögerungszeit für die Erfassung der initialen Ansauglufttemperatur" VALUE 0x1DF7B0 Kw_Wu16 655350.0 Time_ms 0.00 655350.0 FORMAT "%8.1" /end CHARACTERISTIC
/begin CHARACTERISTIC LSUCtl_dcycRmpUp_C "Anstiegsgeschwindigkeit Aufheizkurvenrampe" VALUE 0x1DF7B4 Kw_Wu32 655359.999847 RmpDtyCyc 0.00 655359.999847 FORMAT "%13.6" /end CHARACTERISTIC
/begin CHARACTERISTIC LSUCtl_dcycRmpDwn_C "Fallgeschwindigkeit Aufheizrampe" VALUE 0x1DF7B8 Kw_Wu32 655359.999847 RmpDtyCyc 0.00 655359.999847 FORMAT "%13.6" /end CHARACTERISTIC
/begin CHARACTERISTIC LSUCtl_dcycStrt_CUR "Kennlinie Anfangsheizungs Tastverhältnis in Abhängigkeit von Ansauglufttemperatur bei Start" CURVE 0x1DF7BC Kl_Xs16_Ws16 100.0000 DtyCyc 0.00 100.0000 FORMAT "%8.4" EXTENDED_LIMITS -327.6800 327.6700
 /begin AXIS_DESCR STD_AXIS LSUCtl_tAirStrt_mp Temp_Cels 5 -73.14000 126.8600 FORMAT "%8.4" EXTENDED_LIMITS -3549.940 3003.560 DEPOSIT ABSOLUTE /end AXIS_DESCR
/end CHARACTERISTIC
/begin CHARACTERISTIC LSUCtl_tiDebRiExcMaxDef_C "Defekterkennungszeit bleibend obere Ri Schwelle überschritten" VALUE 0x1DF7D2 Kw_Wu16 655350.0 Time_ms 0.00 655350.0 FORMAT "%8.1" /end CHARACTERISTIC
/begin CHARACTERISTIC LSUCtl_tiDebRiExcMaxOk_C "Heilungszeit bleibend obere Ri Schwelle überschritten" VALUE 0x1DF7D4 Kw_Wu16 655350.0 Time_ms 0.00 655350.0 FORMAT "%8.1" /end CHARACTERISTIC
/begin CHARACTERISTIC LSUCtl_tiDebRiExcMinDef_C "Defekterkennungszeit bleibend untere Ri Schwelle unterschritten" VALUE 0x1DF7D6 Kw_Wu16 655350.0 Time_ms 0.00 655350.0 FORMAT "%8.1" /end CHARACTERISTIC
/begin CHARACTERISTIC LSUCtl_tiDebRiExcMinOk_C "Heilungszeit bleibend untere Ri Schwelle unterschritten" VALUE 0x1DF7D8 Kw_Wu16 655350.0 Time_ms 0.00 655350.0 FORMAT "%8.1" /end CHARACTERISTIC
/begin CHARACTERISTIC LSUCtl_tiSens1HtDT1_C "Verzugszeit T1 des D-Gliedes der LSU Heizungsregelung Sensoren vor Katalysator" VALUE 0x1DF7DC Kw_Wu32 4294.9673 TimeDelay_s 0.0000010000000 4294.9673 FORMAT "%9.4" /end CHARACTERISTIC
/begin CHARACTERISTIC LSUCtl_Sens1HtDT1Kd_C "Kd Parameter der Heizungsregelung für die Sensoren vor Katalysator" VALUE 0x1DF7E0 Kw_Ws32 6553.59999847 Kd_Temp_Kelv2Dcyc -3276.80000000 3276.79999847 FORMAT "%13.8" /end CHARACTERISTIC
/begin CHARACTERISTIC LSUCtl_Sens1HtIKi_C "Ki Parameter der Heizungsregelung für die Sensoren vor Katalysator (Kleinsignalbereich)" VALUE 0x1DF7E4 Kw_Wu32 99999.9999767 Ki_Temp_Kelv2Dcyc 0.00 99999.9999767 FORMAT "%13.7" /end CHARACTERISTIC
/begin CHARACTERISTIC LSUCtl_Sens1HtIKiPos_C "Ki Parameter der Heizungsregelung für die Sensoren vor Katalysator (positiver Großsignalbereich)" VALUE 0x1DF7E8 Kw_Wu32 99999.9999767 Ki_Temp_Kelv2Dcyc 0.00 99999.9999767 FORMAT "%13.7" /end CHARACTERISTIC
/begin CHARACTERISTIC LSUCtl_Sens1HtIKiNeg_C "Ki Parameter der Heizungsregelung für die Sensoren vor Katalysator (negativer Großsignalbereich)" VALUE 0x1DF7EC Kw_Wu32 99999.9999767 Ki_Temp_Kelv2Dcyc 0.00 99999.9999767 FORMAT "%13.7" /end CHARACTERISTIC
/begin CHARACTERISTIC LSUCtl_tSens1HtIWinPos_C "Obere Fenstergrenze des I-Anteils der LSU-Heizungsregelung (Sensoren vor Katalysator)" VALUE 0x1DF7F0 Kw_Ws16 6553.500 TempDiff_Kelv -3276.800 3276.700 FORMAT "%8.3" /end CHARACTERISTIC
/begin CHARACTERISTIC LSUCtl_tSens1HtIWinNeg_C "Untere Fenstergrenze des I-Anteils der LSU-Heizungsregelung (Sensoren vor Katalysator)" VALUE 0x1DF7F2 Kw_Ws16 6553.500 TempDiff_Kelv -3276.800 3276.700 FORMAT "%8.3" /end CHARACTERISTIC
/begin CHARACTERISTIC LSUCtl_Sens1HtPKp_C "Kp Parameter der Heizungsregelung für die Sensoren vor Katalysator (Kleinsignalbereich)" VALUE 0x1DF7F4 Kw_Wu32 6553.59999847 Kp_Temp_Kelv2Dcyc 0.00 6553.59999847 FORMAT "%13.8" /end CHARACTERISTIC
/begin CHARACTERISTIC LSUCtl_Sens1HtPKpPos_C "Kp Parameter der Heizungsregelung für die Sensoren vor Katalysator (positiver Großsignalbereich)" VALUE 0x1DF7F8 Kw_Wu32 6553.59999847 Kp_Temp_Kelv2Dcyc 0.00 6553.59999847 FORMAT "%13.8" /end CHARACTERISTIC
/begin CHARACTERISTIC LSUCtl_Sens1HtPKpNeg_C "Kp Parameter der Heizungsregelung für die Sensoren vor Katalysator (negativer Großsignalbereich)" VALUE 0x1DF7FC Kw_Wu32 6553.59999847 Kp_Temp_Kelv2Dcyc 0.00 6553.59999847 FORMAT "%13.8" /end CHARACTERISTIC
/begin CHARACTERISTIC LSUCtl_tSens1HtPWinPos_C "Obere Fenstergrenze des P-Anteils der LSU-Heizungsregelung (Sensoren vor Katalysator)" VALUE 0x1DF800 Kw_Ws16 6553.500 TempDiff_Kelv -3276.800 3276.700 FORMAT "%8.3" /end CHARACTERISTIC
/begin CHARACTERISTIC LSUCtl_tSens1HtPWinNeg_C "Untere Fenstergrenze des P-Anteils der LSU-Heizungsregelung (Sensoren vor Katalysator)" VALUE 0x1DF802 Kw_Ws16 6553.500 TempDiff_Kelv -3276.800 3276.700 FORMAT "%8.3" /end CHARACTERISTIC
/begin CHARACTERISTIC LSUCtl_tiSens2HtDT1_C "Verzugszeit T1 des D-Gliedes der LSU Heizungsregelung Sensoren nach Katalysator" VALUE 0x1DF804 Kw_Wu32 4294.9673 TimeDelay_s 0.0000010000000 4294.9673 FORMAT "%9.4" /end CHARACTERISTIC
/begin CHARACTERISTIC LSUCtl_Sens2HtDT1Kd_C "Kd Parameter der Heizungsregelung für die Sensoren nach Katalysator" VALUE 0x1DF808 Kw_Ws32 6553.59999847 Kd_Temp_Kelv2Dcyc -3276.80000000 3276.79999847 FORMAT "%13.8" /end CHARACTERISTIC
/begin CHARACTERISTIC LSUCtl_Sens2HtIKi_C "Ki Parameter der Heizungsregelung für die Sensoren nach Katalysator (Kleinsignalbereich)" VALUE 0x1DF80C Kw_Wu32 99999.9999767 Ki_Temp_Kelv2Dcyc 0.00 99999.9999767 FORMAT "%13.7" /end CHARACTERISTIC
/begin CHARACTERISTIC LSUCtl_Sens2HtIKiPos_C "Ki Parameter der Heizungsregelung für die Sensoren nach Katalysator (positiver Großsignalbereich)" VALUE 0x1DF810 Kw_Wu32 99999.9999767 Ki_Temp_Kelv2Dcyc 0.00 99999.9999767 FORMAT "%13.7" /end CHARACTERISTIC
/begin CHARACTERISTIC LSUCtl_Sens2HtIKiNeg_C "Ki Parameter der Heizungsregelung für die Sensoren nach Katalysator (negativer Großsignalbereich)" VALUE 0x1DF814 Kw_Wu32 99999.9999767 Ki_Temp_Kelv2Dcyc 0.00 99999.9999767 FORMAT "%13.7" /end CHARACTERISTIC
/begin CHARACTERISTIC LSUCtl_tSens2HtIWinPos_C "Obere Fenstergrenze des I-Anteils der LSU-Heizungsregelung (Sensoren nach Katalysator)" VALUE 0x1DF818 Kw_Ws16 6553.500 TempDiff_Kelv -3276.800 3276.700 FORMAT "%8.3" /end CHARACTERISTIC
/begin CHARACTERISTIC LSUCtl_tSens2HtIWinNeg_C "Untere Fenstergrenze des I-Anteils der LSU-Heizungsregelung (Sensoren nach Katalysator)" VALUE 0x1DF81A Kw_Ws16 6553.500 TempDiff_Kelv -3276.800 3276.700 FORMAT "%8.3" /end CHARACTERISTIC
/begin CHARACTERISTIC LSUCtl_Sens2HtPKp_C "Kp Parameter der Heizungsregelung für die Sensoren nach Katalysator (Kleinsignalbereich)" VALUE 0x1DF81C Kw_Wu32 6553.59999847 Kp_Temp_Kelv2Dcyc 0.00 6553.59999847 FORMAT "%13.8" /end CHARACTERISTIC
/begin CHARACTERISTIC LSUCtl_Sens2HtPKpPos_C "Kp Parameter der Heizungsregelung für die Sensoren nach Katalysator (positiver Großsignalbereich)" VALUE 0x1DF820 Kw_Wu32 6553.59999847 Kp_Temp_Kelv2Dcyc 0.00 6553.59999847 FORMAT "%13.8" /end CHARACTERISTIC
/begin CHARACTERISTIC LSUCtl_Sens2HtPKpNeg_C "Kp Parameter der Heizungsregelung für die Sensoren nach Katalysator (negativer Großsignalbereich)" VALUE 0x1DF824 Kw_Wu32 6553.59999847 Kp_Temp_Kelv2Dcyc 0.00 6553.59999847 FORMAT "%13.8" /end CHARACTERISTIC
/begin CHARACTERISTIC LSUCtl_tSens2HtPWinPos_C "Obere Fenstergrenze des P-Anteils der LSU-Heizungsregelung (Sensoren nach Katalysator)" VALUE 0x1DF828 Kw_Ws16 6553.500 TempDiff_Kelv -3276.800 3276.700 FORMAT "%8.3" /end CHARACTERISTIC
/begin CHARACTERISTIC LSUCtl_tSens2HtPWinNeg_C "Untere Fenstergrenze des P-Anteils der LSU-Heizungsregelung (Sensoren nach Katalysator)" VALUE 0x1DF82A Kw_Ws16 6553.500 TempDiff_Kelv -3276.800 3276.700 FORMAT "%8.3" /end CHARACTERISTIC
/begin CHARACTERISTIC LSU_ctRgnEna_C "Zahl von Kalibrierungs-Zyklen, nach der Regeneration vorkommen soll" VALUE 0x1DF510 Kw_Wu16 65535.00 OneToOne 0.00 65535.00 FORMAT "%8.2" /end CHARACTERISTIC
/begin CHARACTERISTIC LSU_dcycMax_C "minimale Tastverhältnis-Änderung für Aktivierung Heizereinkopplungs-Diagnose" VALUE 0x1DF538 Kw_Ws16 655.3500 DtyCyc -327.6800 327.6700 FORMAT "%8.4" /end CHARACTERISTIC
/begin CHARACTERISTIC LSU_DebDynErrDef_C "Zählerstand zur Defektentprellung Dynamikfehler" VALUE 0x1DF57C Kw_Wu16 65535.00 OneToOne 0.00 65535.00 FORMAT "%8.2" /end CHARACTERISTIC
/begin CHARACTERISTIC LSU_DebDynErrOk_C "Zählerstand zur Heilungsentprellung Dynamikfehler" VALUE 0x1DF57E Kw_Wu16 65535.00 OneToOne 0.00 65535.00 FORMAT "%8.2" /end CHARACTERISTIC
/begin CHARACTERISTIC LSUCD_tiDebNoLdErrIPDef_C "Defekterkennungszeit der Kabelunterbrechungsdiagnose am Anschluss Pumpzelle (IP)" VALUE 0x1DF78A Kw_Wu16 655350.0 Time_ms 0.00 655350.0 FORMAT "%8.1" /end CHARACTERISTIC
/begin CHARACTERISTIC LSUCD_tiDebNoLdErrIPOk_C "Heilungsdauer der Kabelunterbrechungsdiagnose am Anschluss Pumpzelle (IP)" VALUE 0x1DF78C Kw_Wu16 655350.0 Time_ms 0.00 655350.0 FORMAT "%8.1" /end CHARACTERISTIC
/begin CHARACTERISTIC LSU_DebO2ConcHighDef_C "Zählerstand zur Defektentprellung unplausibel hohe O2-Konzentration" VALUE 0x1DF580 Kw_Wu16 65535.00 OneToOne 0.00 65535.00 FORMAT "%8.2" /end CHARACTERISTIC
/begin CHARACTERISTIC LSU_DebO2ConcHighOk_C "Zählerstand zur Heilungsentprellung unplausibel hohe O2-Konzentration" VALUE 0x1DF582 Kw_Wu16 65535.00 OneToOne 0.00 65535.00 FORMAT "%8.2" /end CHARACTERISTIC
/begin CHARACTERISTIC LSU_DebO2ConcLowDef_C "Zählerstand zur Defektentprellung unplausibel niedrige O2-Konzentration" VALUE 0x1DF584 Kw_Wu16 65535.00 OneToOne 0.00 65535.00 FORMAT "%8.2" /end CHARACTERISTIC
/begin CHARACTERISTIC LSU_DebO2ConcLowOk_C "Zählerstand zur Heilungsentprellung unplausibel niedrige O2-Konzentration" VALUE 0x1DF586 Kw_Wu16 65535.00 OneToOne 0.00 65535.00 FORMAT "%8.2" /end CHARACTERISTIC
/begin CHARACTERISTIC LSUCD_tiDebHeaterDef_C "Defektentprellung Lambdasonden Heizerendstufe" VALUE 0x1DF618 Kw_Wu16 655350.0 Time_ms 0.00 655350.0 FORMAT "%8.1" /end CHARACTERISTIC
/begin CHARACTERISTIC LSUCD_tiDebHeaterOk_C "Heilungsentprellung der Heizerendstufe Lambdasensor" VALUE 0x1DF61A Kw_Wu16 655350.0 Time_ms 0.00 655350.0 FORMAT "%8.1" /end CHARACTERISTIC
/begin CHARACTERISTIC LSUCD_uBattNominal_C "Nominale Batteriespannung für Heizleistungskorrektur (= Spannung die 100 % entspricht)" VALUE 0x1DF61C Kw_Wu16 16008.03 Volt_Batt 0.00 16008.03 FORMAT "%8.2" EXTENDED_LIMITS 0.00 1331328. /end CHARACTERISTIC
/begin CHARACTERISTIC LSUCD_uBattMaxHigh_C "Schwelle für Abschaltung Heizeransteuern aufgrund zu hoher Batteriespannung" VALUE 0x1DF61E Kw_Ws16 690681.5 Volt_Batt -665674.1 25007.47 FORMAT "%8.1" EXTENDED_LIMITS -665674.1 665653.8 /end CHARACTERISTIC
/begin CHARACTERISTIC LSUCD_uBattMaxLow_C "Schwelle für Rücknahme Abschaltung Heizeransteuern aufgrund zu hoher Batteriespannung" VALUE 0x1DF620 Kw_Ws16 690681.5 Volt_Batt -665674.1 25007.47 FORMAT "%8.1" EXTENDED_LIMITS -665674.1 665653.8 /end CHARACTERISTIC
/begin CHARACTERISTIC LSUCD_stPwrStgDia_C "Verriegelungsmaske für Heizer Endstufen Diagnose" VALUE 0x1DF622 Kw_Wu8 255.0 OneToOne 0.00 255.0 FORMAT "%5.1" /end CHARACTERISTIC
/begin CHARACTERISTIC LSUCD_dcycTstPowerStage_C "Tastverhältnis Endstufen Testimpuls" VALUE 0x1DF624 Kw_Ws16 50.00000 DtyCyc 0.00 50.00000 FORMAT "%8.5" EXTENDED_LIMITS -327.6800 327.6700 /end CHARACTERISTIC
/begin CHARACTERISTIC LSUCD_tiDebReset_C "Zeitverzögerung für zurücksetzen PWM Fehlerentprellung bei nicht aktiver Ansteuerung" VALUE 0x1DF626 Kw_Wu16 655350.0 Time_ms 0.00 655350.0 FORMAT "%8.1" /end CHARACTERISTIC
/begin CHARACTERISTIC LSUCD_stHtDis_C "Maske zur Auswahl der Betriebsmode abhängigen Abschaltbedingungen der Heizer Endstufe" VALUE 0x1DF628 Kw_Wu8 255.0 OneToOne 0.00 255.0 FORMAT "%5.1" /end CHARACTERISTIC
/begin CHARACTERISTIC LSUCD_stRefPumpDis_C "Maske zur Auswahl der Betriebsart abhängigen Abschaltbedingungen für den Referenzpumpstrom" VALUE 0x1DF62A Kw_Wu8 255.0 OneToOne 0.00 255.0 FORMAT "%5.1" /end CHARACTERISTIC
/begin CHARACTERISTIC LSUCD_tiRefPumpHigh_C "Zeit für Regeneration Referenzzelle mit erhöhtem Pumpstrom" VALUE 0x1DF62C Kw_Wu16 655350.0 Time_ms 0.00 655350.0 FORMAT "%8.1" /end CHARACTERISTIC
/begin CHARACTERISTIC LSUCD_tiRefTransLow_C "Verzögerungszeit bis zum Setzen des Bits in LSUCD_stRefPmp nach Übergang von hohem zu niedrigem Referenzpumpstrom" VALUE 0x1DF62E Kw_Wu16 655350.0 Time_ms 0.00 655350.0 FORMAT "%8.1" /end CHARACTERISTIC
/begin CHARACTERISTIC LSUCD_tiRgnEna_C "Zeit-Periode für Regeneration" VALUE 0x1DF630 Kw_Wu16 655350.0 Time_ms 0.00 655350.0 FORMAT "%8.1" /end CHARACTERISTIC
/begin CHARACTERISTIC LSUCD_tiRgnIpSettle_C "Zeitdauer zum Ausregeln des Pumpstroms nach Regeneration (nur für CJ125)" VALUE 0x1DF632 Kw_Wu16 655350.0 Time_ms 0.00 655350.0 FORMAT "%8.1" /end CHARACTERISTIC
/begin CHARACTERISTIC LSUCD_tiDebLowBattErrDef_C "Defekterkennungszeit für Fehler niedrige Batteriespannung" VALUE 0x1DF78E Kw_Wu16 655350.0 Time_ms 0.00 655350.0 FORMAT "%8.1" /end CHARACTERISTIC
/begin CHARACTERISTIC LSUCD_tiDebLowBattErrOk_C "Heilungszeit für Fehler niedrige Batteriespannung" VALUE 0x1DF790 Kw_Wu16 655350.0 Time_ms 0.00 655350.0 FORMAT "%8.1" /end CHARACTERISTIC
/begin CHARACTERISTIC LSU_mAirMaxClb1_C "upper air mass threshold for calibration/regeneration of  CJ120/125 (for operating point1)" VALUE 0x1DF512 Kw_Ws16 6553.500 AirMassPerCyl -3276.800 3276.700 FORMAT "%8.3" /end CHARACTERISTIC
/begin CHARACTERISTIC LSU_mAirMaxClb2_C "upper air mass threshold for calibration/regeneration of CJ120/125 (for operating point2)" VALUE 0x1DF514 Kw_Ws16 6553.500 AirMassPerCyl -3276.800 3276.700 FORMAT "%8.3" /end CHARACTERISTIC
/begin CHARACTERISTIC LSU_mAirMax_C "obere Luftmassen-Schwelle für Plausibilitätscheck (0 - Vollast, 1 - Teillast, 2 - Schub)" VAL_BLK 0x1DF588 Kwb_Ws16 6553.500 AirMassPerCyl -3276.800 3276.700 FORMAT "%8.3" NUMBER 3 /end CHARACTERISTIC
/begin CHARACTERISTIC LSU_mAirMinClb1_C "lower air mass threshold for calibration/regeneration of CJ120/125 (for operating point1)" VALUE 0x1DF516 Kw_Ws16 6553.500 AirMassPerCyl -3276.800 3276.700 FORMAT "%8.3" /end CHARACTERISTIC
/begin CHARACTERISTIC LSU_mAirMinClb2_C "lower air mass threshold for calibration/regeneration of  CJ120/125 (for operating point2)" VALUE 0x1DF518 Kw_Ws16 6553.500 AirMassPerCyl -3276.800 3276.700 FORMAT "%8.3" /end CHARACTERISTIC
/begin CHARACTERISTIC LSU_mAirMin_C "untere Luftmassenschwelle für Plausibilitäts-Check (0 - Vollast, 1 - Teillast, 2 - Schub)" VAL_BLK 0x1DF58E Kwb_Ws16 6553.500 AirMassPerCyl -3276.800 3276.700 FORMAT "%8.3" NUMBER 3 /end CHARACTERISTIC
/begin CHARACTERISTIC LSUCD_tiDebO2MaxTstDef_C "Defekt Entprellung der oberen Grenze  Sauerstoffsignal mit reduzierter Verstärkung" VALUE 0x1DF67C Kw_Wu16 655350.0 Time_ms 0.00 655350.0 FORMAT "%8.1" /end CHARACTERISTIC
/begin CHARACTERISTIC LSUCD_tiDebO2MaxTstOk_C "Heilungs Entprellung der oberen Grenze  Sauerstoffsignal mit reduzierter Verstärkung" VALUE 0x1DF67E Kw_Wu16 655350.0 Time_ms 0.00 655350.0 FORMAT "%8.1" /end CHARACTERISTIC
/begin CHARACTERISTIC LSUCD_tiDebO2MinDef_C "Defekt Entprellung der unteren Genze Sauerstoffsignal" VALUE 0x1DF680 Kw_Wu16 655350.0 Time_ms 0.00 655350.0 FORMAT "%8.1" /end CHARACTERISTIC
/begin CHARACTERISTIC LSUCD_tiDebO2MinOk_C "Heilungsentprellung untere Grenze Sauerstoffsignal" VALUE 0x1DF682 Kw_Wu16 655350.0 Time_ms 0.00 655350.0 FORMAT "%8.1" /end CHARACTERISTIC
/begin CHARACTERISTIC LSUCD_tiDebCircNernstDef_C "Defekt Entprellung des Nernst Anschlusses der Lambdasonde" VALUE 0x1DF792 Kw_Wu16 655350.0 Time_ms 0.00 655350.0 FORMAT "%8.1" /end CHARACTERISTIC
/begin CHARACTERISTIC LSUCD_tiDebCircNernstOk_C "Heilungsentprellung des Nernst Anschlusses Lambdasensor" VALUE 0x1DF794 Kw_Wu16 655350.0 Time_ms 0.00 655350.0 FORMAT "%8.1" /end CHARACTERISTIC
/begin CHARACTERISTIC LSU_nMaxClb1_C "upper engine speed  threshold for calibration/regeneration of  CJ120/125 (for operating point1)" VALUE 0x1DF51A Kw_Ws16 65535.00 EngN -32768.00 32767.00 FORMAT "%8.2" /end CHARACTERISTIC
/begin CHARACTERISTIC LSU_nMaxClb2_C "lower engine speed  threshold for calibration/regeneration of CJ120/125 (for operating point2)" VALUE 0x1DF51C Kw_Ws16 65535.00 EngN -32768.00 32767.00 FORMAT "%8.2" /end CHARACTERISTIC
/begin CHARACTERISTIC LSU_nMax_C "obere Drehzahlschwelle für Plausibilitäts-Check (0 - Vollast, 1 - Teillast, 2 - Schub)" VAL_BLK 0x1DF594 Kwb_Ws16 65535.00 EngN -32768.00 32767.00 FORMAT "%8.2" NUMBER 3 /end CHARACTERISTIC
/begin CHARACTERISTIC LSU_nMinChkDyn_C "minimale Drehzahl zur Aktivierung Dynamiküberwachung" VALUE 0x1DF59A Kw_Ws16 65535.00 EngN -32768.00 32767.00 FORMAT "%8.2" /end CHARACTERISTIC
/begin CHARACTERISTIC LSU_nMinClb1_C "lower engine speed threshold for for calibration/regeneration of  CJ120/125 (for operating point1)" VALUE 0x1DF51E Kw_Ws16 65535.00 EngN -32768.00 32767.00 FORMAT "%8.2" /end CHARACTERISTIC
/begin CHARACTERISTIC LSU_nMinClb2_C "lower engine speed  threshold for for calibration/regeneration of  CJ120/125 (for operating point2)" VALUE 0x1DF520 Kw_Ws16 65535.00 EngN -32768.00 32767.00 FORMAT "%8.2" /end CHARACTERISTIC
/begin CHARACTERISTIC LSU_nMin_C "untere Drehzahlschwelle für Plausibilitäts-Check (0 - Vollast, 1 - Teillast, 2 - Schub)" VAL_BLK 0x1DF59C Kwb_Ws16 65535.00 EngN -32768.00 32767.00 FORMAT "%8.2" NUMBER 3 /end CHARACTERISTIC
/begin CHARACTERISTIC LSUCD_tiDelO2Clb_C "Wartezeit auf Einschwingen O2 Abgleichwert" VALUE 0x1DF684 Kw_Wu16 100.0000 Time_ms 0.00 100.0000 FORMAT "%8.4" EXTENDED_LIMITS 0.00 655350.0 /end CHARACTERISTIC
/begin CHARACTERISTIC LSUCD_tiO2Clb_C "Lernzeit O2 Abgleichwert" VALUE 0x1DF686 Kw_Wu16 100.0000 Time_ms 0.00 100.0000 FORMAT "%8.4" EXTENDED_LIMITS 0.00 655350.0 /end CHARACTERISTIC
/begin CHARACTERISTIC LSUCD_tiDelO2Val_C "Wartezeit auf Einschwingen O2 Meßwert nach Abgleich" VALUE 0x1DF688 Kw_Wu16 100.0000 Time_ms 0.00 100.0000 FORMAT "%8.4" EXTENDED_LIMITS 0.00 655350.0 /end CHARACTERISTIC
/begin CHARACTERISTIC LSUCD_uO2Ref_C "Sollspannung Auswerteschaltung bei Lambda = 1" VALUE 0x1DF68A Kw_Ws16 5000.000 Volt 0.00 5000.000 FORMAT "%8.3" EXTENDED_LIMITS -160156.4 160151.5 /end CHARACTERISTIC
/begin CHARACTERISTIC LSUCD_uO2ClbMax_C "Maximal zulässiger O2 Spannungskorrekturwert" VALUE 0x1DF68C Kw_Ws16 320307.9 Volt -160156.4 160151.5 FORMAT "%8.1" /end CHARACTERISTIC
/begin CHARACTERISTIC LSUCD_uO2ClbMin_C "Minimal zulässiger O2 Spannungskorrekturwert" VALUE 0x1DF68E Kw_Ws16 320307.9 Volt -160156.4 160151.5 FORMAT "%8.1" /end CHARACTERISTIC
/begin CHARACTERISTIC LSUCD_swtO2Filter_C "Schalter zur aktivierung der O2 Rohspannungs Filterung (0= Filter aus, 1 = Filter an)" VALUE 0x1DF690 Kw_Wu8 1.000 OneToOne 0.00 1.000 FORMAT "%5.3" EXTENDED_LIMITS 0.00 255.0 /end CHARACTERISTIC
/begin CHARACTERISTIC LSUCD_uO2MaxNorm_C "Zulässige obere Spannungsgrenze für Normalkennlinie" VALUE 0x1DF692 Kw_Ws16 5000.000 Volt 0.00 5000.000 FORMAT "%8.3" EXTENDED_LIMITS -160156.4 160151.5 /end CHARACTERISTIC
/begin CHARACTERISTIC LSUCD_uO2MaxTst_C "Zulässige obere Spannungsgrenze für Fettkennlinie (Nur für Test verwendet)" VALUE 0x1DF694 Kw_Ws16 5000.000 Volt 0.00 5000.000 FORMAT "%8.3" EXTENDED_LIMITS -160156.4 160151.5 /end CHARACTERISTIC
/begin CHARACTERISTIC LSUCD_uO2Min_C "Unter Grenze Signalbereich" VALUE 0x1DF696 Kw_Ws16 5000.000 Volt 0.00 5000.000 FORMAT "%8.3" EXTENDED_LIMITS -160156.4 160151.5 /end CHARACTERISTIC
/begin CHARACTERISTIC LSUCD_tiDebCircPumpDef_C "Defekt Entrpellung des Pumpstromanschlusses der Lambdasonde" VALUE 0x1DF796 Kw_Wu16 655350.0 Time_ms 0.00 655350.0 FORMAT "%8.1" /end CHARACTERISTIC
/begin CHARACTERISTIC LSUCD_tiDebCircPumpOk_C "Heilungsentprellung des Pumpstromanschlusses Lambdasensor" VALUE 0x1DF798 Kw_Wu16 655350.0 Time_ms 0.00 655350.0 FORMAT "%8.1" /end CHARACTERISTIC
/begin CHARACTERISTIC LSU_qDiffMax_C "Toleranzband Einspritzmenge für Stationärerkennung" VALUE 0x1DF5A2 Kw_Ws16 655.3500 InjMass -327.6800 327.6700 FORMAT "%8.4" /end CHARACTERISTIC
/begin CHARACTERISTIC LSU_qMaxClb1_C "upper fuel quantity threshold for calibration/regeneration of  CJ120/125 (for operating point1)" VALUE 0x1DF522 Kw_Ws16 655.3500 InjMass -327.6800 327.6700 FORMAT "%8.4" /end CHARACTERISTIC
/begin CHARACTERISTIC LSU_qMaxClb2_C "upper fuel quantity threshold for calibration/regeneration of CJ120/125 (for operating point2)" VALUE 0x1DF524 Kw_Ws16 655.3500 InjMass -327.6800 327.6700 FORMAT "%8.4" /end CHARACTERISTIC
/begin CHARACTERISTIC LSU_qMax_C "obere Mengenschwelle für Plausibilitäts-Check (0 - Vollast, 1 - Teillast, 2 - Schub)" VAL_BLK 0x1DF5A4 Kwb_Ws16 655.3500 InjMass -327.6800 327.6700 FORMAT "%8.4" NUMBER 3 /end CHARACTERISTIC
/begin CHARACTERISTIC LSU_qMinClb1_C "lower fuel quantity threshold for calibration/regeneration of CJ120/125 (for operating point1)" VALUE 0x1DF526 Kw_Ws16 655.3500 InjMass -327.6800 327.6700 FORMAT "%8.4" /end CHARACTERISTIC
/begin CHARACTERISTIC LSU_qMinClb2_C "lower fuel quantity threshold for calibration/regeneration of CJ120/125 (for operating point2)" VALUE 0x1DF528 Kw_Ws16 655.3500 InjMass -327.6800 327.6700 FORMAT "%8.4" /end CHARACTERISTIC
/begin CHARACTERISTIC LSU_qMin_C "untere Mengenschwelle für Plausibilitäts-Check (0 - Vollast, 1 - Teillast, 2 - Schub)" VAL_BLK 0x1DF5AA Kwb_Ws16 655.3500 InjMass -327.6800 327.6700 FORMAT "%8.4" NUMBER 3 /end CHARACTERISTIC
/begin CHARACTERISTIC LSU_qThresChkDyn_C "minimale Kraftstoffmenge für Aktivierung Dynamiküberwachung" VALUE 0x1DF5B0 Kw_Ws16 655.3500 InjMass -327.6800 327.6700 FORMAT "%8.4" /end CHARACTERISTIC
/begin CHARACTERISTIC LSU_qThresOvrRun_C "Mengenschwelle zur Schuberkennung" VALUE 0x1DF5B2 Kw_Ws16 655.3500 InjMass -327.6800 327.6700 FORMAT "%8.4" /end CHARACTERISTIC
/begin CHARACTERISTIC LSUCD_tiDelRiClb_C "Wartezeit auf Einschwingen Ri Abgleichwert" VALUE 0x1DF73E Kw_Wu16 100.0000 Time_ms 0.00 100.0000 FORMAT "%8.4" EXTENDED_LIMITS 0.00 655350.0 /end CHARACTERISTIC
/begin CHARACTERISTIC LSUCD_tiRiClb_C "Lernzeit Ri Abgleichwert" VALUE 0x1DF740 Kw_Wu16 150.0000 Time_ms 0.00 150.0000 FORMAT "%8.4" EXTENDED_LIMITS 0.00 655350.0 /end CHARACTERISTIC
/begin CHARACTERISTIC LSUCD_tiDelRiVal_C "Wartezeit auf Einschwingen Ri Meßwert nach Abgleich" VALUE 0x1DF742 Kw_Wu16 100.0000 Time_ms 0.00 100.0000 FORMAT "%8.4" EXTENDED_LIMITS 0.00 655350.0 /end CHARACTERISTIC
/begin CHARACTERISTIC LSUCD_tiRiFltSettle_C "Maximale Zeitdauer zur Deaktivierung der Störungsunterdrückung" VALUE 0x1DF744 Kw_Wu16 3000.000 Time_ms 0.00 3000.000 FORMAT "%8.3" EXTENDED_LIMITS 0.00 655350.0 /end CHARACTERISTIC
/begin CHARACTERISTIC LSUCD_resRiMaxJmp_C "Maximal zulässige Ri-Änderung zwischen gemessenem und zuletzt gefiltertem Wert" VALUE 0x1DF746 Kw_Wu16 6553.500 Resist 0.00 6553.500 FORMAT "%8.3" /end CHARACTERISTIC
/begin CHARACTERISTIC LSUCD_uRiOfs_C "Sollspannung während Ri Offsetabgleich" VALUE 0x1DF748 Kw_Ws16 5000.000 Volt 0.00 5000.000 FORMAT "%8.3" EXTENDED_LIMITS -160156.4 160151.5 /end CHARACTERISTIC
/begin CHARACTERISTIC LSUCD_facUToRi_C "Umrechnungsfaktor Meßspannung in Ri" VALUE 0x1DF74A Kw_Ws16 1.289275 VoltToRes -0.6446474 0.6446277 FORMAT "%9.7" /end CHARACTERISTIC
/begin CHARACTERISTIC LSUCD_resRiClbRef_C "Wert Ri Referenzwiderstand" VALUE 0x1DF74C Kw_Ws16 6553.500 Resist -3276.800 3276.700 FORMAT "%8.3" /end CHARACTERISTIC
/begin CHARACTERISTIC LSUCD_resRiClbMax_C "Maximal zulässiger Ri Korrekturwert" VALUE 0x1DF74E Kw_Ws16 6553.500 Resist -3276.800 3276.700 FORMAT "%8.3" /end CHARACTERISTIC
/begin CHARACTERISTIC LSUCD_resRiClbMin_C "Minimal zulässiger Ri Korrekturwert" VALUE 0x1DF750 Kw_Ws16 6553.500 Resist -3276.800 3276.700 FORMAT "%8.3" /end CHARACTERISTIC
/begin CHARACTERISTIC LSUCD_numRiDistSupp_C "Anzahl der aufeinanderfolgenden Zyklen zur Störungsunterdrückung" VALUE 0x1DF752 Kw_Wu8 255.0 OneToOne 0.00 255.0 FORMAT "%5.1" /end CHARACTERISTIC
/begin CHARACTERISTIC LSU_rLmbdRec_CUR "Kennlinie für Kehrwert von Lambda" CURVE 0x1DF53E Kl_Xs16_Ws16 65.53500 lambdaRecVal -32.76800 32.76700 FORMAT "%8.5"
 /begin AXIS_DESCR STD_AXIS LSU_rO2AdptLastLSU_mp O2 15 -0.3276800 0.3276700 FORMAT "%9.7" DEPOSIT ABSOLUTE /end AXIS_DESCR
/end CHARACTERISTIC
/begin CHARACTERISTIC LSU_tiO2CalcFlt_C "Filterzeitkonstante für berechneten O2-Wert" VALUE 0x1DF5B4 Kw_Wu32 4294.9673 TimeDelay_s 0.0000010000000 4294.9673 FORMAT "%9.4" /end CHARACTERISTIC
/begin CHARACTERISTIC LSU_rO2ConstVal_C "Mitte Toleranzband für Lambda-1-Erkennung" VALUE 0x1DF5B8 Kw_Ws16 0.6553500 O2 -0.3276800 0.3276700 FORMAT "%9.7" /end CHARACTERISTIC
/begin CHARACTERISTIC LSU_tiDvtFlt_C "Filterzeitkonstante Lambda-1-Erkennung" VALUE 0x1DF5BC Kw_Wu32 4294.9673 TimeDelay_s 0.0000010000000 4294.9673 FORMAT "%9.4" /end CHARACTERISTIC
/begin CHARACTERISTIC LSU_rO2Lmbd1Thres_C "Toleranzband für Lambda-1-Erkennung" VALUE 0x1DF5C0 Kw_Ws16 0.6553500 O2 -0.3276800 0.3276700 FORMAT "%9.7" /end CHARACTERISTIC
/begin CHARACTERISTIC LSU_rO2MaxVar_C "Breite des Toleranzbands für O2-Stationärerkennung" VALUE 0x1DF5C2 Kw_Ws16 0.6553500 O2 -0.3276800 0.3276700 FORMAT "%9.7" /end CHARACTERISTIC
/begin CHARACTERISTIC LSU_rO2Min_C "minimaler O2-Sollwert für Aktivierung der Lambda-1-Erkennung" VALUE 0x1DF5C4 Kw_Ws16 0.6553500 O2 -0.3276800 0.3276700 FORMAT "%9.7" /end CHARACTERISTIC
/begin CHARACTERISTIC LSU_rO2NegDvt_C "negative O2-Toleranz (0 - Vollast, 1 - Teillast, 2 - Schub)" VAL_BLK 0x1DF5C6 Kwb_Ws16 0.6553500 O2 -0.3276800 0.3276700 FORMAT "%9.7" NUMBER 3 /end CHARACTERISTIC
/begin CHARACTERISTIC LSU_rO2PosDvt_C "positive O2-Toleranz (0 - Vollast, 1 - Teillast, 2 - Schub)" VAL_BLK 0x1DF5CC Kwb_Ws16 0.6553500 O2 -0.3276800 0.3276700 FORMAT "%9.7" NUMBER 3 /end CHARACTERISTIC
/begin CHARACTERISTIC LSU_stEGTClbOff_C "Bitmaske zur Unterdrückung der CJ12x-Kalibrierung bei Regenerationsanforderung Abgasnachbehandlung" VALUE 0x1DF52C Kw_Wu32 4294967295.00 OneToOne 0.00 4294967295.00 FORMAT "%13.2" /end CHARACTERISTIC
/begin CHARACTERISTIC LSU_stMonActv_C "Aktivierungsflags für Diagnoseroutinen" VALUE 0x1DF5D2 Kw_Wu16 65535.00 OneToOne 0.00 65535.00 FORMAT "%8.2" /end CHARACTERISTIC
/begin CHARACTERISTIC LSU_stSelPlausChkSig_C "Auswahl O2-Signal für Plausibilisierung" VALUE 0x1DF5D4 Kw_Wu16 65535.00 OneToOne 0.00 65535.00 FORMAT "%8.2" /end CHARACTERISTIC
/begin CHARACTERISTIC LSU_swtVal_C "Freigabe oder Sperren der LSU-Funktionen" VALUE 0x1DF53A Kw_Wu8 1.000 OneToOne 0.00 1.000 FORMAT "%5.3" EXTENDED_LIMITS 0.00 255.0 /end CHARACTERISTIC
/begin CHARACTERISTIC LSU_swtType_C "Datensatz oder EEPROM-Wert Freigabe LSU Funktion" VALUE 0x1DF53B Kw_Wu8 0.00 OneToOne 2.000 2.000 FORMAT "%5.3" EXTENDED_LIMITS 0.00 255.0 /end CHARACTERISTIC
/begin CHARACTERISTIC LSU_ti1stClb_C "Zeitdauer von SG-Start bis zu erster Kalibrierung CJ120" VALUE 0x1DF530 Kw_Wu16 655.3500 Time_s 0.00 655.3500 FORMAT "%8.4" /end CHARACTERISTIC
/begin CHARACTERISTIC LSU_tiDvt1Flt_C "Filterzeitkonstante für Lambda-1-Erkennung" VALUE 0x1DF5D6 Kw_Wu16 655.3500 Time_s 0.00 655.3500 FORMAT "%8.4" /end CHARACTERISTIC
/begin CHARACTERISTIC LSU_tiO2Eval_C "erforderliche Dauer für O2-Stationärerkennung" VALUE 0x1DF5D8 Kw_Wu16 655.3500 Time_s 0.00 655.3500 FORMAT "%8.4" /end CHARACTERISTIC
/begin CHARACTERISTIC LSU_tiPerClb_C "Periodendauer CJ120-Kalibrierung" VALUE 0x1DF532 Kw_Wu16 655.3500 Time_s 0.00 655.3500 FORMAT "%8.4" /end CHARACTERISTIC
/begin CHARACTERISTIC LSU_tiSwitch_C "maximale Anstiegszeit des O2-Signals beim Last-Schub-Übergang" VALUE 0x1DF5DA Kw_Wu16 655.3500 Time_s 0.00 655.3500 FORMAT "%8.4" /end CHARACTERISTIC
/begin CHARACTERISTIC LSU_tiWait1_C "Zeitdauer für Stationärerkennung" VALUE 0x1DF5DC Kw_Wu16 655.3500 Time_s 0.00 655.3500 FORMAT "%8.4" /end CHARACTERISTIC
/begin CHARACTERISTIC LSU_tiWait2_C "maximale Zeitdauer zum Erreichen des Schubs" VALUE 0x1DF5DE Kw_Wu16 655.3500 Time_s 0.00 655.3500 FORMAT "%8.4" /end CHARACTERISTIC
/begin CHARACTERISTIC LSU_tiWait3_C "maximale Zeitdauer zum Erreichen der oberen O2-Schwelle" VALUE 0x1DF5E0 Kw_Wu16 655.3500 Time_s 0.00 655.3500 FORMAT "%8.4" /end CHARACTERISTIC
/begin CHARACTERISTIC LSU_uBattMin_C "minimale Batteriespannung" VALUE 0x1DF53C Kw_Wu16 16008.03 Volt_Batt 0.00 16008.03 FORMAT "%8.2" EXTENDED_LIMITS 0.00 1331328. /end CHARACTERISTIC
/begin CHARACTERISTIC LSUCD_tiDebCircVirtGndDef_C "Defekt Entprellung der virtuellen Masse Lambdasensor" VALUE 0x1DF79A Kw_Wu16 655350.0 Time_ms 0.00 655350.0 FORMAT "%8.1" /end CHARACTERISTIC
/begin CHARACTERISTIC LSUCD_tiDebCircVirtGndOk_C "Heilungsentprellung der virtuellen Masse Lambdasensor" VALUE 0x1DF79C Kw_Wu16 655350.0 Time_ms 0.00 655350.0 FORMAT "%8.1" /end CHARACTERISTIC
/begin CHARACTERISTIC McMess_stEnable_C "McMess Service aktivieren (1) / deaktivieren (0)" VALUE 0x1C0F8C Kw_Wu8 1.000 OneToOne 0.00 1.000 FORMAT "%5.3" EXTENDED_LIMITS 0.00 255.0 /end CHARACTERISTIC
/begin CHARACTERISTIC MemMon_numErrChkRam_C "Fehlertoleranzschwelle für Doppelablage und zyklischen RAM-Test" VALUE 0x1C1620 Kw_Wu8 255.0 OneToOne 0.00 255.0 FORMAT "%5.1" /end CHARACTERISTIC
/begin CHARACTERISTIC MemMon_numErrChkRom_C "Fehlertoleranzschwelle für zyklischen ROM-Test" VALUE 0x1C1621 Kw_Wu8 255.0 OneToOne 0.00 255.0 FORMAT "%5.1" /end CHARACTERISTIC
/begin CHARACTERISTIC MemMon_tiHealChkRam_C "Heilungszeit für Fehler in der Doppelablage und im zyklischen RAM-Test" VALUE 0x1C1622 Kw_Wu8 10200. Time_ms_40ms 0.00 10200. FORMAT "%5.0" /end CHARACTERISTIC
/begin CHARACTERISTIC MemMon_tiHealChkRom_C "Heilungszeit für Fehler im zyklischen ROM-Test" VALUE 0x1C1623 Kw_Wu8 10200. Time_ms_40ms 0.00 10200. FORMAT "%5.0" /end CHARACTERISTIC
/begin CHARACTERISTIC MeUnCD_uSRCMin_C "Analogeingang, Signal Range Check Min-Spannungswert" VALUE 0x1DF85C Kw_Ws16 5200.391 Volt 0.00 5200.391 FORMAT "%8.3" EXTENDED_LIMITS -160156.4 160151.5 /end CHARACTERISTIC
/begin CHARACTERISTIC MeUnCD_uSRCMax_C "Analogeingang, Signal Range Check Max-Spannungswert" VALUE 0x1DF85E Kw_Ws16 5200.391 Volt 0.00 5200.391 FORMAT "%8.3" EXTENDED_LIMITS -160156.4 160151.5 /end CHARACTERISTIC
/begin CHARACTERISTIC MeUnCD_iLin_CUR "Analogeingang, Linearisierungskennlinie" CURVE 0x1DF860 Kl_Xs16_Ws16 5000.000 Curr 0.00 5000.000 FORMAT "%8.3" EXTENDED_LIMITS -32768.00 32767.00
 /begin AXIS_DESCR STD_AXIS MeUnCD_uRawVal_mp Volt 2 0.00 5200.391 FORMAT "%8.3" EXTENDED_LIMITS -160156.4 160151.5 DEPOSIT ABSOLUTE /end AXIS_DESCR
/end CHARACTERISTIC
/begin CHARACTERISTIC MeUnCD_dcycMax_C "Max-Wert, Ausgangstastverhältnis" VALUE 0x1DF86A Kw_Ws16 100.0000 DtyCyc 0.00 100.0000 FORMAT "%8.4" EXTENDED_LIMITS -327.6800 327.6700 /end CHARACTERISTIC
/begin CHARACTERISTIC MeUnCD_dcycMin_C "Min-Wert, Ausgangstastverhältnis" VALUE 0x1DF86C Kw_Ws16 100.0000 DtyCyc 0.00 100.0000 FORMAT "%8.4" EXTENDED_LIMITS -327.6800 327.6700 /end CHARACTERISTIC
/begin CHARACTERISTIC MeUnCD_dcycSetValLin_CUR "Linearisierungskurve des Tastverhältnisses der  Zumesseinheit" CURVE 0x1DF86E Kl_Xs16_Ws16 100.0000 DtyCyc 0.00 100.0000 FORMAT "%8.4" EXTENDED_LIMITS -327.6800 327.6700
 /begin AXIS_DESCR STD_AXIS MeUnCD_dcycSetVal_mp DtyCyc 4 -327.6800 327.6700 FORMAT "%8.4" DEPOSIT ABSOLUTE /end AXIS_DESCR
/end CHARACTERISTIC
/begin CHARACTERISTIC MeUnCD_dcycTst_C "Tastverhältnis, das im Fehlerfall zyklisch ausgegeben wird" VALUE 0x1DF880 Kw_Ws16 100.0000 DtyCyc 0.00 100.0000 FORMAT "%8.4" EXTENDED_LIMITS -327.6800 327.6700 /end CHARACTERISTIC
/begin CHARACTERISTIC MeUnCD_DebExcTempDef_C "Fehlerentprellzeit Übertemperatur" VALUE 0x1DF882 Kw_Wu16 655350.0 Time_ms 0.00 655350.0 FORMAT "%8.1" /end CHARACTERISTIC
/begin CHARACTERISTIC MeUnCD_DebExcTempOk_C "Heilungsentprellzeit Übertemperatur" VALUE 0x1DF884 Kw_Wu16 655350.0 Time_ms 0.00 655350.0 FORMAT "%8.1" /end CHARACTERISTIC
/begin CHARACTERISTIC MeUnCD_DebNoLoadDef_C "Fehlerentprellzeit Leerlauf" VALUE 0x1DF886 Kw_Wu16 655350.0 Time_ms 0.00 655350.0 FORMAT "%8.1" /end CHARACTERISTIC
/begin CHARACTERISTIC MeUnCD_DebNoLoadOk_C "Heilungszeit Leerlauf" VALUE 0x1DF888 Kw_Wu16 655350.0 Time_ms 0.00 655350.0 FORMAT "%8.1" /end CHARACTERISTIC
/begin CHARACTERISTIC MeUnCD_DebShortCircBatDef_C "Fehlerentprellzeit Kurzschluss Batterie" VALUE 0x1DF88A Kw_Wu16 655350.0 Time_ms 0.00 655350.0 FORMAT "%8.1" /end CHARACTERISTIC
/begin CHARACTERISTIC MeUnCD_DebShortCircBatOk_C "Heilungsentprellzeit Kurzschluss Batterie" VALUE 0x1DF88C Kw_Wu16 655350.0 Time_ms 0.00 655350.0 FORMAT "%8.1" /end CHARACTERISTIC
/begin CHARACTERISTIC MeUnCD_DebShortCircGndDef_C "Fehlerentprellzeit Kurzschluss Masse" VALUE 0x1DF88E Kw_Wu16 655350.0 Time_ms 0.00 655350.0 FORMAT "%8.1" /end CHARACTERISTIC
/begin CHARACTERISTIC MeUnCD_DebShortCircGndOk_C "Heilungsentprellzeit Kurzschluss Masse" VALUE 0x1DF890 Kw_Wu16 655350.0 Time_ms 0.00 655350.0 FORMAT "%8.1" /end CHARACTERISTIC
/begin CHARACTERISTIC MeUnCD_DebSRCHighDef_C "Fehlerentprellzeit für Analogeingang SRC-High Fehler" VALUE 0x1DF892 Kw_Wu16 655350.0 Time_ms 0.00 655350.0 FORMAT "%8.1" /end CHARACTERISTIC
/begin CHARACTERISTIC MeUnCD_DebSRCHighOk_C "Heilungsentprellzeit für Analogeingang SRC-High Fehler" VALUE 0x1DF894 Kw_Wu16 655350.0 Time_ms 0.00 655350.0 FORMAT "%8.1" /end CHARACTERISTIC
/begin CHARACTERISTIC MeUnCD_DebSRCLowDef_C "Fehlerentprellzeit Analogeingang SRC-Low Fehler" VALUE 0x1DF896 Kw_Wu16 655350.0 Time_ms 0.00 655350.0 FORMAT "%8.1" /end CHARACTERISTIC
/begin CHARACTERISTIC MeUnCD_DebSRCLowOk_C "Heilungsentprellzeit für Analogeingang SRC-Low Fehler" VALUE 0x1DF898 Kw_Wu16 655350.0 Time_ms 0.00 655350.0 FORMAT "%8.1" /end CHARACTERISTIC
/begin CHARACTERISTIC MeUnCD_facIGovInit_CUR "Initialisierungsfaktor für I-Anteil des Stromreglers als Funktion der Systemtemperatur" CURVE 0x1DF89A Kl_Xs16_Ws16 2.000000 Fact 0.00 2.000000 FORMAT "%8.6" EXTENDED_LIMITS -4.000000 3.999878
 /begin AXIS_DESCR STD_AXIS FlSys_t Temp_Cels 6 -50.14000 149.8600 FORMAT "%8.4" EXTENDED_LIMITS -3549.940 3003.560 DEPOSIT ABSOLUTE /end AXIS_DESCR
/end CHARACTERISTIC
/begin CHARACTERISTIC MeUnCD_facIGovMax_C "maximaler I-Anteil" VALUE 0x1DF8B4 Kw_Ws16 1.000000 Fact 1.000000 2.000000 FORMAT "%8.6" EXTENDED_LIMITS -4.000000 3.999878 /end CHARACTERISTIC
/begin CHARACTERISTIC MeUnCD_facIGovMin_C "minimaler I-Anteil" VALUE 0x1DF8B6 Kw_Ws16 0.5000000 Fact 0.5000000 1.000000 FORMAT "%8.6" EXTENDED_LIMITS -4.000000 3.999878 /end CHARACTERISTIC
/begin CHARACTERISTIC MeUnCD_tiFlt1PT1_C "PT1 Filter Zeitkonstante für Strom-Istwert" VALUE 0x1DF8B8 Kw_Wu32 4294.9673 TimeDelay_s 0.0000010000000 4294.9673 FORMAT "%9.4" /end CHARACTERISTIC
/begin CHARACTERISTIC MeUnCD_tiFlt2PT1_C "PT1 Filter Zeitkonstante für Strom-Sollwert" VALUE 0x1DF8BC Kw_Wu32 4294.9673 TimeDelay_s 0.0000010000000 4294.9673 FORMAT "%9.4" /end CHARACTERISTIC
/begin CHARACTERISTIC MeUnCD_tiIGovDT1_C "DT1 Zeitkonstante" VALUE 0x1DF8C0 Kw_Wu32 4294.9673 TimeDelay_s 0.0000010000000 4294.9673 FORMAT "%9.4" /end CHARACTERISTIC
/begin CHARACTERISTIC MeUnCD_IGovDKd_C "DT1 Differenziationsfaktor" VALUE 0x1DF8C4 Kw_Ws32 65535.9999847 Kd -32768.0000000 32767.9999847 FORMAT "%13.7" /end CHARACTERISTIC
/begin CHARACTERISTIC MeUnCD_IGovIKi_C "I-Glied, Kleinsignalverstärkung" VALUE 0x1DF8C8 Kw_Wu32 122.070312472 Ki_curr2fact 0.00 122.070312472 FORMAT "%13.9" /end CHARACTERISTIC
/begin CHARACTERISTIC MeUnCD_IGovIKiPos_C "I-Glied, Verstärkung für positive Großsignale" VALUE 0x1DF8CC Kw_Wu32 122.070312472 Ki_curr2fact 0.00 122.070312472 FORMAT "%13.9" /end CHARACTERISTIC
/begin CHARACTERISTIC MeUnCD_IGovIKiNeg_C "I-Glied, Verstärkung für negative Großsignale" VALUE 0x1DF8D0 Kw_Wu32 122.070312472 Ki_curr2fact 0.00 122.070312472 FORMAT "%13.9" /end CHARACTERISTIC
/begin CHARACTERISTIC MeUnCD_iIGovIWinPos_C "I-Glied, Kleinsignalfenster positiv" VALUE 0x1DF8D4 Kw_Ws16 65535.00 Curr -32768.00 32767.00 FORMAT "%8.2" /end CHARACTERISTIC
/begin CHARACTERISTIC MeUnCD_iIGovIWinNeg_C "I-Glied, Kleinsignalfenster negativ" VALUE 0x1DF8D6 Kw_Ws16 65535.00 Curr -32768.00 32767.00 FORMAT "%8.2" /end CHARACTERISTIC
/begin CHARACTERISTIC MeUnCD_tiFltPT1Init_C "PT1 Filter Zeitkonstante während Initialisierungsphase des Stromreglers" VALUE 0x1DF8D8 Kw_Wu32 4294.9673 TimeDelay_s 0.0000010000000 4294.9673 FORMAT "%9.4" /end CHARACTERISTIC
/begin CHARACTERISTIC MeUnCD_nDiffMax_C "maximale Differenz zwischen gefilterter Drehzahl für Kennlinie und aktueller Drehzahl um neuen Drehzahlwert zu übernehmen" VALUE 0x1DF8DC Kw_Ws16 6000.000 EngN 0.00 6000.000 FORMAT "%8.3" EXTENDED_LIMITS -32768.00 32767.00 /end CHARACTERISTIC
/begin CHARACTERISTIC MeUnCD_numAdc_C "Parameter für die Auswahl des Analogkanals für die Zumesseinheit" VALUE 0x1DF8DE Kw_Wu8 74.0000000000 NumPinAdc 0.00 74.0000000000 FORMAT "%13.10" /end CHARACTERISTIC
/begin CHARACTERISTIC MeUnCD_numDia1_C "Parameter für Zuordnung der Diagnose zur 1. Endstufe der Zumesseinheit" VALUE 0x1DF8DF Kw_Wu8 42.0000000000 NumPinDia 0.00 42.0000000000 FORMAT "%13.10" /end CHARACTERISTIC
/begin CHARACTERISTIC MeUnCD_numDia2_C "Parameter für Zuordnung der Diagnose zur 2. Endstufe der Zumesseinheit" VALUE 0x1DF8E0 Kw_Wu8 42.0000000000 NumPinDia 0.00 42.0000000000 FORMAT "%13.10" /end CHARACTERISTIC
/begin CHARACTERISTIC MeUnCD_numPwmOut_C "Parameter für die Auswahl des Hardware-Pins für die Zumesseinheit" VALUE 0x1DF8E1 Kw_Wu8 13.0000000000 NumPinPwmOut 0.00 13.0000000000 FORMAT "%13.10" /end CHARACTERISTIC
/begin CHARACTERISTIC MeUnCD_resCoil_C "Widerstandswert der Spule für die Zumesseinheit" VALUE 0x1DF8E2 Kw_Ws16 5000.000 Resist_1 0.00 5000.000 FORMAT "%8.3" EXTENDED_LIMITS -32768.00 32767.00 /end CHARACTERISTIC
/begin CHARACTERISTIC MeUnCD_stInvOut_C "Invertierungsparameter der PWM Endstufe" VALUE 0x1DF8E4 Kw_Wu8 1.000 OneToOne 0.00 1.000 FORMAT "%5.3" EXTENDED_LIMITS 0.00 255.0 /end CHARACTERISTIC
/begin CHARACTERISTIC MeUnCD_stPwrStgDia_C "Statuswort zur Spezifikation des Abschaltverhaltens der Endstufenfehlerdiagnose Zumesseinheit" VALUE 0x1DF8E5 Kw_Wu8 255.0 OneToOne 0.00 255.0 FORMAT "%5.1" /end CHARACTERISTIC
/begin CHARACTERISTIC MeUnCD_swt_C "allgemeine Schalterfunktionen der Endstufe für die Zumesseinheit" VALUE 0x1DF8E6 Kw_Wu8 255.0 OneToOne 0.00 255.0 FORMAT "%5.1" /end CHARACTERISTIC
/begin CHARACTERISTIC MeUnCD_tiBtwTst_C "Zeitabstand, in dem im Fehlerfall die Endstufe getestet wird" VALUE 0x1DF8E8 Kw_Wu16 29990.00 Time_ms 10.00000 30000.00 FORMAT "%8.2" EXTENDED_LIMITS 0.00 655350.0 /end CHARACTERISTIC
/begin CHARACTERISTIC MeUnCD_tiIGovInit_C "maximale Zeitdauer der Initialisierungsphase" VALUE 0x1DF8EA Kw_Wu16 655350.0 Time_ms 0.00 655350.0 FORMAT "%8.1" /end CHARACTERISTIC
/begin CHARACTERISTIC MeUnCD_tiPer_CUR "Kennlinie für Periodendauer der PWM-Endstufe" CURVE 0x1DF8EC Kl_Xs16_Ws16 6.400000 Period 0.1000000 6.500000 FORMAT "%8.6" EXTENDED_LIMITS -3276.800 3276.700
 /begin AXIS_DESCR STD_AXIS MeUnCD_nDiffRef_mp EngN 30 -32768.00 32767.00 FORMAT "%8.2" DEPOSIT ABSOLUTE /end AXIS_DESCR
/end CHARACTERISTIC
/begin CHARACTERISTIC MeUn_iCnvFlowRate_CUR "Kennlinie zur Umrechnung von Volumenstrom nach Strom" CURVE 0x1DF82C Kl_Xs16_Ws16 5000.000 Curr 0.00 5000.000 FORMAT "%8.3" EXTENDED_LIMITS -32768.00 32767.00
 /begin AXIS_DESCR STD_AXIS Rail_dvolMeUnSet Qp_mm3_sec 10 -10000.00 50000.00 FORMAT "%8.2" EXTENDED_LIMITS -327680.0 327670.0 DEPOSIT ABSOLUTE /end AXIS_DESCR
/end CHARACTERISTIC
/begin CHARACTERISTIC MeUn_iSetMin_C "Sollstrom bei elektrischer Abschaltung der Zumesseinheit" VALUE 0x1DF856 Kw_Ws16 65535.00 Curr -32768.00 32767.00 FORMAT "%8.2" /end CHARACTERISTIC
/begin CHARACTERISTIC MeUn_iSet_Vector "Bypass-Label für MeUn_iSet (Nicht verstellen!)" VALUE 0x1C0B24 Kw_Wu8 255.0 OneToOne 0.00 255.0 FORMAT "%5.1" /end CHARACTERISTIC
/begin CHARACTERISTIC MeUn_iSet_Channel "Bypass-Label für MeUn_iSet, nicht editieren !" VALUE 0x1C0B25 Kw_Wu8 255.0 OneToOne 0.00 255.0 FORMAT "%5.1" /end CHARACTERISTIC
/begin CHARACTERISTIC MeUn_pActrPrt_C "Raildruckschwelle für die Freigabe der Stellerschutzfunktion" VALUE 0x1DF858 Kw_Ws16 6553500. Pres_Rail -3276800. 3276700. FORMAT "%8.0" /end CHARACTERISTIC
/begin CHARACTERISTIC MeUn_pFlowOfFl_C "Raildruckschwelle zum Rückschalten auf Stellwertvorgabe der Hochdruckregelung" VALUE 0x1DF85A Kw_Ws16 6553500. Pres_Rail -3276800. 3276700. FORMAT "%8.0" /end CHARACTERISTIC
/begin CHARACTERISTIC MRlyCD_ctTooEarlyThres_C "Schwelle die MRlyCD_ctTooEarly_mp überschreiten muß bis Fehler Hauptrelais öffnet zu früh gemeldet wird" VALUE 0x1DF968 Kw_Wu8 255.0 OneToOne 0.00 255.0 FORMAT "%5.1" /end CHARACTERISTIC
/begin CHARACTERISTIC MRlyCD_stInvOutNAB_C "Invertierungsparameter für Notabschaltsignal" VALUE 0x1DF969 Kw_Wu8 1.000 OneToOne 0.00 1.000 FORMAT "%5.3" EXTENDED_LIMITS 0.00 255.0 READ_ONLY /end CHARACTERISTIC
/begin CHARACTERISTIC MRlyCD_stInvOutPSOFF_C "Invertierungsparameter für Abschaltsignal  des Spannungsstabilisators" VALUE 0x1DF96A Kw_Wu8 1.000 OneToOne 0.00 1.000 FORMAT "%5.3" EXTENDED_LIMITS 0.00 255.0 READ_ONLY /end CHARACTERISTIC
/begin CHARACTERISTIC MRlyCD_stInvOut_C "Invertierungsparameter für Hauptrelais Ausgangssignal" VALUE 0x1DF96B Kw_Wu8 1.000 OneToOne 0.00 1.000 FORMAT "%5.3" EXTENDED_LIMITS 0.00 255.0 READ_ONLY /end CHARACTERISTIC
/begin CHARACTERISTIC MRlyCD_tiNotOpen_C "Zeit nach dem Öffnen des Hauptrelais bis Fehler Hauptrelais öffnet nicht rechtzeitig erkannt wird" VALUE 0x1DF96C Kw_Wu16 655350.0 Time_ms 0.00 655350.0 FORMAT "%8.1" /end CHARACTERISTIC
/begin CHARACTERISTIC MSidCD_numECUS_C "Anzahl der ECU in diesem system: 1 - 4 (Master/Slave)" VALUE 0x1C0F90 Kw_Wu8 255.0 OneToOne 0.00 255.0 FORMAT "%5.1" /end CHARACTERISTIC
/begin CHARACTERISTIC MSid_swtMAIN_C "Typ der ECU: Single ECU=0xFF, Master Slave - Master: 0, Master Slave - Slave: 1,2,3 or 4" VALUE 0x1C0F91 Kw_Wu8 255.0 OneToOne 0.00 255.0 FORMAT "%5.1" /end CHARACTERISTIC
/begin CHARACTERISTIC NetMng_CANFadeOutMaskA_C "CAN-Ausblendmaske CAN A" VALUE 0x1DF96E Kw_Wu8 255.0 OneToOne 0.00 255.0 FORMAT "%5.1" /end CHARACTERISTIC
/begin CHARACTERISTIC NetMng_CANFadeOutMaskB_C "CAN-Ausblendmaske CAN B" VALUE 0x1DF96F Kw_Wu8 255.0 OneToOne 0.00 255.0 FORMAT "%5.1" /end CHARACTERISTIC
/begin CHARACTERISTIC NetMng_CANFadeOutMaskC_C "CAN-Ausblendmaske CAN C" VALUE 0x1DF970 Kw_Wu8 255.0 OneToOne 0.00 255.0 FORMAT "%5.1" /end CHARACTERISTIC
/begin CHARACTERISTIC NetMng_ctBusOffRetriesA_C "Zählergrenze für Recoveries nach Busoff CAN A" VALUE 0x1DF971 Kw_Wu8 254.0 OneToOne 1.000 255.0 FORMAT "%5.1" EXTENDED_LIMITS 0.00 255.0 /end CHARACTERISTIC
/begin CHARACTERISTIC NetMng_ctBusOffRetriesB_C "Zählergrenze für Recoveries nach Busoff CAN B" VALUE 0x1DF972 Kw_Wu8 254.0 OneToOne 1.000 255.0 FORMAT "%5.1" EXTENDED_LIMITS 0.00 255.0 /end CHARACTERISTIC
/begin CHARACTERISTIC NetMng_ctBusOffRetriesC_C "Zählergrenze für Recoveries nach Busoff CAN C" VALUE 0x1DF973 Kw_Wu8 254.0 OneToOne 1.000 255.0 FORMAT "%5.1" EXTENDED_LIMITS 0.00 255.0 /end CHARACTERISTIC
/begin CHARACTERISTIC NetMng_ctInitRetryCanA_C "Zählergrenze für Initretries CAN A" VALUE 0x1DF974 Kw_Wu8 255.0 OneToOne 0.00 255.0 FORMAT "%5.1" /end CHARACTERISTIC
/begin CHARACTERISTIC NetMng_ctInitRetryCanB_C "Zählergrenze für Initretries CAN B" VALUE 0x1DF975 Kw_Wu8 255.0 OneToOne 0.00 255.0 FORMAT "%5.1" /end CHARACTERISTIC
/begin CHARACTERISTIC NetMng_ctInitRetryCanC_C "Zählergrenze für Initretries CAN C" VALUE 0x1DF976 Kw_Wu8 255.0 OneToOne 0.00 255.0 FORMAT "%5.1" /end CHARACTERISTIC
/begin CHARACTERISTIC NetMng_tiDebBusOffOkCanA_C "Heilungsentprellzeit für BusOff Fehler von Can A" VALUE 0x1DF978 Kw_Wu16 2000.000 TimeDeb 0.00 2000.000 FORMAT "%8.3" EXTENDED_LIMITS 0.00 655350.0 /end CHARACTERISTIC
/begin CHARACTERISTIC NetMng_tiDebBusOffDefCanA_C "Entprellzeit für BusOff Fehler von Can A" VALUE 0x1DF97A Kw_Wu16 2000.000 TimeDeb 0.00 2000.000 FORMAT "%8.3" EXTENDED_LIMITS 0.00 655350.0 /end CHARACTERISTIC
/begin CHARACTERISTIC NetMng_tiDebBusOffOkCanB_C "Heilungsentprellzeit für BusOff Fehler von Can B" VALUE 0x1DF97C Kw_Wu16 2000.000 TimeDeb 0.00 2000.000 FORMAT "%8.3" EXTENDED_LIMITS 0.00 655350.0 /end CHARACTERISTIC
/begin CHARACTERISTIC NetMng_tiDebBusOffDefCanB_C "Entprellzeit für BusOff Fehler von Can B" VALUE 0x1DF97E Kw_Wu16 2000.000 TimeDeb 0.00 2000.000 FORMAT "%8.3" EXTENDED_LIMITS 0.00 655350.0 /end CHARACTERISTIC
/begin CHARACTERISTIC NetMng_tiDebBusOffOkCanC_C "Heilungsentprellzeit für BusOff Fehler von Can C" VALUE 0x1DF980 Kw_Wu16 2000.000 TimeDeb 0.00 2000.000 FORMAT "%8.3" EXTENDED_LIMITS 0.00 655350.0 /end CHARACTERISTIC
/begin CHARACTERISTIC NetMng_tiDebBusOffDefCanC_C "Entprellzeit für BusOff Fehler von Can C" VALUE 0x1DF982 Kw_Wu16 2000.000 TimeDeb 0.00 2000.000 FORMAT "%8.3" EXTENDED_LIMITS 0.00 655350.0 /end CHARACTERISTIC
/begin CHARACTERISTIC NetMng_tiDebErrOkCanA_C "Heilzeit ""error active"" Can A" VALUE 0x1DF984 Kw_Wu16 2000.000 TimeDeb 0.00 2000.000 FORMAT "%8.3" EXTENDED_LIMITS 0.00 655350.0 /end CHARACTERISTIC
/begin CHARACTERISTIC NetMng_tiDebErrDefCanA_C "Fehlerentprellzeit ""error active"" Can A" VALUE 0x1DF986 Kw_Wu16 655350.0 TimeDeb 0.00 655350.0 FORMAT "%8.1" /end CHARACTERISTIC
/begin CHARACTERISTIC NetMng_tiDebErrOkCanB_C "Heilzeit ""error active"" Can B" VALUE 0x1DF988 Kw_Wu16 2000.000 TimeDeb 0.00 2000.000 FORMAT "%8.3" EXTENDED_LIMITS 0.00 655350.0 /end CHARACTERISTIC
/begin CHARACTERISTIC NetMng_tiDebErrDefCanB_C "Fehlerentprellzeit ""error active"" Can B" VALUE 0x1DF98A Kw_Wu16 655350.0 TimeDeb 0.00 655350.0 FORMAT "%8.1" /end CHARACTERISTIC
/begin CHARACTERISTIC NetMng_tiDebErrOkCanC_C "Heilzeit ""error active"" Can C" VALUE 0x1DF98C Kw_Wu16 2000.000 TimeDeb 0.00 2000.000 FORMAT "%8.3" EXTENDED_LIMITS 0.00 655350.0 /end CHARACTERISTIC
/begin CHARACTERISTIC NetMng_tiDebErrDefCanC_C "Fehlerentprellzeit ""error active"" Can C" VALUE 0x1DF98E Kw_Wu16 655350.0 TimeDeb 0.00 655350.0 FORMAT "%8.1" /end CHARACTERISTIC
/begin CHARACTERISTIC NetMng_tiDebFadeoutASWInactvA_C "Entprellzeit Ausblendung für ASW aus Can A" VALUE 0x1DF990 Kw_Wu16 2000.000 TimeDeb 0.00 2000.000 FORMAT "%8.3" EXTENDED_LIMITS 0.00 655350.0 /end CHARACTERISTIC
/begin CHARACTERISTIC NetMng_tiDebFadeoutASWActvA_C "Entprellzeit Ausblendung für ASW ein Can A" VALUE 0x1DF992 Kw_Wu16 2000.000 TimeDeb 0.00 2000.000 FORMAT "%8.3" EXTENDED_LIMITS 0.00 655350.0 /end CHARACTERISTIC
/begin CHARACTERISTIC NetMng_tiDebFadeoutASWInactvB_C "Entprellzeit Ausblendung für ASW aus Can B" VALUE 0x1DF994 Kw_Wu16 2000.000 TimeDeb 0.00 2000.000 FORMAT "%8.3" EXTENDED_LIMITS 0.00 655350.0 /end CHARACTERISTIC
/begin CHARACTERISTIC NetMng_tiDebFadeoutASWActvB_C "Entprellzeit Ausblendung für ASW ein Can B" VALUE 0x1DF996 Kw_Wu16 2000.000 TimeDeb 0.00 2000.000 FORMAT "%8.3" EXTENDED_LIMITS 0.00 655350.0 /end CHARACTERISTIC
/begin CHARACTERISTIC NetMng_tiDebFadeoutASWInactvC_C "Entprellzeit Ausblendung für ASW aus Can C" VALUE 0x1DF998 Kw_Wu16 2000.000 TimeDeb 0.00 2000.000 FORMAT "%8.3" EXTENDED_LIMITS 0.00 655350.0 /end CHARACTERISTIC
/begin CHARACTERISTIC NetMng_tiDebFadeoutASWActvC_C "Entprellzeit Ausblendung für ASW ein Can C" VALUE 0x1DF99A Kw_Wu16 2000.000 TimeDeb 0.00 2000.000 FORMAT "%8.3" EXTENDED_LIMITS 0.00 655350.0 /end CHARACTERISTIC
/begin CHARACTERISTIC NetMng_tiDebFadeoutDiaInactvA_C "Entprellzeit CAN-Ausblendung aus Can A" VALUE 0x1DF99C Kw_Wu16 2000.000 TimeDeb 0.00 2000.000 FORMAT "%8.3" EXTENDED_LIMITS 0.00 655350.0 /end CHARACTERISTIC
/begin CHARACTERISTIC NetMng_tiDebFadeoutDiaActvA_C "Entprellzeit CAN-Ausblendung ein Can A" VALUE 0x1DF99E Kw_Wu16 2000.000 TimeDeb 0.00 2000.000 FORMAT "%8.3" EXTENDED_LIMITS 0.00 655350.0 /end CHARACTERISTIC
/begin CHARACTERISTIC NetMng_tiDebFadeoutDiaInactvB_C "Entprellzeit CAN-Ausblendung aus Can B" VALUE 0x1DF9A0 Kw_Wu16 2000.000 TimeDeb 0.00 2000.000 FORMAT "%8.3" EXTENDED_LIMITS 0.00 655350.0 /end CHARACTERISTIC
/begin CHARACTERISTIC NetMng_tiDebFadeoutDiaActvB_C "Entprellzeit CAN-Ausblendung ein Can B" VALUE 0x1DF9A2 Kw_Wu16 2000.000 TimeDeb 0.00 2000.000 FORMAT "%8.3" EXTENDED_LIMITS 0.00 655350.0 /end CHARACTERISTIC
/begin CHARACTERISTIC NetMng_tiDebFadeoutDiaInactvC_C "Entprellzeit CAN-Ausblendung aus Can C" VALUE 0x1DF9A4 Kw_Wu16 2000.000 TimeDeb 0.00 2000.000 FORMAT "%8.3" EXTENDED_LIMITS 0.00 655350.0 /end CHARACTERISTIC
/begin CHARACTERISTIC NetMng_tiDebFadeoutDiaActvC_C "Entprellzeit CAN-Ausblendung ein Can C" VALUE 0x1DF9A6 Kw_Wu16 2000.000 TimeDeb 0.00 2000.000 FORMAT "%8.3" EXTENDED_LIMITS 0.00 655350.0 /end CHARACTERISTIC
/begin CHARACTERISTIC NetMng_dRelBusCtrl_C "Zugehörigkeit Bus-Controller" VALUE 0x1DF9A8 Kw_Wu16 819.0000 OneToOne 0.00 819.0000 FORMAT "%8.4" EXTENDED_LIMITS 0.00 65535.00 /end CHARACTERISTIC
/begin CHARACTERISTIC NetMng_FadeOutMaskA_C "SW-Ausblendmaske CAN A" VALUE 0x1DF9AA Kw_Wu16 65535.00 OneToOne 0.00 65535.00 FORMAT "%8.2" /end CHARACTERISTIC
/begin CHARACTERISTIC NetMng_FadeOutMaskB_C "SW-Ausblendmaske CAN B" VALUE 0x1DF9AC Kw_Wu16 65535.00 OneToOne 0.00 65535.00 FORMAT "%8.2" /end CHARACTERISTIC
/begin CHARACTERISTIC NetMng_FadeOutMaskC_C "SW-Ausblendmaske CAN C" VALUE 0x1DF9AE Kw_Wu16 65535.00 OneToOne 0.00 65535.00 FORMAT "%8.2" /end CHARACTERISTIC
/begin CHARACTERISTIC NetMng_SplyVltgHysXLow_C "Untere Grenze Hysterese Versorgungsspannung" VALUE 0x1DF9B0 Kw_Ws16 13996.87 Volt_Batt 0.00 13996.87 FORMAT "%8.2" EXTENDED_LIMITS -665674.1 665653.8 /end CHARACTERISTIC
/begin CHARACTERISTIC NetMng_SplyVltgHysXHigh_C "Obere Grenze Hysterese Versorgungsspannung" VALUE 0x1DF9B2 Kw_Ws16 13996.87 Volt_Batt 0.00 13996.87 FORMAT "%8.2" EXTENDED_LIMITS -665674.1 665653.8 /end CHARACTERISTIC
/begin CHARACTERISTIC NetMng_SplyVltgHysYLow_C "Unterer Ausgangswert Hysterese Versorgungsspannung" VALUE 0x1DF9B4 Kw_Ws16 0.00 OneToOne 1.000000 1.000000 FORMAT "%8.6" EXTENDED_LIMITS -32768.00 32767.00 READ_ONLY /end CHARACTERISTIC
/begin CHARACTERISTIC NetMng_SplyVltgHysYHigh_C "Oberer Ausgangswert Hysterese Versorgungsspannung" VALUE 0x1DF9B6 Kw_Ws16 0.00 OneToOne 0.00 0.00 FORMAT "%8.2" EXTENDED_LIMITS -32768.00 32767.00 READ_ONLY /end CHARACTERISTIC
/begin CHARACTERISTIC NetMng_tiEngState_C "Ausblendzeit nach Start" VALUE 0x1DF9B8 Kw_Wu16 655350.0 Time_ms 0.00 655350.0 FORMAT "%8.1" /end CHARACTERISTIC
/begin CHARACTERISTIC NetMng_tiFadeoutGWSlpAck_C "Haltezeit für Fehlerausblendung  nach Sleep Acknowledge" VALUE 0x1DF9BA Kw_Wu16 655350.0 Time_ms 0.00 655350.0 FORMAT "%8.1" /end CHARACTERISTIC
/begin CHARACTERISTIC NetMng_tiFadeoutLowBat_C "Ausblendzeit nach Unterspannung Versorgung" VALUE 0x1DF9BC Kw_Wu16 655350.0 Time_ms 0.00 655350.0 FORMAT "%8.1" /end CHARACTERISTIC
/begin CHARACTERISTIC NetMng_tiFadeoutLowT15_C "Ausblendzeit nach Unterspannung K15" VALUE 0x1DF9BE Kw_Wu16 655350.0 Time_ms 0.00 655350.0 FORMAT "%8.1" /end CHARACTERISTIC
/begin CHARACTERISTIC NetMng_tiFadeoutMin_C "Ausblendzeit nach Initialisierung" VALUE 0x1DF9C0 Kw_Wu16 327670.0 Time_ms 0.00 327670.0 FORMAT "%8.1" EXTENDED_LIMITS 0.00 655350.0 /end CHARACTERISTIC
/begin CHARACTERISTIC NetMng_tiFadeoutSpareStrt_C "Ausblendzeit nach Notstart" VALUE 0x1DF9C2 Kw_Wu16 655350.0 Time_ms 0.00 655350.0 FORMAT "%8.1" /end CHARACTERISTIC
/begin CHARACTERISTIC NetMng_tiFrstLckTxMsgCanA_C "Sperrzeit für alle Sendebotschaften nach der ersten Initialisierung wenn ein BusOff aufgetreten ist für CAN A" VALUE 0x1DF9C4 Kw_Wu16 500.0000 Time_ms 0.00 500.0000 FORMAT "%8.4" EXTENDED_LIMITS 0.00 655350.0 /end CHARACTERISTIC
/begin CHARACTERISTIC NetMng_tiFrstLckTxMsgCanB_C "Sperrzeit für alle Sendebotschaften nach der ersten Initialisierung wenn ein BusOff aufgetreten ist für CAN B" VALUE 0x1DF9C6 Kw_Wu16 500.0000 Time_ms 0.00 500.0000 FORMAT "%8.4" EXTENDED_LIMITS 0.00 655350.0 /end CHARACTERISTIC
/begin CHARACTERISTIC NetMng_tiFrstLckTxMsgCanC_C "Sperrzeit für alle Sendebotschaften nach der ersten Initialisierung wenn ein BusOff aufgetreten ist für CAN C" VALUE 0x1DF9C8 Kw_Wu16 500.0000 Time_ms 0.00 500.0000 FORMAT "%8.4" EXTENDED_LIMITS 0.00 655350.0 /end CHARACTERISTIC
/begin CHARACTERISTIC NetMng_tiLckTxMsgAftIniCanA_C "Sperrzeit für die Sende Botschaften von  CAN Controller A nach BusOff (nach der zweiten Initialisierung))" VALUE 0x1DF9CA Kw_Wu16 500.0000 Time_ms 0.00 500.0000 FORMAT "%8.4" EXTENDED_LIMITS 0.00 655350.0 /end CHARACTERISTIC
/begin CHARACTERISTIC NetMng_tiLckTxMsgAftIniCanB_C "Sperrzeit für die Sende Botschaften von CAN controller B nach Busoff (nach der zweiten Initialisierung)" VALUE 0x1DF9CC Kw_Wu16 500.0000 Time_ms 0.00 500.0000 FORMAT "%8.4" EXTENDED_LIMITS 0.00 655350.0 /end CHARACTERISTIC
/begin CHARACTERISTIC NetMng_tiLckTxMsgAftIniCanC_C "Sperrzeit für die Sende Botschaften von  CAN Controller C nach BusOff (nach der zweiten Initialisierung)" VALUE 0x1DF9CE Kw_Wu16 500.0000 Time_ms 0.00 500.0000 FORMAT "%8.4" EXTENDED_LIMITS 0.00 655350.0 /end CHARACTERISTIC
/begin CHARACTERISTIC NetMng_tiRecoverA_C "Zeit zwischen den Recoveries Can A" VALUE 0x1DF9D0 Kw_Wu16 655200.0 Time_ms 150.0000 655350.0 FORMAT "%8.1" EXTENDED_LIMITS 0.00 655350.0 /end CHARACTERISTIC
/begin CHARACTERISTIC NetMng_tiRecoverB_C "Zeit zwischen den Recoveries Can B" VALUE 0x1DF9D2 Kw_Wu16 655200.0 Time_ms 150.0000 655350.0 FORMAT "%8.1" EXTENDED_LIMITS 0.00 655350.0 /end CHARACTERISTIC
/begin CHARACTERISTIC NetMng_tiRecoverC_C "Zeit zwischen den Recoveries Can C" VALUE 0x1DF9D4 Kw_Wu16 655200.0 Time_ms 150.0000 655350.0 FORMAT "%8.1" EXTENDED_LIMITS 0.00 655350.0 /end CHARACTERISTIC
/begin CHARACTERISTIC NSC_numPrio_C "Applikationswert für Testzwecke" VALUE 0x1DF9D8 Kw_Wu16 65535.00 OneToOne 0.00 65535.00 FORMAT "%8.2" /end CHARACTERISTIC
/begin CHARACTERISTIC NSC_st_C "Applikationswert für Testzwecke" VALUE 0x1DF9DC Kw_Wu32 4294967295.00 OneToOne 0.00 4294967295.00 FORMAT "%13.2" /end CHARACTERISTIC
/begin MEASUREMENT IVCtl_stVoltPI "Status des PI-Reglers (bit 0-2:obere Grenze, bit 3-5:untere Grenze - 0:top, 1:up, 2:dwn, 3:top, 4:up, 5:dwn)" UBYTE OneToOne 1 100 0.00 255.0 FORMAT "%5.1" ECU_ADDRESS 0x7F9475 /end MEASUREMENT
/begin MEASUREMENT IVCtl_uClsActrUp "Spannungssollwert für Aktorklassifizierung" SWORD Volt_PA 1 100 -327.6800 327.6700 FORMAT "%8.4" ECU_ADDRESS 0x7F9936 /end MEASUREMENT
/begin MEASUREMENT IVCtl_uCorrUp "Reglerausgang zur Korrektur der Aktorspannung" SWORD Volt_PA 1 100 -327.6800 327.6700 FORMAT "%8.4" ECU_ADDRESS 0x7F9938 /end MEASUREMENT
/begin MEASUREMENT IVCtl_uSetBott "Spannungssollwert für Bottom-Level" SWORD Volt_PA 1 100 -327.6800 327.6700 FORMAT "%8.4" ECU_ADDRESS 0x7F993A /end MEASUREMENT
/begin MEASUREMENT IVCtl_uSetOfsActr "Spannungssollwert fuer Spannungsoffsetberechnung" SWORD Volt_PA 1 100 -327.6800 327.6700 FORMAT "%8.4" ARRAY_SIZE 6 ECU_ADDRESS 0x7F9D3E /end MEASUREMENT
/begin MEASUREMENT IVCtl_uSetUpActr "Mittlerer aktorspezifischer Spannungssollwert für Piezo-Aktor (up-level)" SWORD Volt_PA 1 100 -327.6800 327.6700 FORMAT "%8.4" ARRAY_SIZE 6 ECU_ADDRESS 0x7F9D4A /end MEASUREMENT
/begin MEASUREMENT IVCtl_uSetUpActrUnCorr_mp "unkorrigierter Spannungssollwert (Up-Niveau)" SWORD Volt_PA 1 100 -327.6800 327.6700 FORMAT "%8.4" ARRAY_SIZE 6 ECU_ADDRESS 0x8033B2 /end MEASUREMENT
/begin MEASUREMENT IVCtl_uSetUpActrUnLim_mp "Nicht begrenzter, korrigierter, mittlerer, aktorspezifischer Spannungssollwert für Piezo-Aktor (up-level)" SWORD Volt_PA 1 100 -327.6800 327.6700 FORMAT "%8.4" ARRAY_SIZE 6 ECU_ADDRESS 0x8033BE /end MEASUREMENT
/begin MEASUREMENT IVCtl_uSetUpPreCtl_mp "Vorsteuerwert für Spannungssollwertberechnung" SWORD Volt_PA 1 100 -327.6800 327.6700 FORMAT "%8.4" ECU_ADDRESS 0x8033CA /end MEASUREMENT
/begin MEASUREMENT IVCtl_uSetUpTmp_mp "Temporärer gemittelter und gefilterter Spannungssollwert des Piezo-Aktors (up-level)" SWORD Volt_PA 1 100 -327.6800 327.6700 FORMAT "%8.4" ECU_ADDRESS 0x8033CC /end MEASUREMENT
/begin MEASUREMENT IVCtl_uUpInPI "Eingangsgröße der Spannungsreglers" SWORD Volt_PA 1 100 -327.6800 327.6700 FORMAT "%8.4" ECU_ADDRESS 0x7F993C /end MEASUREMENT
/begin MEASUREMENT IVCtl_uUpInPIActr_mp "Regelabweichung des Spannungsreglers (aktorspezifisch)" SWORD Volt_PA 1 100 -327.6800 327.6700 FORMAT "%8.4" ARRAY_SIZE 6 ECU_ADDRESS 0x8033CE /end MEASUREMENT
/begin MEASUREMENT IVCtl_uUpInPIMaxActr_mp "Maximale Regelabweichung des Spannungsreglers (aktorspezifisch)" SWORD Volt_PA 1 100 -327.6800 327.6700 FORMAT "%8.4" ARRAY_SIZE 6 ECU_ADDRESS 0x8033DA /end MEASUREMENT
/begin MEASUREMENT IVCtl_uUpInPIMax_mp "Maximale Regelabweichung des Spannungsreglers (gemittelt)" SWORD Volt_PA 1 100 -327.6800 327.6700 FORMAT "%8.4" ECU_ADDRESS 0x8033E6 /end MEASUREMENT
/begin MEASUREMENT IVCtl_uUpInPIMinActr_mp "Minimale Regelabweichung des Spannungsreglers (aktorspezifisch)" SWORD Volt_PA 1 100 -327.6800 327.6700 FORMAT "%8.4" ARRAY_SIZE 6 ECU_ADDRESS 0x8033E8 /end MEASUREMENT
/begin MEASUREMENT IVCtl_uUpInPIMin_mp "Minimale Regelabweichung des Spannungsreglers (gemittelt)" SWORD Volt_PA 1 100 -327.6800 327.6700 FORMAT "%8.4" ECU_ADDRESS 0x8033F4 /end MEASUREMENT
/begin MEASUREMENT IVCtl_uUpTmp_mp "Gemittelte Spannungsistwerte des Piezoaktors (Up-Niveau)" SWORD Volt_PA 1 100 -327.6800 327.6700 FORMAT "%8.4" ECU_ADDRESS 0x8033F6 /end MEASUREMENT
/begin MEASUREMENT LIGov_nAvrg_mp "OLDA-Größe für Eng_nAvrg" SWORD EngN 1 100 -32768.00 32767.00 FORMAT "%8.2" ECU_ADDRESS 0x8033FA /end MEASUREMENT
/begin MEASUREMENT LIGov_nDiff_mp "n Regelabweichung" SWORD EngN 1 100 -32768.00 32767.00 FORMAT "%8.2" ECU_ADDRESS 0x8033FC /end MEASUREMENT
/begin MEASUREMENT LIGov_nLim "erhöhte Leerlauf-Solldrehzahl" SWORD EngN 1 100 -32768.00 32767.00 FORMAT "%8.2" ECU_ADDRESS 0x7F9A34 /end MEASUREMENT
/begin MEASUREMENT LIGov_nRgn_mp "Meßpunkt für die LL-Drehzahlanhebung je nach Regenerationsstufe" SWORD EngN 1 100 -32768.00 32767.00 FORMAT "%8.2" ECU_ADDRESS 0x8033FE /end MEASUREMENT
/begin MEASUREMENT LIGov_nSetpoint "Untergrenze Drehzahlintervall des LIGov" SWORD EngN 1 100 -32768.00 32767.00 FORMAT "%8.2" ECU_ADDRESS 0x7F9A36 /end MEASUREMENT
/begin MEASUREMENT LIGov_nSetpointTemp "Sollwert Leerlaufregler temperaturabhängig" SWORD EngN 1 100 -32768.00 32767.00 FORMAT "%8.2" ECU_ADDRESS 0x7F9A38 /end MEASUREMENT
/begin MEASUREMENT LIGov_nSetpointTrmEEP_mp "Limitierter EEPROM Abgleichwert von LIGOV_SETDIA" SWORD EngN 1 100 -32768.00 32767.00 FORMAT "%8.2" ECU_ADDRESS 0x8033F8 /end MEASUREMENT
/begin MEASUREMENT LIGov_st "Zustand des Leerlaufreglers" UWORD OneToOne 1 100 0.00 65535.00 FORMAT "%8.2" ECU_ADDRESS 0x7F9A3A /end MEASUREMENT
/begin MEASUREMENT LIGov_stCalcRgnMsk_mp "Statusbyte des Regenerationseingriffs" UBYTE OneToOne 1 100 0.00 255.0 FORMAT "%5.1" ECU_ADDRESS 0x803400 /end MEASUREMENT
/begin MEASUREMENT LIGov_stFFCalcRgnMsk_mp "Statusbyte nach dem Flip Flop des Regenerationseingriffs" UBYTE OneToOne 1 100 0.00 255.0 FORMAT "%5.1" ECU_ADDRESS 0x803401 /end MEASUREMENT
/begin MEASUREMENT LIGov_swtParDriveoff "SW-Schalter für die Verwendung eines Parametersatzes DriveOff (Anfahren)" UBYTE OneToOne 1 100 0.00 255.0 FORMAT "%5.1" ECU_ADDRESS 0x7F94A5 /end MEASUREMENT
/begin MEASUREMENT LIGov_tEngHys_mp "Temperaturwert von dem Array Eng_tFld" SWORD Temp_Cels 1 100 -3549.940 3003.560 FORMAT "%8.3" ECU_ADDRESS 0x803402 /end MEASUREMENT
/begin MEASUREMENT LIGov_tEngTrqInit_mp "Temperaturwert von dem Array Eng_tFld" SWORD Temp_Cels 1 100 -3549.940 3003.560 FORMAT "%8.3" ECU_ADDRESS 0x803404 /end MEASUREMENT
/begin MEASUREMENT LIGov_tiPT1_mp "aktuelle PT1 Zeitkonstante für PT1 filtern des LLR Ausgangs" SWORD TimeDelay_s_Lin_16 1 100 -5.000153 5.000000 FORMAT "%8.6" ECU_ADDRESS 0x803406 /end MEASUREMENT
/begin MEASUREMENT LIGov_trq "Leerlaufreglermoment" SWORD Trq 1 100 -3276.800 3276.700 FORMAT "%8.3" ECU_ADDRESS 0x7F9A3C /end MEASUREMENT
/begin MEASUREMENT LIGov_trqCurrPredef "aktuell verwendetes Einsschrittmoment" SWORD Trq 1 100 -3276.800 3276.700 FORMAT "%8.3" ECU_ADDRESS 0x7F9A3E /end MEASUREMENT
/begin MEASUREMENT LIGov_trqD_mp "Messpunkt für den Wert des D-Anteils des LLR" SWORD Trq 1 100 -3276.800 3276.700 FORMAT "%8.3" ECU_ADDRESS 0x803408 /end MEASUREMENT
/begin MEASUREMENT LIGov_trqFlt "Leerlaufreglermoment PT1 gefiltert" SWORD Trq 1 100 -3276.800 3276.700 FORMAT "%8.3" ECU_ADDRESS 0x7F9A40 /end MEASUREMENT
/begin MEASUREMENT LIGov_trqI "Wert des I-Anteils des LLR" SWORD Trq 1 100 -3276.800 3276.700 FORMAT "%8.3" ECU_ADDRESS 0x7F9A42 /end MEASUREMENT
/begin MEASUREMENT LIGov_trqInitI "Initialisierungsmoment für I-Anteil nach Start" SWORD Trq 1 100 -3276.800 3276.700 FORMAT "%8.3" ECU_ADDRESS 0x7F9A44 /end MEASUREMENT
/begin MEASUREMENT LIGov_trqIState "LIGov Status des I-Anteils" SLONG Trq 1 100 -214748364.800 214748364.700 FORMAT "%13.3" ECU_ADDRESS 0x7F9CFC /end MEASUREMENT
/begin MEASUREMENT LIGov_trqI_mp "Messpunkt für den Wert des I-Anteils des LLR" SWORD Trq 1 100 -3276.800 3276.700 FORMAT "%8.3" ECU_ADDRESS 0x80340A /end MEASUREMENT
/begin MEASUREMENT LIGov_trqMax_mp "aktueller LLR Begrenzungswert" SWORD Trq 1 100 -3276.800 3276.700 FORMAT "%8.3" ECU_ADDRESS 0x80340C /end MEASUREMENT
/begin MEASUREMENT LIGov_trqP "Wert des P-Anteils des LLR" SWORD Trq 1 100 -3276.800 3276.700 FORMAT "%8.3" ECU_ADDRESS 0x7F9A46 /end MEASUREMENT
/begin MEASUREMENT LIGov_trqP_mp "Messpunkt für den Wert des P-Anteils des LLR" SWORD Trq 1 100 -3276.800 3276.700 FORMAT "%8.3" ECU_ADDRESS 0x80340E /end MEASUREMENT
/begin MEASUREMENT LockCnt_tiLock "Zeit in Minuten die das ECU gesperrt bleibt." UBYTE OneToOne 1 100 0.00 255.0 FORMAT "%5.1" ECU_ADDRESS 0x7F94CC /end MEASUREMENT
/begin MEASUREMENT LSUCD_ctHtCoup "Zähler für LSU Diagnose Heizerkopplung" UWORD OneToOne 1 100 0.00 65535.00 FORMAT "%8.2" ARRAY_SIZE 1 ECU_ADDRESS 0x7F9A48 /end MEASUREMENT
/begin MEASUREMENT LSUCD_d2rO2Eval_mp "Bewertungsgröße für Lernfortschritt" SWORD O2 1 100 -0.3276800 0.3276700 FORMAT "%9.7" ARRAY_SIZE 1 ECU_ADDRESS 0x80342E /end MEASUREMENT
/begin MEASUREMENT LSUCD_d2rO2_mp "Eingangsgröße des Bewertungsfilters" SWORD O2 1 100 -0.3276800 0.3276700 FORMAT "%9.7" ARRAY_SIZE 1 ECU_ADDRESS 0x803430 /end MEASUREMENT
/begin MEASUREMENT LSUCD_dcycHtCor "Tastverhältnis Heizer Endstufe nach Batteriespannungs Korrektur" SWORD DtyCyc 1 100 -327.6800 327.6700 FORMAT "%8.4" ARRAY_SIZE 1 ECU_ADDRESS 0x7F9A4A /end MEASUREMENT
/begin MEASUREMENT LSUCD_dcycHtCoupStep1 "Heizungs-Aufgabe fährt im ersten Signalerwerbungs-Zyklus rad" SWORD DtyCyc 1 100 -327.6800 327.6700 FORMAT "%8.4" ARRAY_SIZE 1 ECU_ADDRESS 0x7F9A4C /end MEASUREMENT
/begin MEASUREMENT LSUCD_dcycHtCoupStep2 "Heizungs-Aufgabe fährt im zweiten Signalerwerbungs-Zyklus rad" SWORD DtyCyc 1 100 -327.6800 327.6700 FORMAT "%8.4" ARRAY_SIZE 1 ECU_ADDRESS 0x7F9A4E /end MEASUREMENT
/begin MEASUREMENT LSUCD_dcycHtCoupStep3 "Heizungs-Aufgabe fährt im dritten Signalerwerbungs-Zyklus rad" SWORD DtyCyc 1 100 -327.6800 327.6700 FORMAT "%8.4" ARRAY_SIZE 1 ECU_ADDRESS 0x7F9A50 /end MEASUREMENT
/begin MEASUREMENT LSUCD_dcycLimActHt "Aktuelle Tastverhältnisgrenze Heizeransteuerung für nominales Tastverhältnis (vor Korrektur)" SWORD DtyCyc 1 100 -327.6800 327.6700 FORMAT "%8.4" ECU_ADDRESS 0x7F9A52 /end MEASUREMENT
/begin MEASUREMENT LSUCD_dcycRippel_mp "Änderung des Heizungs-Tastverhältnisses bei Diagnose der Heizungskopplung" SWORD DtyCyc 1 100 -327.6800 327.6700 FORMAT "%8.4" ARRAY_SIZE 1 ECU_ADDRESS 0x803454 /end MEASUREMENT
/begin MEASUREMENT LSUCD_dHtCoupStep "Schieberegister für die Aufzeichnung der Werte" UBYTE OneToOne 1 100 0.00 255.0 FORMAT "%5.1" ECU_ADDRESS 0x7F94A6 /end MEASUREMENT
/begin MEASUREMENT LSUCD_dHtCoupStepLast "Letzter Wert des Schieberegisters" UBYTE OneToOne 1 100 0.00 255.0 FORMAT "%5.1" ECU_ADDRESS 0x7F94A7 /end MEASUREMENT
/begin MEASUREMENT LSUCD_drO2Adpt "Eingelernter absoluter Messfehler der Sauerstoffkonzentration" SWORD O2 1 100 -0.3276800 0.3276700 FORMAT "%9.7" ARRAY_SIZE 1 ECU_ADDRESS 0x7F9A54 /end MEASUREMENT
/begin MEASUREMENT LSUCD_drO2Flt_mp "Ausgangsgröße des Adaptionsfilters" SWORD O2 1 100 -0.3276800 0.3276700 FORMAT "%9.7" ARRAY_SIZE 1 ECU_ADDRESS 0x803432 /end MEASUREMENT
/begin MEASUREMENT LSUCD_facO2Corr_mp "Aktueller Korrekturfaktor der Adaption" SWORD Fact 1 100 -4.000000 3.999878 FORMAT "%8.6" ARRAY_SIZE 1 ECU_ADDRESS 0x803434 /end MEASUREMENT
/begin MEASUREMENT LSUCD_facPresComp_mp "Druckkorrekturfaktor" SWORD Fact 1 100 -4.000000 3.999878 FORMAT "%8.6" ARRAY_SIZE 1 ECU_ADDRESS 0x803448 /end MEASUREMENT
/begin MEASUREMENT LSUCD_facUCor_mp "Korrektur Faktor für Heizeranforderung" SWORD Fact 1 100 -4.000000 3.999878 FORMAT "%8.6" ECU_ADDRESS 0x80343C /end MEASUREMENT
/begin MEASUREMENT LSUCD_mAirAftOvrRun_mp "Integral über Luftmassenstrom seit Beginn der Schubphase" SWORD AirMass_2 1 100 -3276.800 3276.700 FORMAT "%8.3" ECU_ADDRESS 0x803436 /end MEASUREMENT
/begin MEASUREMENT LSUCD_pExhGasLstVal_mp "Abgas-Wert des letzten geschätzten Sensors" SWORD Pres_hPa 1 100 -32768.00 32767.00 FORMAT "%8.2" ECU_ADDRESS 0x80344A /end MEASUREMENT
/begin MEASUREMENT LSUCD_resRi "Ri Meßwert (gefiltert und korrigiert)" SWORD Resist 1 100 -3276.800 3276.700 FORMAT "%8.3" ARRAY_SIZE 1 ECU_ADDRESS 0x7F9A5E /end MEASUREMENT
/begin MEASUREMENT LSUCD_resRiChange_mp "Betrag der Ri-Änderung mit dem letzten gefilterten Wert" SWORD Resist 1 100 -3276.800 3276.700 FORMAT "%8.3" ARRAY_SIZE 1 ECU_ADDRESS 0x80344C /end MEASUREMENT
/begin MEASUREMENT LSUCD_resRiClb "Korrekturwert Ri Offset" SWORD Resist 1 100 -3276.800 3276.700 FORMAT "%8.3" ARRAY_SIZE 1 ECU_ADDRESS 0x7F9A60 /end MEASUREMENT
/begin MEASUREMENT LSUCD_resRiClbRaw_mp "Rohwert Ri Korrektur ohne Filterung" SWORD Resist 1 100 -3276.800 3276.700 FORMAT "%8.3" ARRAY_SIZE 1 ECU_ADDRESS 0x80344E /end MEASUREMENT
/begin MEASUREMENT LSUCD_resRiHtCoupStep1 "Innerer Wiederstand im ersten Datenakquisitionszyklus" SWORD Resist 1 100 -3276.800 3276.700 FORMAT "%8.3" ARRAY_SIZE 1 ECU_ADDRESS 0x7F9A62 /end MEASUREMENT
/begin MEASUREMENT LSUCD_resRiHtCoupStep2 "Innerer Wiederstand im zweiten Datenakquisitionszyklus" SWORD Resist 1 100 -3276.800 3276.700 FORMAT "%8.3" ARRAY_SIZE 1 ECU_ADDRESS 0x7F9A64 /end MEASUREMENT
/begin MEASUREMENT LSUCD_resRiHtCoupStep3 "Innerer Wiederstand im dritten Datenakquisitionszyklus" SWORD Resist 1 100 -3276.800 3276.700 FORMAT "%8.3" ARRAY_SIZE 1 ECU_ADDRESS 0x7F9A66 /end MEASUREMENT
/begin MEASUREMENT LSUCD_resRiRaw "Ri Meßwert ohne Korrektur" SWORD Resist 1 100 -3276.800 3276.700 FORMAT "%8.3" ARRAY_SIZE 1 ECU_ADDRESS 0x7F9A68 /end MEASUREMENT
/begin MEASUREMENT LSUCD_resRiRippel_mp "Änderung des Innenwiderstands bei Freigabe der Heizung" SWORD Resist 1 100 -3276.800 3276.700 FORMAT "%8.3" ARRAY_SIZE 1 ECU_ADDRESS 0x803456 /end MEASUREMENT
/begin MEASUREMENT LSUCD_resRi_mp "Ri-Messwert gefiltert und korrigiert" SWORD Resist 1 100 -3276.800 3276.700 FORMAT "%8.3" ECU_ADDRESS 0x803450 /end MEASUREMENT
/begin MEASUREMENT LSUCD_rO2Act "Aktueller O2 Meßwert ohne Ausblendung Abgleichvorgang" SWORD O2 1 100 -0.3276800 0.3276700 FORMAT "%9.7" ARRAY_SIZE 1 ECU_ADDRESS 0x7F9A56 /end MEASUREMENT
/begin MEASUREMENT LSUCD_rO2Adpt "Adaptierte Sauerstoffkonzentration" SWORD O2 1 100 -0.3276800 0.3276700 FORMAT "%9.7" ARRAY_SIZE 1 ECU_ADDRESS 0x7F9A58 /end MEASUREMENT
/begin MEASUREMENT LSUCD_rO2PresComp "Druckkompensierte Sauerstoffkonzentration" SWORD O2 1 100 -0.3276800 0.3276700 FORMAT "%9.7" ARRAY_SIZE 1 ECU_ADDRESS 0x7F9A5A /end MEASUREMENT
/begin MEASUREMENT LSUCD_rO2Raw "O2 Wert ohne Druck- und Empfindlichkeitskorrektur" SWORD O2 1 100 -0.3276800 0.3276700 FORMAT "%9.7" ARRAY_SIZE 1 ECU_ADDRESS 0x7F9A5C /end MEASUREMENT
/begin MEASUREMENT LSUCD_rOutHWE_mp "Tastverhältnis Heizerendstufe nach Stellertest Anforderung und Endstufen Diagnose." SWORD DtyCyc 1 100 -327.6800 327.6700 FORMAT "%8.4" ARRAY_SIZE 1 ECU_ADDRESS 0x80343E /end MEASUREMENT
/begin MEASUREMENT LSUCD_stAdpt "Zustandsgröße der Adaption (adaptiert / nicht adaptiert)" UBYTE OneToOne 1 100 0.00 255.0 FORMAT "%5.1" ARRAY_SIZE 1 ECU_ADDRESS 0x7F94A8 /end MEASUREMENT
/begin MEASUREMENT LSUCD_stAdptActv_mp "Zustand der Lernphase (aktiv / nicht aktiv)" UBYTE OneToOne 1 100 0.00 255.0 FORMAT "%5.1" ARRAY_SIZE 1 ECU_ADDRESS 0x803438 /end MEASUREMENT
/begin MEASUREMENT LSUCD_stChange_mp "Neues Lernergebnis im aktuellen Fahrzyklus" UBYTE OneToOne 1 100 0.00 255.0 FORMAT "%5.1" ARRAY_SIZE 1 ECU_ADDRESS 0x803439 /end MEASUREMENT
/begin MEASUREMENT LSUCD_stCircModeNew "Aktueller Wert des Auswerteschaltungs Modes (CJ 120 Konfiguration)" UWORD OneToOne 1 100 0.00 65535.00 FORMAT "%8.2" ARRAY_SIZE 1 ECU_ADDRESS 0x7F9A6A /end MEASUREMENT
/begin MEASUREMENT LSUCD_stDiaIAEna "Message um die Erkennung von IA oder IP Kurzschluss nach Masse freizugeben" UBYTE OneToOne 1 100 0.00 255.0 FORMAT "%5.1" ARRAY_SIZE 1 ECU_ADDRESS 0x7F94AA /end MEASUREMENT
/begin MEASUREMENT LSUCD_stHold_mp "Zustandsgröße der Adaption (gestört / nicht gestört)" UBYTE OneToOne 1 100 0.00 255.0 FORMAT "%5.1" ARRAY_SIZE 1 ECU_ADDRESS 0x80343A /end MEASUREMENT
/begin MEASUREMENT LSUCD_stHtCoupActv "Statusbotschaft für Heizungskopplung aktiv" UBYTE OneToOne 1 100 0.00 255.0 FORMAT "%5.1" ECU_ADDRESS 0x7F94AB /end MEASUREMENT
/begin MEASUREMENT LSUCD_stHtDis "Zustand Heizerabschaltung wegen Batteriespannung oder Betriebsmodus" UBYTE OneToOne 1 100 0.00 255.0 FORMAT "%5.1" ECU_ADDRESS 0x7F94AC /end MEASUREMENT
/begin MEASUREMENT LSUCD_stInitClb "Erste CJ120-Kalibrierung wurde angefordert" UBYTE OneToOne 1 100 0.00 255.0 FORMAT "%5.1" ECU_ADDRESS 0x7F94AD /end MEASUREMENT
/begin MEASUREMENT LSUCD_stIpHighCurEna "Status-Message für hohen (0 bis 150ua) Referenzpumpstrom für CJ125" UBYTE OneToOne 1 100 0.00 255.0 FORMAT "%5.1" ARRAY_SIZE 1 ECU_ADDRESS 0x7F94AE /end MEASUREMENT
/begin MEASUREMENT LSUCD_stIpNormCurEna "Status-Message für normalen (0 bis 150ua) Referenzpumpstrom für CJ125" UBYTE OneToOne 1 100 0.00 255.0 FORMAT "%5.1" ARRAY_SIZE 1 ECU_ADDRESS 0x7F94AF /end MEASUREMENT
/begin MEASUREMENT LSUCD_stIsolChkActv "Nebenschlußerkennung ist momentan aktiv" UBYTE OneToOne 1 100 0.00 255.0 FORMAT "%5.1" ARRAY_SIZE 1 ECU_ADDRESS 0x7F94B0 /end MEASUREMENT
/begin MEASUREMENT LSUCD_stIsolChkO2Last "Status ob die O2 Konzentration im letzten Zyklus innerhalb des vorgegebenen Fensters war" UBYTE OneToOne 1 100 0.00 255.0 FORMAT "%5.1" ARRAY_SIZE 1 ECU_ADDRESS 0x7F94B1 /end MEASUREMENT
/begin MEASUREMENT LSUCD_stIsolChkStrt "Statusmessage zum Starten der Nebenschlusserkennung" UBYTE OneToOne 1 100 0.00 255.0 FORMAT "%5.1" ARRAY_SIZE 1 ECU_ADDRESS 0x7F94B2 /end MEASUREMENT
/begin MEASUREMENT LSUCD_stO2Act "Gültigkeitsstatus des aktuellen O2 Signals (0 = ungültig, 1 = gültig)" UBYTE OneToOne 1 100 0.00 255.0 FORMAT "%5.1" ARRAY_SIZE 1 ECU_ADDRESS 0x7F94B3 /end MEASUREMENT
/begin MEASUREMENT LSUCD_stO2ClbEna "Auslösesignal für O2 Offsetspannung Kalibriersequenz" UBYTE OneToOne 1 100 0.00 255.0 FORMAT "%5.1" ECU_ADDRESS 0x7F94B4 /end MEASUREMENT
/begin MEASUREMENT LSUCD_stO2Clb_mp "Zusatands Bits der O2 Offset Abgleich Sequenz" UBYTE OneToOne 1 100 0.00 255.0 FORMAT "%5.1" ECU_ADDRESS 0x803442 /end MEASUREMENT
/begin MEASUREMENT LSUCD_stO2IntValid "Status des internen O2-Rohsignals (gültig/ungültig)" UBYTE OneToOne 1 100 0.00 255.0 FORMAT "%5.1" ARRAY_SIZE 1 ECU_ADDRESS 0x7F94B5 /end MEASUREMENT
/begin MEASUREMENT LSUCD_stO2SPICalDem "SPI Status-Message um die Schaltung in den Kalibriermodus zu versetzen" UBYTE OneToOne 1 100 0.00 255.0 FORMAT "%5.1" ECU_ADDRESS 0x7F94B6 /end MEASUREMENT
/begin MEASUREMENT LSUCD_stO2SPISens "Modus-Bits zum Setzen der Empfindlichkeit der O2-Auswertung" UWORD OneToOne 1 100 0.00 65535.00 FORMAT "%8.2" ARRAY_SIZE 1 ECU_ADDRESS 0x7F9A6C /end MEASUREMENT
/begin MEASUREMENT LSUCD_stO2Valid "Zustand O2 Signal (0 = ungültig, 1 = gültig)" UBYTE OneToOne 1 100 0.00 255.0 FORMAT "%5.1" ARRAY_SIZE 1 ECU_ADDRESS 0x7F94B7 /end MEASUREMENT
/begin MEASUREMENT LSUCD_stOpnErrIP "Status Leerlauf-Fehler Pumpstrom Pin (IP)" UBYTE OneToOne 1 100 0.00 255.0 FORMAT "%5.1" ARRAY_SIZE 1 ECU_ADDRESS 0x7F94B8 /end MEASUREMENT
/begin MEASUREMENT LSUCD_stOpnLdTstActv "Message von LSU_WireDiagnosis, die anzeigt, ob die Kabelunterbrechungsdiagnose für Nernst-Zelle und virtuelle Masse aktiv ist" UBYTE OneToOne 1 100 0.00 255.0 FORMAT "%5.1" ARRAY_SIZE 1 ECU_ADDRESS 0x7F94B9 /end MEASUREMENT
/begin MEASUREMENT LSUCD_stPumpCtl "Status der Pumpensteuerung (ein/aus)" UBYTE OneToOne 1 100 0.00 255.0 FORMAT "%5.1" ARRAY_SIZE 1 ECU_ADDRESS 0x7F94BA /end MEASUREMENT
/begin MEASUREMENT LSUCD_stPumpDemRef "externe Anforderung Referenzpumpströme" UBYTE OneToOne 1 100 0.00 255.0 FORMAT "%5.1" ARRAY_SIZE 1 ECU_ADDRESS 0x7F94BB /end MEASUREMENT
/begin MEASUREMENT LSUCD_stPumpEna "Zustand der CJ 120 Pumpstromregelung (0 = abgeschaltet, 1 = aktiv = Strom angeschaltet)" UBYTE OneToOne 1 100 0.00 255.0 FORMAT "%5.1" ARRAY_SIZE 1 ECU_ADDRESS 0x7F94BC /end MEASUREMENT
/begin MEASUREMENT LSUCD_stRecValEval_mp "Messpunkt für den Status der Auswertung erfasster Werte in der Heizungskopplung" UBYTE OneToOne 1 100 0.00 255.0 FORMAT "%5.1" ARRAY_SIZE 1 ECU_ADDRESS 0x803458 /end MEASUREMENT
/begin MEASUREMENT LSUCD_stRefCurTrans_mp "Status des Übergangs von hohem zu niedrigem Strom" UBYTE OneToOne 1 100 0.00 255.0 FORMAT "%5.1" ARRAY_SIZE 1 ECU_ADDRESS 0x803440 /end MEASUREMENT
/begin MEASUREMENT LSUCD_stRefPump "Status der Referenz Pumpströme (0 = off, 1 = 20 uA, 2 = 40 uA, 3 = 60 uA)" UBYTE OneToOne 1 100 0.00 255.0 FORMAT "%5.1" ARRAY_SIZE 1 ECU_ADDRESS 0x7F94BD /end MEASUREMENT
/begin MEASUREMENT LSUCD_stRgnEna "Nachricht, um Regeneration zu befähigen" UBYTE OneToOne 1 100 0.00 255.0 FORMAT "%5.1" ECU_ADDRESS 0x7F94BE /end MEASUREMENT
/begin MEASUREMENT LSUCD_stRgnIpSettle "Status des Pumpe-Stromes, der nach Regeneration setzt" UBYTE OneToOne 1 100 0.00 255.0 FORMAT "%5.1" ECU_ADDRESS 0x7F94BF /end MEASUREMENT
/begin MEASUREMENT LSUCD_stRiClb "Status der Ri-Kalibrierungssequenz" UBYTE OneToOne 1 100 0.00 255.0 FORMAT "%5.1" ECU_ADDRESS 0x7F94C0 /end MEASUREMENT
/begin MEASUREMENT LSUCD_stRiClbEna "Auslöser für Ri Abgleichsequenz" UBYTE OneToOne 1 100 0.00 255.0 FORMAT "%5.1" ECU_ADDRESS 0x7F94C1 /end MEASUREMENT
/begin MEASUREMENT LSUCD_stRiFltAct_mp "Messpunkt für den Status der Filteraktivierung" UBYTE OneToOne 1 100 0.00 255.0 FORMAT "%5.1" ARRAY_SIZE 1 ECU_ADDRESS 0x803452 /end MEASUREMENT
/begin MEASUREMENT LSUCD_stRiLimSlp_mp "Zustand der Ri Störungsunterdrückung" UBYTE OneToOne 1 100 0.00 255.0 FORMAT "%5.1" ARRAY_SIZE 1 ECU_ADDRESS 0x803453 /end MEASUREMENT
/begin MEASUREMENT LSUCD_stRiSPICalDem "Anforderung der Ri-Regelung Einschaltung des Lern- oder Messmodus" UBYTE OneToOne 1 100 0.00 255.0 FORMAT "%5.1" ECU_ADDRESS 0x7F94C2 /end MEASUREMENT
/begin MEASUREMENT LSUCD_stRiValid "Zustand Ri Signals (0 = ungültig, 1 = gültig)" UBYTE OneToOne 1 100 0.00 255.0 FORMAT "%5.1" ARRAY_SIZE 1 ECU_ADDRESS 0x7F94C3 /end MEASUREMENT
/begin MEASUREMENT LSUCD_stSPIDiaInfo "Status der SPI Chip Diagnose" UWORD OneToOne 1 100 0.00 65535.00 FORMAT "%8.2" ARRAY_SIZE 1 ECU_ADDRESS 0x7F9A6E /end MEASUREMENT
/begin MEASUREMENT LSUCD_stSPIInitVal "Wert des CJ12x Initialisierungsregisters" UWORD OneToOne 1 100 0.00 65535.00 FORMAT "%8.2" ARRAY_SIZE 1 ECU_ADDRESS 0x7F9A70 /end MEASUREMENT
/begin MEASUREMENT LSUCD_stSRCState_mp "Status der SRC Überwachung des O2 Rohsignales" UBYTE OneToOne 1 100 0.00 255.0 FORMAT "%5.1" ARRAY_SIZE 1 ECU_ADDRESS 0x803443 /end MEASUREMENT
/begin MEASUREMENT LSUCD_stTstTrigger_mp "Messpunkt für den Status zur Auslösung des Tests der Nebenschlusserkennung" UBYTE OneToOne 1 100 0.00 255.0 FORMAT "%5.1" ARRAY_SIZE 1 ECU_ADDRESS 0x803459 /end MEASUREMENT
/begin MEASUREMENT LSUCD_stWireDiaChk_mp "Bitfeld: Unterdiagnosen ausgeführt" UBYTE OneToOne 1 100 0.00 255.0 FORMAT "%5.1" ARRAY_SIZE 1 ECU_ADDRESS 0x80345A /end MEASUREMENT
/begin MEASUREMENT LSUCD_stWireDiaErr_mp "Status des Fehlers Nebenschlusserkennung" UBYTE OneToOne 1 100 0.00 255.0 FORMAT "%5.1" ARRAY_SIZE 1 ECU_ADDRESS 0x80345B /end MEASUREMENT
/begin MEASUREMENT LSUCD_swtAdpt "Schalter für Adaption der Lambda-Sonde" UBYTE OneToOne 1 100 0.00 255.0 FORMAT "%5.1" ECU_ADDRESS 0x7F94C4 /end MEASUREMENT
/begin MEASUREMENT LSUCD_tRi "Äquivalenztemperatur des gemessenen Ri-Werts" SWORD Temp_Cels 1 100 -3549.940 3003.560 FORMAT "%8.3" ARRAY_SIZE 1 ECU_ADDRESS 0x7F9A72 /end MEASUREMENT
/begin MEASUREMENT LSUCD_uO2Clb "Offsetspannungs Korrekturwert für Lambda Spannungswert" SWORD Volt 1 100 -160156.4 160151.5 FORMAT "%8.1" ARRAY_SIZE 1 ECU_ADDRESS 0x7F9A74 /end MEASUREMENT
/begin MEASUREMENT LSUCD_uO2FltRippel_mp "Gefilterte, überlagerte Sauerstoff-Wechselspannung bei Diagnose der Heizungskopplung" SWORD Volt 1 100 -160156.4 160151.5 FORMAT "%8.1" ARRAY_SIZE 1 ECU_ADDRESS 0x80345C /end MEASUREMENT
/begin MEASUREMENT LSUCD_uO2Grad_mp "Gradient der Sauerstoff-Spannung bei Diagnose der Heizungskopplung" SWORD Volt 1 100 -160156.4 160151.5 FORMAT "%8.1" ARRAY_SIZE 1 ECU_ADDRESS 0x80345E /end MEASUREMENT
/begin MEASUREMENT LSUCD_uO2HtCoupStep1 "O2 Konzentration im ersten Datenakquisitionszyklus" SWORD Volt 1 100 -160156.4 160151.5 FORMAT "%8.1" ARRAY_SIZE 1 ECU_ADDRESS 0x7F9A76 /end MEASUREMENT
/begin MEASUREMENT LSUCD_uO2HtCoupStep2 "O2 Konzentration im zweiten Datenakquisitionszyklus" SWORD Volt 1 100 -160156.4 160151.5 FORMAT "%8.1" ARRAY_SIZE 1 ECU_ADDRESS 0x7F9A78 /end MEASUREMENT
/begin MEASUREMENT LSUCD_uO2HtCoupStep3 "O2 Konzentration im dritten Datenakquisitionszyklus" SWORD Volt 1 100 -160156.4 160151.5 FORMAT "%8.1" ARRAY_SIZE 1 ECU_ADDRESS 0x7F9A7A /end MEASUREMENT
/begin MEASUREMENT LSUCD_uO2OfsCor_mp "O2 Spannungswert nach Offset Kompensation" SWORD Volt 1 100 -160156.4 160151.5 FORMAT "%8.1" ECU_ADDRESS 0x803444 /end MEASUREMENT
/begin MEASUREMENT LSUCD_uO2Raw "Spannungsrohwert Lambdasignal nach Mittelung und Subtraktion Referenzwert" SWORD Volt 1 100 -160156.4 160151.5 FORMAT "%8.1" ARRAY_SIZE 1 ECU_ADDRESS 0x7F9A7C /end MEASUREMENT
/begin MEASUREMENT LSUCD_uO2Raw_mp "O2 Spannung nach Mittelwertbildung" SWORD Volt 1 100 -160156.4 160151.5 FORMAT "%8.1" ARRAY_SIZE 1 ECU_ADDRESS 0x803446 /end MEASUREMENT
/begin MEASUREMENT LSUCD_uO2Rippel_mp "Sauerstoff-Wechselspannung bei Diagnose der Heizungskopplung" SWORD Volt 1 100 -160156.4 160151.5 FORMAT "%8.1" ARRAY_SIZE 1 ECU_ADDRESS 0x803460 /end MEASUREMENT
/begin MEASUREMENT LSUCD_uRiRaw "Spannungsrohwert Ri nach Mittelung" SWORD Volt 1 100 -160156.4 160151.5 FORMAT "%8.1" ARRAY_SIZE 1 ECU_ADDRESS 0x7F9A7E /end MEASUREMENT
/begin MEASUREMENT LSUCtl_dcycDT1_mp "DT1 Anteil der Heizungsregler Tastverhältnisanforderung" SWORD DtyCyc 1 100 -327.6800 327.6700 FORMAT "%8.4" ARRAY_SIZE 1 ECU_ADDRESS 0x803462 /end MEASUREMENT
/begin MEASUREMENT LSUCtl_dcycHt "Heizertastverhältnis Anforderung durch Ri Regelung" SWORD DtyCyc 1 100 -327.6800 327.6700 FORMAT "%8.4" ARRAY_SIZE 1 ECU_ADDRESS 0x7F9A80 /end MEASUREMENT
/begin MEASUREMENT LSUCtl_dcycHtIniRamp "Startwert für Aufheizkurven Rampe" SWORD DtyCyc 1 100 -327.6800 327.6700 FORMAT "%8.4" ECU_ADDRESS 0x7F9A82 /end MEASUREMENT
/begin MEASUREMENT LSUCtl_dcycHtStrt "Tastverhältnisvorgabe Heizung durch Aufheizstrategie" SWORD DtyCyc 1 100 -327.6800 327.6700 FORMAT "%8.4" ARRAY_SIZE 1 ECU_ADDRESS 0x7F9A84 /end MEASUREMENT
/begin MEASUREMENT LSUCtl_dcycPI_mp "Tastverhältnisforderung aus dem P I Regelglied" SWORD DtyCyc 1 100 -327.6800 327.6700 FORMAT "%8.4" ARRAY_SIZE 1 ECU_ADDRESS 0x803464 /end MEASUREMENT
/begin MEASUREMENT LSUCtl_stHtCtl "Statusbits Zustand Heizungsregelung" UBYTE OneToOne 1 100 0.00 255.0 FORMAT "%5.1" ARRAY_SIZE 1 ECU_ADDRESS 0x7F94C5 /end MEASUREMENT
/begin MEASUREMENT LSUCtl_stHtDisable "High level Diagnose Anforderung Heizungsregelungsabschaltung (0 = nicht abgeschaltet, >0 Ausgang = 0 %)" UBYTE OneToOne 1 100 0.00 255.0 FORMAT "%5.1" ARRAY_SIZE 1 ECU_ADDRESS 0x7F94C6 /end MEASUREMENT
/begin MEASUREMENT LSUCtl_stRmp_mp "Ansteuerstatus für geschaltete Rampe" UBYTE OneToOne 1 100 0.00 255.0 FORMAT "%5.1" ARRAY_SIZE 1 ECU_ADDRESS 0x803466 /end MEASUREMENT
/begin MEASUREMENT LSUCtl_stSCUNEna "Message um Test für Erkennung von Kurzschluss nach Vbat bei UNI freizugeben" UBYTE OneToOne 1 100 0.00 255.0 FORMAT "%5.1" ARRAY_SIZE 1 ECU_ADDRESS 0x7F94C7 /end MEASUREMENT
/begin MEASUREMENT LSUCtl_tAirStrt_mp "Ansauglufttemperatur nach Zündung an (mit Verzögerung erfasst!)" SWORD Temp_Cels 1 100 -3549.940 3003.560 FORMAT "%8.3" ECU_ADDRESS 0x803468 /end MEASUREMENT
/begin MEASUREMENT LSUCtl_tDvt_mp "Regelabweichung Ri-Äquivalenztemperatur" SWORD TempDiff_Kelv 1 100 -3276.800 3276.700 FORMAT "%8.3" ARRAY_SIZE 1 ECU_ADDRESS 0x80346A /end MEASUREMENT
/begin MEASUREMENT LSU_bpPlausSetPoint_mp "Bitposition für Zugriff auf LSU_stO2Err_mp" UBYTE OneToOne 1 100 0.00 255.0 FORMAT "%5.1" ECU_ADDRESS 0x803414 /end MEASUREMENT
/begin MEASUREMENT LSU_qStrt_mp "anfängliche Kraftstoffmenge in Dynamik-Überwachung" SWORD InjMass 1 100 -327.6800 327.6700 FORMAT "%8.4" ECU_ADDRESS 0x803416 /end MEASUREMENT
/begin MEASUREMENT LSU_rLmbd "Lambda" SWORD lambda 1 100 -32.76800 32.76700 FORMAT "%8.5" ARRAY_SIZE 1 ECU_ADDRESS 0x7F9A86 /end MEASUREMENT
/begin MEASUREMENT LSU_rLmbdRec "Kehrwert von Lambda" SWORD lambdaRecVal 1 100 -32.76800 32.76700 FORMAT "%8.5" ARRAY_SIZE 1 ECU_ADDRESS 0x7F9A88 /end MEASUREMENT
/begin MEASUREMENT LSU_rO2ActVal "Aktuell von Plausibilisierung verwendete O2-Konzentration" SWORD O2 1 100 -0.3276800 0.3276700 FORMAT "%9.7" ARRAY_SIZE 1 ECU_ADDRESS 0x7F9A8A /end MEASUREMENT
/begin MEASUREMENT LSU_rO2Adpt "Adaptierte Sauerstoffkonzentration die an externe Module übertragen wird" SWORD O2 1 100 -0.3276800 0.3276700 FORMAT "%9.7" ARRAY_SIZE 1 ECU_ADDRESS 0x7F9A8C /end MEASUREMENT
/begin MEASUREMENT LSU_rO2AdptLastLSU_mp "Adaptierte Sauerstoffkonzentration des Sensors mit der höchsten Nummer" SWORD O2 1 100 -0.3276800 0.3276700 FORMAT "%9.7" ECU_ADDRESS 0x803412 /end MEASUREMENT
/begin MEASUREMENT LSU_rO2Calc_mp "aktuelle O2-Konzentration aus Luftmasse und Einspritzmenge" SWORD O2 1 100 -0.3276800 0.3276700 FORMAT "%9.7" ECU_ADDRESS 0x803418 /end MEASUREMENT
/begin MEASUREMENT LSU_rO2DvtNeg_mp "Minustoleranz für Plausibilisierung O2-Signal LSU" SWORD O2 1 100 -0.3276800 0.3276700 FORMAT "%9.7" ECU_ADDRESS 0x80341A /end MEASUREMENT
/begin MEASUREMENT LSU_rO2DvtPos_mp "Plustoleranz für Plausibilisierung O2-Signal LSU" SWORD O2 1 100 -0.3276800 0.3276700 FORMAT "%9.7" ECU_ADDRESS 0x80341C /end MEASUREMENT
/begin MEASUREMENT LSU_rO2Lmbd1Thres "Message: Toleranzband für Lambda-1-Erkennung" SWORD O2 1 100 -0.3276800 0.3276700 FORMAT "%9.7" ECU_ADDRESS 0x7F9A8E /end MEASUREMENT
/begin MEASUREMENT LSU_rO2MaxVal "Oberer Grenzwert der Plausibilisierung" SWORD O2 1 100 -0.3276800 0.3276700 FORMAT "%9.7" ARRAY_SIZE 1 ECU_ADDRESS 0x7F9A90 /end MEASUREMENT
/begin MEASUREMENT LSU_rO2MinVal "Unterer Grenzwert der Plausibilisierung" SWORD O2 1 100 -0.3276800 0.3276700 FORMAT "%9.7" ARRAY_SIZE 1 ECU_ADDRESS 0x7F9A92 /end MEASUREMENT
/begin MEASUREMENT LSU_rO2RawFlt "Gefilterte O2Raw-Sauerstoffkonzentration in Lambda-1-Erkennung" SWORD O2 1 100 -0.3276800 0.3276700 FORMAT "%9.7" ARRAY_SIZE 1 ECU_ADDRESS 0x7F9A94 /end MEASUREMENT
/begin MEASUREMENT LSU_rO2Stat_mp "gefilterte O2-Konzentration aus Luftmasse und Einspritzmenge" SWORD O2 1 100 -0.3276800 0.3276700 FORMAT "%9.7" ECU_ADDRESS 0x80341E /end MEASUREMENT
/begin MEASUREMENT LSU_rO2Thres1_mp "untere O2-Schwelle für Messung der Anstiegszeit" SWORD O2 1 100 -0.3276800 0.3276700 FORMAT "%9.7" ECU_ADDRESS 0x803420 /end MEASUREMENT
/begin MEASUREMENT LSU_rO2Thres2_mp "obere O2-Schwelle für Messung der Anstiegszeit" SWORD O2 1 100 -0.3276800 0.3276700 FORMAT "%9.7" ECU_ADDRESS 0x803422 /end MEASUREMENT
/begin MEASUREMENT LSU_stChkDyn_mp "Nummer der zuletzt erreichten O2-Schwelle" UBYTE OneToOne 1 100 0.00 255.0 FORMAT "%5.1" ECU_ADDRESS 0x803424 /end MEASUREMENT
/begin MEASUREMENT LSU_stClbDisable "Disable-Signal für CJ120-Kalibrierung" UBYTE OneToOne 1 100 0.00 255.0 FORMAT "%5.1" ECU_ADDRESS 0x7F94C8 /end MEASUREMENT
/begin MEASUREMENT LSU_stNotOpPoint1_mp "Messen des Punktes für Status des Betriebsgebiets 1" UBYTE OneToOne 1 100 0.00 255.0 FORMAT "%5.1" ECU_ADDRESS 0x803410 /end MEASUREMENT
/begin MEASUREMENT LSU_stNotOpPoint2_mp "Messen des Punktes für Status des Betriebsgebiets 2" UBYTE OneToOne 1 100 0.00 255.0 FORMAT "%5.1" ECU_ADDRESS 0x803411 /end MEASUREMENT
/begin MEASUREMENT LSU_stO2Chk_mp "Bitfeld :: Teildiagnosen durchgeführt" UWORD OneToOne 1 100 0.00 65535.00 FORMAT "%8.2" ECU_ADDRESS 0x803426 /end MEASUREMENT
/begin MEASUREMENT LSU_stO2Err_mp "Statuswort :: Diagnoseergebnisse" UWORD OneToOne 1 100 0.00 65535.00 FORMAT "%8.2" ECU_ADDRESS 0x803428 /end MEASUREMENT
/begin MEASUREMENT LSU_stPlausChk_mp "Statuswort Zustand Plausibilitäts-Check" UBYTE OneToOne 1 100 0.00 255.0 FORMAT "%5.1" ECU_ADDRESS 0x80342A /end MEASUREMENT
/begin MEASUREMENT LSU_stStrtClb "Hilfsvariable für Kalibrierungs-Scheduler" UBYTE OneToOne 1 100 0.00 255.0 FORMAT "%5.1" ECU_ADDRESS 0x7F94C9 /end MEASUREMENT
/begin MEASUREMENT LSU_stTmrClbPerRun "Status des Kalibrier-Timers" UBYTE OneToOne 1 100 0.00 255.0 FORMAT "%5.1" ECU_ADDRESS 0x7F94CA /end MEASUREMENT
/begin MEASUREMENT LSU_swtEna "Status-Message zu Freigabe oder Sperren der gesamten LSU-Funktionen" UBYTE OneToOne 1 100 0.00 255.0 FORMAT "%5.1" ECU_ADDRESS 0x7F94CB /end MEASUREMENT
/begin MEASUREMENT LSU_tiState1_mp "Timervariable: Kraftstoffmenge liegt innerhalb Toleranzband" UWORD Time_s 1 100 0.00 655.3500 FORMAT "%8.4" ECU_ADDRESS 0x80342C /end MEASUREMENT
/begin MEASUREMENT LSU_tiState2 "Message: Anstiegszeit O2-Signal beim Übergang Last-Schub (Dynamiküberwachung)" SWORD Time_s 1 100 -327.6800 327.6700 FORMAT "%8.4" ARRAY_SIZE 1 ECU_ADDRESS 0x7F9A96 /end MEASUREMENT
/begin MEASUREMENT LSU_tiState3 "Message: Zeitdauer bis zum Erreichen des Schubs (Kraftstoffmenge kleiner als Schwellwert)" SWORD Time_s 1 100 -327.6800 327.6700 FORMAT "%8.4" ARRAY_SIZE 1 ECU_ADDRESS 0x7F9A98 /end MEASUREMENT
/begin MEASUREMENT LSU_tiSwitch "Message: Maximal zulässiger Wert für O2-Flankenzeit Last -> Schub" SWORD Time_s 1 100 -327.6800 327.6700 FORMAT "%8.4" ECU_ADDRESS 0x7F9A9A /end MEASUREMENT
/begin MEASUREMENT LSU_tiWait3 "Message: maximale Zeitdauer zum erreichen der oberen O2-Schwelle in Dynamiküberwachung" SWORD Time_s 1 100 -327.6800 327.6700 FORMAT "%8.4" ECU_ADDRESS 0x7F9A9C /end MEASUREMENT
/begin MEASUREMENT Lub_nMin "Drehzahlforderung Minimalwert für Schmierung" SWORD EngN 1 100 -32768.00 32767.00 FORMAT "%8.2" ECU_ADDRESS 0x7F9A9E /end MEASUREMENT
/begin MEASUREMENT MemMon_ctErrChkRam "Fehlerzähler für Doppelablage und zyklischen RAM-Test" UBYTE OneToOne 1 100 0.00 255.0 FORMAT "%5.1" ECU_ADDRESS 0x7FACA3 /end MEASUREMENT
/begin MEASUREMENT MemMon_ctErrChkRom "Fehlerzähler für zyklischen ROM-Test" UBYTE OneToOne 1 100 0.00 255.0 FORMAT "%5.1" ECU_ADDRESS 0x7FACA4 /end MEASUREMENT
/begin MEASUREMENT MemMon_ctHealChkRam "Heilungszähler für Doppelablage und zyklischen RAM-Test" UBYTE Time_ms_40ms 1 100 0.00 10200. FORMAT "%5.0" ECU_ADDRESS 0x7FACA5 /end MEASUREMENT
/begin MEASUREMENT MemMon_ctHealChkRom "Heilungszähler für zyklischen ROM-Test" UBYTE Time_ms_40ms 1 100 0.00 10200. FORMAT "%5.0" ECU_ADDRESS 0x7FACA6 /end MEASUREMENT
/begin MEASUREMENT MemMon_st "Status der Speicherüberwachung" UBYTE OneToOne 1 100 0.00 255.0 FORMAT "%5.1" ECU_ADDRESS 0x7FACA2 /end MEASUREMENT
/begin MEASUREMENT MeUnCD_dcycDT1_mp "Sollwert Tastverhältnis mit DT1-Anteil" SWORD DtyCyc 1 100 -327.6800 327.6700 FORMAT "%8.4" ECU_ADDRESS 0x803470 /end MEASUREMENT
/begin MEASUREMENT MeUnCD_dcycOut_mp "Ausgangstastverhältnis" SWORD DtyCyc 1 100 -327.6800 327.6700 FORMAT "%8.4" ECU_ADDRESS 0x7FD044 /end MEASUREMENT
/begin MEASUREMENT MeUnCD_dcycSetValLin_mp "linearisierter Sollwert der Zumesseinheit" SWORD DtyCyc 1 100 -327.6800 327.6700 FORMAT "%8.4" ECU_ADDRESS 0x803472 /end MEASUREMENT
/begin MEASUREMENT MeUnCD_dcycSetVal_mp "Sollwert Tastverhältnis für Zumesseinheit" SWORD DtyCyc 1 100 -327.6800 327.6700 FORMAT "%8.4" ECU_ADDRESS 0x803474 /end MEASUREMENT
/begin MEASUREMENT MeUnCD_facIGov_mp "Zumesseinheit-Stromregelung I-Anteil" SWORD Fact 1 100 -4.000000 3.999878 FORMAT "%8.6" ECU_ADDRESS 0x803476 /end MEASUREMENT
/begin MEASUREMENT MeUnCD_iActFlt_mp "Zumesseinheit-Stromregelung gefilterter Strom-Istwert" SWORD Curr 1 100 -32768.00 32767.00 FORMAT "%8.2" ECU_ADDRESS 0x803478 /end MEASUREMENT
/begin MEASUREMENT MeUnCD_iDvt_mp "Zumesseinheit-Stromregelung Regelabweichung" SWORD Curr 1 100 -32768.00 32767.00 FORMAT "%8.2" ECU_ADDRESS 0x80347A /end MEASUREMENT
/begin MEASUREMENT MeUnCD_iGovActVal "Analogeingang Strom-Istwert" SWORD Curr 1 100 -32768.00 32767.00 FORMAT "%8.2" ECU_ADDRESS 0x7F9AA0 /end MEASUREMENT
/begin MEASUREMENT MeUnCD_iSetFlt_mp "Zumesseinheit-Stromregelung gefilterter Strom-Sollwert" SWORD Curr 1 100 -32768.00 32767.00 FORMAT "%8.2" ECU_ADDRESS 0x80347C /end MEASUREMENT
/begin MEASUREMENT MeUnCD_nDiffRef_mp "gefilterte Drehzahl für Kennlinie" SWORD EngN 1 100 -32768.00 32767.00 FORMAT "%8.2" ECU_ADDRESS 0x80347E /end MEASUREMENT
/begin MEASUREMENT MeUnCD_tiPer_mp "Periodendauer der PWM-Endstufe" SWORD Period 1 100 -3276.800 3276.700 FORMAT "%8.3" ECU_ADDRESS 0x803480 /end MEASUREMENT
/begin MEASUREMENT MeUnCD_uRawVal_mp "Analogeingang Spannungsrohwert" SWORD Volt 1 100 -160156.4 160151.5 FORMAT "%8.1" ECU_ADDRESS 0x803482 /end MEASUREMENT
/begin MEASUREMENT MeUn_iSet_mp "Sollstrom für die Zumesseinheit" SWORD Curr 1 100 -32768.00 32767.00 FORMAT "%8.2" ECU_ADDRESS 0x80346C /end MEASUREMENT
/begin MEASUREMENT MeUn_stActrCtl_mp "Zustand der Stellwertsteuerung für die Zumesseinheit" UBYTE OneToOne 1 100 0.00 255.0 FORMAT "%5.1" ECU_ADDRESS 0x80346E /end MEASUREMENT
/begin MEASUREMENT MRlyCD_ctTooEarly_mp "Fehlerzähler für ""Hauptrelais öffnet zu früh"" Fehler" UBYTE OneToOne 1 100 0.00 255.0 FORMAT "%5.1" ECU_ADDRESS 0x803484 /end MEASUREMENT
/begin MEASUREMENT MRlyCD_stFanShutOff "Anforderung zum Anfang des Lüfterabschaltvorgangs" UBYTE OneToOne 1 100 0.00 255.0 FORMAT "%5.1" ECU_ADDRESS 0x7F94CD /end MEASUREMENT
/begin MEASUREMENT MRlyCD_stMon "aktueller Zustand der Hauptrelaisüberwachung" UBYTE OneToOne 1 100 0.00 255.0 FORMAT "%5.1" ECU_ADDRESS 0x7F94CE /end MEASUREMENT
/begin MEASUREMENT MRlyCD_stPrevOpening "Bedingung / Grund für das Öffnen des Hauptrelais während letztem Steuergerätelauf" UBYTE OneToOne 1 100 0.00 255.0 FORMAT "%5.1" ECU_ADDRESS 0x7F94CF /end MEASUREMENT
/begin MEASUREMENT MSidCD_numECUS "Anzahl der ECU in diesem system: 1 - 4 (Master/Slave)" UBYTE OneToOne 1 100 0.00 255.0 FORMAT "%5.1" ECU_ADDRESS 0x7F94D0 /end MEASUREMENT
/begin MEASUREMENT MSidCD_swtMAIN "Typ der ECU: Single ECU=0xFF, Master Slave - Master: 0, Master Slave - Slave: 1,2,3 or 4" UBYTE OneToOne 1 100 0.00 255.0 FORMAT "%5.1" ECU_ADDRESS 0x7F94D1 /end MEASUREMENT
/begin MEASUREMENT NetMng_ctRecoveryA_mp "Meßpunkt der die Anzahl der Neuinitialisierungen des CAN-Controller A bei BusOff wiedergibt" UBYTE OneToOne 1 100 0.00 255.0 FORMAT "%5.1" ECU_ADDRESS 0x803485 /end MEASUREMENT
/begin MEASUREMENT NetMng_ctRecoveryB_mp "Meßpunkt der die Anzahl der Neuinitialisierungen des CAN-Controller B bei BusOff wiedergibt" UBYTE OneToOne 1 100 0.00 255.0 FORMAT "%5.1" ECU_ADDRESS 0x803486 /end MEASUREMENT
/begin MEASUREMENT NetMng_ctRecoveryC_mp "Meßpunkt der die Anzahl der Neuinitialisierungen des CAN-Controller C bei BusOff wiedergibt" UBYTE OneToOne 1 100 0.00 255.0 FORMAT "%5.1" ECU_ADDRESS 0x803487 /end MEASUREMENT
/begin MEASUREMENT NetMng_stCAN "Status der CAN-Controller" ULONG OneToOne 1 100 0.00 4294967295.00 FORMAT "%13.2" ECU_ADDRESS 0x7F9D04 /end MEASUREMENT
/begin MEASUREMENT NetMng_stCanBusOffAct "Unentprellter Busoff Zustand aller Controller und aller Busse" UWORD OneToOne 1 100 0.00 65535.00 FORMAT "%8.2" ECU_ADDRESS 0x7F9AA4 /end MEASUREMENT
/begin MEASUREMENT NetMng_stCanBusOffDeb "Entprellter Busoff Zustand aller Controller und aller Busse" UWORD OneToOne 1 100 0.00 65535.00 FORMAT "%8.2" ECU_ADDRESS 0x7F9AA6 /end MEASUREMENT
/begin MEASUREMENT NetMng_stFadeOut "Status der CAN Ausblendung" UBYTE OneToOne 1 100 0.00 255.0 FORMAT "%5.1" ECU_ADDRESS 0x7F94D2 /end MEASUREMENT
/begin MEASUREMENT NetMng_stTP20CANMute "Status: sperren der CAN- Sende- Botschaften durch TP20 Mute Anforderung" UBYTE OneToOne 1 100 0.00 255.0 FORMAT "%5.1" ECU_ADDRESS 0x7F94D3 /end MEASUREMENT
/begin MEASUREMENT NetMng_stTxMsgDisbl "Status welche Sendebotschaften durch den auftretenden BusOff gesperrt werden" UWORD OneToOne 1 100 0.00 65535.00 FORMAT "%8.2" ECU_ADDRESS 0x7F9AA8 /end MEASUREMENT
/begin MEASUREMENT NetMng_stUsrMsgDisbl "Status welche Sendebotschaften durch den auftretenden BusOff gesperrt sind bzw. wurden" UWORD OneToOne 1 100 0.00 65535.00 FORMAT "%8.2" ECU_ADDRESS 0x7F9AAA /end MEASUREMENT
/begin MEASUREMENT NSC_numPrio "Prioritätszahl des Regenerationsanforderungslevel des NOx-Specherkat" UWORD OneToOne 1 100 0.00 65535.00 FORMAT "%8.2" ECU_ADDRESS 0x7F9AA2 /end MEASUREMENT
/begin MEASUREMENT NSC_st "von NOx-Speicherkatalysator angeforderter Regenerationsstatus" ULONG OneToOne 1 100 0.00 4294967295.00 FORMAT "%13.2" ECU_ADDRESS 0x7F9D00 /end MEASUREMENT
/begin FUNCTION ivctl_volt "Spannungsregelung"
 /begin DEF_CHARACTERISTIC IVCtl_IKi_C IVCtl_IKiPos_C IVCtl_IKiNeg_C IVCtl_uIWinPos_C IVCtl_uIWinNeg_C IVCtl_PKp_C IVCtl_PKpPos_C IVCtl_PKpNeg_C IVCtl_uPWinPos_C IVCtl_uPWinNeg_C IVCtl_swtUUpMinMaxActr_C IVCtl_swtUUpMinMaxRst_C IVCtl_swtUUpMinMax_C IVCtl_uClsActrUp_C IVCtl_uMaxSetUp_C IVCtl_uMinSetUp_C IVCtl_uPIMax_C IVCtl_uPIMin_C IVCtl_uSetUpPreCtl_CUR IVCtl_uUpInitI_C /end DEF_CHARACTERISTIC
 /begin IN_MEASUREMENT InjVlv_pCalcVolt /end IN_MEASUREMENT
 /begin OUT_MEASUREMENT IVCtl_uSetUpActrUnCorr_mp IVCtl_uSetUpActrUnLim_mp IVCtl_uSetUpPreCtl_mp IVCtl_uSetUpTmp_mp IVCtl_uUpInPIActr_mp IVCtl_uUpInPIMaxActr_mp IVCtl_uUpInPIMax_mp IVCtl_uUpInPIMinActr_mp IVCtl_uUpInPIMin_mp IVCtl_uUpTmp_mp /end OUT_MEASUREMENT
/end FUNCTION
/begin FUNCTION ivctl_volt_msg ""
 /begin OUT_MEASUREMENT IVCtl_stVoltPI IVCtl_uClsActrUp IVCtl_uCorrUp IVCtl_uSetBott IVCtl_uSetOfsActr IVCtl_uSetUpActr IVCtl_uUpInPI /end OUT_MEASUREMENT
/end FUNCTION
/begin FUNCTION ivctl_volt_uic "" /end FUNCTION
/begin FUNCTION k2rffd "" /begin DEF_CHARACTERISTIC K2rffd_FrzFrEnv_Idx_C /end DEF_CHARACTERISTIC /end FUNCTION
/begin FUNCTION ligov "Leerlaufregler"
 /begin DEF_CHARACTERISTIC LIGov_tiCldCltchDT1_C LIGov_CldCltchDKd_C LIGov_CldCltchIKi_C LIGov_CldCltchIKiPos_C LIGov_CldCltchIKiNeg_C LIGov_CldCltchIWinPos_C LIGov_CldCltchIWinNeg_C LIGov_CldCltchPredef_C LIGov_CldCltchPKp_C LIGov_CldCltchPKpPos_C LIGov_CldCltchPKpNeg_C LIGov_CldCltchPWinPos_C LIGov_CldCltchPWinNeg_C LIGov_tiCldGearDT1_C LIGov_CldGearDKd_C LIGov_CldGearIKi_C LIGov_CldGearIKiPos_C LIGov_CldGearIKiNeg_C LIGov_CldGearIWinPos_C LIGov_CldGearIWinNeg_C LIGov_CldGearPredef_C LIGov_CldGearPKp_C LIGov_CldGearPKpPos_C LIGov_CldGearPKpNeg_C LIGov_CldGearPWinPos_C LIGov_CldGearPWinNeg_C LIGov_dnLimHighTrm_C LIGov_dnLimLowTrm_C LIGov_tiGear1DT1_C LIGov_Gear1DKd_C LIGov_Gear1IKi_C LIGov_Gear1IKiPos_C LIGov_Gear1IKiNeg_C LIGov_Gear1IWinPos_C LIGov_Gear1IWinNeg_C LIGov_Gear1Predef_C LIGov_Gear1PKp_C LIGov_Gear1PKpPos_C LIGov_Gear1PKpNeg_C LIGov_Gear1PWinPos_C LIGov_Gear1PWinNeg_C LIGov_tiGear2DT1_C LIGov_Gear2DKd_C LIGov_Gear2IKi_C LIGov_Gear2IKiPos_C LIGov_Gear2IKiNeg_C LIGov_Gear2IWinPos_C LIGov_Gear2IWinNeg_C LIGov_Gear2Predef_C LIGov_Gear2PKp_C LIGov_Gear2PKpPos_C LIGov_Gear2PKpNeg_C LIGov_Gear2PWinPos_C LIGov_Gear2PWinNeg_C LIGov_tiGear3DT1_C LIGov_Gear3DKd_C LIGov_Gear3IKi_C LIGov_Gear3IKiPos_C LIGov_Gear3IKiNeg_C LIGov_Gear3IWinPos_C LIGov_Gear3IWinNeg_C LIGov_Gear3Predef_C LIGov_Gear3PKp_C LIGov_Gear3PKpPos_C LIGov_Gear3PKpNeg_C LIGov_Gear3PWinPos_C LIGov_Gear3PWinNeg_C LIGov_tiGear4DT1_C LIGov_Gear4DKd_C LIGov_Gear4IKi_C LIGov_Gear4IKiPos_C LIGov_Gear4IKiNeg_C LIGov_Gear4IWinPos_C LIGov_Gear4IWinNeg_C LIGov_Gear4Predef_C LIGov_Gear4PKp_C LIGov_Gear4PKpPos_C LIGov_Gear4PKpNeg_C LIGov_Gear4PWinPos_C LIGov_Gear4PWinNeg_C LIGov_tiGear5DT1_C LIGov_Gear5DKd_C LIGov_Gear5IKi_C LIGov_Gear5IKiPos_C LIGov_Gear5IKiNeg_C LIGov_Gear5IWinPos_C LIGov_Gear5IWinNeg_C LIGov_Gear5Predef_C LIGov_Gear5PKp_C LIGov_Gear5PKpPos_C LIGov_Gear5PKpNeg_C LIGov_Gear5PWinPos_C LIGov_Gear5PWinNeg_C LIGov_nDHypDenom_C LIGov_nDHypNum_C LIGov_nLimHigh_C LIGov_nLimLow_C LIGov_nOffsetPreCtrlCold_C LIGov_nOffsetPreCtrltrqDem_C LIGov_nOffsetPreCtrlWarm_C LIGov_nOffsetPredef_C LIGov_nRgnIdleOffset_C LIGov_nSetpointDriveAway_CUR LIGov_nSetPointErr_C LIGov_rThresDriveoff_C LIGov_rThresTrqDem_C LIGov_nRmpSlpUpSetPoint_C LIGov_nRmpSlpDwnSetPoint_C LIGov_stPsRev_C LIGov_swtTempHys_C LIGov_swtTempTrqInit_C LIGov_tClntXLow_C LIGov_tClntXHigh_C LIGov_stCold_C LIGov_stWarm_C LIGov_tiPT1_CUR LIGov_trqInitI_CUR LIGov_trqMaxCold_C LIGov_trqMaxWarm_C LIGov_trqThresDefrostI_C LIGov_UbrPKp_C LIGov_UbrPKpPos_C LIGov_UbrPKpNeg_C LIGov_UbrPWinPos_C LIGov_UbrPWinNeg_C LIGov_vThreshUbr_C LIGov_tiWrmCltchDT1_C LIGov_WrmCltchDKd_C LIGov_WrmCltchIKi_C LIGov_WrmCltchIKiPos_C LIGov_WrmCltchIKiNeg_C LIGov_WrmCltchIWinPos_C LIGov_WrmCltchIWinNeg_C LIGov_WrmCltchPredef_C LIGov_WrmCltchPKp_C LIGov_WrmCltchPKpPos_C LIGov_WrmCltchPKpNeg_C LIGov_WrmCltchPWinPos_C LIGov_WrmCltchPWinNeg_C /end DEF_CHARACTERISTIC
 /begin IN_MEASUREMENT APSCD_pVal LIGov_nDiff_mp LIGov_tEngTrqInit_mp /end IN_MEASUREMENT
/end FUNCTION
/begin FUNCTION ligov_msg ""
 /begin OUT_MEASUREMENT LIGov_nLim LIGov_nSetpoint LIGov_st LIGov_trq LIGov_trqCurrPredef LIGov_trqFlt LIGov_trqInitI LIGov_trqIState /end OUT_MEASUREMENT
/end FUNCTION
/begin FUNCTION ligov_setpoint_uic "" /begin OUT_MEASUREMENT LIGov_nSetpointTrmEEP_mp /end OUT_MEASUREMENT /end FUNCTION
/begin FUNCTION ligov_uic ""
 /begin DEF_CHARACTERISTIC LIGov_nSetpoint_Vector LIGov_nSetpoint_Channel LIGov_trq_Vector LIGov_trq_Channel /end DEF_CHARACTERISTIC
 /begin OUT_MEASUREMENT LIGov_nAvrg_mp LIGov_nDiff_mp LIGov_nRgn_mp LIGov_stCalcRgnMsk_mp LIGov_stFFCalcRgnMsk_mp LIGov_tEngHys_mp LIGov_tEngTrqInit_mp LIGov_tiPT1_mp LIGov_trqD_mp LIGov_trqI_mp LIGov_trqMax_mp LIGov_trqP_mp /end OUT_MEASUREMENT
/end FUNCTION
/begin FUNCTION ligov_var ""
 /begin DEF_CHARACTERISTIC LIGov_tiDriveoffDT1_C LIGov_DriveoffDKd_C LIGov_DriveoffIKi_C LIGov_DriveoffIKiPos_C LIGov_DriveoffIKiNeg_C LIGov_DriveoffIWinPos_C LIGov_DriveoffIWinNeg_C LIGov_DriveoffPredef_C LIGov_DriveoffPKp_C LIGov_DriveoffPKpPos_C LIGov_DriveoffPKpNeg_C LIGov_DriveoffPWinPos_C LIGov_DriveoffPWinNeg_C LIGov_nCltAirP_MAP LIGov_nDHypDenomCold_C LIGov_nDHypNumCold_C LIGov_nEngOffset_C LIGov_nLim_C LIGov_nRev_CUR LIGov_nSetpointWarm_CUR LIGov_nTemp1_MAP LIGov_nTemp2Rgn1_CUR LIGov_nTemp2Rgn2_CUR LIGov_nTemp2_CUR LIGov_stCalcRgnMsk1_C LIGov_stCalcRgnMsk2_C LIGov_vThresPointLow_C LIGov_vThresPointHigh_C LIGov_YLow_C LIGov_YHigh_C LIGov_swtParDriveoffVal_C LIGov_swtParDriveoffType_C LIGov_tEngLim_C LIGov_tiST_C LIGov_tiTW_C LIGov_tiUbrDT1_C LIGov_UbrDKd_C LIGov_UbrIKi_C LIGov_UbrIKiPos_C LIGov_UbrIKiNeg_C LIGov_UbrIWinPos_C LIGov_UbrIWinNeg_C LIGov_UbrPredef_C /end DEF_CHARACTERISTIC
 /begin IN_MEASUREMENT APSCD_pVal Eng_tEng /end IN_MEASUREMENT
/end FUNCTION
/begin FUNCTION ligov_var_msg ""
 /begin OUT_MEASUREMENT LIGov_nSetpointTemp LIGov_swtParDriveoff LIGov_trqI LIGov_trqP /end OUT_MEASUREMENT
/end FUNCTION
/begin FUNCTION lockcnt "Sperrzähler" /begin DEF_CHARACTERISTIC LockCnt_tiOneMinute_C /end DEF_CHARACTERISTIC /end FUNCTION
/begin FUNCTION lockcnt_msg "" /begin OUT_MEASUREMENT LockCnt_tiLock /end OUT_MEASUREMENT /end FUNCTION
/begin FUNCTION lsucd_adaption "Adaption des Lambdasondensignals"
 /begin DEF_CHARACTERISTIC LSUCD_tiAdptFltInit_C LSUCD_tiAdptFlt_C LSUCD_d2rInit_C LSUCD_dmAirIKi_C LSUCD_dmAirIKiPos_C LSUCD_dmAirIKiNeg_C LSUCD_dmAirIWinPos_C LSUCD_dmAirIWinNeg_C LSUCD_EvalMaxVal_C LSUCD_EvalMinVal_C LSUCD_tiEvalFltInit_C LSUCD_tiEvalFlt_C LSUCD_mAirAdptActv_C LSUCD_swtAdptVal_C LSUCD_swtAdptType_C LSUCD_tAirAdptActv_C /end DEF_CHARACTERISTIC
 /begin OUT_MEASUREMENT LSUCD_d2rO2Eval_mp LSUCD_d2rO2_mp LSUCD_drO2Flt_mp LSUCD_facO2Corr_mp LSUCD_mAirAftOvrRun_mp LSUCD_stAdptActv_mp LSUCD_stChange_mp LSUCD_stHold_mp /end OUT_MEASUREMENT
/end FUNCTION
/begin FUNCTION lsucd_adaption_msg "" /begin OUT_MEASUREMENT LSUCD_drO2Adpt LSUCD_rO2Adpt LSUCD_stAdpt LSUCD_swtAdpt /end OUT_MEASUREMENT /end FUNCTION
/begin FUNCTION lsucd_adaption_uic "" /end FUNCTION
/begin FUNCTION lsucd_heater "Heizung der Lambdasonde"
 /begin DEF_CHARACTERISTIC LSUCD_stHtInvOut_C LSUCD_tiHtPer_C LSUCD_tiDebHeaterDef_C LSUCD_tiDebHeaterOk_C LSUCD_uBattNominal_C LSUCD_uBattMaxHigh_C LSUCD_uBattMaxLow_C LSUCD_stPwrStgDia_C LSUCD_dcycTstPowerStage_C LSUCD_tiDebReset_C LSUCD_stHtDis_C /end DEF_CHARACTERISTIC
 /begin OUT_MEASUREMENT LSUCD_facUCor_mp LSUCD_rOutHWE_mp /end OUT_MEASUREMENT
/end FUNCTION
/begin FUNCTION lsucd_heater_msg "" /begin OUT_MEASUREMENT LSUCD_dcycHtCor LSUCD_dcycLimActHt LSUCD_stHtDis /end OUT_MEASUREMENT /end FUNCTION
/begin FUNCTION lsucd_iprefctl "Controlling of the reference pump current"
 /begin DEF_CHARACTERISTIC LSUCD_stRefPumpDis_C LSUCD_tiRefPumpHigh_C LSUCD_tiRefTransLow_C LSUCD_tiRgnEna_C LSUCD_tiRgnIpSettle_C /end DEF_CHARACTERISTIC
 /begin OUT_MEASUREMENT LSUCD_stRefCurTrans_mp /end OUT_MEASUREMENT
/end FUNCTION
/begin FUNCTION lsucd_iprefctl_msg ""
 /begin OUT_MEASUREMENT LSUCD_stIpHighCurEna LSUCD_stIpNormCurEna LSUCD_stPumpDemRef LSUCD_stRefPump LSUCD_stRgnEna LSUCD_stRgnIpSettle /end OUT_MEASUREMENT
/end FUNCTION
/begin FUNCTION lsucd_iprefctl_uic "" /end FUNCTION
/begin FUNCTION lsucd_o2raw "Sauerstoffrohwert der Lambdasonde"
 /begin DEF_CHARACTERISTIC LSUCD_rO2_CUR LSUCD_tiO2ClbPT1_C LSUCD_tiO2PT1_C LSUCD_tiDebO2MaxTstDef_C LSUCD_tiDebO2MaxTstOk_C LSUCD_tiDebO2MinDef_C LSUCD_tiDebO2MinOk_C LSUCD_tiDelO2Clb_C LSUCD_tiO2Clb_C LSUCD_tiDelO2Val_C LSUCD_uO2Ref_C LSUCD_uO2ClbMax_C LSUCD_uO2ClbMin_C LSUCD_swtO2Filter_C LSUCD_uO2MaxNorm_C LSUCD_uO2MaxTst_C LSUCD_uO2Min_C /end DEF_CHARACTERISTIC
 /begin OUT_MEASUREMENT LSUCD_stO2Clb_mp LSUCD_stSRCState_mp LSUCD_uO2OfsCor_mp LSUCD_uO2Raw_mp /end OUT_MEASUREMENT
/end FUNCTION
/begin FUNCTION lsucd_o2raw_msg ""
 /begin OUT_MEASUREMENT LSUCD_rO2Act LSUCD_rO2Raw LSUCD_stO2Act LSUCD_stO2ClbEna LSUCD_stO2IntValid LSUCD_stO2SPICalDem LSUCD_stO2SPISens LSUCD_uO2Clb LSUCD_uO2Raw LSU_swtEna /end OUT_MEASUREMENT
/end FUNCTION
/begin FUNCTION lsucd_o2raw_msg_var "" /begin OUT_MEASUREMENT LSUCD_stO2Valid /end OUT_MEASUREMENT /end FUNCTION
/begin FUNCTION lsucd_prescomp "Druckkompensation der mit Lambdasonde gemessenen Sauerstoffkonzentration"
 /begin DEF_CHARACTERISTIC LSUCD_facPresCompLean_CUR LSUCD_facPresCompRich_CUR LSUCD_rO2SwtPresComp_C LSUCD_stPresCompActv_C /end DEF_CHARACTERISTIC
 /begin OUT_MEASUREMENT LSUCD_facPresComp_mp LSUCD_pExhGasLstVal_mp /end OUT_MEASUREMENT
/end FUNCTION
/begin FUNCTION lsucd_prescomp_msg "" /begin OUT_MEASUREMENT LSUCD_rO2PresComp /end OUT_MEASUREMENT /end FUNCTION
/begin FUNCTION lsucd_prescomp_uic "" /end FUNCTION
/begin FUNCTION lsucd_pumpctl "Pump current control" /begin DEF_CHARACTERISTIC LSUCD_stPumpCtlDis_C /end DEF_CHARACTERISTIC /end FUNCTION
/begin FUNCTION lsucd_pumpctl_msg "" /begin OUT_MEASUREMENT LSUCD_stPumpCtl /end OUT_MEASUREMENT /end FUNCTION
/begin FUNCTION lsucd_pumpctl_uic "" /end FUNCTION
/begin FUNCTION lsucd_ri "Ri der Lambdasonde"
 /begin DEF_CHARACTERISTIC LSUCD_tiRiClbPT1_C LSUCD_tiRiPT1_C LSUCD_tRi_CUR LSUCD_tiDelRiClb_C LSUCD_tiRiClb_C LSUCD_tiDelRiVal_C LSUCD_tiRiFltSettle_C LSUCD_resRiMaxJmp_C LSUCD_uRiOfs_C LSUCD_facUToRi_C LSUCD_resRiClbRef_C LSUCD_resRiClbMax_C LSUCD_resRiClbMin_C LSUCD_numRiDistSupp_C /end DEF_CHARACTERISTIC
 /begin OUT_MEASUREMENT LSUCD_resRiChange_mp LSUCD_resRiClbRaw_mp LSUCD_resRi_mp LSUCD_stRiFltAct_mp LSUCD_stRiLimSlp_mp /end OUT_MEASUREMENT
/end FUNCTION
/begin FUNCTION lsucd_ri_msg ""
 /begin OUT_MEASUREMENT LSUCD_resRi LSUCD_resRiClb LSUCD_resRiRaw LSUCD_stRiClb LSUCD_stRiClbEna LSUCD_stRiSPICalDem LSUCD_stRiValid LSUCD_tRi LSUCD_uRiRaw /end OUT_MEASUREMENT
/end FUNCTION
/begin FUNCTION lsucd_spictl "SPI Chip control" /begin DEF_CHARACTERISTIC LSUCD_stRefCurHigh_C LSUCD_stRefCurNormal_C /end DEF_CHARACTERISTIC /end FUNCTION
/begin FUNCTION lsucd_spictl_msg "" /begin OUT_MEASUREMENT LSUCD_stCircModeNew LSUCD_stSPIDiaInfo LSUCD_stSPIInitVal /end OUT_MEASUREMENT /end FUNCTION
/begin FUNCTION lsucd_spictl_uic "" /end FUNCTION
/begin FUNCTION lsucd_wiredia "Überwachung und Fehlererkennung von Kabel"
 /begin DEF_CHARACTERISTIC LSUCD_dcycMinGrad_C LSUCD_DebHtCoupDef_C LSUCD_DebHtCoupOk_C LSUCD_dNumHtCoup_C LSUCD_resRiMaxGrad_C LSUCD_rO2IsolChkMax_C LSUCD_rO2IsolChkMin_C LSUCD_stWireDiaActv_C LSUCD_tiHtCoupChk_C LSUCD_tiHtCoupPer_C LSUCD_tiIsolChkErr_C LSUCD_tiIsolChkPer_C LSUCD_tiIsolChkPump_C LSUCD_tiHtCoupFlt_C LSUCD_uO2MaxGrad_C LSUCD_uO2MaxRippel_C /end DEF_CHARACTERISTIC
 /begin OUT_MEASUREMENT LSUCD_dcycRippel_mp LSUCD_resRiRippel_mp LSUCD_stRecValEval_mp LSUCD_stTstTrigger_mp LSUCD_stWireDiaChk_mp LSUCD_stWireDiaErr_mp LSUCD_uO2FltRippel_mp LSUCD_uO2Grad_mp LSUCD_uO2Rippel_mp /end OUT_MEASUREMENT
/end FUNCTION
/begin FUNCTION lsucd_wiredia_100ms ""
 /begin DEF_CHARACTERISTIC LSUCD_tiOpnLdTstActv_C LSUCD_tiRiMeasDisa_C LSUCD_uO2OpnLdNernstMax_C LSUCD_uO2OpnLdNernstMin_C LSUCD_uO2OpnLdVirtGndMax_C LSUCD_uO2OpnLdVirtGndMin_C LSUCD_uRiOpnLdTstMax_C LSUCD_tiDebNoLdErrIPDef_C LSUCD_tiDebNoLdErrIPOk_C LSUCD_tiDebLowBattErrDef_C LSUCD_tiDebLowBattErrOk_C LSUCD_tiDebCircNernstDef_C LSUCD_tiDebCircNernstOk_C LSUCD_tiDebCircPumpDef_C LSUCD_tiDebCircPumpOk_C LSUCD_tiDebCircVirtGndDef_C LSUCD_tiDebCircVirtGndOk_C /end DEF_CHARACTERISTIC
/end FUNCTION
/begin FUNCTION lsucd_wiredia_100ms_msg "" /begin OUT_MEASUREMENT LSUCD_stOpnErrIP LSUCD_stOpnLdTstActv /end OUT_MEASUREMENT /end FUNCTION
/begin FUNCTION lsucd_wiredia_msg ""
 /begin OUT_MEASUREMENT LSUCD_ctHtCoup LSUCD_dcycHtCoupStep1 LSUCD_dcycHtCoupStep2 LSUCD_dcycHtCoupStep3 LSUCD_dHtCoupStep LSUCD_dHtCoupStepLast LSUCD_resRiHtCoupStep1 LSUCD_resRiHtCoupStep2 LSUCD_resRiHtCoupStep3 LSUCD_stDiaIAEna LSUCD_stHtCoupActv LSUCD_stInitClb LSUCD_stIsolChkActv LSUCD_stIsolChkO2Last LSUCD_stIsolChkStrt LSUCD_stPumpEna LSUCD_uO2HtCoupStep1 LSUCD_uO2HtCoupStep2 LSUCD_uO2HtCoupStep3 /end OUT_MEASUREMENT
/end FUNCTION
/begin FUNCTION lsucd_wiredia_uic "" /end FUNCTION
/begin FUNCTION lsuctl "Regelung zur Lambdaerfassung"
 /begin DEF_CHARACTERISTIC LSUCtl_tUpLim_C LSUCtl_tLowLim_C LSUCtl_tRiSetPoint_C LSUCtl_tHtCtlEna_C LSUCtl_nHtCtlEna_C LSUCtl_dcycHtMin_C LSUCtl_tExcMax_C LSUCtl_tExcMin_C LSUCtl_tiDelIniVal_C LSUCtl_dcycRmpUp_C LSUCtl_dcycRmpDwn_C LSUCtl_dcycStrt_CUR LSUCtl_tiDebRiExcMaxDef_C LSUCtl_tiDebRiExcMaxOk_C LSUCtl_tiDebRiExcMinDef_C LSUCtl_tiDebRiExcMinOk_C LSUCtl_tiSens1HtDT1_C LSUCtl_Sens1HtDT1Kd_C LSUCtl_Sens1HtIKi_C LSUCtl_Sens1HtIKiPos_C LSUCtl_Sens1HtIKiNeg_C LSUCtl_tSens1HtIWinPos_C LSUCtl_tSens1HtIWinNeg_C LSUCtl_Sens1HtPKp_C LSUCtl_Sens1HtPKpPos_C LSUCtl_Sens1HtPKpNeg_C LSUCtl_tSens1HtPWinPos_C LSUCtl_tSens1HtPWinNeg_C LSUCtl_tiSens2HtDT1_C LSUCtl_Sens2HtDT1Kd_C LSUCtl_Sens2HtIKi_C LSUCtl_Sens2HtIKiPos_C LSUCtl_Sens2HtIKiNeg_C LSUCtl_tSens2HtIWinPos_C LSUCtl_tSens2HtIWinNeg_C LSUCtl_Sens2HtPKp_C LSUCtl_Sens2HtPKpPos_C LSUCtl_Sens2HtPKpNeg_C LSUCtl_tSens2HtPWinPos_C LSUCtl_tSens2HtPWinNeg_C /end DEF_CHARACTERISTIC
 /begin OUT_MEASUREMENT LSUCtl_dcycDT1_mp LSUCtl_dcycPI_mp LSUCtl_stRmp_mp LSUCtl_tAirStrt_mp LSUCtl_tDvt_mp /end OUT_MEASUREMENT
/end FUNCTION
/begin FUNCTION lsuctl_msg ""
 /begin OUT_MEASUREMENT LSUCtl_dcycHt LSUCtl_dcycHtIniRamp LSUCtl_dcycHtStrt LSUCtl_stHtCtl LSUCtl_stHtDisable LSUCtl_stSCUNEna /end OUT_MEASUREMENT
/end FUNCTION
/begin FUNCTION lsu_clbsched "Lambda-Sensor Universal-Kalibrierungs-Scheduler"
 /begin DEF_CHARACTERISTIC LSU_ctRgnEna_C LSU_mAirMaxClb1_C LSU_mAirMaxClb2_C LSU_mAirMinClb1_C LSU_mAirMinClb2_C LSU_nMaxClb1_C LSU_nMaxClb2_C LSU_nMinClb1_C LSU_nMinClb2_C LSU_qMaxClb1_C LSU_qMaxClb2_C LSU_qMinClb1_C LSU_qMinClb2_C LSU_stEGTClbOff_C LSU_ti1stClb_C LSU_tiPerClb_C /end DEF_CHARACTERISTIC
 /begin OUT_MEASUREMENT LSU_stNotOpPoint1_mp LSU_stNotOpPoint2_mp /end OUT_MEASUREMENT
/end FUNCTION
/begin FUNCTION lsu_clbsched_msg "" /begin OUT_MEASUREMENT LSU_stClbDisable LSU_stStrtClb LSU_stTmrClbPerRun /end OUT_MEASUREMENT /end FUNCTION
/begin FUNCTION lsu_conf ""
 /begin DEF_CHARACTERISTIC LSUCD_stCJChpSel_C LSUCD_stRgnEna_C LSU_dcycMax_C LSU_swtVal_C LSU_swtType_C LSU_uBattMin_C /end DEF_CHARACTERISTIC
/end FUNCTION
/begin FUNCTION lsu_lmbdcalc "Berechnung Lambda und 1/Lambda" /begin DEF_CHARACTERISTIC LSU_rLmbdRec_CUR /end DEF_CHARACTERISTIC /begin OUT_MEASUREMENT LSU_rO2AdptLastLSU_mp /end OUT_MEASUREMENT /end FUNCTION
/begin FUNCTION lsu_lmbdcalc_msg "" /end FUNCTION
/begin FUNCTION lsu_lmbdcalc_msg_var "" /begin OUT_MEASUREMENT LSU_rLmbd LSU_rLmbdRec LSU_rO2Adpt /end OUT_MEASUREMENT /end FUNCTION
/begin FUNCTION lsu_lmbdcalc_uic "" /end FUNCTION
/begin FUNCTION lsu_mon "Lambda-Sensor Universal-Diagnosefunktion"
 /begin DEF_CHARACTERISTIC LSU_DebDynErrDef_C LSU_DebDynErrOk_C LSU_DebO2ConcHighDef_C LSU_DebO2ConcHighOk_C LSU_DebO2ConcLowDef_C LSU_DebO2ConcLowOk_C LSU_mAirMax_C LSU_mAirMin_C LSU_nMax_C LSU_nMinChkDyn_C LSU_nMin_C LSU_qDiffMax_C LSU_qMax_C LSU_qMin_C LSU_qThresChkDyn_C LSU_qThresOvrRun_C LSU_tiO2CalcFlt_C LSU_rO2ConstVal_C LSU_tiDvtFlt_C LSU_rO2Lmbd1Thres_C LSU_rO2MaxVar_C LSU_rO2Min_C LSU_rO2NegDvt_C LSU_rO2PosDvt_C LSU_stMonActv_C LSU_stSelPlausChkSig_C LSU_tiDvt1Flt_C LSU_tiO2Eval_C LSU_tiSwitch_C LSU_tiWait1_C LSU_tiWait2_C LSU_tiWait3_C /end DEF_CHARACTERISTIC
/end FUNCTION
/begin FUNCTION lsu_mon_msg ""
 /begin OUT_MEASUREMENT LSU_rO2ActVal LSU_rO2Lmbd1Thres LSU_rO2MaxVal LSU_rO2MinVal LSU_rO2RawFlt LSU_tiState2 LSU_tiState3 LSU_tiSwitch LSU_tiWait3 /end OUT_MEASUREMENT
/end FUNCTION
/begin FUNCTION lsu_mon_uic ""
 /begin OUT_MEASUREMENT LSU_bpPlausSetPoint_mp LSU_qStrt_mp LSU_rO2Calc_mp LSU_rO2DvtNeg_mp LSU_rO2DvtPos_mp LSU_rO2Stat_mp LSU_rO2Thres1_mp LSU_rO2Thres2_mp LSU_stChkDyn_mp LSU_stO2Chk_mp LSU_stO2Err_mp LSU_stPlausChk_mp LSU_tiState1_mp /end OUT_MEASUREMENT
/end FUNCTION
/begin FUNCTION lub_getnmin "" /end FUNCTION
/begin FUNCTION lub_getnmin_uic "" /end FUNCTION
/begin FUNCTION lub_getnmin_var "" /end FUNCTION
/begin FUNCTION lub_msg "" /begin OUT_MEASUREMENT Lub_nMin /end OUT_MEASUREMENT /end FUNCTION
/begin FUNCTION mcmess "Messen über K-Line" /begin DEF_CHARACTERISTIC McMess_stEnable_C /end DEF_CHARACTERISTIC /end FUNCTION
/begin FUNCTION mcy315_conf ""
 /begin DEF_CHARACTERISTIC CrSCD_numGlFilter_C CrSCD_numThresCtlHigh_C CrSCD_numThresCtlLow_C /end DEF_CHARACTERISTIC
/end FUNCTION
/begin FUNCTION memmon "Überwachung des Speichers"
 /begin DEF_CHARACTERISTIC MemMon_numErrChkRam_C MemMon_numErrChkRom_C MemMon_tiHealChkRam_C MemMon_tiHealChkRom_C /end DEF_CHARACTERISTIC
/end FUNCTION
/begin FUNCTION memmon_msg ""
 /begin OUT_MEASUREMENT MemMon_ctErrChkRam MemMon_ctErrChkRom MemMon_ctHealChkRam MemMon_ctHealChkRom MemMon_st /end OUT_MEASUREMENT
/end FUNCTION
/begin FUNCTION meuncd_co "Zumeßeinheit"
 /begin DEF_CHARACTERISTIC MeUnCD_uSRCMin_C MeUnCD_uSRCMax_C MeUnCD_iLin_CUR MeUnCD_dcycMax_C MeUnCD_dcycMin_C MeUnCD_dcycSetValLin_CUR MeUnCD_dcycTst_C MeUnCD_DebExcTempDef_C MeUnCD_DebExcTempOk_C MeUnCD_DebNoLoadDef_C MeUnCD_DebNoLoadOk_C MeUnCD_DebShortCircBatDef_C MeUnCD_DebShortCircBatOk_C MeUnCD_DebShortCircGndDef_C MeUnCD_DebShortCircGndOk_C MeUnCD_DebSRCHighDef_C MeUnCD_DebSRCHighOk_C MeUnCD_DebSRCLowDef_C MeUnCD_DebSRCLowOk_C MeUnCD_facIGovInit_CUR MeUnCD_facIGovMax_C MeUnCD_facIGovMin_C MeUnCD_tiFlt1PT1_C MeUnCD_tiFlt2PT1_C MeUnCD_tiIGovDT1_C MeUnCD_IGovDKd_C MeUnCD_IGovIKi_C MeUnCD_IGovIKiPos_C MeUnCD_IGovIKiNeg_C MeUnCD_iIGovIWinPos_C MeUnCD_iIGovIWinNeg_C MeUnCD_tiFltPT1Init_C MeUnCD_nDiffMax_C MeUnCD_numAdc_C MeUnCD_numDia1_C MeUnCD_numDia2_C MeUnCD_numPwmOut_C MeUnCD_resCoil_C MeUnCD_stInvOut_C MeUnCD_stPwrStgDia_C MeUnCD_swt_C MeUnCD_tiBtwTst_C MeUnCD_tiIGovInit_C MeUnCD_tiPer_CUR /end DEF_CHARACTERISTIC
 /begin IN_MEASUREMENT FlSys_t MeUnCD_dcycSetVal_mp MeUnCD_nDiffRef_mp MeUnCD_uRawVal_mp /end IN_MEASUREMENT
/end FUNCTION
/begin FUNCTION meuncd_co_msg "" /begin OUT_MEASUREMENT MeUnCD_iGovActVal /end OUT_MEASUREMENT /end FUNCTION
/begin FUNCTION meuncd_co_uic ""
 /begin OUT_MEASUREMENT MeUnCD_dcycDT1_mp MeUnCD_dcycOut_mp MeUnCD_dcycSetValLin_mp MeUnCD_dcycSetVal_mp MeUnCD_facIGov_mp MeUnCD_iActFlt_mp MeUnCD_iDvt_mp MeUnCD_iSetFlt_mp MeUnCD_nDiffRef_mp MeUnCD_tiPer_mp MeUnCD_uRawVal_mp /end OUT_MEASUREMENT
/end FUNCTION
/begin FUNCTION meun_setcurr "Berechnung elektrischer Sollstrom für die Zumesseinheit"
 /begin DEF_CHARACTERISTIC MeUn_iCnvFlowRate_CUR MeUn_iSetMin_C MeUn_pActrPrt_C MeUn_pFlowOfFl_C /end DEF_CHARACTERISTIC
 /begin IN_MEASUREMENT Rail_dvolMeUnSet /end IN_MEASUREMENT
/end FUNCTION
/begin FUNCTION meun_setcurr_uic "" /begin DEF_CHARACTERISTIC MeUn_iSet_Vector MeUn_iSet_Channel /end DEF_CHARACTERISTIC /begin OUT_MEASUREMENT MeUn_iSet_mp MeUn_stActrCtl_mp /end OUT_MEASUREMENT /end FUNCTION
/begin FUNCTION models "" /end FUNCTION
/begin FUNCTION mrlycd "Hauptrelais Komponententreiber"
 /begin DEF_CHARACTERISTIC MRlyCD_ctTooEarlyThres_C MRlyCD_stInvOutNAB_C MRlyCD_stInvOutPSOFF_C MRlyCD_stInvOut_C MRlyCD_tiNotOpen_C /end DEF_CHARACTERISTIC
/end FUNCTION
/begin FUNCTION mrlycd_msg "" /begin OUT_MEASUREMENT MRlyCD_stFanShutOff MRlyCD_stMon MRlyCD_stPrevOpening /end OUT_MEASUREMENT /end FUNCTION
/begin FUNCTION mrlycd_uic "" /begin OUT_MEASUREMENT MRlyCD_ctTooEarly_mp /end OUT_MEASUREMENT /end FUNCTION
/begin FUNCTION msid "Master-Slave-Erkennung (Steuergeräteauswahl)" /begin DEF_CHARACTERISTIC MSidCD_numECUS_C MSid_swtMAIN_C /end DEF_CHARACTERISTIC /end FUNCTION
/begin FUNCTION msid_msg "" /begin OUT_MEASUREMENT MSidCD_numECUS MSidCD_swtMAIN /end OUT_MEASUREMENT /end FUNCTION
/begin FUNCTION netmng "Netzwerk Manager"
 /begin DEF_CHARACTERISTIC NetMng_CANFadeOutMaskA_C NetMng_CANFadeOutMaskB_C NetMng_CANFadeOutMaskC_C NetMng_ctBusOffRetriesA_C NetMng_ctBusOffRetriesB_C NetMng_ctBusOffRetriesC_C NetMng_ctInitRetryCanA_C NetMng_ctInitRetryCanB_C NetMng_ctInitRetryCanC_C NetMng_tiDebBusOffOkCanA_C NetMng_tiDebBusOffDefCanA_C NetMng_tiDebBusOffOkCanB_C NetMng_tiDebBusOffDefCanB_C NetMng_tiDebBusOffOkCanC_C NetMng_tiDebBusOffDefCanC_C NetMng_tiDebErrOkCanA_C NetMng_tiDebErrDefCanA_C NetMng_tiDebErrOkCanB_C NetMng_tiDebErrDefCanB_C NetMng_tiDebErrOkCanC_C NetMng_tiDebErrDefCanC_C NetMng_tiDebFadeoutASWInactvA_C NetMng_tiDebFadeoutASWActvA_C NetMng_tiDebFadeoutASWInactvB_C NetMng_tiDebFadeoutASWActvB_C NetMng_tiDebFadeoutASWInactvC_C NetMng_tiDebFadeoutASWActvC_C NetMng_tiDebFadeoutDiaInactvA_C NetMng_tiDebFadeoutDiaActvA_C NetMng_tiDebFadeoutDiaInactvB_C NetMng_tiDebFadeoutDiaActvB_C NetMng_tiDebFadeoutDiaInactvC_C NetMng_tiDebFadeoutDiaActvC_C NetMng_dRelBusCtrl_C NetMng_FadeOutMaskA_C NetMng_FadeOutMaskB_C NetMng_FadeOutMaskC_C NetMng_SplyVltgHysXLow_C NetMng_SplyVltgHysXHigh_C NetMng_SplyVltgHysYLow_C NetMng_SplyVltgHysYHigh_C NetMng_tiEngState_C NetMng_tiFadeoutGWSlpAck_C NetMng_tiFadeoutLowBat_C NetMng_tiFadeoutLowT15_C NetMng_tiFadeoutMin_C NetMng_tiFadeoutSpareStrt_C NetMng_tiFrstLckTxMsgCanA_C NetMng_tiFrstLckTxMsgCanB_C NetMng_tiFrstLckTxMsgCanC_C NetMng_tiLckTxMsgAftIniCanA_C NetMng_tiLckTxMsgAftIniCanB_C NetMng_tiLckTxMsgAftIniCanC_C NetMng_tiRecoverA_C NetMng_tiRecoverB_C NetMng_tiRecoverC_C /end DEF_CHARACTERISTIC
/end FUNCTION
/begin FUNCTION netmng_msg ""
 /begin OUT_MEASUREMENT NetMng_stCAN NetMng_stCanBusOffAct NetMng_stCanBusOffDeb NetMng_stFadeOut NetMng_stTP20CANMute NetMng_stTxMsgDisbl NetMng_stUsrMsgDisbl /end OUT_MEASUREMENT
/end FUNCTION
/begin FUNCTION netmng_uic ""
 /begin OUT_MEASUREMENT NetMng_ctRecoveryA_mp NetMng_ctRecoveryB_mp NetMng_ctRecoveryC_mp /end OUT_MEASUREMENT
/end FUNCTION
/begin FUNCTION nsc_corgn "" /begin DEF_CHARACTERISTIC NSC_numPrio_C NSC_st_C /end DEF_CHARACTERISTIC /end FUNCTION
/begin FUNCTION nsc_corgn_msg "" /begin OUT_MEASUREMENT NSC_numPrio NSC_st /end OUT_MEASUREMENT /end FUNCTION
/begin FUNCTION nsc_corgn_uic "" /end FUNCTION
/begin FUNCTION nvclb_calibration "" /end FUNCTION
/begin FUNCTION nvclb_calibration_uic "" /end FUNCTION
/begin COMPU_METHOD AirMassPerCyl "Luftmasse pro Zylinder" RAT_FUNC "%6.3" "[mg/Hub Luft]" COEFFS 0 10 0 0 0 1 /end COMPU_METHOD
/begin COMPU_METHOD AirMassPerTime "Luftmasse pro Zeit" RAT_FUNC "%6.3" "[Kg/h Luft]" COEFFS 0 10 0 0 0 1 /end COMPU_METHOD
/begin COMPU_METHOD AirMass_2 "Luftmasse (geringere Auflösung)" RAT_FUNC "%6.3" "[g]" COEFFS 0 10 0 0 0 1 /end COMPU_METHOD
/begin COMPU_METHOD Curr "Strom" RAT_FUNC "%6.2" "[mA]" COEFFS 0 1 0 0 0 1 /end COMPU_METHOD
/begin COMPU_METHOD CurRefPump "Applizierbarer Pumpreferenzstrom" TAB_VERB "%6.3" "" COMPU_TAB_REF CurRefPump /end COMPU_METHOD
/begin COMPU_VTAB CurRefPump "Applizierbarer Pumpreferenzstrom" TAB_VERB 16 0 "0 uA" 1 "10 uA" 2 "20 uA" 3 "30 uA" 4 "40 uA" 5 "50 uA" 6 "60 uA" 7 "70 uA" 8 "80 uA" 9 "90 uA" 10 "100 uA" 11 "110 uA" 12 "120 uA" 13 "130 uA" 14 "140 uA" 15 "150 uA" /end COMPU_VTAB
/begin COMPU_METHOD DtyCyc "Tastverhaeltnis" RAT_FUNC "%6.4" "[%]" COEFFS 0 100 0 0 0 1 /end COMPU_METHOD
/begin COMPU_METHOD EngN "Motordrehzahl" RAT_FUNC "%6.2" "[rpm]" COEFFS 0 1 0 0 0 1 /end COMPU_METHOD
/begin COMPU_METHOD EngTempFldSel "Verbale Umrechnung für Auswahl aus dem Motortemperatur-Feld Eng_tFld" TAB_VERB "%6.3" "" COMPU_TAB_REF EngTempFldSel /end COMPU_METHOD
/begin COMPU_VTAB EngTempFldSel "Verbale Umrechnung für Auswahl aus dem Motortemperatur-Feld Eng_tFld" TAB_VERB 5 0 "Coolant_Temperature" 1 "Oil_Temperature" 2 "Engine_Temperature" 3 "Fuel_Temperature" 4 "Coolant_Temperature_CAN" /end COMPU_VTAB
/begin COMPU_METHOD Fact "Faktor mit Auflösung 1 / 8192, hauptsächlich für einen Faktorenbereich 0...1 verwendet" RAT_FUNC "%6.5" "[-]" COEFFS 0 8192 0 0 0 1 /end COMPU_METHOD
/begin COMPU_METHOD InjMass "Einspritzmenge" RAT_FUNC "%6.4" "[mg/hub]" COEFFS 0 100 0 0 0 1 /end COMPU_METHOD
/begin COMPU_METHOD Kd "Differentialverstärkung Kd (gleiche Einheit/Umrechnungsformel an Ein- und Ausgang)" RAT_FUNC "%7.6" "[1/1]" COEFFS 0 65536 0 0 0 1 /end COMPU_METHOD
/begin COMPU_METHOD Kd_rpm2Nm "Differentialverstärkung Kd (Motordrehzahl EngN zu Motormoment Trq)" RAT_FUNC "%8.7" "[Nm/rpm]" COEFFS 0 655360 0 0 0 1 /end COMPU_METHOD
/begin COMPU_METHOD Kd_Temp_Kelv2Dcyc "Differentialverstärkung Kd (Temperatur zu Tastverhältnis)" RAT_FUNC "%8.7" "[%/(K)]" COEFFS 0 655360 0 0 0 1 /end COMPU_METHOD
/begin COMPU_METHOD Ki "Integrale Verstärkung Ki (gleiche Einheit/Umrechnungsregel an Ein- und Ausgang)" RAT_FUNC "%6.5" "[1/s]" COEFFS 0 4294.967296 0 0 0 1 /end COMPU_METHOD
/begin COMPU_METHOD Ki_curr2fact "Integralverstärkung (Strom Curr zu Faktor Fact)" RAT_FUNC "%10.9" "1/mA*s" COEFFS 0 35184372.088832 0 0 0 1 /end COMPU_METHOD
/begin COMPU_METHOD Ki_rpm2Nm "Integralverstärkung Ki (Motordrehzahl EngN zu Motormoment Trq)" RAT_FUNC "%7.6" "[Nm/(rpm*s)]" COEFFS 0 42949.67296 0 0 0 1 /end COMPU_METHOD
/begin COMPU_METHOD Ki_Temp_Kelv2Dcyc "Integralverstärkung (Temperatur zu Tastverhältnis)" RAT_FUNC "%7.6" "[%/(K)]" COEFFS 0 42949.67296 0 0 0 1 /end COMPU_METHOD
/begin COMPU_METHOD Kp "proportionale Verstärkung Kp (gleiche Einheit/Umrechnungsregel an Ein- und Ausgang)" RAT_FUNC "%7.6" "[1/1]" COEFFS 0 65536 0 0 0 1 /end COMPU_METHOD
/begin COMPU_METHOD Kp_rpm2Nm "Proportionale Verstärkung Kp (Motordrehzahl EngN zu Moment Trq)" RAT_FUNC "%8.7" "[Nm/rpm]" COEFFS 0 655360 0 0 0 1 /end COMPU_METHOD
/begin COMPU_METHOD Kp_Temp_Kelv2Dcyc "Proportionalverstärkung (Temperatur zu Tastverhältnis)" RAT_FUNC "%8.7" "[%/(K)]" COEFFS 0 655360 0 0 0 1 /end COMPU_METHOD
/begin COMPU_METHOD lambda "Lambda" RAT_FUNC "%6.5" "[-]" COEFFS 0 1000 0 0 0 1 /end COMPU_METHOD
/begin COMPU_METHOD lambdaRecVal "Reziproker Lambda Wert" RAT_FUNC "%6.5" "[-]" COEFFS 0 1000 0 0 0 1 /end COMPU_METHOD
/begin COMPU_METHOD NumPinAdc "verbale Umrechnung für ADC Signale" TAB_VERB "%6.3" "" COMPU_TAB_REF NumPinAdc /end COMPU_METHOD
/begin COMPU_VTAB NumPinAdc "verbale Umrechnung für ADC Signale" TAB_VERB 75 0 "Dummy_0" 1 "Dummy_1" 2 "Kick_Down_Switch" 3 "EGR_Actuator_Sensor" 4 "Intake_Air_Temperature_Sensor" 5 "Variable_Swirl_Position_1" 6 "Dummy_2" 7 "Terminal_50_Signal" 8 "Atmospheric_Pressure_Sensor" 9 "Starter_Sensor_1" 10 "Terminal_15_Signal" 11 "Dummy_3" 12 "Engine_Oil_Temperature_Sensor" 13 "Internal_Temperature_ECU" 14 "Variable_Swirl_Position_2" 15 "Dummy_4" 16 "Brake_Pedal_Switch" 17 "Empty_Tank_Switch" 18 "Dummy_5" 19 "Rhaps_Methyl_Sensor" 20 "Fuel_Level_Additive_Pump" 21 "Dummy_6" 22 "Interlock_Switch" 23 "Fuel_Temperature_Sensor" 24 "Fuel_Low_Pressure_Sensor" 25 "Dummy_7" 26 "Throttle_Valve_Position" 27 "Terminal_50_redundant_Signal" 28 "Water_Temperature_Sensor_2" 29 "Starter_Sensor_2" 30 "Boost_Pressure_Sensor" 31 "Rail_Pressure_Sensor_Peak" 32 "Rail_Pressure_Sensor_Actual" 33 "Lambda_Sensor_NLamda" 34 "Lambda_Sensor_RLamda" 35 "Exhaust_Gas_contra_Pressure_Sensor_1" 36 "Exhaust_Gas_contra_Pressure_Sensor_2" 37 "Engine_Temperature_Sensor" 38 "Air_Mass_Sensor_HFM5" 39 "1st_APP_Sensor" 40 "2nd_APP_Sensor" 41 "Exhaust_Gas_Temperature_Sensor_1_1" 42 "Exhaust_Gas_Temperature_Sensor_2_1" 43 "Exhaust_Gas_Temperature_Sensor_3_1" 44 "Exhaust_Gas_Temperature_Sensor_1_2" 45 "Exhaust_Gas_Temperature_Sensor_2_2" 46 "Reference_Voltage" 47 "Current_MeUn_Sensor" 48 "Current_PCV_Sensor" 49 "Battery_Voltage" 50 "Charge_Actuator_Event_1" 51 "Voltage_Piezo_Actuator_Bank_1_Event_1" 52 "Voltage_Piezo_Actuator_Bank_2_Event_1" 53 "Charge_Actuator_Event_2" 54 "Voltage_Piezo_Actuator_Bank_1_Event_2" 55 "Voltage_Piezo_Actuator_Bank_2_Event_2" 56 "Charge_Actuator_Event_3" 57 "Voltage_Piezo_Actuator_Bank_1_Event_3" 58 "Voltage_Piezo_Actuator_Bank_2_Event_3" 59 "Voltage_Buffer_Entry_1" 60 "Voltage_Buffer_Entry_2" 61 "Voltage_Buffer_Entry_3" 62 "Voltage_Buffer_Entry_4" 63 "Voltage_Buffer_Entry_5" 64 "Voltage_Buffer_Entry_6" 65 "Voltage_Buffer_Entry_7" 66 "Voltage_Buffer_Entry_8" 67 "Voltage_Buffer_Entry_9" 68 "Voltage_Buffer_Entry_10" 69 "Voltage_Buffer_Entry_11" 70 "Voltage_Buffer_Entry_12" 71 "Voltage_Buffer_Entry_13" 72 "Voltage_Buffer_Entry_14" 73 "Voltage_Buffer_Entry_15" 74 "Booster_Voltage_Piezo" /end COMPU_VTAB
/begin COMPU_METHOD NumPinDia "Verbale Umrechnung für Diagnose Signale" TAB_VERB "%6.3" "" COMPU_TAB_REF NumPinDia /end COMPU_METHOD
/begin COMPU_VTAB NumPinDia "Verbale Umrechnung für Diagnose Signale" TAB_VERB 43 0 "Fuel_Cooling_DiaSig" 1 "Engine_Mount_1_DiaSig" 2 "Additive_Pump_DiaSig" 3 "Intercooler_Fan_DiaSig" 4 "Electric_Tank_Pump_DiaSig" 5 "Gearbox_Mount_2_DiaSig" 6 "TLE_State_DiaSig" 7 "Variable_Swirl_1_DiaSig" 8 "Engine_Mount_2_DiaSig" 9 "Variable_Swirl_2_DiaSig" 10 "Water_Pump_Relais_DiaSig" 11 "Boost_Pressure_Actuator_DiaSig" 12 "Throttle_Valve_Actuator_DiaSig" 13 "Fan_Control_2_DiaSig" 14 "Fan_Control_1_DiaSig" 15 "Gearbox_Mount_1_DiaSig" 16 "Glow_Relais_DiaSig" 17 "Alternator_Shut_Off_DiaSig" 18 "Exhaust_Gas_Recirculation_DiaSig" 19 "1st_Metering_Unit_DiaSig" 20 "2nd_Metering_Unit_DiaSig" 21 "1st_Pressure_Control_Valve_DiaSig" 22 "2nd_Pressure_Control_Valve_DiaSig" 23 "Exhaust_Gas_Recirculation_Cooling_Bypass_DiaSig" 24 "Snow_Valve_DiaSig" 25 "CJ945_State_DiaSig" 26 "1st_Sensor_Supply_Voltage_DiaSig" 27 "2nd_Sensor_Supply_Voltage_DiaSig" 28 "3rd_Sensor_Supply_Voltage_DiaSig" 29 "Glow_Control_3_DiaSig" 30 "CJ315_State_DiaSig" 31 "Lambda_VM_DiaSig" 32 "Lambda_UN_DiaSig" 33 "Lambda_IA_DiaSig" 34 "Lambda_Heater_DiaSig" 35 "Lambda_CJ120_DiaSig" 36 "Dummy_FELA_DiaSig" 37 "Dummy_K15NAB_DiaSig" 38 "Dummy_MIL_DiaSig" 39 "Dummy_KOS_DiaSig" 40 "Dummy_ZHSG_DiaSig" 41 "Dummy_GAZ_DiaSig" 42 "Dummy_ETR_DiaSig" /end COMPU_VTAB
/begin COMPU_METHOD NumPinPwmOut "Verbale Umrechnung für PWM-Ausgang Signale" TAB_VERB "%6.3" "" COMPU_TAB_REF NumPinPwmOut /end COMPU_METHOD
/begin COMPU_VTAB NumPinPwmOut "Verbale Umrechnung für PWM-Ausgang Signale" TAB_VERB 14 0 "Dummy_1" 1 "Lambda_Probe_Internal_Use" 2 "Variable_Swirl_Actuator_1" 3 "Variable_Swirl_Actuator_2" 4 "Fan_Control_1" 5 "Fan_Control_2" 6 "Boost_Pressure_Actuator_1" 7 "Boost_Pressure_Actuator_2" 8 "Throttle_Valve_Actuator" 9 "Additive_Pump_Diagnosis" 10 "Exhaust_Gas_Recirculation_Actuator" 11 "Glow_Control_3" 12 "PCV_Actuator" 13 "MeUn_Actuator" /end COMPU_VTAB
/begin COMPU_METHOD O2 "Sauerstoffkonzentration" RAT_FUNC "%8.7" "[-]" COEFFS 0 100000 0 0 0 1 /end COMPU_METHOD
/begin COMPU_METHOD OneToOne "eins zu eins (physikalischer Wert ist gleich dem internen Wert)" RAT_FUNC "%6.2" "[-]" COEFFS 0 1 0 0 0 1 /end COMPU_METHOD
/begin COMPU_METHOD Period "Periodendauer" RAT_FUNC "%6.3" "[ms]" COEFFS 0 10 0 0 0 1 /end COMPU_METHOD
/begin COMPU_METHOD Prc "Prozent, gleiche interne Auflösung wie Fact, aber Darstellung in Prozent (0...100%)" RAT_FUNC "%6.4" "[%]" COEFFS 0 100 0 0 0 1 /end COMPU_METHOD
/begin COMPU_METHOD Pres_hPa "Druck (angezeigt in [hPa])" RAT_FUNC "%6.2" "[hPa]" COEFFS 0 1 0 0 0 1 /end COMPU_METHOD
/begin COMPU_METHOD Pres_Rail "Raildruck in hPa" RAT_FUNC "%6.0" "[hPa]" COEFFS 0 0.01 0 0 0 1 /end COMPU_METHOD
/begin COMPU_METHOD Qp_mm3_sec "Umrechnung für Volumenstrom" RAT_FUNC "%6.1" "mm3/s" COEFFS 0 0.1 0 0 0 1 /end COMPU_METHOD
/begin COMPU_METHOD Resist "Widerstand" RAT_FUNC "%6.3" "[Ohm]" COEFFS 0 10 0 0 0 1 /end COMPU_METHOD
/begin COMPU_METHOD Resist_1 "1. Widerstandsvariante" RAT_FUNC "%6.2" "mOhm" COEFFS 0 1 0 0 0 1 /end COMPU_METHOD
/begin COMPU_METHOD RmpDtyCyc "Rampengradient für Tastverhältnis" RAT_FUNC "%6.5" "[%/s]" COEFFS 0 6553.6 0 0 0 1 /end COMPU_METHOD
/begin COMPU_METHOD RmpEngN_LIGov "Motordrehzahlgradient für Leerlaufreglerrampe" RAT_FUNC "%6.4" "[rpm/s]" COEFFS 0 458.752 0 0 0 1 /end COMPU_METHOD
/begin COMPU_METHOD TempDiff_Kelv "Offsettemperatur dargestellt in [K]" RAT_FUNC "%6.3" "[ deg C ]" COEFFS 0 10 0 0 0 1 /end COMPU_METHOD
/begin COMPU_METHOD Temp_Cels "Temperatur dargestellt in °C (gleiche interne Darstellung wie Temp_Kelv)" RAT_FUNC "%6.1" "[deg C]" COEFFS 0 10 2731.4 0 0 1 /end COMPU_METHOD
/begin COMPU_METHOD TimeDeb "Entprellzeit in Millisekunden für Libraryfunktion Debounce" RAT_FUNC "%6.1" "[ms]" COEFFS 0 0.1 0 0 0 1 /end COMPU_METHOD
/begin COMPU_METHOD TimeDelay_s "Zeitkonstante T1 (in s) für PT1, DT1, etc." RAT_FUNC "%9.3" "[s]" COEFFS 0 0 1 0 0.00023283064365387 0 /end COMPU_METHOD
/begin COMPU_METHOD TimeDelay_s_Lin_16 "Zeitkonstante T1 (in s) für PT1, DT1, etc. für SINT16, kein Kehrwert" RAT_FUNC "%6.5" "s" COEFFS 0 6553.4 0 0 0 1 /end COMPU_METHOD
/begin COMPU_METHOD TimeDT_ms "sample time (DT) des Tasks ,verwendet fuer Regler, Filter etc. ... angezeigt in [ms]" RAT_FUNC "%6.5" "[ms]" COEFFS 0 1000 0 0 0 1 /end COMPU_METHOD
/begin COMPU_METHOD Time_ms "Zeit in ms für Fehlerentprellung (DSM) und SW-Timer" RAT_FUNC "%6.1" "[ms]" COEFFS 0 0.1 0 0 0 1 /end COMPU_METHOD
/begin COMPU_METHOD Time_ms_40ms "Aktuelle Zaehler in 40 ms Takt" RAT_FUNC "%6.1" "ms" COEFFS 0 0.025 0 0 0 1 /end COMPU_METHOD
/begin COMPU_METHOD Time_s "Zeit in s für Fehlerentprellung (DSM) und SW-Timer" RAT_FUNC "%6.4" "[s]" COEFFS 0 100 0 0 0 1 /end COMPU_METHOD
/begin COMPU_METHOD Trq "Motormoment" RAT_FUNC "%6.3" "[Nm]" COEFFS 0 10 0 0 0 1 /end COMPU_METHOD
/begin COMPU_METHOD Vel "Fahrzeuggeschwindigkeit, gleiche interne Auflösung wie Vel_SI" RAT_FUNC "%6.4" "[km/h]" COEFFS 0 100 0 0 0 1 /end COMPU_METHOD
/begin COMPU_METHOD Volt "Spannung in V (von ADC)" RAT_FUNC "%6.2" "[mV]" COEFFS 0 0.2046 0 0 0 1 /end COMPU_METHOD
/begin COMPU_METHOD VoltToRes "Umrechnung für Faktor Spannung zu Widerstand" RAT_FUNC "%7.6" "[Ohm/mV]" COEFFS 0 50830.889540567 0 0 0 1 /end COMPU_METHOD
/begin COMPU_METHOD Volt_Batt "Batteriespannung" RAT_FUNC "%6.1" "[mV]" COEFFS 0 0.0492252911173131 0 0 0 1 /end COMPU_METHOD
/begin COMPU_METHOD Volt_PA "Spannung des Piezo-Aktors" RAT_FUNC "%6.4" "V" COEFFS 0 100 0 0 0 1 /end COMPU_METHOD
/begin RECORD_LAYOUT Kf_Xs16_Ys16_Ws16 NO_AXIS_PTS_X 1 SWORD NO_AXIS_PTS_Y 2 SWORD AXIS_PTS_X 3 SWORD INDEX_INCR DIRECT AXIS_PTS_Y 4 SWORD INDEX_INCR DIRECT FNC_VALUES 5 SWORD COLUMN_DIR DIRECT /end RECORD_LAYOUT
/begin RECORD_LAYOUT Kl_Xs16_Ws16 NO_AXIS_PTS_X 1 SWORD AXIS_PTS_X 2 SWORD INDEX_INCR DIRECT FNC_VALUES 3 SWORD COLUMN_DIR DIRECT /end RECORD_LAYOUT
/begin RECORD_LAYOUT Kwb_Ws16 FNC_VALUES 1 SWORD COLUMN_DIR DIRECT /end RECORD_LAYOUT
/begin RECORD_LAYOUT Kwb_Wu8 FNC_VALUES 1 UBYTE COLUMN_DIR DIRECT /end RECORD_LAYOUT
/begin RECORD_LAYOUT Kw_Ws16 FNC_VALUES 1 SWORD COLUMN_DIR DIRECT /end RECORD_LAYOUT
/begin RECORD_LAYOUT Kw_Ws32 FNC_VALUES 1 SLONG COLUMN_DIR DIRECT /end RECORD_LAYOUT
/begin RECORD_LAYOUT Kw_Ws8 FNC_VALUES 1 SBYTE COLUMN_DIR DIRECT /end RECORD_LAYOUT
/begin RECORD_LAYOUT Kw_Wu16 FNC_VALUES 1 UWORD COLUMN_DIR DIRECT /end RECORD_LAYOUT
/begin RECORD_LAYOUT Kw_Wu32 FNC_VALUES 1 ULONG COLUMN_DIR DIRECT /end RECORD_LAYOUT
/begin RECORD_LAYOUT Kw_Wu8 FNC_VALUES 1 UBYTE COLUMN_DIR DIRECT /end RECORD_LAYOUT
/end MODULE
/end PROJECT
