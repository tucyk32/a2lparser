ASAP2_VERSION 1 3
/begin PROJECT C177 "EDC16CP"
/begin HEADER "" VERSION "VCP7A3" PROJECT_NO C177 /end HEADER
/begin MODULE DIM ""
/begin MOD_COMMON "" BYTE_ORDER MSB_FIRST ALIGNMENT_BYTE 1 ALIGNMENT_WORD 2 ALIGNMENT_LONG 4 ALIGNMENT_FLOAT32_IEEE 4 /end MOD_COMMON
/begin CHARACTERISTIC PFlt_cpExhGs_C "Spezifische Wärmekapazität des Abgases" VALUE 0x1E4684 Kw_Wu16 2000.000 Thr_Cpty_ExhGs 0.00 2000.000 FORMAT "%8.3" EXTENDED_LIMITS 0.00 655350.0 /end CHARACTERISTIC
/begin CHARACTERISTIC PFlt_CPFlt_C "Wärmekapazität des Partikelfilters" VALUE 0x1E4686 Kw_Wu16 32900.00 Thr_Cpty 100.0000 33000.00 FORMAT "%8.2" EXTENDED_LIMITS 0.00 65535.00 /end CHARACTERISTIC
/begin CHARACTERISTIC PFlt_ddvolHsLnPlausNeg_C "Negativer Schwellwert Volumenstromänderung zur Dynamikplausibilisierung" VALUE 0x1E4618 Kw_Ws16 1500.000 CubMtrPerHrPerSec -1500.000 0.00 FORMAT "%8.3" EXTENDED_LIMITS -3276.800 3276.700 /end CHARACTERISTIC
/begin CHARACTERISTIC PFlt_ddvolHsLnPlausPos_C "Positiver Schwellwert Volumenstromänderung zur Dynamikplausibilisierung" VALUE 0x1E461A Kw_Ws16 1500.000 CubMtrPerHrPerSec 0.00 1500.000 FORMAT "%8.3" EXTENDED_LIMITS -3276.800 3276.700 /end CHARACTERISTIC
/begin CHARACTERISTIC PFlt_ddvolHsLnSot_C "Schwellwert Volumenstromänderung zur Schlauchleitungsüberwachung" VALUE 0x1E461C Kw_Ws16 3000.000 CubMtrPerHrPerSec -1500.000 1500.000 FORMAT "%8.3" EXTENDED_LIMITS -3276.800 3276.700 /end CHARACTERISTIC
/begin CHARACTERISTIC PFlt_dtAccPedMax_C "Min. Fahrpedal-Betätigungsgeschwindigkeit für schnelle Regenerations-Unterbrechung" VALUE 0x1E33F0 Kw_Ws16 300.0000 TrqPerSec 0.00 300.0000 FORMAT "%8.4" EXTENDED_LIMITS -32768.00 32767.00 /end CHARACTERISTIC
/begin CHARACTERISTIC PFlt_dvolCharMonMin_C "Mindestvolumenstrom für Überwachung des Strömungswiderstandes" VALUE 0x1E461E Kw_Ws16 100.0000 CubMtrPerHr 0.00 100.0000 FORMAT "%8.4" EXTENDED_LIMITS -3276.800 3276.700 /end CHARACTERISTIC
/begin CHARACTERISTIC PFlt_dvolMaxSotSim_C "Maximaler Abgasvolumenstrom für Rußbeladungsberechnung" VALUE 0x1E3AB0 Kw_Ws16 3000.000 CubMtrPerHr 0.00 3000.000 FORMAT "%8.3" EXTENDED_LIMITS -3276.800 3276.700 /end CHARACTERISTIC
/begin CHARACTERISTIC PFlt_dvolMinSotSim_C "Minimaler Abgasvolumenstrom für Rußbeladungsberechnung" VALUE 0x1E3AB2 Kw_Ws16 3000.000 CubMtrPerHr 0.00 3000.000 FORMAT "%8.3" EXTENDED_LIMITS -3276.800 3276.700 /end CHARACTERISTIC
/begin CHARACTERISTIC PFlt_facAdd2Ash_C "Umrechnungsfaktor Aschemasse pro verbrannte Additivmenge [g/l]" VALUE 0x1E3AB4 Kw_Wu16 9999.847 volAddfine2mAsh 0.00 9999.847 FORMAT "%8.3" /end CHARACTERISTIC
/begin CHARACTERISTIC PFlt_facAshMs2Ld_C "Umrechnungsfaktor Filterbeladung pro Aschemasse [%/g]" VALUE 0x1E3AB6 Kw_Ws16 4095.875 facMsAsh2Prc 0.00 4095.875 FORMAT "%8.3" EXTENDED_LIMITS -4096.000 4095.875 /end CHARACTERISTIC
/begin CHARACTERISTIC PFlt_facAshMs2Ld_CUR "Interpolation des Aschenbeladungskorrekturfaktors wegen einer  nicht-linearen Aschenverteilung im Partikelfilter[ ]" CURVE 0x1E3AB8 Kl_Xs16_Ws16 3.999878 Fact 0.00 3.999878 FORMAT "%8.6" EXTENDED_LIMITS -4.000000 3.999878
 /begin AXIS_DESCR STD_AXIS PFlt_mAshTrmTot_mp mAsh 5 0.00 500.0000 FORMAT "%8.4" EXTENDED_LIMITS -3276.800 3276.700 DEPOSIT ABSOLUTE /end AXIS_DESCR
/end CHARACTERISTIC
/begin CHARACTERISTIC PFlt_facBlwBy_C "Thermischer Austauschfaktor für Abgas im Filter" VALUE 0x1E4688 Kw_Ws16 1.000000 Fact 0.00 1.000000 FORMAT "%8.6" EXTENDED_LIMITS -4.000000 3.999878 /end CHARACTERISTIC
/begin CHARACTERISTIC PFlt_facDpn_C "Dissipationsfaktor für Abgasdruck" VALUE 0x1E468A Kw_Ws16 1.000000 Fact 0.00 1.000000 FORMAT "%8.6" EXTENDED_LIMITS -4.000000 3.999878 /end CHARACTERISTIC
/begin CHARACTERISTIC PFlt_facFl2Ash_C "Umrechnungsfaktor Aschemasse pro verbrannte Treibstoffmenge [g/l]" VALUE 0x1E3ACE Kw_Wu16 0.1525856 volFl2mAsh 0.00 0.1525856 FORMAT "%9.7" /end CHARACTERISTIC
/begin CHARACTERISTIC PFlt_facFltEmpConst_C "Faktor zur Ermittlung des simulierten Differenzdruckes bei leerem Filter [1/m^4]" VALUE 0x1E3AD0 Kw_Ws16 1200000. facEulerToPres 0.00 1200000. FORMAT "%8.0" EXTENDED_LIMITS -1241212. 1241174. /end CHARACTERISTIC
/begin CHARACTERISTIC PFlt_facFltEmp_CUR "zur Interpolation des simulierten Differenzdrucks für leeres Filter [-]" CURVE 0x1E3AD2 Kl_Xs16_Ws16 3.999878 Fact 0.00 3.999878 FORMAT "%8.6" EXTENDED_LIMITS -4.000000 3.999878
 /begin AXIS_DESCR STD_AXIS PFlt_pPreInt Pres_hPa 8 0.00 3500.000 FORMAT "%8.3" EXTENDED_LIMITS -32768.00 32767.00 DEPOSIT ABSOLUTE /end AXIS_DESCR
/end CHARACTERISTIC
/begin CHARACTERISTIC PFlt_facFltFulConst_C "Faktor zur Ermittlung des simulierten Differenzdruckes bei vollem Filter [1/m^4]" VALUE 0x1E3AF4 Kw_Ws16 1200000. facEulerToPres 0.00 1200000. FORMAT "%8.0" EXTENDED_LIMITS -1241212. 1241174. /end CHARACTERISTIC
/begin CHARACTERISTIC PFlt_facFltFul_CUR "zur Interpolation des simulierten Differenzdrucks für volles Filter [-]" CURVE 0x1E3AF6 Kl_Xs16_Ws16 3.999878 Fact 0.00 3.999878 FORMAT "%8.6" EXTENDED_LIMITS -4.000000 3.999878
 /begin AXIS_DESCR STD_AXIS PFlt_pPreInt Pres_hPa 8 0.00 3500.000 FORMAT "%8.3" EXTENDED_LIMITS -32768.00 32767.00 DEPOSIT ABSOLUTE /end AXIS_DESCR
/end CHARACTERISTIC
/begin CHARACTERISTIC PFlt_facHtTransNoLin_CUR "Nichtlinearitätsfaktor in der Wärmeübertragung im Filter" CURVE 0x1E468C Kl_Xs16_Ws16 1.000000 Fact 0.00 1.000000 FORMAT "%8.6" EXTENDED_LIMITS -4.000000 3.999878
 /begin AXIS_DESCR STD_AXIS PFlt_tDiffCorr_mp TempDiff_Kelv 8 500.0000 1000.000 FORMAT "%8.3" EXTENDED_LIMITS -3276.800 3276.700 DEPOSIT ABSOLUTE /end AXIS_DESCR
/end CHARACTERISTIC
/begin CHARACTERISTIC PFlt_facSotPresFac_C "Steigung für Partikelfilterbeladung [-]" VALUE 0x1E3B18 Kw_Ws16 1.000000 Fact 0.00 1.000000 FORMAT "%8.6" EXTENDED_LIMITS -4.000000 3.999878 /end CHARACTERISTIC
/begin CHARACTERISTIC PFlt_facSotSimLmbd_CUR "Kennlinie für Gewichtung des Beladungsgfaktors für Entladung mit einem lambdaabh Faktor[-]" CURVE 0x1E3B1A Kl_Xs16_Ws16 2.000000 Fact 0.00 2.000000 FORMAT "%8.6" EXTENDED_LIMITS -4.000000 3.999878
 /begin AXIS_DESCR STD_AXIS PFlt_rLmbd lambda 8 0.00 30.00000 FORMAT "%8.5" EXTENDED_LIMITS -32.76800 32.76700 DEPOSIT ABSOLUTE /end AXIS_DESCR
/end CHARACTERISTIC
/begin CHARACTERISTIC PFlt_facSotSimTempHi_C "oberer Schwellwert für Berücksichtigung des integrierten Wertes" VALUE 0x1E3B3C Kw_Ws16 1.000000 Fact 0.00 1.000000 FORMAT "%8.6" EXTENDED_LIMITS -4.000000 3.999878 /end CHARACTERISTIC
/begin CHARACTERISTIC PFlt_facSotSimTempLo_C "unterer Schwellwert zur Berücksichtigung des integrierten Wertes" VALUE 0x1E3B3E Kw_Ws16 1.000000 Fact 0.00 1.000000 FORMAT "%8.6" EXTENDED_LIMITS -4.000000 3.999878 /end CHARACTERISTIC
/begin CHARACTERISTIC PFlt_facSotSimTemp_C "multiplikative Anpassung der berechneten Russmasse im Beladungszähler" VALUE 0x1E3B40 Kw_Ws16 1.000000 Fact 0.00 1.000000 FORMAT "%8.6" EXTENDED_LIMITS -4.000000 3.999878 /end CHARACTERISTIC
/begin CHARACTERISTIC PFlt_facSotSim_CUR "Berechnung des Summanden im Beladungszähler" CURVE 0x1E3B42 Kl_Xs16_Ws16 2.000000 Fact 0.00 2.000000 FORMAT "%8.6" EXTENDED_LIMITS -4.000000 3.999878
 /begin AXIS_DESCR STD_AXIS PFlt_rLmbd lambda 8 0.00 30.00000 FORMAT "%8.5" EXTENDED_LIMITS -32.76800 32.76700 DEPOSIT ABSOLUTE /end AXIS_DESCR
/end CHARACTERISTIC
/begin CHARACTERISTIC PFlt_facSOxPsng_C "Verhältnis von Verschwefelungs- zu Entschwefelungszeit im Partikelfilter" VALUE 0x1E33F2 Kw_Ws16 1.000000 Fact 0.00 1.000000 FORMAT "%8.6" EXTENDED_LIMITS -4.000000 3.999878 /end CHARACTERISTIC
/begin CHARACTERISTIC PFlt_facTRgnMaxRlx_C "Faktor für Herunterzählverhältnis des Regenerationsüberwachungszählers" VALUE 0x1E33F4 Kw_Wu16 7.900024 Fact 0.09997559 8.000000 FORMAT "%8.6" EXTENDED_LIMITS 0.00 7.999878 /end CHARACTERISTIC
/begin CHARACTERISTIC PFlt_KdDT1TempCor_C "Sprunghöhe des DT1-Filters der Wärmeübergangssim. im Filter" VALUE 0x1E46B0 Kw_Ws32 100.000000000 Kd -50.0000000000 50.0000000000 FORMAT "%13.10" EXTENDED_LIMITS -32768.0000000 32767.9999847 /end CHARACTERISTIC
/begin CHARACTERISTIC PFlt_kiITempMod_C "Verstärkungsfaktor Integrator Temperaturmodell" VALUE 0x1E46B4 Kw_Ws32 999999.999767 Ki -500000.000000 499999.999767 FORMAT "%13.6" /end CHARACTERISTIC
/begin CHARACTERISTIC PFlt_lSumMaxDef_C "gefahrene Strecke Schwelle für Regeneration im Fehlerfall" VALUE 0x1E33F8 Kw_Wu32 4294967295.00 Length 0.00 4294967295.00 FORMAT "%13.2" /end CHARACTERISTIC
/begin CHARACTERISTIC PFlt_lSumMax_C "gefahrene Strecke Schwelle für Regeneration" VALUE 0x1E33FC Kw_Wu32 4294967295.00 Length 0.00 4294967295.00 FORMAT "%13.2" /end CHARACTERISTIC
/begin CHARACTERISTIC PFlt_lSumSubs_C "Ersatzwert für gefahrene Strecke im Fall eines Eeprom lese Fehlers" VALUE 0x1E3400 Kw_Wu32 4294967295.00 Length 0.00 4294967295.00 FORMAT "%13.2" /end CHARACTERISTIC
/begin CHARACTERISTIC PFlt_mAshfacAdjDfl_C "Standardablgleichwert für Aschemasse" VALUE 0x1E3B64 Kw_Wu32 300.000000000 mAsh_g 0.00 300.000000000 FORMAT "%13.9" EXTENDED_LIMITS 0.00 655.359999847 /end CHARACTERISTIC
/begin CHARACTERISTIC PFlt_mAshfacAdjMax_C "Maximaler Abgleichwert für Aschemasse" VALUE 0x1E3B68 Kw_Wu32 300.000000000 mAsh_g 0.00 300.000000000 FORMAT "%13.9" EXTENDED_LIMITS 0.00 655.359999847 /end CHARACTERISTIC
/begin CHARACTERISTIC PFlt_mAshfacAdjMin_C "Minimaler Abgleichwert für Aschemasse" VALUE 0x1E3B6C Kw_Wu32 300.000000000 mAsh_g 0.00 300.000000000 FORMAT "%13.9" EXTENDED_LIMITS 0.00 655.359999847 /end CHARACTERISTIC
/begin CHARACTERISTIC PFlt_nAvrgHysHigh1_C "Oberer Hystereseschwellwert Drehzahlhysterese 1" VALUE 0x1E3844 Kw_Ws16 5960.000 EngN 40.00000 6000.000 FORMAT "%8.3" EXTENDED_LIMITS -32768.00 32767.00 /end CHARACTERISTIC
/begin CHARACTERISTIC PFlt_nAvrgHysHigh2_C "Oberer Hystereseschwellwert Drehzahlhysterese 2" VALUE 0x1E3846 Kw_Ws16 5960.000 EngN 40.00000 6000.000 FORMAT "%8.3" EXTENDED_LIMITS -32768.00 32767.00 /end CHARACTERISTIC
/begin CHARACTERISTIC PFlt_nAvrgHysLow1_C "Unterer Hystereseschwellwert Drehzahlhysterese 1" VALUE 0x1E3848 Kw_Ws16 5960.000 EngN 40.00000 6000.000 FORMAT "%8.3" EXTENDED_LIMITS -32768.00 32767.00 /end CHARACTERISTIC
/begin CHARACTERISTIC PFlt_nAvrgHysLow2_C "Oberer Hystereseschwellwert Drehzahlhysterese 2" VALUE 0x1E384A Kw_Ws16 5960.000 EngN 40.00000 6000.000 FORMAT "%8.3" EXTENDED_LIMITS -32768.00 32767.00 /end CHARACTERISTIC
/begin CHARACTERISTIC PFlt_nTempChkTrg_C "Drehzahlschwelle zur Triggerung Zeitfenster Temperaturplausibilisierung" VALUE 0x1E4620 Kw_Ws16 1500.000 EngN 500.0000 2000.000 FORMAT "%8.3" EXTENDED_LIMITS -32768.00 32767.00 /end CHARACTERISTIC
/begin CHARACTERISTIC PFlt_numEngPOp1_CA "Matrix 1 zur Berücksichtigung des Motorbetriebszustandes bei der Regeneration" MAP 0x1E3404 Kf_Xu8_Yu8_Wu8 6.000 OneToOne 0.00 6.000 FORMAT "%5.3" EXTENDED_LIMITS 0.00 255.0
 /begin AXIS_DESCR STD_AXIS PFlt_stEngPOp OneToOne 7 0.00 15.00 FORMAT "%5.2" EXTENDED_LIMITS 0.00 255.0 DEPOSIT ABSOLUTE /end AXIS_DESCR
 /begin AXIS_DESCR STD_AXIS PFlt_numRgn_mp OneToOne 8 0.00 7.000 FORMAT "%5.3" EXTENDED_LIMITS 0.00 255.0 DEPOSIT ABSOLUTE /end AXIS_DESCR
/end CHARACTERISTIC
/begin CHARACTERISTIC PFlt_numEngPOp2_CA "Matrix 2 zur Berücksichtigung des Motorbetriebszustandes bei der Regeneration" MAP 0x1E344D Kf_Xu8_Yu8_Wu8 6.000 OneToOne 0.00 6.000 FORMAT "%5.3" EXTENDED_LIMITS 0.00 255.0
 /begin AXIS_DESCR STD_AXIS PFlt_stEngPOp OneToOne 7 0.00 15.00 FORMAT "%5.2" EXTENDED_LIMITS 0.00 255.0 DEPOSIT ABSOLUTE /end AXIS_DESCR
 /begin AXIS_DESCR STD_AXIS PFlt_numRgn_mp OneToOne 8 0.00 7.000 FORMAT "%5.3" EXTENDED_LIMITS 0.00 255.0 DEPOSIT ABSOLUTE /end AXIS_DESCR
/end CHARACTERISTIC
/begin CHARACTERISTIC PFlt_numFltEmpEu_CUR "Eulerzahl für leeres filter [-]" CURVE 0x1E3B70 Kl_Xs16_Ws16 3276.700 EulerNum 0.00 3276.700 FORMAT "%8.3" EXTENDED_LIMITS -3276.800 3276.700
 /begin AXIS_DESCR STD_AXIS PFlt_numFltEmpRe_mp ReynoldsNum 16 0.00 3276700. FORMAT "%8.0" EXTENDED_LIMITS -3276800. 3276700. DEPOSIT ABSOLUTE /end AXIS_DESCR
/end CHARACTERISTIC
/begin CHARACTERISTIC PFlt_numFltEmpRe_MAP "Reynoldszahl für leeres Filter" MAP 0x1E3BB2 Kf_Xs16_Ys16_Ws16 3276700. ReynoldsNum 0.00 3276700. FORMAT "%8.0" EXTENDED_LIMITS -3276800. 3276700.
 /begin AXIS_DESCR STD_AXIS PFlt_tFlt Temp_Cels 8 -50.14000 999.8600 FORMAT "%8.4" EXTENDED_LIMITS -3549.940 3003.560 DEPOSIT ABSOLUTE /end AXIS_DESCR
 /begin AXIS_DESCR STD_AXIS PFlt_dmEG AirMassPerTime 8 0.00 1000.000 FORMAT "%8.3" EXTENDED_LIMITS -3276.800 3276.700 DEPOSIT ABSOLUTE /end AXIS_DESCR
/end CHARACTERISTIC
/begin CHARACTERISTIC PFlt_numFltFulEu_CUR "Eulerzahl für volles Filter [-]" CURVE 0x1E3C56 Kl_Xs16_Ws16 3276.700 EulerNum 0.00 3276.700 FORMAT "%8.3" EXTENDED_LIMITS -3276.800 3276.700
 /begin AXIS_DESCR STD_AXIS PFlt_numFltFulRe_mp ReynoldsNum 16 0.00 3276700. FORMAT "%8.0" EXTENDED_LIMITS -3276800. 3276700. DEPOSIT ABSOLUTE /end AXIS_DESCR
/end CHARACTERISTIC
/begin CHARACTERISTIC PFlt_numFltFulRe_MAP "Reynoldszahl für volles Filter [-]" MAP 0x1E3C98 Kf_Xs16_Ys16_Ws16 3276700. ReynoldsNum 0.00 3276700. FORMAT "%8.0" EXTENDED_LIMITS -3276800. 3276700.
 /begin AXIS_DESCR STD_AXIS PFlt_tFlt Temp_Cels 8 -50.14000 999.8600 FORMAT "%8.4" EXTENDED_LIMITS -3549.940 3003.560 DEPOSIT ABSOLUTE /end AXIS_DESCR
 /begin AXIS_DESCR STD_AXIS PFlt_dmEG AirMassPerTime 8 0.00 1000.000 FORMAT "%8.3" EXTENDED_LIMITS -3276.800 3276.700 DEPOSIT ABSOLUTE /end AXIS_DESCR
/end CHARACTERISTIC
/begin CHARACTERISTIC PFlt_numLst_C "Regenerationsanforderung aufgrund von gefahrener Strecke, Betriebszeit oder Verbrauch" VALUE 0x1E3496 Kw_Wu8 255.0 OneToOne 0.00 255.0 FORMAT "%5.1" /end CHARACTERISTIC
/begin CHARACTERISTIC PFlt_numPrioRgnStg1_C "Priorität für Regenerationstate 1" VALUE 0x1E3498 Kw_Wu16 65535.00 OneToOne 0.00 65535.00 FORMAT "%8.2" /end CHARACTERISTIC
/begin CHARACTERISTIC PFlt_numPrioRgnStg2_C "Priorität für Regenerationstate 2" VALUE 0x1E349A Kw_Wu16 65535.00 OneToOne 0.00 65535.00 FORMAT "%8.2" /end CHARACTERISTIC
/begin CHARACTERISTIC PFlt_numPrioRgnStg3_C "Priorität für Regenerationstate 3" VALUE 0x1E349C Kw_Wu16 65535.00 OneToOne 0.00 65535.00 FORMAT "%8.2" /end CHARACTERISTIC
/begin CHARACTERISTIC PFlt_numPrioRgnStg4_C "Priorität für Regenerationstate 4" VALUE 0x1E349E Kw_Wu16 65535.00 OneToOne 0.00 65535.00 FORMAT "%8.2" /end CHARACTERISTIC
/begin CHARACTERISTIC PFlt_numPrioRgnStg5_C "Priorität für Regenerationstate 5" VALUE 0x1E34A0 Kw_Wu16 65535.00 OneToOne 0.00 65535.00 FORMAT "%8.2" /end CHARACTERISTIC
/begin CHARACTERISTIC PFlt_numPrioRgnStg6_C "Prioritätszahl für Regenerationsstufe 6" VALUE 0x1E34A2 Kw_Wu16 65535.00 OneToOne 0.00 65535.00 FORMAT "%8.2" /end CHARACTERISTIC
/begin CHARACTERISTIC PFlt_numPrt_C "Regenerationsanforderung aufgrund v. Motorschutz" VALUE 0x1E34A4 Kw_Wu8 255.0 OneToOne 0.00 255.0 FORMAT "%5.1" /end CHARACTERISTIC
/begin CHARACTERISTIC PFlt_numRgn_mp_Vector "Konfigurationslabel für Bypass" VALUE 0x1C0B32 Kw_Wu8 255.0 OneToOne 0.00 255.0 FORMAT "%5.1" /end CHARACTERISTIC
/begin CHARACTERISTIC PFlt_numRgn_mp_Channel "Konfigurationslabel für Bypass" VALUE 0x1C0B33 Kw_Wu8 255.0 OneToOne 0.00 255.0 FORMAT "%5.1" /end CHARACTERISTIC
/begin CHARACTERISTIC PFlt_numSotPrio_CA "Zustandsmatrix über Priorisierungslogik" MAP 0x1E34A5 Kf_Xu8_Yu8_Wu8 4.000 OneToOne 0.00 4.000 FORMAT "%5.3" EXTENDED_LIMITS 0.00 255.0
 /begin AXIS_DESCR STD_AXIS PFlt_numSotSimPres_mp OneToOne 5 0.00 4.000 FORMAT "%5.3" EXTENDED_LIMITS 0.00 255.0 DEPOSIT ABSOLUTE /end AXIS_DESCR
 /begin AXIS_DESCR STD_AXIS PFlt_numSotSimTemp_mp OneToOne 5 0.00 4.000 FORMAT "%5.3" EXTENDED_LIMITS 0.00 255.0 DEPOSIT ABSOLUTE /end AXIS_DESCR
/end CHARACTERISTIC
/begin CHARACTERISTIC PFlt_numTimeStpPlausSens_C "Anzahl Zeitschritte für numerische Differentiation der Sensorsignale" VALUE 0x1E4622 Kw_Wu8 9.000 OneToOne 1.000 10.00 FORMAT "%5.2" EXTENDED_LIMITS 0.00 255.0 /end CHARACTERISTIC
/begin CHARACTERISTIC PFlt_pDiffCharMonMin_C "Mindestdifferenzdruck für Überwachung des Strömungswiderstandes" VALUE 0x1E4624 Kw_Ws16 2000.000 Pres_hPa -1000.000 1000.000 FORMAT "%8.3" EXTENDED_LIMITS -32768.00 32767.00 /end CHARACTERISTIC
/begin CHARACTERISTIC PFlt_pDiffDfl_C "Ersatzwert bei Differenzdruck unplausibel" VALUE 0x1E3D3C Kw_Ws16 5000.000 Pres_hPa 0.00 5000.000 FORMAT "%8.3" EXTENDED_LIMITS -32768.00 32767.00 /end CHARACTERISTIC
/begin CHARACTERISTIC PFlt_pDiffHsLnNeg_C "Untere Schwelle Differenzdruck zur Schlauchleitungsüberwachung" VALUE 0x1E4626 Kw_Ws16 250.0000 Pres_hPa 223.0000 473.0000 FORMAT "%8.4" EXTENDED_LIMITS -32768.00 32767.00 /end CHARACTERISTIC
/begin CHARACTERISTIC PFlt_pDiffMaxSotSim_C "Maximaler Abgasgegendruck für Rußbeladungsberechnung [hpa]" VALUE 0x1E3D3E Kw_Ws16 5000.000 Pres_hPa 0.00 5000.000 FORMAT "%8.3" EXTENDED_LIMITS -32768.00 32767.00 /end CHARACTERISTIC
/begin CHARACTERISTIC PFlt_pDiffMax_C "Obere Schwelle SRC Differenzdruck" VALUE 0x1E4628 Kw_Ws16 250.0000 Pres_hPa 223.0000 473.0000 FORMAT "%8.4" EXTENDED_LIMITS -32768.00 32767.00 /end CHARACTERISTIC
/begin CHARACTERISTIC PFlt_pDiffMin_C "Untere Schwelle SRC Differenzdruck" VALUE 0x1E462A Kw_Ws16 250.0000 Pres_hPa 223.0000 473.0000 FORMAT "%8.4" EXTENDED_LIMITS -32768.00 32767.00 /end CHARACTERISTIC
/begin CHARACTERISTIC PFlt_pDiffTolcMax_C "Toleranzband Differenzdrucksensor" VALUE 0x1E462C Kw_Ws16 250.0000 Pres_hPa 223.0000 473.0000 FORMAT "%8.4" EXTENDED_LIMITS -32768.00 32767.00 /end CHARACTERISTIC
/begin CHARACTERISTIC PFlt_pEngPrtMaxInit_C "Inititialisierungswert des PT1-Filters für den Maximalwert im Motorschutz" VALUE 0x1E34CA Kw_Ws16 32767.00 Pres_hPa 0.00 32767.00 FORMAT "%8.2" EXTENDED_LIMITS -32768.00 32767.00 /end CHARACTERISTIC
/begin CHARACTERISTIC PFlt_pEngPrtMax_MAP "Kennfeld obere Druckschwelle Motorschutz" MAP 0x1E34CC Kf_Xs16_Ys16_Ws16 1500.000 Pres_hPa 0.00 1500.000 FORMAT "%8.3" EXTENDED_LIMITS -32768.00 32767.00
 /begin AXIS_DESCR STD_AXIS Eng_nAvrg EngN 8 40.00000 6000.000 FORMAT "%8.3" EXTENDED_LIMITS -32768.00 32767.00 DEPOSIT ABSOLUTE /end AXIS_DESCR
 /begin AXIS_DESCR STD_AXIS InjCtl_qSetUnBal InjMass 8 0.00 327.6700 FORMAT "%8.4" EXTENDED_LIMITS -327.6800 327.6700 DEPOSIT ABSOLUTE /end AXIS_DESCR
/end CHARACTERISTIC
/begin CHARACTERISTIC PFlt_pEngPrtMin_MAP "untere Druckschwelle Motorschutz" MAP 0x1E3570 Kf_Xs16_Ys16_Ws16 1500.000 Pres_hPa 0.00 1500.000 FORMAT "%8.3" EXTENDED_LIMITS -32768.00 32767.00
 /begin AXIS_DESCR STD_AXIS Eng_nAvrg EngN 8 40.00000 6000.000 FORMAT "%8.3" EXTENDED_LIMITS -32768.00 32767.00 DEPOSIT ABSOLUTE /end AXIS_DESCR
 /begin AXIS_DESCR STD_AXIS InjCtl_qSetUnBal InjMass 8 0.00 327.6700 FORMAT "%8.4" EXTENDED_LIMITS -327.6800 327.6700 DEPOSIT ABSOLUTE /end AXIS_DESCR
/end CHARACTERISTIC
/begin CHARACTERISTIC PFlt_pFltEmpHi_MAP "Simulierter Differenzdruck bei hohem Druck vor Filter für leeres Filter [hPa]" MAP 0x1E3D40 Kf_Xs16_Ys16_Ws16 3500.000 Pres_hPa 0.00 3500.000 FORMAT "%8.3" EXTENDED_LIMITS -32768.00 32767.00
 /begin AXIS_DESCR STD_AXIS PFlt_tFlt Temp_Cels 8 -50.14000 999.8600 FORMAT "%8.4" EXTENDED_LIMITS -3549.940 3003.560 DEPOSIT ABSOLUTE /end AXIS_DESCR
 /begin AXIS_DESCR STD_AXIS PFlt_dmEG AirMassPerTime 8 0.00 1000.000 FORMAT "%8.3" EXTENDED_LIMITS -3276.800 3276.700 DEPOSIT ABSOLUTE /end AXIS_DESCR
/end CHARACTERISTIC
/begin CHARACTERISTIC PFlt_pFltEmpLo_MAP "Simulierter Differenzdruck bei niedrigem Druck vor Filter für leeres Filter [hPa]" MAP 0x1E3DE4 Kf_Xs16_Ys16_Ws16 3500.000 Pres_hPa 0.00 3500.000 FORMAT "%8.3" EXTENDED_LIMITS -32768.00 32767.00
 /begin AXIS_DESCR STD_AXIS PFlt_tFlt Temp_Cels 8 -50.14000 999.8600 FORMAT "%8.4" EXTENDED_LIMITS -3549.940 3003.560 DEPOSIT ABSOLUTE /end AXIS_DESCR
 /begin AXIS_DESCR STD_AXIS PFlt_dmEG AirMassPerTime 8 0.00 1000.000 FORMAT "%8.3" EXTENDED_LIMITS -3276.800 3276.700 DEPOSIT ABSOLUTE /end AXIS_DESCR
/end CHARACTERISTIC
/begin CHARACTERISTIC PFlt_pFltFulHi_MAP "Simulierter Differenzdruck bei hohem Druck vor Filter für volles Filter [hPa]" MAP 0x1E3E88 Kf_Xs16_Ys16_Ws16 3500.000 Pres_hPa 0.00 3500.000 FORMAT "%8.3" EXTENDED_LIMITS -32768.00 32767.00
 /begin AXIS_DESCR STD_AXIS PFlt_tFlt Temp_Cels 8 -50.14000 999.8600 FORMAT "%8.4" EXTENDED_LIMITS -3549.940 3003.560 DEPOSIT ABSOLUTE /end AXIS_DESCR
 /begin AXIS_DESCR STD_AXIS PFlt_dmEG AirMassPerTime 8 0.00 1000.000 FORMAT "%8.3" EXTENDED_LIMITS -3276.800 3276.700 DEPOSIT ABSOLUTE /end AXIS_DESCR
/end CHARACTERISTIC
/begin CHARACTERISTIC PFlt_pFltFulLo_MAP "Simulierter Differenzdruck bei niedrigem Druck vor Filter für volles Filter [hPa]" MAP 0x1E3F2C Kf_Xs16_Ys16_Ws16 3500.000 Pres_hPa 0.00 3500.000 FORMAT "%8.3" EXTENDED_LIMITS -32768.00 32767.00
 /begin AXIS_DESCR STD_AXIS PFlt_tFlt Temp_Cels 8 -50.14000 999.8600 FORMAT "%8.4" EXTENDED_LIMITS -3549.940 3003.560 DEPOSIT ABSOLUTE /end AXIS_DESCR
 /begin AXIS_DESCR STD_AXIS PFlt_dmEG AirMassPerTime 8 0.00 1000.000 FORMAT "%8.3" EXTENDED_LIMITS -3276.800 3276.700 DEPOSIT ABSOLUTE /end AXIS_DESCR
/end CHARACTERISTIC
/begin CHARACTERISTIC PFlt_pHysHigh1_C "Oberer Hystereseschwellwert Atmosphärendruck 1" VALUE 0x1E384C Kw_Ws16 1050.000 Pres_hPa -50.00000 1000.000 FORMAT "%8.4" EXTENDED_LIMITS -32768.00 32767.00 /end CHARACTERISTIC
/begin CHARACTERISTIC PFlt_pHysHigh2_C "Oberer Hystereseschwellwert Atmosphärendruck 2" VALUE 0x1E384E Kw_Ws16 3500.000 Pres_hPa 0.00 3500.000 FORMAT "%8.3" EXTENDED_LIMITS -32768.00 32767.00 /end CHARACTERISTIC
/begin CHARACTERISTIC PFlt_pHysHigh3_C "Oberer Hystereseschwellwert Atmosphärendruck 3" VALUE 0x1E3850 Kw_Ws16 3500.000 Pres_hPa 0.00 3500.000 FORMAT "%8.3" EXTENDED_LIMITS -32768.00 32767.00 /end CHARACTERISTIC
/begin CHARACTERISTIC PFlt_pHysHigh4_C "Oberer Hystereseschwellwert Atmosphärendruck 4" VALUE 0x1E3852 Kw_Ws16 3500.000 Pres_hPa 0.00 3500.000 FORMAT "%8.3" EXTENDED_LIMITS -32768.00 32767.00 /end CHARACTERISTIC
/begin CHARACTERISTIC PFlt_pHysHigh5_C "Oberer Hystereseschwellwert Atmosphärendruck 5" VALUE 0x1E3854 Kw_Ws16 3500.000 Pres_hPa 0.00 3500.000 FORMAT "%8.3" EXTENDED_LIMITS -32768.00 32767.00 /end CHARACTERISTIC
/begin CHARACTERISTIC PFlt_pHysLow1_C "Unterer Hystereseschwellwert Atmosphärendruck 1" VALUE 0x1E3856 Kw_Ws16 3500.000 Pres_hPa 0.00 3500.000 FORMAT "%8.3" EXTENDED_LIMITS -32768.00 32767.00 /end CHARACTERISTIC
/begin CHARACTERISTIC PFlt_pHysLow2_C "Unterer Hystereseschwellwert Atmosphärendruck 2" VALUE 0x1E3858 Kw_Ws16 3500.000 Pres_hPa 0.00 3500.000 FORMAT "%8.3" EXTENDED_LIMITS -32768.00 32767.00 /end CHARACTERISTIC
/begin CHARACTERISTIC PFlt_pHysLow3_C "Unterer Hystereseschwellwert Atmosphärendruck 3" VALUE 0x1E385A Kw_Ws16 3500.000 Pres_hPa 0.00 3500.000 FORMAT "%8.3" EXTENDED_LIMITS -32768.00 32767.00 /end CHARACTERISTIC
/begin CHARACTERISTIC PFlt_pHysLow4_C "Unterer Hystereseschwellwert Atmosphärendruck 4" VALUE 0x1E385C Kw_Ws16 3500.000 Pres_hPa 0.00 3500.000 FORMAT "%8.3" EXTENDED_LIMITS -32768.00 32767.00 /end CHARACTERISTIC
/begin CHARACTERISTIC PFlt_pHysLow5_C "Unterer Hystereseschwellwert Atmosphärendruck 5" VALUE 0x1E385E Kw_Ws16 3500.000 Pres_hPa 0.00 3500.000 FORMAT "%8.3" EXTENDED_LIMITS -32768.00 32767.00 /end CHARACTERISTIC
/begin CHARACTERISTIC PFlt_pMinNrmCldStrt_C "Mindestumgebungsdruck für normalen Kaltstart" VALUE 0x1E462E Kw_Ws16 400.0000 Pres_hPa 800.0000 1200.000 FORMAT "%8.3" EXTENDED_LIMITS -32768.00 32767.00 /end CHARACTERISTIC
/begin CHARACTERISTIC PFlt_pPreDfl_C "Ersatzwert bei Druck vor Partikelfilter unplausibel" VALUE 0x1E3A98 Kw_Ws16 5000.000 Pres_hPa 0.00 5000.000 FORMAT "%8.3" EXTENDED_LIMITS -32768.00 32767.00 /end CHARACTERISTIC
/begin CHARACTERISTIC PFlt_pPreTolcMax_C "Toleranzband Absolutdrucksensor" VALUE 0x1E4630 Kw_Ws16 250.0000 Pres_hPa 223.0000 473.0000 FORMAT "%8.4" EXTENDED_LIMITS -32768.00 32767.00 /end CHARACTERISTIC
/begin CHARACTERISTIC PFlt_qFlMaxDef_C "Regenerationsschwelle für Treibstoffverbrauch im Fehlerfall" VALUE 0x1E3614 Kw_Ws16 320.0000 Fl_L 0.00 320.0000 FORMAT "%8.4" EXTENDED_LIMITS -327.6800 327.6700 /end CHARACTERISTIC
/begin CHARACTERISTIC PFlt_qFlMax_C "Regenerationsschwelle für Treibstoffverbrauch" VALUE 0x1E3616 Kw_Ws16 320.0000 Fl_L 0.00 320.0000 FORMAT "%8.4" EXTENDED_LIMITS -327.6800 327.6700 /end CHARACTERISTIC
/begin CHARACTERISTIC PFlt_qFlSubs_C "Treibstoffverbrauch Ersatzwert für den Fall eines Eeprom lese Fehlers" VALUE 0x1E3618 Kw_Ws16 320.0000 Fl_L 0.00 320.0000 FORMAT "%8.4" EXTENDED_LIMITS -327.6800 327.6700 /end CHARACTERISTIC
/begin CHARACTERISTIC PFlt_rAshLdMaxSotSim_C "Maximale Aschebeladung für Rußbeladungsberechnung" VALUE 0x1E3FD0 Kw_Ws16 100.0000 Prc 0.00 100.0000 FORMAT "%8.4" EXTENDED_LIMITS -327.6800 327.6700 /end CHARACTERISTIC
/begin CHARACTERISTIC PFlt_rAshMs2Ld_CUR "Kennlinie für Bestimmung der Aschebeladung aus Aschemasse[%]" CURVE 0x1E3FD2 Kl_Xs16_Ws16 250.0000 Prc 0.00 250.0000 FORMAT "%8.4" EXTENDED_LIMITS -327.6800 327.6700
 /begin AXIS_DESCR STD_AXIS PFlt_mAshTrmTot_mp mAsh 5 0.00 500.0000 FORMAT "%8.4" EXTENDED_LIMITS -3276.800 3276.700 DEPOSIT ABSOLUTE /end AXIS_DESCR
/end CHARACTERISTIC
/begin CHARACTERISTIC PFlt_resFlowMax_C "Obere Schwelle SRC Strömungswiderstand" VALUE 0x1E4632 Kw_Ws16 25.00000 Res_hPaHrPerCM 0.00 25.00000 FORMAT "%8.5" EXTENDED_LIMITS -32.76800 32.76700 /end CHARACTERISTIC
/begin CHARACTERISTIC PFlt_resFlowMin_C "Untere Schwelle SRC Strömungswiderstand" VALUE 0x1E4634 Kw_Ws16 25.00000 Res_hPaHrPerCM 0.00 25.00000 FORMAT "%8.5" EXTENDED_LIMITS -32.76800 32.76700 /end CHARACTERISTIC
/begin CHARACTERISTIC PFlt_resFlowTolcDynPlaus_C "Faktor für Festlegung Toleranzschwelle dynamische Drucküberwachung" VALUE 0x1E4636 Kw_Ws16 25.00000 Res_hPaHrPerCM 0.00 25.00000 FORMAT "%8.5" EXTENDED_LIMITS -32.76800 32.76700 /end CHARACTERISTIC
/begin CHARACTERISTIC PFlt_rHtg1_C "Stellgröße zu Ansteuerung der Heizung Stufe 1" VALUE 0x1E3A9C Kw_Ws16 100.0000 Prc 0.00 100.0000 FORMAT "%8.4" EXTENDED_LIMITS -327.6800 327.6700 /end CHARACTERISTIC
/begin CHARACTERISTIC PFlt_rHtg2_C "Stellgröße zur Ansteuerung der Heizung Stufe 2" VALUE 0x1E3A9E Kw_Ws16 100.0000 Prc 0.00 100.0000 FORMAT "%8.4" EXTENDED_LIMITS -327.6800 327.6700 /end CHARACTERISTIC
/begin CHARACTERISTIC PFlt_rHtg3_C "Stellgröße zu Ansteuerung der Heizung Stufe 3" VALUE 0x1E3AA0 Kw_Ws16 100.0000 Prc 0.00 100.0000 FORMAT "%8.4" EXTENDED_LIMITS -327.6800 327.6700 /end CHARACTERISTIC
/begin CHARACTERISTIC PFlt_rLmbdRegMin_C "Maximales Lambda für die Entschwefelung des Oxi-Kat im Partikelfilter" VALUE 0x1E361A Kw_Ws16 2.000000 lambda 0.00 2.000000 FORMAT "%8.6" EXTENDED_LIMITS -32.76800 32.76700 /end CHARACTERISTIC
/begin CHARACTERISTIC PFlt_rSotfacAdjDfl_C "Standardabgleichwert für den Russsimulationsprozentwert" VALUE 0x1E3FE8 Kw_Wu32 655.359999847 Prc32 0.00 655.359999847 FORMAT "%13.7" /end CHARACTERISTIC
/begin CHARACTERISTIC PFlt_rSotfacAdjMax_C "Maximaler Abgleichwert für Russsimulationsprozentwert" VALUE 0x1E3FEC Kw_Wu32 655.359999847 Prc32 0.00 655.359999847 FORMAT "%13.7" /end CHARACTERISTIC
/begin CHARACTERISTIC PFlt_rSotfacAdjMin_C "Minimaler Abgleichwert für Russsimulationsprozentwert" VALUE 0x1E3FF0 Kw_Wu32 655.359999847 Prc32 0.00 655.359999847 FORMAT "%13.7" /end CHARACTERISTIC
/begin CHARACTERISTIC PFlt_rSotPresMax_C "Maximale Partikelfilterbeladung [%]" VALUE 0x1E3FF4 Kw_Ws16 100.0000 Prc 0.00 100.0000 FORMAT "%8.4" EXTENDED_LIMITS -327.6800 327.6700 /end CHARACTERISTIC
/begin CHARACTERISTIC PFlt_rSotPresMin_C "Minimale Partikelfilterbeladung [%]" VALUE 0x1E3FF6 Kw_Ws16 100.0000 Prc 0.00 100.0000 FORMAT "%8.4" EXTENDED_LIMITS -327.6800 327.6700 /end CHARACTERISTIC
/begin CHARACTERISTIC PFlt_rSotPresOfs_C "Offset zur Partikelfilterbeladung [%]" VALUE 0x1E3FF8 Kw_Ws16 100.0000 Prc 0.00 100.0000 FORMAT "%8.4" EXTENDED_LIMITS -327.6800 327.6700 /end CHARACTERISTIC
/begin CHARACTERISTIC PFlt_rSotSimOffset_C "Offsetfaktor für Beladungssimulation aus Filtertemperatur" VALUE 0x1E3FFA Kw_Ws16 100.0000 Prc 0.00 100.0000 FORMAT "%8.4" EXTENDED_LIMITS -327.6800 327.6700 /end CHARACTERISTIC
/begin CHARACTERISTIC PFlt_rSotSimPresAddHigh_C "obere Hystereseschwelle für bedarfsgesteuerte Additivierung" VALUE 0x1E361C Kw_Ws16 100.0000 Prc 0.00 100.0000 FORMAT "%8.4" EXTENDED_LIMITS -327.6800 327.6700 /end CHARACTERISTIC
/begin CHARACTERISTIC PFlt_rSotSimPresAddLow_C "untere Hystereseschwelle für bedarfsgesteuerte Additivierung" VALUE 0x1E361E Kw_Ws16 100.0000 Prc 0.00 100.0000 FORMAT "%8.4" EXTENDED_LIMITS -327.6800 327.6700 /end CHARACTERISTIC
/begin CHARACTERISTIC PFlt_rSotSimPresDfl_C "Startwert für PT1-Filter der Rußbeladung" VALUE 0x1E3FFC Kw_Ws16 100.0000 Prc 0.00 100.0000 FORMAT "%8.4" EXTENDED_LIMITS -327.6800 327.6700 /end CHARACTERISTIC
/begin CHARACTERISTIC PFlt_rSotSimPresHigh1_C "Höherer Schwellenwert des Ladezustands 1, abgeleitet vom Druckabfall über das Luftmassenniveau" VALUE 0x1E3620 Kw_Ws16 100.0000 Prc 0.00 100.0000 FORMAT "%8.4" EXTENDED_LIMITS -327.6800 327.6700 /end CHARACTERISTIC
/begin CHARACTERISTIC PFlt_rSotSimPresHigh2_C "Höherer Schwellenwert des Ladezustands 2, abgeleitet vom Druckabfall über das Luftmassenniveau" VALUE 0x1E3622 Kw_Ws16 100.0000 Prc 0.00 100.0000 FORMAT "%8.4" EXTENDED_LIMITS -327.6800 327.6700 /end CHARACTERISTIC
/begin CHARACTERISTIC PFlt_rSotSimPresHigh3_C "Höherer Schwellenwert des Ladezustands 3, abgeleitet vom Druckabfall über das Luftmassenniveau" VALUE 0x1E3624 Kw_Ws16 100.0000 Prc 0.00 100.0000 FORMAT "%8.4" EXTENDED_LIMITS -327.6800 327.6700 /end CHARACTERISTIC
/begin CHARACTERISTIC PFlt_rSotSimPresHigh4_C "Höherer Schwellenwert des Ladezustands 4, abgeleitet vom Druckabfall über das Luftmassenniveau" VALUE 0x1E3626 Kw_Ws16 100.0000 Prc 0.00 100.0000 FORMAT "%8.4" EXTENDED_LIMITS -327.6800 327.6700 /end CHARACTERISTIC
/begin CHARACTERISTIC PFlt_rSotSimPresLow1_CUR "stellt die temperaturabhängige untere Hysteresenschwelle bei Stufe 1 [s] zur Verfügung." CURVE 0x1E3628 Kl_Xs16_Ws16 100.0000 Prc 0.00 100.0000 FORMAT "%8.4" EXTENDED_LIMITS -327.6800 327.6700
 /begin AXIS_DESCR STD_AXIS PFlt_tFlt Temp_Cels 5 -50.14000 999.8600 FORMAT "%8.4" EXTENDED_LIMITS -3549.940 3003.560 DEPOSIT ABSOLUTE /end AXIS_DESCR
/end CHARACTERISTIC
/begin CHARACTERISTIC PFlt_rSotSimPresLow2_CUR "stellt die temperaturabhängige untere Hysteresenschwelle bei Stufe 2 [s] zur Verfügung." CURVE 0x1E363E Kl_Xs16_Ws16 100.0000 Prc 0.00 100.0000 FORMAT "%8.4" EXTENDED_LIMITS -327.6800 327.6700
 /begin AXIS_DESCR STD_AXIS PFlt_tFlt Temp_Cels 5 -50.14000 999.8600 FORMAT "%8.4" EXTENDED_LIMITS -3549.940 3003.560 DEPOSIT ABSOLUTE /end AXIS_DESCR
/end CHARACTERISTIC
/begin CHARACTERISTIC PFlt_rSotSimPresLow3_CUR "stellt die temperaturabhängige untere Hysteresenschwelle bei Stufe 3 [s] zur Verfügung." CURVE 0x1E3654 Kl_Xs16_Ws16 100.0000 Prc 0.00 100.0000 FORMAT "%8.4" EXTENDED_LIMITS -327.6800 327.6700
 /begin AXIS_DESCR STD_AXIS PFlt_tFlt Temp_Cels 5 -50.14000 999.8600 FORMAT "%8.4" EXTENDED_LIMITS -3549.940 3003.560 DEPOSIT ABSOLUTE /end AXIS_DESCR
/end CHARACTERISTIC
/begin CHARACTERISTIC PFlt_rSotSimPresLow4_CUR "stellt die temperaturabhängige untere Hysteresenschwelle bei Stufe 4 [s] zur Verfügung." CURVE 0x1E366A Kl_Xs16_Ws16 100.0000 Prc 0.00 100.0000 FORMAT "%8.4" EXTENDED_LIMITS -327.6800 327.6700
 /begin AXIS_DESCR STD_AXIS PFlt_tFlt Temp_Cels 5 -50.14000 999.8600 FORMAT "%8.4" EXTENDED_LIMITS -3549.940 3003.560 DEPOSIT ABSOLUTE /end AXIS_DESCR
/end CHARACTERISTIC
/begin CHARACTERISTIC PFlt_rSotSimPresRstLow1_C "Niedrigerer Schwellenwert des Ladezustands 1, abgeleitet vom Druckabfall über das Luftmassenniveau." VALUE 0x1E3680 Kw_Ws16 100.0000 Prc 0.00 100.0000 FORMAT "%8.4" EXTENDED_LIMITS -327.6800 327.6700 /end CHARACTERISTIC
/begin CHARACTERISTIC PFlt_rSotSimPresRstLow2_C "Niedrigerer Schwellenwert des Ladezustands 2, abgeleitet vom Druckabfall über das Luftmassenniveau." VALUE 0x1E3682 Kw_Ws16 100.0000 Prc 0.00 100.0000 FORMAT "%8.4" EXTENDED_LIMITS -327.6800 327.6700 /end CHARACTERISTIC
/begin CHARACTERISTIC PFlt_rSotSimPresRstLow3_C "Niedrigerer Schwellenwert des Ladezustands 3, abgeleitet vom Druckabfall über das Luftmassenniveau." VALUE 0x1E3684 Kw_Ws16 100.0000 Prc 0.00 100.0000 FORMAT "%8.4" EXTENDED_LIMITS -327.6800 327.6700 /end CHARACTERISTIC
/begin CHARACTERISTIC PFlt_rSotSimPresRstLow4_C "Niedrigerer Schwellenwert des Ladezustands 4, abgeleitet vom Druckabfall über das Luftmassenniveau." VALUE 0x1E3686 Kw_Ws16 100.0000 Prc 0.00 100.0000 FORMAT "%8.4" EXTENDED_LIMITS -327.6800 327.6700 /end CHARACTERISTIC
/begin CHARACTERISTIC PFlt_rSotSimPresSOxHigh_CUR "Oberer Schwellwert der Hysterese zur Auswertung des Verschwefelungszustands [%]" CURVE 0x1E3688 Kl_Xs16_Ws16 100.0000 Prc 0.00 100.0000 FORMAT "%8.4" EXTENDED_LIMITS -327.6800 327.6700
 /begin AXIS_DESCR STD_AXIS PFlt_rSotSimTemp Prc 10 0.00 100.0000 FORMAT "%8.4" EXTENDED_LIMITS -327.6800 327.6700 DEPOSIT ABSOLUTE /end AXIS_DESCR
/end CHARACTERISTIC
/begin CHARACTERISTIC PFlt_rSotSimPresSOxLow_CUR "Unterer Schwellwert der Hysterese zur Auswertung des Verschwefelungszustands [%]" CURVE 0x1E36B2 Kl_Xs16_Ws16 100.0000 Prc 0.00 100.0000 FORMAT "%8.4" EXTENDED_LIMITS -327.6800 327.6700
 /begin AXIS_DESCR STD_AXIS PFlt_rSotSimTemp Prc 10 0.00 100.0000 FORMAT "%8.4" EXTENDED_LIMITS -327.6800 327.6700 DEPOSIT ABSOLUTE /end AXIS_DESCR
/end CHARACTERISTIC
/begin CHARACTERISTIC PFlt_rSotSimPresSubs_C "Ersatzwert für Rußbeladung bei permanentem Defekt in der Druckmessung" VALUE 0x1E3FFE Kw_Ws16 100.0000 Prc 0.00 100.0000 FORMAT "%8.4" EXTENDED_LIMITS -327.6800 327.6700 /end CHARACTERISTIC
/begin CHARACTERISTIC PFlt_rSotSimPres_Vector "Konfigurationslabel für Bypass" VALUE 0x1C0B34 Kw_Wu8 255.0 OneToOne 0.00 255.0 FORMAT "%5.1" /end CHARACTERISTIC
/begin CHARACTERISTIC PFlt_rSotSimPres_Channel "Konfigurationslabel für Bypass" VALUE 0x1C0B35 Kw_Wu8 255.0 OneToOne 0.00 255.0 FORMAT "%5.1" /end CHARACTERISTIC
/begin CHARACTERISTIC PFlt_rSotSimTemp0_MAP "Kennfeld für Subtrahend bei Status keine Regeneration" MAP 0x1E4000 Kf_Xs16_Ys16_Ws16 64.00000 Prc_Soot 0.00 64.00000 FORMAT "%8.5" EXTENDED_LIMITS -64.00000 63.99805
 /begin AXIS_DESCR STD_AXIS Eng_nAvrg EngN 10 0.00 6000.000 FORMAT "%8.3" EXTENDED_LIMITS -32768.00 32767.00 DEPOSIT ABSOLUTE /end AXIS_DESCR
 /begin AXIS_DESCR STD_AXIS InjCtl_qCurr InjMass 10 0.00 327.6700 FORMAT "%8.4" EXTENDED_LIMITS -327.6800 327.6700 DEPOSIT ABSOLUTE /end AXIS_DESCR
/end CHARACTERISTIC
/begin CHARACTERISTIC PFlt_rSotSimTemp1_MAP "Berechnung des Subtrahenden in Status 1" MAP 0x1E40F4 Kf_Xs16_Ys16_Ws16 64.00000 Prc_Soot 0.00 64.00000 FORMAT "%8.5" EXTENDED_LIMITS -64.00000 63.99805
 /begin AXIS_DESCR STD_AXIS Eng_nAvrg EngN 10 0.00 6000.000 FORMAT "%8.3" EXTENDED_LIMITS -32768.00 32767.00 DEPOSIT ABSOLUTE /end AXIS_DESCR
 /begin AXIS_DESCR STD_AXIS InjCtl_qCurr InjMass 10 0.00 327.6700 FORMAT "%8.4" EXTENDED_LIMITS -327.6800 327.6700 DEPOSIT ABSOLUTE /end AXIS_DESCR
/end CHARACTERISTIC
/begin CHARACTERISTIC PFlt_rSotSimTemp2_MAP "Berechnung des Subtrahenden bei Status 2" MAP 0x1E41E8 Kf_Xs16_Ys16_Ws16 64.00000 Prc_Soot 0.00 64.00000 FORMAT "%8.5" EXTENDED_LIMITS -64.00000 63.99805
 /begin AXIS_DESCR STD_AXIS Eng_nAvrg EngN 10 0.00 6000.000 FORMAT "%8.3" EXTENDED_LIMITS -32768.00 32767.00 DEPOSIT ABSOLUTE /end AXIS_DESCR
 /begin AXIS_DESCR STD_AXIS InjCtl_qCurr InjMass 10 0.00 327.6700 FORMAT "%8.4" EXTENDED_LIMITS -327.6800 327.6700 DEPOSIT ABSOLUTE /end AXIS_DESCR
/end CHARACTERISTIC
/begin CHARACTERISTIC PFlt_rSotSimTemp3_MAP "Berechnung des Subtrahenden in Status 3" MAP 0x1E42DC Kf_Xs16_Ys16_Ws16 64.00000 Prc_Soot 0.00 64.00000 FORMAT "%8.5" EXTENDED_LIMITS -64.00000 63.99805
 /begin AXIS_DESCR STD_AXIS Eng_nAvrg EngN 10 0.00 6000.000 FORMAT "%8.3" EXTENDED_LIMITS -32768.00 32767.00 DEPOSIT ABSOLUTE /end AXIS_DESCR
 /begin AXIS_DESCR STD_AXIS InjCtl_qCurr InjMass 10 0.00 327.6700 FORMAT "%8.4" EXTENDED_LIMITS -327.6800 327.6700 DEPOSIT ABSOLUTE /end AXIS_DESCR
/end CHARACTERISTIC
/begin CHARACTERISTIC PFlt_rSotSimTemp5_MAP "Berechnung des Summanden" MAP 0x1E43D0 Kf_Xs16_Ys16_Ws16 64.00000 Prc_Soot 0.00 64.00000 FORMAT "%8.5" EXTENDED_LIMITS -64.00000 63.99805
 /begin AXIS_DESCR STD_AXIS Eng_nAvrg EngN 10 0.00 6000.000 FORMAT "%8.3" EXTENDED_LIMITS -32768.00 32767.00 DEPOSIT ABSOLUTE /end AXIS_DESCR
 /begin AXIS_DESCR STD_AXIS InjCtl_qCurr InjMass 10 0.00 327.6700 FORMAT "%8.4" EXTENDED_LIMITS -327.6800 327.6700 DEPOSIT ABSOLUTE /end AXIS_DESCR
/end CHARACTERISTIC
/begin CHARACTERISTIC PFlt_rSotSimTemp6_MAP "Berechnung des Summanden" MAP 0x1E44C4 Kf_Xs16_Ys16_Ws16 64.00000 Prc_Soot 0.00 64.00000 FORMAT "%8.5" EXTENDED_LIMITS -64.00000 63.99805
 /begin AXIS_DESCR STD_AXIS Eng_nAvrg EngN 10 0.00 6000.000 FORMAT "%8.3" EXTENDED_LIMITS -32768.00 32767.00 DEPOSIT ABSOLUTE /end AXIS_DESCR
 /begin AXIS_DESCR STD_AXIS InjCtl_qCurr InjMass 10 0.00 327.6700 FORMAT "%8.4" EXTENDED_LIMITS -327.6800 327.6700 DEPOSIT ABSOLUTE /end AXIS_DESCR
/end CHARACTERISTIC
/begin CHARACTERISTIC PFlt_rSotSimTempHigh1_C "Höherer Schwellenwert des Ladezustands 1, abgeleitet von der Temperatur" VALUE 0x1E36DC Kw_Ws16 100.0000 Prc 0.00 100.0000 FORMAT "%8.4" EXTENDED_LIMITS -327.6800 327.6700 /end CHARACTERISTIC
/begin CHARACTERISTIC PFlt_rSotSimTempHigh2_C "Höherer Schwellenwert des Ladezustands 2, abgeleitet von der Temperatur" VALUE 0x1E36DE Kw_Ws16 100.0000 Prc 0.00 100.0000 FORMAT "%8.4" EXTENDED_LIMITS -327.6800 327.6700 /end CHARACTERISTIC
/begin CHARACTERISTIC PFlt_rSotSimTempHigh3_C "Höherer Schwellenwert des Ladezustands 3, abgeleitet von der Temperatur" VALUE 0x1E36E0 Kw_Ws16 100.0000 Prc 0.00 100.0000 FORMAT "%8.4" EXTENDED_LIMITS -327.6800 327.6700 /end CHARACTERISTIC
/begin CHARACTERISTIC PFlt_rSotSimTempHigh4_C "Höherer Schwellenwert des Ladezustands 4, abgeleitet von der Temperatur" VALUE 0x1E36E2 Kw_Ws16 100.0000 Prc 0.00 100.0000 FORMAT "%8.4" EXTENDED_LIMITS -327.6800 327.6700 /end CHARACTERISTIC
/begin CHARACTERISTIC PFlt_rSotSimTempLow1_C "Niedrigerer Schwellenwert des Ladezustands 1, abgeleitet von der Temperatur" VALUE 0x1E36E4 Kw_Ws16 100.0000 Prc 0.00 100.0000 FORMAT "%8.4" EXTENDED_LIMITS -327.6800 327.6700 /end CHARACTERISTIC
/begin CHARACTERISTIC PFlt_rSotSimTempLow2_C "Niedrigerer Schwellenwert des Ladezustands 2, abgeleitet von der Temperatur" VALUE 0x1E36E6 Kw_Ws16 100.0000 Prc 0.00 100.0000 FORMAT "%8.4" EXTENDED_LIMITS -327.6800 327.6700 /end CHARACTERISTIC
/begin CHARACTERISTIC PFlt_rSotSimTempLow3_C "Niedrigerer Schwellenwert des Ladezustands 3, abgeleitet von der Temperatur" VALUE 0x1E36E8 Kw_Ws16 100.0000 Prc 0.00 100.0000 FORMAT "%8.4" EXTENDED_LIMITS -327.6800 327.6700 /end CHARACTERISTIC
/begin CHARACTERISTIC PFlt_rSotSimTempLow4_C "Niedrigerer Schwellenwert des Ladezustands 4, abgeleitet von der Temperatur" VALUE 0x1E36EA Kw_Ws16 100.0000 Prc 0.00 100.0000 FORMAT "%8.4" EXTENDED_LIMITS -327.6800 327.6700 /end CHARACTERISTIC
/begin CHARACTERISTIC PFlt_rSotSimTempMx_C "Maximale berechnete Russmasse im Beladungszähler" VALUE 0x1E45B8 Kw_Ws32 400.000000000 Prc_Soot32 0.00 400.000000000 FORMAT "%13.9" EXTENDED_LIMITS -4194304.00000 4194303.99805 /end CHARACTERISTIC
/begin CHARACTERISTIC PFlt_rSotSimTemp_Vector "Konfigurationslabel für Bypass" VALUE 0x1C0B36 Kw_Wu8 255.0 OneToOne 0.00 255.0 FORMAT "%5.1" /end CHARACTERISTIC
/begin CHARACTERISTIC PFlt_rSotSimTemp_Channel "Konfigurationslabel für Bypass" VALUE 0x1C0B37 Kw_Wu8 255.0 OneToOne 0.00 255.0 FORMAT "%5.1" /end CHARACTERISTIC
/begin CHARACTERISTIC PFlt_rSotSim_CUR "Berechnung des Subtrahenden im Beladungszähler" CURVE 0x1E45BC Kl_Xs16_Ws16 64.00000 Prc_Soot 0.00 64.00000 FORMAT "%8.5" EXTENDED_LIMITS -64.00000 63.99805
 /begin AXIS_DESCR STD_AXIS PFlt_tFlt Temp_Cels 8 -50.14000 999.8600 FORMAT "%8.4" EXTENDED_LIMITS -3549.940 3003.560 DEPOSIT ABSOLUTE /end AXIS_DESCR
/end CHARACTERISTIC
/begin CHARACTERISTIC PFlt_rThresTransAWD_C "Schwelle für das zusätzliche Unterzungsgetriebe ,wenn die Rduzierung aktiviert." VALUE 0x1E3860 Kw_Ws16 100.0000 TransR 0.00 100.0000 FORMAT "%8.4" EXTENDED_LIMITS -327.6800 327.6700 /end CHARACTERISTIC
/begin CHARACTERISTIC PFlt_rThresTrans_C "Schwelle für das zusätzliche Unterzungsgetriebe,wenn di Reduzierung nicht aktiviert." VALUE 0x1E3862 Kw_Ws16 100.0000 TransR 0.00 100.0000 FORMAT "%8.4" EXTENDED_LIMITS -327.6800 327.6700 /end CHARACTERISTIC
/begin CHARACTERISTIC PFlt_SotSimTempKi_C "Verstärkungskonstante des Temperaturintegrators im Beladungszähler" VALUE 0x1E45E0 Kw_Ws32 39.9999999814 KI_Temp2Fact 0.00 39.9999999814 FORMAT "%13.10" EXTENDED_LIMITS -40.0000000000 39.9999999814 /end CHARACTERISTIC
/begin CHARACTERISTIC PFlt_stCfgTempSens_C "Bitleiste zur Auswahl der Abgastemperatursensoren" VALUE 0x1E4638 Kw_Wu8 255.0 OneToOne 0.00 255.0 FORMAT "%5.1" /end CHARACTERISTIC
/begin CHARACTERISTIC PFlt_stCmpHtg1_C "Maske zur Ansteuerung der Heizung Stufe 2" VALUE 0x1E3AA4 Kw_Wu32 2147483647.00 OneToOne 0.00 2147483647.00 FORMAT "%13.2" EXTENDED_LIMITS 0.00 4294967295.00 /end CHARACTERISTIC
/begin CHARACTERISTIC PFlt_stCmpHtg2_C "Maske zur Ansteuerung der Heizung Stufe 2" VALUE 0x1E3AA8 Kw_Wu32 2147483647.00 OneToOne 0.00 2147483647.00 FORMAT "%13.2" EXTENDED_LIMITS 0.00 4294967295.00 /end CHARACTERISTIC
/begin CHARACTERISTIC PFlt_stCmpHtg3_C "Maske zu Ansteuerung der Heizung Stufe 3" VALUE 0x1E3AAC Kw_Wu32 2147483647.00 OneToOne 0.00 2147483647.00 FORMAT "%13.2" EXTENDED_LIMITS 0.00 4294967295.00 /end CHARACTERISTIC
/begin CHARACTERISTIC PFlt_stDiaRgnMsk_C "Maske zum Rücksetzen der Anzeige für erfolgreiche Regeneration am Kundendiensttester" VALUE 0x1E45E4 Kw_Wu32 2147483647.00 OneToOne 0.00 2147483647.00 FORMAT "%13.2" EXTENDED_LIMITS 0.00 4294967295.00 /end CHARACTERISTIC
/begin CHARACTERISTIC PFlt_stEngPOp_Vector "Konfigurationslabel für Bypass" VALUE 0x1C0B38 Kw_Wu8 255.0 OneToOne 0.00 255.0 FORMAT "%5.1" /end CHARACTERISTIC
/begin CHARACTERISTIC PFlt_stEngPOp_Channel "Konfigurationslabel für Bypass" VALUE 0x1C0B39 Kw_Wu8 255.0 OneToOne 0.00 255.0 FORMAT "%5.1" /end CHARACTERISTIC
/begin CHARACTERISTIC PFlt_stInrRgnMsk1_C "Maske 1 für Regenerations-Unterbrechung wegen hohem Moment" VALUE 0x1E36EC Kw_Wu32 2147483647.00 OneToOne 0.00 2147483647.00 FORMAT "%13.2" EXTENDED_LIMITS 0.00 4294967295.00 /end CHARACTERISTIC
/begin CHARACTERISTIC PFlt_stInrRgnMsk2_C "Maske 2 für Regenerations-Unterbrechung wegen hohem Moment" VALUE 0x1E36F0 Kw_Wu32 2147483647.00 OneToOne 0.00 2147483647.00 FORMAT "%13.2" EXTENDED_LIMITS 0.00 4294967295.00 /end CHARACTERISTIC
/begin CHARACTERISTIC PFlt_stLckRgnMsk_C "Maske für Blockierung und Freigabe der Regeneration" VALUE 0x1E36F4 Kw_Wu32 2147483647.00 OneToOne 0.00 2147483647.00 FORMAT "%13.2" EXTENDED_LIMITS 0.00 4294967295.00 /end CHARACTERISTIC
/begin CHARACTERISTIC PFlt_stRgnCtl_C "Status Regenerationssteuerung im Fehlerfall aktiv" VALUE 0x1E36F8 Kw_Wu8 255.0 OneToOne 0.00 255.0 FORMAT "%5.1" /end CHARACTERISTIC
/begin CHARACTERISTIC PFlt_stRgnStg1_C "PFlt_st im Fall Regenerationsstate 1" VALUE 0x1E36FC Kw_Wu32 4294967295.00 OneToOne 0.00 4294967295.00 FORMAT "%13.2" /end CHARACTERISTIC
/begin CHARACTERISTIC PFlt_stRgnStg2_C "PFlt_st im Fall Regenerationsstate 2" VALUE 0x1E3700 Kw_Wu32 4294967295.00 OneToOne 0.00 4294967295.00 FORMAT "%13.2" /end CHARACTERISTIC
/begin CHARACTERISTIC PFlt_stRgnStg3_C "PFlt_st im Fall Regenerationsstate 3" VALUE 0x1E3704 Kw_Wu32 4294967295.00 OneToOne 0.00 4294967295.00 FORMAT "%13.2" /end CHARACTERISTIC
/begin CHARACTERISTIC PFlt_stRgnStg4_C "PFlt_st im Fall Regenerationsstate 4" VALUE 0x1E3708 Kw_Wu32 4294967295.00 OneToOne 0.00 4294967295.00 FORMAT "%13.2" /end CHARACTERISTIC
/begin CHARACTERISTIC PFlt_stRgnStg5_C "PFlt_st im Fall Regenerationsstate 5" VALUE 0x1E370C Kw_Wu32 4294967295.00 OneToOne 0.00 4294967295.00 FORMAT "%13.2" /end CHARACTERISTIC
/begin CHARACTERISTIC PFlt_stRgnStg6_C "Maßnahmenbitwort Regenerationsstufe 6" VALUE 0x1E3710 Kw_Wu32 4294967295.00 OneToOne 0.00 4294967295.00 FORMAT "%13.2" /end CHARACTERISTIC
/begin CHARACTERISTIC PFlt_stSotSimTemp1_C "Maske für Erkennung Status 1" VALUE 0x1E45E8 Kw_Wu32 4294967295.00 OneToOne 0.00 4294967295.00 FORMAT "%13.2" /end CHARACTERISTIC
/begin CHARACTERISTIC PFlt_stSotSimTemp2_C "Maske für Erkennung Status 2" VALUE 0x1E45EC Kw_Wu32 4294967295.00 OneToOne 0.00 4294967295.00 FORMAT "%13.2" /end CHARACTERISTIC
/begin CHARACTERISTIC PFlt_stSotSimTemp3_C "Maske für Erkennung Status 3" VALUE 0x1E45F0 Kw_Wu32 4294967295.00 OneToOne 0.00 4294967295.00 FORMAT "%13.2" /end CHARACTERISTIC
/begin CHARACTERISTIC PFlt_stThresGear_C "Gangvergleichswert" VALUE 0x1E3864 Kw_Wu8 6.000 OneToOne 0.00 6.000 FORMAT "%5.3" EXTENDED_LIMITS 0.00 255.0 /end CHARACTERISTIC
/begin CHARACTERISTIC PFlt_swtEngPrtSel_C "Auswahlschalter für Eingangsgröße Motorschutz" VALUE 0x1E3714 Kw_Wu8 1.000 OneToOne 0.00 1.000 FORMAT "%5.3" EXTENDED_LIMITS 0.00 255.0 /end CHARACTERISTIC
/begin CHARACTERISTIC PFlt_swtEnvTempSens_C "Schalter Umgebungstemperatursensorfühler appliziert" VALUE 0x1E4639 Kw_Wu8 1.000 OneToOne 0.00 1.000 FORMAT "%5.3" EXTENDED_LIMITS 0.00 255.0 /end CHARACTERISTIC
/begin CHARACTERISTIC PFlt_swtFltTemp_C "Umschalter des Filteroberflächentemperaturmodells" VALUE 0x1E46B8 Kw_Wu8 1.000 OneToOne 0.00 1.000 FORMAT "%5.3" EXTENDED_LIMITS 0.00 255.0 /end CHARACTERISTIC
/begin CHARACTERISTIC PFlt_swtLmbdAprx_C "Mess- oder Simulationssignal für Lambda-Messung" VALUE 0x1E3A9A Kw_Wu8 1.000 OneToOne 0.00 1.000 FORMAT "%5.3" EXTENDED_LIMITS 0.00 255.0 /end CHARACTERISTIC
/begin CHARACTERISTIC PFlt_swtMonCharMin_C "Schalter Auswahl Überwachung Strömungswiderstand" VALUE 0x1E463A Kw_Wu8 1.000 OneToOne 0.00 1.000 FORMAT "%5.3" EXTENDED_LIMITS 0.00 255.0 /end CHARACTERISTIC
/begin CHARACTERISTIC PFlt_swtPresSensCfg_C "Auswahlwert für Sensorkonfiguration" VALUE 0x1E4680 Kw_Wu8 2.000 OneToOne 0.00 2.000 FORMAT "%5.3" EXTENDED_LIMITS 0.00 255.0 /end CHARACTERISTIC
/begin CHARACTERISTIC PFlt_swtSotMul_C "Umschalter additive (0) / multiplikative (1) Aschebeladungskorrektur [-]" VALUE 0x1E45F4 Kw_Wu8 1.000 OneToOne 0.00 1.000 FORMAT "%5.3" EXTENDED_LIMITS 0.00 255.0 /end CHARACTERISTIC
/begin CHARACTERISTIC PFlt_swtSotReEu_C "Umschalter für Berechnung mit Reynoldszahl (1) / Kennraum (0) [-]" VALUE 0x1E45F5 Kw_Wu8 1.000 OneToOne 0.00 1.000 FORMAT "%5.3" EXTENDED_LIMITS 0.00 255.0 /end CHARACTERISTIC
/begin CHARACTERISTIC PFlt_swtSotSimPT1Init_C "Auswahlschalter für Initialisierung des PT1 Filters im Beladungskoeffizienten" VALUE 0x1E45F6 Kw_Wu8 1.000 OneToOne 0.00 1.000 FORMAT "%5.3" EXTENDED_LIMITS 0.00 255.0 /end CHARACTERISTIC
/begin CHARACTERISTIC PFlt_swtSotSimTempInit_C "Schalter zur Auswahl des Anfangswertes der Russmasse im Beladungszähler" VALUE 0x1E45F7 Kw_Wu8 1.000 OneToOne 0.00 1.000 FORMAT "%5.3" EXTENDED_LIMITS 0.00 255.0 /end CHARACTERISTIC
/begin CHARACTERISTIC PFlt_swtSOxPsngTime_C "Umschalter feste oder verschwefelungszeitabhängige Entschwefelungszeit" VALUE 0x1E3715 Kw_Wu8 1.000 OneToOne 0.00 1.000 FORMAT "%5.3" EXTENDED_LIMITS 0.00 255.0 /end CHARACTERISTIC
/begin CHARACTERISTIC PFlt_swtTempNorm_C "Schalter der Temperaturwert des Arrays auswählt" VALUE 0x1E3865 Kw_Wu8 4.00000000000 EngTempFldSel 0.00 4.00000000000 FORMAT "%13.11" /end CHARACTERISTIC
/begin CHARACTERISTIC PFlt_swtTempPOpCalc_C "Schalter der Temperaturwert des Arrays auswählt" VALUE 0x1E3866 Kw_Wu8 4.00000000000 EngTempFldSel 0.00 4.00000000000 FORMAT "%13.11" /end CHARACTERISTIC
/begin CHARACTERISTIC PFlt_swtTmrLckRst_C "Schalter zum Rücksetzen des EEPROM Wertes der Sperrzeit" VALUE 0x1E3716 Kw_Wu8 255.0 OneToOne 0.00 255.0 FORMAT "%5.1" /end CHARACTERISTIC
/begin CHARACTERISTIC PFlt_tAccPedOff_C "Verzögerungszeit für schnelle Regenerations-Unterbrechung bei schneller Fahrpedalbetätigung" VALUE 0x1E3718 Kw_Wu16 300.0000 Time_s 0.00 300.0000 FORMAT "%8.4" EXTENDED_LIMITS 0.00 655.3500 /end CHARACTERISTIC
/begin CHARACTERISTIC PFlt_tAddPoI1_MAP "Kennfeld für Korrektur der Stationärtemperaturen durch PoI1" MAP 0x1E46BA Kf_Xs16_Ys16_Ws16 700.0000 TempDiff_Kelv 100.0000 800.0000 FORMAT "%8.4" EXTENDED_LIMITS -3276.800 3276.700
 /begin AXIS_DESCR STD_AXIS Eng_nAvrg EngN 8 40.00000 6000.000 FORMAT "%8.3" EXTENDED_LIMITS -32768.00 32767.00 DEPOSIT ABSOLUTE /end AXIS_DESCR
 /begin AXIS_DESCR STD_AXIS PFlt_qPoI1DesAct_mp InjMass 8 0.00 327.6700 FORMAT "%8.4" EXTENDED_LIMITS -327.6800 327.6700 DEPOSIT ABSOLUTE /end AXIS_DESCR
/end CHARACTERISTIC
/begin CHARACTERISTIC PFlt_tAddPoI2_MAP "Kennfeld für Korrektur der Stationärtemperaturen durch PoI2" MAP 0x1E475E Kf_Xs16_Ys16_Ws16 700.0000 TempDiff_Kelv 100.0000 800.0000 FORMAT "%8.4" EXTENDED_LIMITS -3276.800 3276.700
 /begin AXIS_DESCR STD_AXIS Eng_nAvrg EngN 8 40.00000 6000.000 FORMAT "%8.3" EXTENDED_LIMITS -32768.00 32767.00 DEPOSIT ABSOLUTE /end AXIS_DESCR
 /begin AXIS_DESCR STD_AXIS PFlt_qPoI2NonEff_mp InjMass 8 0.00 327.6700 FORMAT "%8.4" EXTENDED_LIMITS -327.6800 327.6700 DEPOSIT ABSOLUTE /end AXIS_DESCR
/end CHARACTERISTIC
/begin CHARACTERISTIC PFlt_tCldStrtDfl_C "Obere Temperaturschwelle für Kaltstarterkennung" VALUE 0x1E463C Kw_Ws16 250.2000 Temp_Cels -50.14000 200.0600 FORMAT "%8.4" EXTENDED_LIMITS -3549.940 3003.560 /end CHARACTERISTIC
/begin CHARACTERISTIC PFlt_tClntHysHigh1_C "Oberer Hystereseschwellwert Kühlmitteltemperatur 1" VALUE 0x1E3868 Kw_Ws16 200.0000 Temp_Cels -50.14000 149.8600 FORMAT "%8.4" EXTENDED_LIMITS -3549.940 3003.560 /end CHARACTERISTIC
/begin CHARACTERISTIC PFlt_tClntHysHigh2_C "Oberer Hystereseschwellwert Kühlmitteltemperatur 2" VALUE 0x1E386A Kw_Ws16 200.0000 Temp_Cels -50.14000 149.8600 FORMAT "%8.4" EXTENDED_LIMITS -3549.940 3003.560 /end CHARACTERISTIC
/begin CHARACTERISTIC PFlt_tClntHysHigh3_C "Oberer Hystereseschwellwert Kühlmitteltemperatur 3" VALUE 0x1E386C Kw_Ws16 200.0000 Temp_Cels -50.14000 149.8600 FORMAT "%8.4" EXTENDED_LIMITS -3549.940 3003.560 /end CHARACTERISTIC
/begin CHARACTERISTIC PFlt_tClntHysHigh4_C "Oberer Hystereseschwellwert Kühlmitteltemperatur 4" VALUE 0x1E386E Kw_Ws16 200.0000 Temp_Cels -50.14000 149.8600 FORMAT "%8.4" EXTENDED_LIMITS -3549.940 3003.560 /end CHARACTERISTIC
/begin CHARACTERISTIC PFlt_tClntHysHigh5_C "Oberer Hystereseschwellwert Kühlmitteltemperatur 5" VALUE 0x1E3870 Kw_Ws16 200.0000 Temp_Cels -50.14000 149.8600 FORMAT "%8.4" EXTENDED_LIMITS -3549.940 3003.560 /end CHARACTERISTIC
/begin CHARACTERISTIC PFlt_tClntHysLow1_C "Unterer Hystereseschwellwert Kühlmitteltemperatur 1" VALUE 0x1E3872 Kw_Ws16 200.0000 Temp_Cels -50.14000 149.8600 FORMAT "%8.4" EXTENDED_LIMITS -3549.940 3003.560 /end CHARACTERISTIC
/begin CHARACTERISTIC PFlt_tClntHysLow2_C "Unterer Hystereseschwellwert Kühlmitteltemperatur 2" VALUE 0x1E3874 Kw_Ws16 200.0000 Temp_Cels -50.14000 149.8600 FORMAT "%8.4" EXTENDED_LIMITS -3549.940 3003.560 /end CHARACTERISTIC
/begin CHARACTERISTIC PFlt_tClntHysLow3_C "Unterer Hystereseschwellwert Kühlmitteltemperatur 3" VALUE 0x1E3876 Kw_Ws16 200.0000 Temp_Cels -50.14000 149.8600 FORMAT "%8.4" EXTENDED_LIMITS -3549.940 3003.560 /end CHARACTERISTIC
/begin CHARACTERISTIC PFlt_tClntHysLow4_C "Unterer Hystereseschwellwert Kühlmitteltemperatur 4" VALUE 0x1E3878 Kw_Ws16 200.0000 Temp_Cels -50.14000 149.8600 FORMAT "%8.4" EXTENDED_LIMITS -3549.940 3003.560 /end CHARACTERISTIC
/begin CHARACTERISTIC PFlt_tClntHysLow5_C "Unterer Hystereseschwellwert Kühlmitteltemperatur 5" VALUE 0x1E387A Kw_Ws16 200.0000 Temp_Cels -50.14000 149.8600 FORMAT "%8.4" EXTENDED_LIMITS -3549.940 3003.560 /end CHARACTERISTIC
/begin CHARACTERISTIC PFlt_tClntLowMax_C "Unterer Hysterese Wert für max. erlaubte Wassertemperatur" VALUE 0x1E371A Kw_Ws16 200.0000 Temp_Cels -50.14000 149.8600 FORMAT "%8.4" EXTENDED_LIMITS -3549.940 3003.560 /end CHARACTERISTIC
/begin CHARACTERISTIC PFlt_tClntUppMax_C "Oberer Hysterese Wert für max. erlaubte Wassertemperatur" VALUE 0x1E371C Kw_Ws16 200.0000 Temp_Cels -50.14000 149.8600 FORMAT "%8.4" EXTENDED_LIMITS -3549.940 3003.560 /end CHARACTERISTIC
/begin CHARACTERISTIC PFlt_tDiffCldMax_C "Maximal erlaubte Abweichung Temperatursensoren bei Kaltstart" VALUE 0x1E463E Kw_Ws16 250.2000 TempDiff_Kelv -50.10000 200.1000 FORMAT "%8.4" EXTENDED_LIMITS -3276.800 3276.700 /end CHARACTERISTIC
/begin CHARACTERISTIC PFlt_tDiffTolcMax_C "Maximal erlaubte Toleranzabweichung Temperaturplausibilisierung" VALUE 0x1E4640 Kw_Ws16 250.2000 TempDiff_Kelv -50.10000 200.1000 FORMAT "%8.4" EXTENDED_LIMITS -3276.800 3276.700 /end CHARACTERISTIC
/begin CHARACTERISTIC PFlt_tDwnStrmTolcMax_C "Maximal zulässige Toleranz bei Plausibilisierung des zweiten Abgastemperatursensors" VALUE 0x1E4642 Kw_Ws16 250.2000 TempDiff_Kelv -50.10000 200.1000 FORMAT "%8.4" EXTENDED_LIMITS -3276.800 3276.700 /end CHARACTERISTIC
/begin CHARACTERISTIC PFlt_tEGMax_C "Obere Schwelle SRC Temperatursensoren" VALUE 0x1E4644 Kw_Ws16 250.2000 Temp_Cels -50.14000 200.0600 FORMAT "%8.4" EXTENDED_LIMITS -3549.940 3003.560 /end CHARACTERISTIC
/begin CHARACTERISTIC PFlt_tEGMin_C "Untere Schwelle SRC Temperatursensoren" VALUE 0x1E4646 Kw_Ws16 250.2000 Temp_Cels -50.14000 200.0600 FORMAT "%8.4" EXTENDED_LIMITS -3549.940 3003.560 /end CHARACTERISTIC
/begin CHARACTERISTIC PFlt_tExhGsSty_MAP "Kennfeld für Stationärtemperaturen [K]" MAP 0x1E4802 Kf_Xs16_Ys16_Ws16 700.0000 TempDiff_Kelv 100.0000 800.0000 FORMAT "%8.4" EXTENDED_LIMITS -3276.800 3276.700
 /begin AXIS_DESCR STD_AXIS Eng_nAvrg EngN 8 40.00000 6000.000 FORMAT "%8.3" EXTENDED_LIMITS -32768.00 32767.00 DEPOSIT ABSOLUTE /end AXIS_DESCR
 /begin AXIS_DESCR STD_AXIS InjCtl_qSetUnBal InjMass 8 0.00 327.6700 FORMAT "%8.4" EXTENDED_LIMITS -327.6800 327.6700 DEPOSIT ABSOLUTE /end AXIS_DESCR
/end CHARACTERISTIC
/begin CHARACTERISTIC PFlt_tFltCorrHysHigh3_C "Oberer Hystereseschwellwert für Filtertemperaturkorrektur 3" VALUE 0x1E387C Kw_Ws16 1050.000 TempDiff_Kelv -50.10000 999.9000 FORMAT "%8.4" EXTENDED_LIMITS -3276.800 3276.700 /end CHARACTERISTIC
/begin CHARACTERISTIC PFlt_tFltCorrHysHigh4_C "Oberer Hystereseschwellwert für Filtertemperaturkorrektur 4" VALUE 0x1E387E Kw_Ws16 1050.000 TempDiff_Kelv -50.10000 999.9000 FORMAT "%8.4" EXTENDED_LIMITS -3276.800 3276.700 /end CHARACTERISTIC
/begin CHARACTERISTIC PFlt_tFltCorrHysLow3_C "Unterer Hystereseschwellwert für Filtertemperaturkorrektur 3" VALUE 0x1E3880 Kw_Ws16 1050.000 TempDiff_Kelv -50.10000 999.9000 FORMAT "%8.4" EXTENDED_LIMITS -3276.800 3276.700 /end CHARACTERISTIC
/begin CHARACTERISTIC PFlt_tFltCorrHysLow4_C "Unterer Hystereseschwellwert für Filtertemperaturkorrektur 4" VALUE 0x1E3882 Kw_Ws16 1050.000 TempDiff_Kelv -50.10000 999.9000 FORMAT "%8.4" EXTENDED_LIMITS -3276.800 3276.700 /end CHARACTERISTIC
/begin CHARACTERISTIC PFlt_tFltHysHigh1_C "Unterer Hystereseschwellwert für Temperatur im Filter 1" VALUE 0x1E3884 Kw_Ws16 1050.000 Temp_Cels -50.14000 999.8600 FORMAT "%8.4" EXTENDED_LIMITS -3549.940 3003.560 /end CHARACTERISTIC
/begin CHARACTERISTIC PFlt_tFltHysHigh2_C "Oberer Hystereseschwellwert für Temperatur im Filter 2" VALUE 0x1E3886 Kw_Ws16 1050.000 Temp_Cels -50.14000 999.8600 FORMAT "%8.4" EXTENDED_LIMITS -3549.940 3003.560 /end CHARACTERISTIC
/begin CHARACTERISTIC PFlt_tFltHysHigh3_C "Oberer Hystereseschwellwert für Temperatur im Filter 3" VALUE 0x1E3888 Kw_Ws16 1050.000 Temp_Cels -50.14000 999.8600 FORMAT "%8.4" EXTENDED_LIMITS -3549.940 3003.560 /end CHARACTERISTIC
/begin CHARACTERISTIC PFlt_tFltHysHigh4_C "Oberer Hystereseschwellwert für Temperatur im Filter 4" VALUE 0x1E388A Kw_Ws16 1050.000 Temp_Cels -50.14000 999.8600 FORMAT "%8.4" EXTENDED_LIMITS -3549.940 3003.560 /end CHARACTERISTIC
/begin CHARACTERISTIC PFlt_tFltHysHigh5_C "Oberer Hystereseschwellwert für Temperatur im Filter 5" VALUE 0x1E388C Kw_Ws16 1050.000 Temp_Cels -50.14000 999.8600 FORMAT "%8.4" EXTENDED_LIMITS -3549.940 3003.560 /end CHARACTERISTIC
/begin CHARACTERISTIC PFlt_tFltHysLow1_C "Unterer Hystereseschwellwert für Temperatur im Filter 1" VALUE 0x1E388E Kw_Ws16 1050.000 Temp_Cels -50.14000 999.8600 FORMAT "%8.4" EXTENDED_LIMITS -3549.940 3003.560 /end CHARACTERISTIC
/begin CHARACTERISTIC PFlt_tFltHysLow2_C "Unterer Hystereseschwellwert für Temperatur im Filter 2" VALUE 0x1E3890 Kw_Ws16 1050.000 Temp_Cels -50.14000 999.8600 FORMAT "%8.4" EXTENDED_LIMITS -3549.940 3003.560 /end CHARACTERISTIC
/begin CHARACTERISTIC PFlt_tFltHysLow3_C "Unterer Hystereseschwellwert für Temperatur im Filter 3" VALUE 0x1E3892 Kw_Ws16 1050.000 Temp_Cels -50.14000 999.8600 FORMAT "%8.4" EXTENDED_LIMITS -3549.940 3003.560 /end CHARACTERISTIC
/begin CHARACTERISTIC PFlt_tFltHysLow4_C "Unterer Hystereseschwellwert für Temperatur im Filter 4" VALUE 0x1E3894 Kw_Ws16 1050.000 Temp_Cels -50.14000 999.8600 FORMAT "%8.4" EXTENDED_LIMITS -3549.940 3003.560 /end CHARACTERISTIC
/begin CHARACTERISTIC PFlt_tFltHysLow5_C "Unterer Hystereseschwellwert für Temperatur im Filter 5" VALUE 0x1E3896 Kw_Ws16 1050.000 Temp_Cels -50.14000 999.8600 FORMAT "%8.4" EXTENDED_LIMITS -3549.940 3003.560 /end CHARACTERISTIC
/begin CHARACTERISTIC PFlt_tFltThres_C "Vergleichstemperatur für Temperatur in Filter für Bit 6" VALUE 0x1E3898 Kw_Ws16 1050.000 Temp_Cels -50.14000 999.8600 FORMAT "%8.4" EXTENDED_LIMITS -3549.940 3003.560 /end CHARACTERISTIC
/begin CHARACTERISTIC PFlt_tiChkTempPlausMax_C "Maximales Zeitfenster zur Durchführung Temperaturplausibilisierung" VALUE 0x1E4648 Kw_Wu16 5.000000 Time_s 0.00 5.000000 FORMAT "%8.6" EXTENDED_LIMITS 0.00 655.3500 /end CHARACTERISTIC
/begin CHARACTERISTIC PFlt_DebCharMaxDef_C "Entprellzeit setzen Strömungswiderstand SRC high" VALUE 0x1E464A Kw_Wu16 1000.000 Time_ms 0.00 1000.000 FORMAT "%8.3" EXTENDED_LIMITS 0.00 655350.0 /end CHARACTERISTIC
/begin CHARACTERISTIC PFlt_DebCharMaxOk_C "Entprellzeit heilen Strömungswiderstand SRC high" VALUE 0x1E464C Kw_Wu16 1000.000 Time_ms 0.00 1000.000 FORMAT "%8.3" EXTENDED_LIMITS 0.00 655350.0 /end CHARACTERISTIC
/begin CHARACTERISTIC PFlt_DebCharMinDef_C "Entprellzeit setzen Strömungswiderstand SRC low" VALUE 0x1E464E Kw_Wu16 1000.000 Time_ms 0.00 1000.000 FORMAT "%8.3" EXTENDED_LIMITS 0.00 655350.0 /end CHARACTERISTIC
/begin CHARACTERISTIC PFlt_DebCharMinOk_C "Entprellzeit heilen Strömungswiderstand SRC low" VALUE 0x1E4650 Kw_Wu16 1000.000 Time_ms 0.00 1000.000 FORMAT "%8.3" EXTENDED_LIMITS 0.00 655350.0 /end CHARACTERISTIC
/begin CHARACTERISTIC PFlt_DebEngPrtMaxDef_C "Entprellzeit setzen Motorschutz-Fehler" VALUE 0x1E4652 Kw_Wu16 1000.000 Time_ms 0.00 1000.000 FORMAT "%8.3" EXTENDED_LIMITS 0.00 655350.0 /end CHARACTERISTIC
/begin CHARACTERISTIC PFlt_DebEngPrtMaxOk_C "Entprellzeit heilen Motorschutz-Fehler" VALUE 0x1E4654 Kw_Wu16 1000.000 Time_ms 0.00 1000.000 FORMAT "%8.3" EXTENDED_LIMITS 0.00 655350.0 /end CHARACTERISTIC
/begin CHARACTERISTIC PFlt_DebPDiffDynPlausDef_C "Entprellzeit setzen dynamischer Fehler Differenzdruck" VALUE 0x1E4656 Kw_Wu16 1000.000 Time_ms 0.00 1000.000 FORMAT "%8.3" EXTENDED_LIMITS 0.00 655350.0 /end CHARACTERISTIC
/begin CHARACTERISTIC PFlt_DebPDiffDynPlausOk_C "Entprellzeit heilen dynamischer Fehler Differenzdruck" VALUE 0x1E4658 Kw_Wu16 1000.000 Time_ms 0.00 1000.000 FORMAT "%8.3" EXTENDED_LIMITS 0.00 655350.0 /end CHARACTERISTIC
/begin CHARACTERISTIC PFlt_DebHsLnPlausDef_C "Entprellzeit setzen Plausibilisierungsfehler Schlauchleitung" VALUE 0x1E465A Kw_Wu16 1000.000 Time_ms 0.00 1000.000 FORMAT "%8.3" EXTENDED_LIMITS 0.00 655350.0 /end CHARACTERISTIC
/begin CHARACTERISTIC PFlt_DebHsLnPlausOk_C "Entprellzeit heilen Plausibilisierungsfehler Schlauchleitung" VALUE 0x1E465C Kw_Wu16 1000.000 Time_ms 0.00 1000.000 FORMAT "%8.3" EXTENDED_LIMITS 0.00 655350.0 /end CHARACTERISTIC
/begin CHARACTERISTIC PFlt_DebPDiffMaxDef_C "Entprellzeit setzen Drucksensoren SRC high" VALUE 0x1E465E Kw_Wu16 1000.000 Time_ms 0.00 1000.000 FORMAT "%8.3" EXTENDED_LIMITS 0.00 655350.0 /end CHARACTERISTIC
/begin CHARACTERISTIC PFlt_DebPDiffMaxOk_C "Entprellzeit heilen Drucksensoren SRC high" VALUE 0x1E4660 Kw_Wu16 1000.000 Time_ms 0.00 1000.000 FORMAT "%8.3" EXTENDED_LIMITS 0.00 655350.0 /end CHARACTERISTIC
/begin CHARACTERISTIC PFlt_DebPDiffMinDef_C "Entprellzeit setzen Drucksensoren SRC low" VALUE 0x1E4662 Kw_Wu16 1000.000 Time_ms 0.00 1000.000 FORMAT "%8.3" EXTENDED_LIMITS 0.00 655350.0 /end CHARACTERISTIC
/begin CHARACTERISTIC PFlt_DebPDiffMinOk_C "Entprellzeit heilen Drucksensoren SRC low" VALUE 0x1E4664 Kw_Wu16 1000.000 Time_ms 0.00 1000.000 FORMAT "%8.3" EXTENDED_LIMITS 0.00 655350.0 /end CHARACTERISTIC
/begin CHARACTERISTIC PFlt_DebSotPlausDef_C "Entprellzeit setzen Plausibilisierungsfehler Versottung" VALUE 0x1E4666 Kw_Wu16 1000.000 Time_ms 0.00 1000.000 FORMAT "%8.3" EXTENDED_LIMITS 0.00 655350.0 /end CHARACTERISTIC
/begin CHARACTERISTIC PFlt_DebSotPlausOk_C "Entprellzeit heilen Plausibilisierungsfehler Versottung" VALUE 0x1E4668 Kw_Wu16 1000.000 Time_ms 0.00 1000.000 FORMAT "%8.3" EXTENDED_LIMITS 0.00 655350.0 /end CHARACTERISTIC
/begin CHARACTERISTIC PFlt_DebRgnPermMaxDef_C "Entprellzeit setzen permanente Regeneration" VALUE 0x1E466A Kw_Wu16 1000.000 Time_ms 0.00 1000.000 FORMAT "%8.3" EXTENDED_LIMITS 0.00 655350.0 /end CHARACTERISTIC
/begin CHARACTERISTIC PFlt_DebRgnPermMaxOk_C "Entprellzeit heilen permanente Regeneration" VALUE 0x1E466C Kw_Wu16 1000.000 Time_ms 0.00 1000.000 FORMAT "%8.3" EXTENDED_LIMITS 0.00 655350.0 /end CHARACTERISTIC
/begin CHARACTERISTIC PFlt_DebTEGMaxDef_C "Entprellzeit setzen Temperatursensoren SRC high" VALUE 0x1E466E Kw_Wu16 1000.000 Time_ms 0.00 1000.000 FORMAT "%8.3" EXTENDED_LIMITS 0.00 655350.0 /end CHARACTERISTIC
/begin CHARACTERISTIC PFlt_DebTEGMaxOk_C "Entprellzeit heilen Temperatursensoren SRC high" VALUE 0x1E4670 Kw_Wu16 1000.000 Time_ms 0.00 1000.000 FORMAT "%8.3" EXTENDED_LIMITS 0.00 655350.0 /end CHARACTERISTIC
/begin CHARACTERISTIC PFlt_DebTEGMinDef_C "Entprellzeit setzen Temperatursensoren SRC low" VALUE 0x1E4672 Kw_Wu16 1000.000 Time_ms 0.00 1000.000 FORMAT "%8.3" EXTENDED_LIMITS 0.00 655350.0 /end CHARACTERISTIC
/begin CHARACTERISTIC PFlt_DebTEGMinOk_C "Entprellzeit heilen Temperatursensoren SRC low" VALUE 0x1E4674 Kw_Wu16 1000.000 Time_ms 0.00 1000.000 FORMAT "%8.3" EXTENDED_LIMITS 0.00 655350.0 /end CHARACTERISTIC
/begin CHARACTERISTIC PFlt_tiEngOnMaxDef_C "maximale Motorbetriebszeit für Regeneration im Fehlerfall" VALUE 0x1E3720 Kw_Wu32 4294967295.00 TimeEngOn 0.00 4294967295.00 FORMAT "%13.2" /end CHARACTERISTIC
/begin CHARACTERISTIC PFlt_tiEngOnMax_C "maximale Motorbetriebszeit für Regeneration" VALUE 0x1E3724 Kw_Wu32 4294967295.00 TimeEngOn 0.00 4294967295.00 FORMAT "%13.2" /end CHARACTERISTIC
/begin CHARACTERISTIC PFlt_tiEngPrtPT1_C "Zeitkonstante des PT1-Gliedes für den Motorschutz" VALUE 0x1E3728 Kw_Wu32 4294.9673 TimeDelay_s 0.0000010000000 4294.9673 FORMAT "%9.4" /end CHARACTERISTIC
/begin CHARACTERISTIC PFlt_tiEngPrt_C "Regenerationsdauer aufgrund von Motorschutz" VALUE 0x1E372C Kw_Wu32 21474836.4700 Time_s 0.00 21474836.4700 FORMAT "%13.4" EXTENDED_LIMITS 0.00 42949672.9500 /end CHARACTERISTIC
/begin CHARACTERISTIC PFlt_tiExhGsDel_CUR "Abgasstromverzögerung" CURVE 0x1E48A6 Kl_Xs16_Ws16 10.00000 Time_s 0.00 10.00000 FORMAT "%8.5" EXTENDED_LIMITS -327.6800 327.6700
 /begin AXIS_DESCR STD_AXIS PFlt_dmEG AirMassPerTime 8 -1000.000 1000.000 FORMAT "%8.3" EXTENDED_LIMITS -3276.800 3276.700 DEPOSIT ABSOLUTE /end AXIS_DESCR
/end CHARACTERISTIC
/begin CHARACTERISTIC PFlt_tiFltTempPT1_C "Filterzeitkonstante für Oberflächentemperatursimulation" VALUE 0x1E48C8 Kw_Wu32 4294.9673 TimeDelay_s 0.0000010000000 4294.9673 FORMAT "%9.4" /end CHARACTERISTIC
/begin CHARACTERISTIC PFlt_tiGear_C "Ausschaltverzögerungszeit für Gangvergleich" VALUE 0x1E389A Kw_Wu16 655350.0 TimeDeb 0.00 655350.0 FORMAT "%8.1" /end CHARACTERISTIC
/begin CHARACTERISTIC PFlt_tiHtTransDT1_CUR "Wärmeübertragungszeit" CURVE 0x1E48CC Kl_Xs16_Ws16 10.00000 Time_s 0.00 10.00000 FORMAT "%8.5" EXTENDED_LIMITS -327.6800 327.6700
 /begin AXIS_DESCR STD_AXIS PFlt_dmEG AirMassPerTime 8 -1000.000 1000.000 FORMAT "%8.3" EXTENDED_LIMITS -3276.800 3276.700 DEPOSIT ABSOLUTE /end AXIS_DESCR
/end CHARACTERISTIC
/begin CHARACTERISTIC PFlt_tiLckChkTempPlaus_C "Verriegelungszeit Temperatursensorplausibilisierung nach kurzem Motorlauf" VALUE 0x1E4676 Kw_Wu16 50.00000 Time_s 50.00000 100.0000 FORMAT "%8.4" EXTENDED_LIMITS 0.00 655.3500 /end CHARACTERISTIC
/begin CHARACTERISTIC PFlt_tiLckRgn_C "Zeit für Freigabe der Regenerationsblockade" VALUE 0x1E3730 Kw_Wu32 42949672.9500 Time_s 0.00 42949672.9500 FORMAT "%13.4" /end CHARACTERISTIC
/begin CHARACTERISTIC PFlt_tiLckSubs_C "Ersatzwert für Sperrzeit" VALUE 0x1E3734 Kw_Wu32 42949672.9500 Time_s 0.00 42949672.9500 FORMAT "%13.4" /end CHARACTERISTIC
/begin CHARACTERISTIC PFlt_tiOpSubs_C "Ersatzwert für Motorbetriebszeit im Fall Eeprom lese Fehler" VALUE 0x1E3738 Kw_Wu32 4294967295.00 TimeEngOn 0.00 4294967295.00 FORMAT "%13.2" /end CHARACTERISTIC
/begin CHARACTERISTIC PFlt_tiOvrRunDebNeg_C "Negative Entprellzeit bei Schubbetrieb im Beladungszähler" VALUE 0x1E45F8 Kw_Wu16 20.00000 Time_s 0.00 20.00000 FORMAT "%8.5" EXTENDED_LIMITS 0.00 655.3500 /end CHARACTERISTIC
/begin CHARACTERISTIC PFlt_tiOvrRunDebPos_C "Positive Entprellzeit bei Schubbetrieb im Beladungszähler" VALUE 0x1E45FA Kw_Wu16 20.00000 Time_s 0.00 20.00000 FORMAT "%8.5" EXTENDED_LIMITS 0.00 655.3500 /end CHARACTERISTIC
/begin CHARACTERISTIC PFlt_tiPerSotSimTemp_C "Integrationsdauer der Temperatur" VALUE 0x1E45FC Kw_Wu16 599.8000 Time_s 0.2000000 600.0000 FORMAT "%8.4" EXTENDED_LIMITS 0.00 655.3500 /end CHARACTERISTIC
/begin CHARACTERISTIC PFlt_tiPOpCalcHold_C "Haltezeit bei Bit 6" VALUE 0x1E389C Kw_Ws16 327670.0 Time_ms 0.00 327670.0 FORMAT "%8.1" EXTENDED_LIMITS -327680.0 327670.0 /end CHARACTERISTIC
/begin CHARACTERISTIC PFlt_tiPOpCalcOn_C "Entprellzeit bei Bit 6" VALUE 0x1E389E Kw_Wu16 655350.0 TimeDeb 0.00 655350.0 FORMAT "%8.1" /end CHARACTERISTIC
/begin CHARACTERISTIC PFlt_tiFltHsLnPT1_C "Filterzeitkonstante Signalfilterung für Schlauchleitungsüberwachung" VALUE 0x1E4678 Kw_Wu32 4294.9673 TimeDelay_s 0.0000010000000 4294.9673 FORMAT "%9.4" /end CHARACTERISTIC
/begin CHARACTERISTIC PFlt_tiRgnCtlMax_C "Regenerationszeit für open loop mode" VALUE 0x1E373C Kw_Wu32 429496.000000 Time_s 0.00 429496.000000 FORMAT "%13.6" EXTENDED_LIMITS 0.00 42949672.9500 /end CHARACTERISTIC
/begin CHARACTERISTIC PFlt_tiRgnCtlSpo_C "Regenerationszeit zur Detektierung einer spontanen Regeneration bei Steuerung" VALUE 0x1E3740 Kw_Wu16 655.3500 Time_s 0.00 655.3500 FORMAT "%8.4" /end CHARACTERISTIC
/begin CHARACTERISTIC PFlt_tiRgnSpo_C "Regenerationszeit zur Detektierung einer spontanen Regeneration" VALUE 0x1E3742 Kw_Wu16 655.3500 Time_s 0.00 655.3500 FORMAT "%8.4" /end CHARACTERISTIC
/begin CHARACTERISTIC PFlt_tiRgnStg1_C "überwachte Maximaldauer der Regeneration Stufe 1[ s]." VALUE 0x1E3744 Kw_Wu32 429496.000000 Time_s 0.00 429496.000000 FORMAT "%13.6" EXTENDED_LIMITS 0.00 42949672.9500 /end CHARACTERISTIC
/begin CHARACTERISTIC PFlt_tiRgnStg2_C "überwachte Maximaldauer der Regeneration Stufe 2[ s]." VALUE 0x1E3748 Kw_Wu32 429496.000000 Time_s 0.00 429496.000000 FORMAT "%13.6" EXTENDED_LIMITS 0.00 42949672.9500 /end CHARACTERISTIC
/begin CHARACTERISTIC PFlt_tiRgnStg3_C "überwachte Maximaldauer der Regeneration Stufe 3[ s]" VALUE 0x1E374C Kw_Wu32 429496.000000 Time_s 0.00 429496.000000 FORMAT "%13.6" EXTENDED_LIMITS 0.00 42949672.9500 /end CHARACTERISTIC
/begin CHARACTERISTIC PFlt_tiRgnStg4_C "überwachte Maximaldauer der Regeneration Stufe 4[ s]." VALUE 0x1E3750 Kw_Wu32 429496.000000 Time_s 0.00 429496.000000 FORMAT "%13.6" EXTENDED_LIMITS 0.00 42949672.9500 /end CHARACTERISTIC
/begin CHARACTERISTIC PFlt_tiRgnStg5_C "überwachte Maximaldauer der Regeneration Stufe 5[ s]." VALUE 0x1E3754 Kw_Wu32 429496.000000 Time_s 0.00 429496.000000 FORMAT "%13.6" EXTENDED_LIMITS 0.00 42949672.9500 /end CHARACTERISTIC
/begin CHARACTERISTIC PFlt_tiRgnStg6_C "überwachte Maximaldauer der Regeneration Stufe 6[ s]." VALUE 0x1E3758 Kw_Wu32 429496.000000 Time_s 0.00 429496.000000 FORMAT "%13.6" EXTENDED_LIMITS 0.00 42949672.9500 /end CHARACTERISTIC
/begin CHARACTERISTIC PFlt_tiSotPresDiffPT1_C "Filterzeitkonstante für Differenzdruck [s]" VALUE 0x1E4600 Kw_Wu32 4294.9673 TimeDelay_s 0.0000010000000 4294.9673 FORMAT "%9.4" /end CHARACTERISTIC
/begin CHARACTERISTIC PFlt_tiSotRatDiffPT1_C "Filterzeitkonstante für simulierten Druckunterschied [s]" VALUE 0x1E4604 Kw_Wu32 4294.9673 TimeDelay_s 0.0000010000000 4294.9673 FORMAT "%9.4" /end CHARACTERISTIC
/begin CHARACTERISTIC PFlt_tiSotRatPT1_C "Filterzeitkonstante für Beladungsverhältniss [s]" VALUE 0x1E4608 Kw_Wu32 4294.9673 TimeDelay_s 0.0000010000000 4294.9673 FORMAT "%9.4" /end CHARACTERISTIC
/begin CHARACTERISTIC PFlt_tiSotSimPresPerm_C "Zusätzliche Entprellzeit für permanente Druckmessfehler" VALUE 0x1E460C Kw_Wu16 655140.0 Time_ms 0.00 655140.0 FORMAT "%8.1" EXTENDED_LIMITS 0.00 655350.0 /end CHARACTERISTIC
/begin CHARACTERISTIC PFlt_tiSotSimTempPT1_C "Zeitkonstante des PT1 Filters im Beladungszähler" VALUE 0x1E4610 Kw_Wu32 4294.9673 TimeDelay_s 0.0000010000000 4294.9673 FORMAT "%9.4" /end CHARACTERISTIC
/begin CHARACTERISTIC PFlt_tiSOxDebPos_C "Positve Entprellzeit der Entschwefelungsbedingungen" VALUE 0x1E375C Kw_Wu16 120.0000 Time_s 0.00 120.0000 FORMAT "%8.4" EXTENDED_LIMITS 0.00 655.3500 /end CHARACTERISTIC
/begin CHARACTERISTIC PFlt_tiSOxPsngMax_C "Begrenzung der Entschwefelungsvorgabezeit- Maximum" VALUE 0x1E3760 Kw_Wu32 42949672.9500 Time_s 0.00 42949672.9500 FORMAT "%13.4" /end CHARACTERISTIC
/begin CHARACTERISTIC PFlt_tiSOxPsngMin_C "Begrenzung der Entschwefelungsvorgabezeit- Minimum" VALUE 0x1E3764 Kw_Wu32 42949672.9500 Time_s 0.00 42949672.9500 FORMAT "%13.4" /end CHARACTERISTIC
/begin CHARACTERISTIC PFlt_tiSOxPsngSet_C "Feste Entschwefelungssollzeit" VALUE 0x1E3768 Kw_Wu32 42949672.9500 Time_s 0.00 42949672.9500 FORMAT "%13.4" /end CHARACTERISTIC
/begin CHARACTERISTIC PFlt_tiThresNorm_MAP "Schwellwert-Kennfeld zum Vergleich mit Zeit seit Erreichen Zustand NORMAL" MAP 0x1E38A0 Kf_Xs16_Ys16_Ws16 30.00000 Time_ms 0.00 30.00000 FORMAT "%8.5" EXTENDED_LIMITS -327680.0 327670.0
 /begin AXIS_DESCR STD_AXIS PFlt_tFlt Temp_Cels 8 -50.14000 999.8600 FORMAT "%8.4" EXTENDED_LIMITS -3549.940 3003.560 DEPOSIT ABSOLUTE /end AXIS_DESCR
 /begin AXIS_DESCR STD_AXIS PFlt_tEngNorm_mp Temp_Cels 8 -50.14000 149.8600 FORMAT "%8.4" EXTENDED_LIMITS -3549.940 3003.560 DEPOSIT ABSOLUTE /end AXIS_DESCR
/end CHARACTERISTIC
/begin CHARACTERISTIC PFlt_tiVelVeh_C "Konstante für Ausschaltverzögerung" VALUE 0x1E3944 Kw_Wu16 655350.0 TimeDeb 0.00 655350.0 FORMAT "%8.1" /end CHARACTERISTIC
/begin CHARACTERISTIC PFlt_tOxiCHysHigh3_C "Oberer Hystereseschwellwert Oxidationskatalysatortemperatur" VALUE 0x1E3946 Kw_Ws16 1050.000 Temp_Cels -50.14000 999.8600 FORMAT "%8.4" EXTENDED_LIMITS -3549.940 3003.560 /end CHARACTERISTIC
/begin CHARACTERISTIC PFlt_tOxiCHysHigh4_C "Oberer Hystereseschwellwert Oxidationskatalysator" VALUE 0x1E3948 Kw_Ws16 1050.000 Temp_Cels -50.14000 999.8600 FORMAT "%8.4" EXTENDED_LIMITS -3549.940 3003.560 /end CHARACTERISTIC
/begin CHARACTERISTIC PFlt_tOxiCHysLow3_C "Unterer Hystereseschwellwert Oxidationskatalysator" VALUE 0x1E394A Kw_Ws16 1050.000 Temp_Cels -50.14000 999.8600 FORMAT "%8.4" EXTENDED_LIMITS -3549.940 3003.560 /end CHARACTERISTIC
/begin CHARACTERISTIC PFlt_tOxiCHysLow4_C "Unterer Hystereseschwellwert Oxidationskatalysator" VALUE 0x1E394C Kw_Ws16 1050.000 Temp_Cels -50.14000 999.8600 FORMAT "%8.4" EXTENDED_LIMITS -3549.940 3003.560 /end CHARACTERISTIC
/begin CHARACTERISTIC PFlt_tPreDfl_C "Ersatzwert bei Temperatur vor Partikelfilter unplausibel" VALUE 0x1E48EE Kw_Ws16 1050.000 Temp_Cels -50.14000 999.8600 FORMAT "%8.4" EXTENDED_LIMITS -3549.940 3003.560 /end CHARACTERISTIC
/begin CHARACTERISTIC PFlt_tPreMax_C "Maximal erlaubter Wert für Temperatur vor Partikelfilter" VALUE 0x1E376C Kw_Ws16 700.0000 Temp_Cels 99.96000 799.9600 FORMAT "%8.4" EXTENDED_LIMITS -3549.940 3003.560 /end CHARACTERISTIC
/begin CHARACTERISTIC PFlt_tPreOxiLowMax_C "Maximal zulässiger Temperaturwert vor Oxidationskatalysator, unterer Wert." VALUE 0x1E376E Kw_Ws16 1095.000 Temp_Cels -45.04000 1049.960 FORMAT "%8.3" EXTENDED_LIMITS -3549.940 3003.560 /end CHARACTERISTIC
/begin CHARACTERISTIC PFlt_tPreOxiUppMax_C "Maximal zulässiger Temperaturwert vor Oxidationskatalysator, oberer Wert." VALUE 0x1E3770 Kw_Ws16 1095.000 Temp_Cels -45.04000 1049.960 FORMAT "%8.3" EXTENDED_LIMITS -3549.940 3003.560 /end CHARACTERISTIC
/begin CHARACTERISTIC PFlt_tPreRegMin_C "Entschwefelungsbedingung Temperatur vor Partikelfilter" VALUE 0x1E3772 Kw_Ws16 700.0000 Temp_Cels 199.9600 899.9600 FORMAT "%8.4" EXTENDED_LIMITS -3549.940 3003.560 /end CHARACTERISTIC
/begin CHARACTERISTIC PFlt_tPreTrbnMax_C "Max. Abgastemperatur vor der Abgasturbine zur Regenerations-Unterbrechung" VALUE 0x1E3774 Kw_Ws16 700.0000 Temp_Cels 99.96000 799.9600 FORMAT "%8.4" EXTENDED_LIMITS -3549.940 3003.560 /end CHARACTERISTIC
/begin CHARACTERISTIC PFlt_trqInrRgnLowMax1_CUR "Kennlinie für untere Grenze 1 der Regenerations-Unterbrechung wegen hohem geforderten Moment" CURVE 0x1E3776 Kl_Xs16_Ws16 1500.000 Trq -500.0000 1000.000 FORMAT "%8.3" EXTENDED_LIMITS -3276.800 3276.700
 /begin AXIS_DESCR STD_AXIS Eng_nAvrg EngN 12 40.00000 6000.000 FORMAT "%8.3" EXTENDED_LIMITS -32768.00 32767.00 DEPOSIT ABSOLUTE /end AXIS_DESCR
/end CHARACTERISTIC
/begin CHARACTERISTIC PFlt_trqInrRgnLowMax2_CUR "Kennlinie für untere Grenze 2 der Regenerations-Unterbrechung wegen hohem geforderten Moment" CURVE 0x1E37A8 Kl_Xs16_Ws16 1500.000 Trq -500.0000 1000.000 FORMAT "%8.3" EXTENDED_LIMITS -3276.800 3276.700
 /begin AXIS_DESCR STD_AXIS Eng_nAvrg EngN 12 40.00000 6000.000 FORMAT "%8.3" EXTENDED_LIMITS -32768.00 32767.00 DEPOSIT ABSOLUTE /end AXIS_DESCR
/end CHARACTERISTIC
/begin CHARACTERISTIC PFlt_trqInrRgnUppMax1_CUR "Kennlinie für obere Grenze 1 der Regenerations-Unterbrechung wegen hohem geforderten Moment" CURVE 0x1E37DA Kl_Xs16_Ws16 1500.000 Trq -500.0000 1000.000 FORMAT "%8.3" EXTENDED_LIMITS -3276.800 3276.700
 /begin AXIS_DESCR STD_AXIS Eng_nAvrg EngN 12 40.00000 6000.000 FORMAT "%8.3" EXTENDED_LIMITS -32768.00 32767.00 DEPOSIT ABSOLUTE /end AXIS_DESCR
/end CHARACTERISTIC
/begin CHARACTERISTIC PFlt_trqInrRgnUppMax2_CUR "Kennlinie für obere Grenze 2 der Regenerations-Unterbrechung wegen hohem geforderten Moment" CURVE 0x1E380C Kl_Xs16_Ws16 1500.000 Trq -500.0000 1000.000 FORMAT "%8.3" EXTENDED_LIMITS -3276.800 3276.700
 /begin AXIS_DESCR STD_AXIS Eng_nAvrg EngN 12 40.00000 6000.000 FORMAT "%8.3" EXTENDED_LIMITS -32768.00 32767.00 DEPOSIT ABSOLUTE /end AXIS_DESCR
/end CHARACTERISTIC
/begin CHARACTERISTIC PFlt_tSOxLvlHi_C "Temperaturabzugswert bei Verschwefelung" VALUE 0x1E4614 Kw_Ws16 1050.000 TempDiff_Kelv -50.10000 999.9000 FORMAT "%8.4" EXTENDED_LIMITS -3276.800 3276.700 /end CHARACTERISTIC
/begin CHARACTERISTIC PFlt_tSOxLvlLo_C "Temperaturabzugswert ohne Verschwefelung" VALUE 0x1E4616 Kw_Ws16 1050.000 TempDiff_Kelv -50.10000 999.9000 FORMAT "%8.4" EXTENDED_LIMITS -3276.800 3276.700 /end CHARACTERISTIC
/begin CHARACTERISTIC PFlt_tSurfInit_C "Oberflächentemperatur Partikelfilter Initialisierungswert" VALUE 0x1E48F0 Kw_Ws16 6553.500 Temp_Cels -3549.940 3003.560 FORMAT "%8.3" /end CHARACTERISTIC
/begin CHARACTERISTIC PFlt_tThresPre1_MAP "Schwellwert- Kennfeld 1 zum Vergleich Abgastemperatur in Motorzustandsberechnung" MAP 0x1E394E Kf_Xs16_Ys16_Ws16 1050.000 Temp_Cels -50.14000 999.8600 FORMAT "%8.4" EXTENDED_LIMITS -3549.940 3003.560
 /begin AXIS_DESCR STD_AXIS Eng_nAvrg EngN 8 40.00000 6000.000 FORMAT "%8.3" EXTENDED_LIMITS -32768.00 32767.00 DEPOSIT ABSOLUTE /end AXIS_DESCR
 /begin AXIS_DESCR STD_AXIS InjCtl_qSetUnBal InjMass 8 0.00 200.0000 FORMAT "%8.4" EXTENDED_LIMITS -327.6800 327.6700 DEPOSIT ABSOLUTE /end AXIS_DESCR
/end CHARACTERISTIC
/begin CHARACTERISTIC PFlt_tThresPre2_MAP "Schwellwert- Kennfeld 1 zum Vergleich Abgastemperatur in Motorzustandsberechnung" MAP 0x1E39F2 Kf_Xs16_Ys16_Ws16 1050.000 Temp_Cels -50.14000 999.8600 FORMAT "%8.4" EXTENDED_LIMITS -3549.940 3003.560
 /begin AXIS_DESCR STD_AXIS Eng_nAvrg EngN 8 40.00000 6000.000 FORMAT "%8.3" EXTENDED_LIMITS -32768.00 32767.00 DEPOSIT ABSOLUTE /end AXIS_DESCR
 /begin AXIS_DESCR STD_AXIS InjCtl_qSetUnBal InjMass 8 0.00 200.0000 FORMAT "%8.4" EXTENDED_LIMITS -327.6800 327.6700 DEPOSIT ABSOLUTE /end AXIS_DESCR
/end CHARACTERISTIC
/begin CHARACTERISTIC PFlt_tUpStrmTolcMax_C "Maximal zulässige Toleranz bei Plausibilisierung des ersten Abgastemperatursensors" VALUE 0x1E467C Kw_Ws16 250.2000 TempDiff_Kelv -50.10000 200.1000 FORMAT "%8.4" EXTENDED_LIMITS -3276.800 3276.700 /end CHARACTERISTIC
/begin CHARACTERISTIC PFlt_TxtMsgMsk_C "Masken-Wert für die Text-Nachricht des Partikel-Filters" VALUE 0x1E3840 Kw_Wu32 4294967295.00 OneToOne 0.00 4294967295.00 FORMAT "%13.2" /end CHARACTERISTIC
/begin CHARACTERISTIC PFlt_vThresVeh_C "Schwellwert zum Vergleich mit Fahrzeuggeschwindigkeit" VALUE 0x1E3A96 Kw_Ws16 300.0000 Vel 0.00 300.0000 FORMAT "%8.4" EXTENDED_LIMITS -327.6800 327.6700 /end CHARACTERISTIC
/begin CHARACTERISTIC PrpCtl_tiDebvLimErrPatDef_C "Debounce Dauer" VALUE 0x1E4FC8 Kw_Wu16 655350.0 Time_ms 0.00 655350.0 FORMAT "%8.1" /end CHARACTERISTIC
/begin CHARACTERISTIC PrpCtl_tiDebvLimErrPatOk_C "Fehlerheilungserkennungszeit" VALUE 0x1E4FCA Kw_Wu16 655350.0 Time_ms 0.00 655350.0 FORMAT "%8.1" /end CHARACTERISTIC
/begin CHARACTERISTIC PrpCtl_rFltMin_C "Schwellwert für Status von Kick-Down" VALUE 0x1E4FCC Kw_Ws16 427.6800 Prc -327.6800 100.0000 FORMAT "%8.4" EXTENDED_LIMITS -327.6800 327.6700 /end CHARACTERISTIC
/begin CHARACTERISTIC PrpCtl_SpdLim4IKi_C "Regler I-Anteil 4. Gang" VALUE 0x1E4FD0 Kw_Wu32 99999999.9767 Ki_Vel2TrqPrp 0.00 99999999.9767 FORMAT "%13.4" /end CHARACTERISTIC
/begin CHARACTERISTIC PrpCtl_SpdLim4IKiPos_C "Regler I-Anteil für positive Großsignale 4. Gang" VALUE 0x1E4FD4 Kw_Wu32 99999999.9767 Ki_Vel2TrqPrp 0.00 99999999.9767 FORMAT "%13.4" /end CHARACTERISTIC
/begin CHARACTERISTIC PrpCtl_SpdLim4IKiNeg_C "Regler I-Anteil für negative Großsignale 4. Gang" VALUE 0x1E4FD8 Kw_Wu32 99999999.9767 Ki_Vel2TrqPrp 0.00 99999999.9767 FORMAT "%13.4" /end CHARACTERISTIC
/begin CHARACTERISTIC PrpCtl_vSpdLim4IWinPos_C "obere Fenstergrenze für I-Anteil Kleinsignale 4.Gang" VALUE 0x1E4FDC Kw_Ws16 300.0000 Vel 0.00 300.0000 FORMAT "%8.4" EXTENDED_LIMITS -327.6800 327.6700 /end CHARACTERISTIC
/begin CHARACTERISTIC PrpCtl_vSpdLim4IWinNeg_C "untere Fenstergrenze für I-Anteil Kleinsignale 4.Gang" VALUE 0x1E4FDE Kw_Ws16 300.0000 Vel -300.0000 0.00 FORMAT "%8.4" EXTENDED_LIMITS -327.6800 327.6700 /end CHARACTERISTIC
/begin CHARACTERISTIC PrpCtl_SpdLim4PKp_C "Regler P-Anteil 4. Gang" VALUE 0x1E4FE0 Kw_Wu32 6553599.99847 Kp_Vel2TrqPrp 0.00 6553599.99847 FORMAT "%13.5" /end CHARACTERISTIC
/begin CHARACTERISTIC PrpCtl_SpdLim4PKpPos_C "Regler P-Anteil für positive Großsignale 4. Gang" VALUE 0x1E4FE4 Kw_Wu32 6553599.99847 Kp_Vel2TrqPrp 0.00 6553599.99847 FORMAT "%13.5" /end CHARACTERISTIC
/begin CHARACTERISTIC PrpCtl_SpdLim4PKpNeg_C "Regler P-Anteil für negative Großsignale 4. Gang" VALUE 0x1E4FE8 Kw_Wu32 6553599.99847 Kp_Vel2TrqPrp 0.00 6553599.99847 FORMAT "%13.5" /end CHARACTERISTIC
/begin CHARACTERISTIC PrpCtl_vSpdLim4PWinPos_C "obere Fenstergrenze für P-Anteil Kleinsignale 4.Gang" VALUE 0x1E4FEC Kw_Ws16 300.0000 Vel 0.00 300.0000 FORMAT "%8.4" EXTENDED_LIMITS -327.6800 327.6700 /end CHARACTERISTIC
/begin CHARACTERISTIC PrpCtl_vSpdLim4PWinNeg_C "untere Fenstergrenze für P-Anteil Kleinsignale 4.Gang" VALUE 0x1E4FEE Kw_Ws16 300.0000 Vel -300.0000 0.00 FORMAT "%8.4" EXTENDED_LIMITS -327.6800 327.6700 /end CHARACTERISTIC
/begin CHARACTERISTIC PrpCtl_SpdLim5IKi_C "Regler I-Anteil 5. Gang" VALUE 0x1E4FF0 Kw_Wu32 99999999.9767 Ki_Vel2TrqPrp 0.00 99999999.9767 FORMAT "%13.4" /end CHARACTERISTIC
/begin CHARACTERISTIC PrpCtl_SpdLim5IKiPos_C "Regler I-Anteil für positive Großsignale 5. Gang" VALUE 0x1E4FF4 Kw_Wu32 99999999.9767 Ki_Vel2TrqPrp 0.00 99999999.9767 FORMAT "%13.4" /end CHARACTERISTIC
/begin CHARACTERISTIC PrpCtl_SpdLim5IKiNeg_C "Regler I-Anteil für negative Großsignale 5. Gang" VALUE 0x1E4FF8 Kw_Wu32 99999999.9767 Ki_Vel2TrqPrp 0.00 99999999.9767 FORMAT "%13.4" /end CHARACTERISTIC
/begin CHARACTERISTIC PrpCtl_vSpdLim5IWinPos_C "obere Fenstergrenze für I-Anteil Kleinsignale 5.Gang" VALUE 0x1E4FFC Kw_Ws16 300.0000 Vel 0.00 300.0000 FORMAT "%8.4" EXTENDED_LIMITS -327.6800 327.6700 /end CHARACTERISTIC
/begin CHARACTERISTIC PrpCtl_vSpdLim5IWinNeg_C "untere Fenstergrenze für I-Anteil Kleinsignale 5.Gang" VALUE 0x1E4FFE Kw_Ws16 300.0000 Vel -300.0000 0.00 FORMAT "%8.4" EXTENDED_LIMITS -327.6800 327.6700 /end CHARACTERISTIC
/begin CHARACTERISTIC PrpCtl_SpdLim5PKp_C "Regler P-Anteil 5. Gang" VALUE 0x1E5000 Kw_Wu32 6553599.99847 Kp_Vel2TrqPrp 0.00 6553599.99847 FORMAT "%13.5" /end CHARACTERISTIC
/begin CHARACTERISTIC PrpCtl_SpdLim5PKpPos_C "Regler P-Anteil für positive Großsignale 5. Gang" VALUE 0x1E5004 Kw_Wu32 6553599.99847 Kp_Vel2TrqPrp 0.00 6553599.99847 FORMAT "%13.5" /end CHARACTERISTIC
/begin CHARACTERISTIC PrpCtl_SpdLim5PKpNeg_C "Regler P-Anteil für negative Großsignale 5. Gang" VALUE 0x1E5008 Kw_Wu32 6553599.99847 Kp_Vel2TrqPrp 0.00 6553599.99847 FORMAT "%13.5" /end CHARACTERISTIC
/begin CHARACTERISTIC PrpCtl_vSpdLim5PWinPos_C "obere Fenstergrenze für P-Anteil Kleinsignale 5.Gang" VALUE 0x1E500C Kw_Ws16 300.0000 Vel 0.00 300.0000 FORMAT "%8.4" EXTENDED_LIMITS -327.6800 327.6700 /end CHARACTERISTIC
/begin CHARACTERISTIC PrpCtl_vSpdLim5PWinNeg_C "untere Fenstergrenze für P-Anteil Kleinsignale 5.Gang" VALUE 0x1E500E Kw_Ws16 300.0000 Vel -300.0000 0.00 FORMAT "%8.4" EXTENDED_LIMITS -327.6800 327.6700 /end CHARACTERISTIC
/begin CHARACTERISTIC PrpCtl_tiSpdLimPT1_C "Zeitkonstante PT1-Glied" VALUE 0x1E5010 Kw_Wu32 4294.9673 TimeDelay_s 0.0000010000000 4294.9673 FORMAT "%9.4" /end CHARACTERISTIC
/begin CHARACTERISTIC PrpCtl_swtAWD1Rls_C "Schalter zum Heilungsmodus AWD1-Fehler" VALUE 0x1E5014 Kw_Wu8 1.000 OneToOne 0.00 1.000 FORMAT "%5.3" EXTENDED_LIMITS 0.00 255.0 /end CHARACTERISTIC
/begin CHARACTERISTIC PrpCtl_swtEnaLimAWD1_C "Freigabeschalter für Höchstgeschwindigkeitsbegrenzung durch AWD-SG" VALUE 0x1E5015 Kw_Wu8 1.000 OneToOne 0.00 1.000 FORMAT "%5.3" EXTENDED_LIMITS 0.00 255.0 /end CHARACTERISTIC
/begin CHARACTERISTIC PrpCtl_swtEnaLimNIVEAU1_C "Freigabeschalter für Höchstgeschwindigkeitsbegrenzung durch Niveau-SG" VALUE 0x1E5016 Kw_Wu8 1.000 OneToOne 0.00 1.000 FORMAT "%5.3" EXTENDED_LIMITS 0.00 255.0 /end CHARACTERISTIC
/begin CHARACTERISTIC PrpCtl_swtNIVEAU1Rls_C "Schalter zum Heilungsmodus NIVEAU1-Fehler" VALUE 0x1E5017 Kw_Wu8 1.000 OneToOne 0.00 1.000 FORMAT "%5.3" EXTENDED_LIMITS 0.00 255.0 /end CHARACTERISTIC
/begin CHARACTERISTIC PrpCtl_swtNoAPPLim_C "Schalter Fahrpedalbegrenzung inaktiv" VALUE 0x1E5018 Kw_Wu8 3.000 OneToOne 0.00 3.000 FORMAT "%5.3" EXTENDED_LIMITS 0.00 255.0 /end CHARACTERISTIC
/begin CHARACTERISTIC PrpCtl_swtVehSpdLimEco_C "Geschwindigkeitsbegrenzung durch ASG" VALUE 0x1E5019 Kw_Wu8 1.000 OneToOne 0.00 1.000 FORMAT "%5.3" EXTENDED_LIMITS 0.00 255.0 /end CHARACTERISTIC
/begin CHARACTERISTIC PrpCtl_tiAPPCDMin_C "Zeit bis Erkennung Leerlauf" VALUE 0x1E501A Kw_Wu16 2000.000 Time_ms 0.00 2000.000 FORMAT "%8.3" EXTENDED_LIMITS 0.00 655350.0 /end CHARACTERISTIC
/begin CHARACTERISTIC PrpCtl_trqAWDLim_CUR "Kennlinie zur drehzahlabhängigen Momentenbegrenzung durch Allrad1" CURVE 0x1E501C Kl_Xs16_Ws16 400.0000 TrqPrp 0.00 400.0000 FORMAT "%8.4" EXTENDED_LIMITS -32768.00 32767.00
 /begin AXIS_DESCR STD_AXIS Eng_nAvrg EngN 25 0.00 6000.000 FORMAT "%8.3" EXTENDED_LIMITS -32768.00 32767.00 DEPOSIT ABSOLUTE /end AXIS_DESCR
/end CHARACTERISTIC
/begin CHARACTERISTIC PrpCtl_trqNIVEAULim_CUR "Kennlinie zur drehzahlabhängigen Momentenbegrenzung durch Niveau1" CURVE 0x1E5082 Kl_Xs16_Ws16 400.0000 TrqPrp 0.00 400.0000 FORMAT "%8.4" EXTENDED_LIMITS -32768.00 32767.00
 /begin AXIS_DESCR STD_AXIS Eng_nAvrg EngN 25 0.00 6000.000 FORMAT "%8.3" EXTENDED_LIMITS -32768.00 32767.00 DEPOSIT ABSOLUTE /end AXIS_DESCR
/end CHARACTERISTIC
/begin CHARACTERISTIC PrpCtl_trqSpdTrackOff_C "Schwellwert Sollwertnachführung ausschalten" VALUE 0x1E50E8 Kw_Ws16 1500.000 TrqPrp -500.0000 1000.000 FORMAT "%8.3" EXTENDED_LIMITS -32768.00 32767.00 /end CHARACTERISTIC
/begin CHARACTERISTIC PrpCtl_vLimAWDMax_C "Maximalgeschwindigkeit durch Allrad1" VALUE 0x1E50EA Kw_Ws16 255.0000 Vel 0.00 255.0000 FORMAT "%8.4" EXTENDED_LIMITS -327.6800 327.6700 /end CHARACTERISTIC
/begin CHARACTERISTIC PrpCtl_vLimAWDMin_C "Mimimalschwelle für Allrad1 Begrenzung" VALUE 0x1E50EC Kw_Ws16 255.0000 Vel 0.00 255.0000 FORMAT "%8.4" EXTENDED_LIMITS -327.6800 327.6700 /end CHARACTERISTIC
/begin CHARACTERISTIC PrpCtl_vNiveauLimOffset_C "Offset-Fahrzeuggeschwindigkeit Fahrpedalbegrenzung inaktiv" VALUE 0x1E50EE Kw_Ws16 300.0000 Vel 0.00 300.0000 FORMAT "%8.4" EXTENDED_LIMITS -327.6800 327.6700 /end CHARACTERISTIC
/begin CHARACTERISTIC PrpCtl_vNiveauMax_C "Maximalgeschwindigkeit durch Niveau1" VALUE 0x1E50F0 Kw_Ws16 255.0000 Vel 0.00 255.0000 FORMAT "%8.4" EXTENDED_LIMITS -327.6800 327.6700 /end CHARACTERISTIC
/begin CHARACTERISTIC PrpCtl_vSpdLimMax_C "Fahrzeughöchstgeschwindigkeit" VALUE 0x1E50F2 Kw_Ws16 300.0000 Vel 0.00 300.0000 FORMAT "%8.4" EXTENDED_LIMITS -327.6800 327.6700 /end CHARACTERISTIC
/begin CHARACTERISTIC PrpCtl_vSpdLimThreshBck_C "Schwellwert Sollwertnachführung freilaufend von Zustand 2" VALUE 0x1E50F4 Kw_Ws16 300.0000 Vel 0.00 300.0000 FORMAT "%8.4" EXTENDED_LIMITS -327.6800 327.6700 /end CHARACTERISTIC
/begin CHARACTERISTIC PrpCtl_vSpdLimThreshFree_C "Schwellwert Sollwertnachführung frei laufend" VALUE 0x1E50F6 Kw_Ws16 300.0000 Vel 0.00 300.0000 FORMAT "%8.4" EXTENDED_LIMITS -327.6800 327.6700 /end CHARACTERISTIC
/begin CHARACTERISTIC PrpCtl_vSpdLimThreshOff_C "Schwellwert Sollwertnachführung ausgeschalten" VALUE 0x1E50F8 Kw_Ws16 300.0000 Vel 0.00 300.0000 FORMAT "%8.4" EXTENDED_LIMITS -327.6800 327.6700 /end CHARACTERISTIC
/begin CHARACTERISTIC PrpCtl_vSpdLimThreshOn_C "Schwellwert Sollwertnachführung eingeschalten" VALUE 0x1E50FA Kw_Ws16 300.0000 Vel 0.00 300.0000 FORMAT "%8.4" EXTENDED_LIMITS -327.6800 327.6700 /end CHARACTERISTIC
/begin CHARACTERISTIC PrpCtl_vSpdLimTrmValLo_C "minimum value for speed limitation" VALUE 0x1E50FC Kw_Ws16 300.0000 Vel 0.00 300.0000 FORMAT "%8.4" EXTENDED_LIMITS -327.6800 327.6700 /end CHARACTERISTIC
/begin CHARACTERISTIC PrpCtl_VSSCDAWDMax_C "obere Grenze für aktuelle Geschwindigkeit (AWD1)" VALUE 0x1E50FE Kw_Ws16 255.0000 Vel 0.00 255.0000 FORMAT "%8.4" EXTENDED_LIMITS -327.6800 327.6700 /end CHARACTERISTIC
/begin CHARACTERISTIC PrpCtl_VSSCDNiveauMax_C "obere Grenze für aktuelle Geschwindigkeit (NIVEAU1)" VALUE 0x1E5100 Kw_Ws16 255.0000 Vel 0.00 255.0000 FORMAT "%8.4" EXTENDED_LIMITS -327.6800 327.6700 /end CHARACTERISTIC
/begin CHARACTERISTIC Prp_rAPP_Vector "Konfigurationslabel für Bypass" VALUE 0x1C0B3A Kw_Wu8 255.0 OneToOne 0.00 255.0 FORMAT "%5.1" /end CHARACTERISTIC
/begin CHARACTERISTIC Prp_rAPP_Channel "Konfigurationslabel für Bypass" VALUE 0x1C0B3B Kw_Wu8 255.0 OneToOne 0.00 255.0 FORMAT "%5.1" /end CHARACTERISTIC
/begin CHARACTERISTIC Prp_rEngLow_CUR "inverse Fahrverhaltenkennlinie für CC/ACC beschleunigt und AWD ist aktiv" CURVE 0x1E4A52 Kl_Xs16_Ws16 655.3500 Prc -327.6800 327.6700 FORMAT "%8.4"
 /begin AXIS_DESCR STD_AXIS Prp_trqEng Trq 16 -3276.800 3276.700 FORMAT "%8.3" DEPOSIT ABSOLUTE /end AXIS_DESCR
/end CHARACTERISTIC
/begin CHARACTERISTIC Prp_rEngLow_MAP "Virtuelles Fahrverhaltenkennfeld bei aktiver Untersetzung." MAP 0x1E4A94 Kf_Xs16_Ys16_Ws16 655.3500 Prc -327.6800 327.6700 FORMAT "%8.4"
 /begin AXIS_DESCR STD_AXIS Eng_nAvrg EngN 16 -32768.00 32767.00 FORMAT "%8.2" DEPOSIT ABSOLUTE /end AXIS_DESCR
 /begin AXIS_DESCR STD_AXIS Prp_trqEng Trq 16 -3276.800 3276.700 FORMAT "%8.3" DEPOSIT ABSOLUTE /end AXIS_DESCR
/end CHARACTERISTIC
/begin CHARACTERISTIC Prp_rEng_CUR "inverse Fahrverhaltenkennlinie für Mastershift" CURVE 0x1E4CD8 Kl_Xs16_Ws16 655.3500 Prc -327.6800 327.6700 FORMAT "%8.4"
 /begin AXIS_DESCR STD_AXIS Prp_trqEng Trq 16 -3276.800 3276.700 FORMAT "%8.3" DEPOSIT ABSOLUTE /end AXIS_DESCR
/end CHARACTERISTIC
/begin CHARACTERISTIC Prp_rEng_MAP "inverses Fahrverhaltenkennfeld für konventionelle Triebstrangsteuerung" MAP 0x1E4D1A Kf_Xs16_Ys16_Ws16 655.3500 Prc -327.6800 327.6700 FORMAT "%8.4"
 /begin AXIS_DESCR STD_AXIS Eng_nAvrg EngN 16 -32768.00 32767.00 FORMAT "%8.2" DEPOSIT ABSOLUTE /end AXIS_DESCR
 /begin AXIS_DESCR STD_AXIS Prp_trqEng Trq 16 -3276.800 3276.700 FORMAT "%8.3" DEPOSIT ABSOLUTE /end AXIS_DESCR
/end CHARACTERISTIC
/begin CHARACTERISTIC Prp_rVirtAPP_Vector "Konfigurationslabel für Bypass" VALUE 0x1C0B3C Kw_Wu8 255.0 OneToOne 0.00 255.0 FORMAT "%5.1" /end CHARACTERISTIC
/begin CHARACTERISTIC Prp_rVirtAPP_Channel "Konfigurationslabel für Bypass" VALUE 0x1C0B3D Kw_Wu8 255.0 OneToOne 0.00 255.0 FORMAT "%5.1" /end CHARACTERISTIC
/begin CHARACTERISTIC Prp_swtCCOnVal_C "Wert von Schalter Prp_swtCCOn" VALUE 0x1E4A4E Kw_Wu8 1.000 OneToOne 0.00 1.000 FORMAT "%5.3" EXTENDED_LIMITS 0.00 255.0 /end CHARACTERISTIC
/begin CHARACTERISTIC Prp_swtCCOnType_C "Typ von Schalter Prp_swtCCOn" VALUE 0x1E4A4F Kw_Wu8 1.000 OneToOne 1.000 2.000 FORMAT "%5.3" EXTENDED_LIMITS 0.00 255.0 /end CHARACTERISTIC
/begin CHARACTERISTIC Prp_swtCCSelVal_C "Wert von Schalter Prp_swtCCSel" VALUE 0x1E4A50 Kw_Wu8 1.000 OneToOne 0.00 1.000 FORMAT "%5.3" EXTENDED_LIMITS 0.00 255.0 /end CHARACTERISTIC
/begin CHARACTERISTIC Prp_swtCCSelType_C "Typ von Schalter Prp_swtCCSel" VALUE 0x1E4A51 Kw_Wu8 1.000 OneToOne 1.000 2.000 FORMAT "%5.3" EXTENDED_LIMITS 0.00 255.0 /end CHARACTERISTIC
/begin CHARACTERISTIC Prp_swtrAPP_C "Ausgabe Virtueller Fahrpedalwert nur wenn CrCtl/ACC aktiv" VALUE 0x1E4F5E Kw_Wu8 1.000 OneToOne 0.00 1.000 FORMAT "%5.3" EXTENDED_LIMITS 0.00 255.0 /end CHARACTERISTIC
/begin CHARACTERISTIC Prp_swtrEngCur_C "Freigabe der Kennlinie Prp_rEng_CUR" VALUE 0x1E4F5F Kw_Wu8 3.000 OneToOne 0.00 3.000 FORMAT "%5.3" EXTENDED_LIMITS 0.00 255.0 /end CHARACTERISTIC
/begin CHARACTERISTIC Prp_trqThresEng_CUR "Schwellwert-Kennlinie zur Unterscheidung zwischen Zug- und Schubbetrieb" CURVE 0x1E4F60 Kl_Xs16_Ws16 300.0000 Trq 0.00 300.0000 FORMAT "%8.4" EXTENDED_LIMITS -3276.800 3276.700
 /begin AXIS_DESCR STD_AXIS Eng_nAvrg EngN 25 0.00 6000.000 FORMAT "%8.3" EXTENDED_LIMITS -32768.00 32767.00 DEPOSIT ABSOLUTE /end AXIS_DESCR
/end CHARACTERISTIC
/begin CHARACTERISTIC PSPCD_DebExcTempDef_C "Fehlerentprellzeit Uebertemperatur" VALUE 0x1E510C Kw_Wu16 655350.0 Time_ms 0.00 655350.0 FORMAT "%8.1" /end CHARACTERISTIC
/begin CHARACTERISTIC PSPCD_DebExcTempOk_C "Heilungsentprellzeit Uebertemperatur" VALUE 0x1E510E Kw_Wu16 655350.0 Time_ms 0.00 655350.0 FORMAT "%8.1" /end CHARACTERISTIC
/begin CHARACTERISTIC PSPCD_DebNoLoadDef_C "Fehlerentprellzeit keine Last" VALUE 0x1E5110 Kw_Wu16 655350.0 Time_ms 0.00 655350.0 FORMAT "%8.1" /end CHARACTERISTIC
/begin CHARACTERISTIC PSPCD_DebNoLoadOk_C "Heilungsentprellzeit keine Last" VALUE 0x1E5112 Kw_Wu16 655350.0 Time_ms 0.00 655350.0 FORMAT "%8.1" /end CHARACTERISTIC
/begin CHARACTERISTIC PSPCD_DebShortCircBatDef_C "Fehlerentprellzeit Kurzschluß nach UBatt" VALUE 0x1E5114 Kw_Wu16 655350.0 Time_ms 0.00 655350.0 FORMAT "%8.1" /end CHARACTERISTIC
/begin CHARACTERISTIC PSPCD_DebShortCircBatOk_C "Heilungsentprellzeit für Kurzschluß nach UBatt" VALUE 0x1E5116 Kw_Wu16 655350.0 Time_ms 0.00 655350.0 FORMAT "%8.1" /end CHARACTERISTIC
/begin CHARACTERISTIC PSPCD_DebShortCircGndDef_C "Fehlerentprellzeit für Kurzschluß nach Masse" VALUE 0x1E5118 Kw_Wu16 655350.0 Time_ms 0.00 655350.0 FORMAT "%8.1" /end CHARACTERISTIC
/begin CHARACTERISTIC PSPCD_DebShortCircGndOk_C "Heilungsentprellzeit für Kurzschluß nach Masse" VALUE 0x1E511A Kw_Wu16 655350.0 Time_ms 0.00 655350.0 FORMAT "%8.1" /end CHARACTERISTIC
/begin CHARACTERISTIC PSPCD_stDigInvOut_C "Invertierung des Ausgangssignals" VALUE 0x1E511C Kw_Wu8 1.000 OneToOne 0.00 1.000 FORMAT "%5.3" EXTENDED_LIMITS 0.00 255.0 /end CHARACTERISTIC
/begin CHARACTERISTIC PSPCD_tiPSPcheckDfpTmr_C "Ansteuerdauer bei Abschaltung im Fehlerfall" VALUE 0x1E511E Kw_Wu16 655350.0 Time_ms 0.00 655350.0 FORMAT "%8.1" /end CHARACTERISTIC
/begin CHARACTERISTIC PSPCD_tiPSPOFFTmr_C "Abschaltzeit der Endstufe im Fehlerfall" VALUE 0x1E5120 Kw_Wu16 655350.0 Time_ms 0.00 655350.0 FORMAT "%8.1" /end CHARACTERISTIC
/begin CHARACTERISTIC PSP_nPSPOn_C "Drehzahlschwelle für PSP ein" VALUE 0x1E5104 Kw_Ws16 32767.00 EngN 0.00 32767.00 FORMAT "%8.2" EXTENDED_LIMITS -32768.00 32767.00 /end CHARACTERISTIC
/begin CHARACTERISTIC PSP_stPSPLogicOff_C "Hauptschalter für die Vorförderpumpe" VALUE 0x1E5106 Kw_Wu8 255.0 OneToOne 0.00 255.0 FORMAT "%5.1" /end CHARACTERISTIC
/begin CHARACTERISTIC PSP_tiEco_C "Mindesteinschaltzeit für EKP nach Init. oder ECO Anforderung" VALUE 0x1E5108 Kw_Wu32 42949672950.0 Time_ms 0.00 42949672950.0 FORMAT "%13.1" /end CHARACTERISTIC
/begin CHARACTERISTIC RailCD_uSRCMin_C "SRC-Minimum Vorgabewert" VALUE 0x1E7678 Kw_Ws16 5200.391 Volt 0.00 5200.391 FORMAT "%8.3" EXTENDED_LIMITS -160156.4 160151.5 /end CHARACTERISTIC
/begin CHARACTERISTIC RailCD_uSRCMax_C "SRC-Maximum Vorgabewert" VALUE 0x1E767A Kw_Ws16 5200.391 Volt 0.00 5200.391 FORMAT "%8.3" EXTENDED_LIMITS -160156.4 160151.5 /end CHARACTERISTIC
/begin CHARACTERISTIC RailCD_pLin_CUR "Linearisierungskennlinie für Kraftstoffdrucksensor" CURVE 0x1E767C Kl_Xs16_Ws16 1800000. Pres_Rail 0.00 1800000. FORMAT "%8.0" EXTENDED_LIMITS -3276800. 3276700.
 /begin AXIS_DESCR STD_AXIS RailCD_uPeakRaw Volt 4 0.00 5200.391 FORMAT "%8.3" EXTENDED_LIMITS -160156.4 160151.5 DEPOSIT ABSOLUTE /end AXIS_DESCR
/end CHARACTERISTIC
/begin CHARACTERISTIC RailCD_DebSRCHighDef_C "Kraftstoffdruck Fehlerentprellzeit SRC-High" VALUE 0x1E768E Kw_Wu16 655350.0 Time_ms 0.00 655350.0 FORMAT "%8.1" /end CHARACTERISTIC
/begin CHARACTERISTIC RailCD_DebSRCHighOk_C "Kraftstoffdruck Heilungsentprellzeit SRC-High" VALUE 0x1E7690 Kw_Wu16 655350.0 Time_ms 0.00 655350.0 FORMAT "%8.1" /end CHARACTERISTIC
/begin CHARACTERISTIC RailCD_DebSRCLowDef_C "Kraftstoffdruck Fehlerentprellzeit SRC-Low" VALUE 0x1E7692 Kw_Wu16 655350.0 Time_ms 0.00 655350.0 FORMAT "%8.1" /end CHARACTERISTIC
/begin CHARACTERISTIC RailCD_DebSRCLowOk_C "Kraftstoffdruck Heilungsentprellzeit SRC-Low" VALUE 0x1E7694 Kw_Wu16 655350.0 Time_ms 0.00 655350.0 FORMAT "%8.1" /end CHARACTERISTIC
/begin CHARACTERISTIC RailCD_swtOfsTst_C "Schalter für Freigabe des Offset-Tests für den Raildrucksensor im Start oder Nachlauf" VALUE 0x1E7696 Kw_Wu8 3.000 OneToOne 0.00 3.000 FORMAT "%5.3" EXTENDED_LIMITS 0.00 255.0 /end CHARACTERISTIC
/begin CHARACTERISTIC RailCD_tiEvalDel_C "Verzögerungszeit zur Auswertung des Überwachungsergebnisses beim Offset-Tests für den Raildrucksensor" VALUE 0x1E7698 Kw_Wu16 655350.0 Time_ms 0.00 655350.0 FORMAT "%8.1" /end CHARACTERISTIC
/begin CHARACTERISTIC RailCD_tiOfsTstAftRun_C "Überwachungszeitraum des Offset-Tests für den Raildrucksensor im Nachlauf" VALUE 0x1E769A Kw_Wu16 655350.0 Time_ms 0.00 655350.0 FORMAT "%8.1" /end CHARACTERISTIC
/begin CHARACTERISTIC RailCD_tiOfsTstDel_CUR "Verzögerungszeit für Offset-Ueberwachung des Raildrucksensors" CURVE 0x1E769C Kl_Xs16_Ws16 5242.720 TimeRed 0.00 5242.720 FORMAT "%8.3" EXTENDED_LIMITS -5242.880 5242.720
 /begin AXIS_DESCR STD_AXIS RailCD_pPeak Pres_Rail 6 0.00 1800000. FORMAT "%8.0" EXTENDED_LIMITS -3276800. 3276700. DEPOSIT ABSOLUTE /end AXIS_DESCR
/end CHARACTERISTIC
/begin CHARACTERISTIC RailCD_tiOfsTstStrt_C "Überwachungszeitraum des Offset-Tests für den Raildrucksensor im Start" VALUE 0x1E76B6 Kw_Wu16 655350.0 Time_ms 0.00 655350.0 FORMAT "%8.1" /end CHARACTERISTIC
/begin CHARACTERISTIC RailCD_tiStrErrDel_C "Timeout zur Speicherung des Überwachungsergebnisses beim Offset-Tests für den Raildrucksensor" VALUE 0x1E76B8 Kw_Wu16 655350.0 Time_ms 0.00 655350.0 FORMAT "%8.1" /end CHARACTERISTIC
/begin CHARACTERISTIC RailCD_tOfsTstAftRun_C "Systemtemperaturschwelle zur Freigabe der Offset-Überwachung des Raildrucksensors im Nachlauf" VALUE 0x1E76BA Kw_Ws16 200.0000 Temp_Cels -50.14000 149.8600 FORMAT "%8.4" EXTENDED_LIMITS -3549.940 3003.560 /end CHARACTERISTIC
/begin CHARACTERISTIC RailCD_tOfsTstDec_C "Wassertemperaturdifferenz 'Abkühlung' zur Freigabe der Offset-Überwachung des Raildrucksensors im Start" VALUE 0x1E76BC Kw_Ws16 100.0000 TempDiff_Kelv 0.00 100.0000 FORMAT "%8.4" EXTENDED_LIMITS -3276.800 3276.700 /end CHARACTERISTIC
/begin CHARACTERISTIC RailCD_tOfsTstInc_C "Wassertemperaturdifferenz 'Erwärmung' zur Freigabe der Offset-Überwachung des Raildrucksensors im Start" VALUE 0x1E76BE Kw_Ws16 100.0000 TempDiff_Kelv -100.0000 0.00 FORMAT "%8.4" EXTENDED_LIMITS -3276.800 3276.700 /end CHARACTERISTIC
/begin CHARACTERISTIC RailCD_tOfsTstStrt_C "Systemtemperaturschwelle zur Freigabe der Offset-Überwachung des Raildrucksensors im Start" VALUE 0x1E76C0 Kw_Ws16 200.0000 Temp_Cels -50.14000 149.8600 FORMAT "%8.4" EXTENDED_LIMITS -3549.940 3003.560 /end CHARACTERISTIC
/begin CHARACTERISTIC RailCD_uOfsAftRunMax_C "obere Offsetschwelle der Offset-Überwachung des Raildrucksensors im Nachlauf" VALUE 0x1E76C2 Kw_Ws16 5200.391 Volt 0.00 5200.391 FORMAT "%8.3" EXTENDED_LIMITS -160156.4 160151.5 /end CHARACTERISTIC
/begin CHARACTERISTIC RailCD_uOfsAftRunMin_C "untere Offsetschwelle der Offset-Überwachung des Raildrucksensors im Nachlauf" VALUE 0x1E76C4 Kw_Ws16 5200.391 Volt 0.00 5200.391 FORMAT "%8.3" EXTENDED_LIMITS -160156.4 160151.5 /end CHARACTERISTIC
/begin CHARACTERISTIC RailCD_uOfsStrtMax_C "obere Offsetschwelle der Offset-Überwachung des Raildrucksensors im Start" VALUE 0x1E76C6 Kw_Ws16 5200.391 Volt 0.00 5200.391 FORMAT "%8.3" EXTENDED_LIMITS -160156.4 160151.5 /end CHARACTERISTIC
/begin CHARACTERISTIC RailCD_uOfsStrtMin_C "untere Offsetschwelle der Offset-Überwachung des Raildrucksensors im Start" VALUE 0x1E76C8 Kw_Ws16 5200.391 Volt 0.00 5200.391 FORMAT "%8.3" EXTENDED_LIMITS -160156.4 160151.5 /end CHARACTERISTIC
/begin CHARACTERISTIC Rail_dvolMeUnCtlInitI_CUR "Kennlinie zur Initialisierung des I-Anteils als Funktion der Systemtemperatur" CURVE 0x1E5630 Kl_Xs16_Ws16 150000.0 Qp_mm3_sec 0.00 150000.0 FORMAT "%8.1" EXTENDED_LIMITS -327680.0 327670.0
 /begin AXIS_DESCR STD_AXIS FlSys_t Temp_Cels 6 -50.14000 149.8600 FORMAT "%8.4" EXTENDED_LIMITS -3549.940 3003.560 DEPOSIT ABSOLUTE /end AXIS_DESCR
/end CHARACTERISTIC
/begin CHARACTERISTIC Rail_dvolMeUnCtlLoLim_C "untere Stellwertbegrenzung" VALUE 0x1E5166 Kw_Ws16 655350.0 Qp_mm3_sec -327680.0 327670.0 FORMAT "%8.1" /end CHARACTERISTIC
/begin CHARACTERISTIC Rail_dvolMeUnCtlUpLim_CUR "obere Stellwertbegrenzung" CURVE 0x1E5168 Kl_Xs16_Ws16 655350.0 Qp_mm3_sec -327680.0 327670.0 FORMAT "%8.1"
 /begin AXIS_DESCR STD_AXIS Eng_nAvrg EngN 16 0.00 6000.000 FORMAT "%8.3" EXTENDED_LIMITS -32768.00 32767.00 DEPOSIT ABSOLUTE /end AXIS_DESCR
/end CHARACTERISTIC
/begin CHARACTERISTIC Rail_dvolMeUnSet_Vector "Bypass-Label für Rail_dvolMeUnSet (Nicht verstellen!)" VALUE 0x1C0B3E Kw_Wu8 255.0 OneToOne 0.00 255.0 FORMAT "%5.1" /end CHARACTERISTIC
/begin CHARACTERISTIC Rail_dvolMeUnSet_Channel "Bypass-Label für Rail_dvolMeUnSet, nicht editieren!" VALUE 0x1C0B3F Kw_Wu8 255.0 OneToOne 0.00 255.0 FORMAT "%5.1" /end CHARACTERISTIC
/begin CHARACTERISTIC Rail_dvolOff_C "Volumenstrom beim Abstellen des Systems (Nullförderung)" VALUE 0x1E512E Kw_Ws16 655350.0 Qp_mm3_sec -327680.0 327670.0 FORMAT "%8.1" /end CHARACTERISTIC
/begin CHARACTERISTIC Rail_dvolStrt_C "Volumenstrom während der Startphase (2-Stellerkonzept)" VALUE 0x1E5130 Kw_Ws16 655350.0 Qp_mm3_sec -327680.0 327670.0 FORMAT "%8.1" /end CHARACTERISTIC
/begin CHARACTERISTIC Rail_facOvrMeUnNegIncr_C "Multiplikativer Faktor zur Erhöhung der I-Verstärkung für negative Großsignale bei Überdruck (Druckregelung über MeUn)" VALUE 0x1E51B2 Kw_Ws16 255.9922 Fact1 0.00 255.9922 FORMAT "%8.4" EXTENDED_LIMITS -256.0000 255.9922 /end CHARACTERISTIC
/begin CHARACTERISTIC Rail_facOvrPCVNegIncr_C "Multiplikativer Faktor zur Erhöhung der I-Verstärkung für negative Großsignale bei Überdruck (Druckregelung über PCV)" VALUE 0x1E5412 Kw_Ws16 255.9922 Fact1 0.00 255.9922 FORMAT "%8.4" EXTENDED_LIMITS -256.0000 255.9922 /end CHARACTERISTIC
/begin CHARACTERISTIC Rail_MeUnCtlDKd_CUR "D-Verstärkung der Druckregelung über Zumesseinheit" CURVE 0x1E51B4 Kl_Xs16_Ws16 0.5000000 Kd_pRail2Q_1 0.00 0.5000000 FORMAT "%9.7" EXTENDED_LIMITS -0.8000000 0.7999756
 /begin AXIS_DESCR STD_AXIS Eng_nAvrg EngN 16 0.00 6000.000 FORMAT "%8.3" EXTENDED_LIMITS -32768.00 32767.00 DEPOSIT ABSOLUTE /end AXIS_DESCR
/end CHARACTERISTIC
/begin CHARACTERISTIC Rail_MeUnCtlIKiNeg_CUR "I-Verstärkung für negative Großsignale für die Druckregelung über Zumesseinheit" CURVE 0x1E51F6 Kl_Xs16_Ws16 2.000015 Ki_pRail2Q_1 0.00 2.000015 FORMAT "%8.6" EXTENDED_LIMITS -3.051758 3.051665
 /begin AXIS_DESCR STD_AXIS Eng_nAvrg EngN 16 0.00 6000.000 FORMAT "%8.3" EXTENDED_LIMITS -32768.00 32767.00 DEPOSIT ABSOLUTE /end AXIS_DESCR
/end CHARACTERISTIC
/begin CHARACTERISTIC Rail_MeUnCtlIKiPos_CUR "I-Verstärkung für positive Großsignale für die Druckregelung über Zumesseinheit" CURVE 0x1E5238 Kl_Xs16_Ws16 2.000015 Ki_pRail2Q_1 0.00 2.000015 FORMAT "%8.6" EXTENDED_LIMITS -3.051758 3.051665
 /begin AXIS_DESCR STD_AXIS Eng_nAvrg EngN 16 0.00 6000.000 FORMAT "%8.3" EXTENDED_LIMITS -32768.00 32767.00 DEPOSIT ABSOLUTE /end AXIS_DESCR
/end CHARACTERISTIC
/begin CHARACTERISTIC Rail_MeUnCtlIKi_CUR "I-Verstärkung für Kleinsignale für die Druckregelung über Zumesseinheit" CURVE 0x1E527A Kl_Xs16_Ws16 2.000015 Ki_pRail2Q_1 0.00 2.000015 FORMAT "%8.6" EXTENDED_LIMITS -3.051758 3.051665
 /begin AXIS_DESCR STD_AXIS Eng_nAvrg EngN 16 0.00 6000.000 FORMAT "%8.3" EXTENDED_LIMITS -32768.00 32767.00 DEPOSIT ABSOLUTE /end AXIS_DESCR
/end CHARACTERISTIC
/begin CHARACTERISTIC Rail_MeUnCtlPKpNeg_CUR "P-Verstärkung für negative Großsignale für die Druckregelung über Zumesseinheit" CURVE 0x1E52BC Kl_Xs16_Ws16 0.2000000 Kp_pRail2Q_1 0.00 0.2000000 FORMAT "%9.7" EXTENDED_LIMITS -0.4000000 0.3999878
 /begin AXIS_DESCR STD_AXIS Eng_nAvrg EngN 16 0.00 6000.000 FORMAT "%8.3" EXTENDED_LIMITS -32768.00 32767.00 DEPOSIT ABSOLUTE /end AXIS_DESCR
/end CHARACTERISTIC
/begin CHARACTERISTIC Rail_MeUnCtlPKpPos_CUR "P-Verstärkung für positive Großsignale für die Druckregelung über Zumesseinheit" CURVE 0x1E52FE Kl_Xs16_Ws16 0.2000000 Kp_pRail2Q_1 0.00 0.2000000 FORMAT "%9.7" EXTENDED_LIMITS -0.4000000 0.3999878
 /begin AXIS_DESCR STD_AXIS Eng_nAvrg EngN 16 0.00 6000.000 FORMAT "%8.3" EXTENDED_LIMITS -32768.00 32767.00 DEPOSIT ABSOLUTE /end AXIS_DESCR
/end CHARACTERISTIC
/begin CHARACTERISTIC Rail_MeUnCtlPKp_CUR "P-Verstärkung für Kleinsignale für die Druckregelung über Zumesseinheit" CURVE 0x1E5340 Kl_Xs16_Ws16 0.2000000 Kp_pRail2Q_1 0.00 0.2000000 FORMAT "%9.7" EXTENDED_LIMITS -0.4000000 0.3999878
 /begin AXIS_DESCR STD_AXIS Eng_nAvrg EngN 16 0.00 6000.000 FORMAT "%8.3" EXTENDED_LIMITS -32768.00 32767.00 DEPOSIT ABSOLUTE /end AXIS_DESCR
/end CHARACTERISTIC
/begin CHARACTERISTIC Rail_nCloseCtl_C "Drehzahlschwelle für Wechsel zwischen gesteuertem und geregeltem Betrieb" VALUE 0x1E5122 Kw_Ws16 65535.00 EngN -32768.00 32767.00 FORMAT "%8.2" /end CHARACTERISTIC
/begin CHARACTERISTIC Rail_nMeUnFrzI_C "Drehzahlschwelle zum Einfrieren des I-Anteils für den Druckregler über Zumesseinheit" VALUE 0x1E564A Kw_Ws16 65535.00 EngN -32768.00 32767.00 FORMAT "%8.2" /end CHARACTERISTIC
/begin CHARACTERISTIC Rail_nThresStrt_C "Drehzahlschwelle zum Verlassen des Startzustandes der Zustandssteuerung" VALUE 0x1E5124 Kw_Ws16 65535.00 EngN -32768.00 32767.00 FORMAT "%8.2" /end CHARACTERISTIC
/begin CHARACTERISTIC Rail_numRevDel_C "Anzahl von Motorumdrehungen um von Steuern auf Regeln umzuschalten" VALUE 0x1E5132 Kw_Wu16 65535.00 OneToOne 0.00 65535.00 FORMAT "%8.2" /end CHARACTERISTIC
/begin CHARACTERISTIC Rail_numRevPlaus_C "Anzahl der Nockenwellenumdrehungen um von Vorregelung auf Regelung umzuschalten." VALUE 0x1E5126 Kw_Wu16 65535.00 OneToOne 0.00 65535.00 FORMAT "%8.2" /end CHARACTERISTIC
/begin CHARACTERISTIC Rail_pCloseCtl_C "Absolutdruckschwelle zum Umschaltung in den Regelbetrieb" VALUE 0x1E5128 Kw_Ws16 6553500. Pres_Rail -3276800. 3276700. FORMAT "%8.0" /end CHARACTERISTIC
/begin CHARACTERISTIC Rail_PCVCtlDKd_CUR "D-Verstärkung der Druckregelung über Druckregelventil" CURVE 0x1E5414 Kl_Xs16_Ws16 50.00000 Kd_1 0.00 50.00000 FORMAT "%8.5" EXTENDED_LIMITS -64.00000 63.99805
 /begin AXIS_DESCR STD_AXIS Eng_nAvrg EngN 16 0.00 6000.000 FORMAT "%8.3" EXTENDED_LIMITS -32768.00 32767.00 DEPOSIT ABSOLUTE /end AXIS_DESCR
/end CHARACTERISTIC
/begin CHARACTERISTIC Rail_PCVCtlIKiNeg_CUR "I-Verstärkung für negative Großsignale für die Druckregelung über Druckregelventil" CURVE 0x1E5456 Kl_Xs16_Ws16 249.9968 Ki_1 0.00 249.9968 FORMAT "%8.4" EXTENDED_LIMITS -488.2812 488.2663
 /begin AXIS_DESCR STD_AXIS Eng_nAvrg EngN 16 0.00 6000.000 FORMAT "%8.3" EXTENDED_LIMITS -32768.00 32767.00 DEPOSIT ABSOLUTE /end AXIS_DESCR
/end CHARACTERISTIC
/begin CHARACTERISTIC Rail_PCVCtlIKiPos_CUR "I-Verstärkung für positive Großsignale für die Druckregelung über Druckregelventil" CURVE 0x1E5498 Kl_Xs16_Ws16 249.9968 Ki_1 0.00 249.9968 FORMAT "%8.4" EXTENDED_LIMITS -488.2812 488.2663
 /begin AXIS_DESCR STD_AXIS Eng_nAvrg EngN 16 0.00 6000.000 FORMAT "%8.3" EXTENDED_LIMITS -32768.00 32767.00 DEPOSIT ABSOLUTE /end AXIS_DESCR
/end CHARACTERISTIC
/begin CHARACTERISTIC Rail_PCVCtlIKi_CUR "I-Verstärkung für Kleinsignale für die Druckregelung über Druckregelventil" CURVE 0x1E54DA Kl_Xs16_Ws16 249.9968 Ki_1 0.00 249.9968 FORMAT "%8.4" EXTENDED_LIMITS -488.2812 488.2663
 /begin AXIS_DESCR STD_AXIS Eng_nAvrg EngN 16 0.00 6000.000 FORMAT "%8.3" EXTENDED_LIMITS -32768.00 32767.00 DEPOSIT ABSOLUTE /end AXIS_DESCR
/end CHARACTERISTIC
/begin CHARACTERISTIC Rail_PCVCtlPKpNeg_CUR "P-Verstärkung für negative Großsignale für die Druckregelung über Druckregelventil" CURVE 0x1E551C Kl_Xs16_Ws16 300.0000 Kp_1 0.00 300.0000 FORMAT "%8.4" EXTENDED_LIMITS -512.0000 511.9844
 /begin AXIS_DESCR STD_AXIS Eng_nAvrg EngN 16 0.00 6000.000 FORMAT "%8.3" EXTENDED_LIMITS -32768.00 32767.00 DEPOSIT ABSOLUTE /end AXIS_DESCR
/end CHARACTERISTIC
/begin CHARACTERISTIC Rail_PCVCtlPKpPos_CUR "P-Verstärkung für positive Großsignale für die Druckregelung über Druckregelventil" CURVE 0x1E555E Kl_Xs16_Ws16 300.0000 Kp_1 0.00 300.0000 FORMAT "%8.4" EXTENDED_LIMITS -512.0000 511.9844
 /begin AXIS_DESCR STD_AXIS Eng_nAvrg EngN 16 0.00 6000.000 FORMAT "%8.3" EXTENDED_LIMITS -32768.00 32767.00 DEPOSIT ABSOLUTE /end AXIS_DESCR
/end CHARACTERISTIC
/begin CHARACTERISTIC Rail_PCVCtlPKp_CUR "P-Verstärkung für Kleinsignale für die Druckregelung über Druckregelventil" CURVE 0x1E55A0 Kl_Xs16_Ws16 300.0000 Kp_1 0.00 300.0000 FORMAT "%8.4" EXTENDED_LIMITS -512.0000 511.9844
 /begin AXIS_DESCR STD_AXIS Eng_nAvrg EngN 16 0.00 6000.000 FORMAT "%8.3" EXTENDED_LIMITS -32768.00 32767.00 DEPOSIT ABSOLUTE /end AXIS_DESCR
/end CHARACTERISTIC
/begin CHARACTERISTIC Rail_pDiffCloseCtl_C "Differenzdruckschwelle zum Umschalten in den Regelbetrieb" VALUE 0x1E512A Kw_Ws16 6553500. Pres_Rail -3276800. 3276700. FORMAT "%8.0" /end CHARACTERISTIC
/begin CHARACTERISTIC Rail_pDvtFltMin_C "minimale absolute Regelabweichung als eingangssignal des DT1-Gliedes" VALUE 0x1E564C Kw_Ws16 6553500. Pres_Rail -3276800. 3276700. FORMAT "%8.0" /end CHARACTERISTIC
/begin CHARACTERISTIC Rail_pMeUnCtlIWinNeg_C "untere Kleinsignalgrenze für den I-Anteil des Druckreglers über Zumesseinheit" VALUE 0x1E5382 Kw_Ws16 6553500. Pres_Rail -3276800. 3276700. FORMAT "%8.0" /end CHARACTERISTIC
/begin CHARACTERISTIC Rail_pMeUnCtlIWinPos_C "obere Kleinsignalgrenze für den I-Anteil des Druckreglers über Zumesseinheit" VALUE 0x1E5384 Kw_Ws16 6553500. Pres_Rail -3276800. 3276700. FORMAT "%8.0" /end CHARACTERISTIC
/begin CHARACTERISTIC Rail_pMeUnCtlPWinNeg_C "untere Kleinsignalgrenze für den P-Anteil des Druckreglers über Zumesseinheit" VALUE 0x1E5386 Kw_Ws16 6553500. Pres_Rail -3276800. 3276700. FORMAT "%8.0" /end CHARACTERISTIC
/begin CHARACTERISTIC Rail_pMeUnCtlPWinPos_C "obere Kleinsignalgrenze für den P-Anteil des Druckreglers über Zumesseinheit" VALUE 0x1E5388 Kw_Ws16 6553500. Pres_Rail -3276800. 3276700. FORMAT "%8.0" /end CHARACTERISTIC
/begin CHARACTERISTIC Rail_pOpnCtl_C "Absolutdruckschwelle zum Umschaltung in den Steuerbetrieb" VALUE 0x1E512C Kw_Ws16 6553500. Pres_Rail -3276800. 3276700. FORMAT "%8.0" /end CHARACTERISTIC
/begin CHARACTERISTIC Rail_pOvrMeUnThresHigh_C "Obere Hystereseschwelle für Überdruckerkennung MeUn" VALUE 0x1E538A Kw_Ws16 1800000. Pres_Rail 0.00 1800000. FORMAT "%8.0" EXTENDED_LIMITS -3276800. 3276700. /end CHARACTERISTIC
/begin CHARACTERISTIC Rail_pOvrMeUnThresLow_C "Untere Hystereseschwelle für Überdruckerkennung MeUn" VALUE 0x1E538C Kw_Ws16 1800000. Pres_Rail 0.00 1800000. FORMAT "%8.0" EXTENDED_LIMITS -3276800. 3276700. /end CHARACTERISTIC
/begin CHARACTERISTIC Rail_pOvrPCVThresHigh_C "Obere Hystereseschwelle für Überdruckerkennung PCV" VALUE 0x1E55E2 Kw_Ws16 1800000. Pres_Rail 0.00 1800000. FORMAT "%8.0" EXTENDED_LIMITS -3276800. 3276700. /end CHARACTERISTIC
/begin CHARACTERISTIC Rail_pOvrPCVThresLow_C "Untere Hystereseschwelle für Überdruckerkennung PCV" VALUE 0x1E55E4 Kw_Ws16 1800000. Pres_Rail 0.00 1800000. FORMAT "%8.0" EXTENDED_LIMITS -3276800. 3276700. /end CHARACTERISTIC
/begin CHARACTERISTIC Rail_pPCVCtlIWinNeg_C "untere Kleinsignalgrenze für den I-Anteil des Druckreglers über Druckregelventil" VALUE 0x1E55E6 Kw_Ws16 6553500. Pres_Rail -3276800. 3276700. FORMAT "%8.0" /end CHARACTERISTIC
/begin CHARACTERISTIC Rail_pPCVCtlIWinPos_C "obere Kleinsignalgrenze für den I-Anteil des Druckreglers über Druckregelventil" VALUE 0x1E55E8 Kw_Ws16 6553500. Pres_Rail -3276800. 3276700. FORMAT "%8.0" /end CHARACTERISTIC
/begin CHARACTERISTIC Rail_pPCVCtlLoLimStrt_C "untere Stellwertbegrenzung des Raildruckreglers über Druckregelventil während der Startphase" VALUE 0x1E51AA Kw_Ws16 6553500. Pres_Rail -3276800. 3276700. FORMAT "%8.0" /end CHARACTERISTIC
/begin CHARACTERISTIC Rail_pPCVCtlLoLim_C "untere Stellwertbegrenzung des Raildruckreglers über Druckregelventil" VALUE 0x1E51AC Kw_Ws16 6553500. Pres_Rail -3276800. 3276700. FORMAT "%8.0" /end CHARACTERISTIC
/begin CHARACTERISTIC Rail_pPCVCtlPWinNeg_C "untere Kleinsignalgrenze für den P-Anteil des Druckreglers über Druckregelventil" VALUE 0x1E55EA Kw_Ws16 6553500. Pres_Rail -3276800. 3276700. FORMAT "%8.0" /end CHARACTERISTIC
/begin CHARACTERISTIC Rail_pPCVCtlPWinPos_C "obere Kleinsignalgrenze für den P-Anteil des Druckreglers über Druckregelventil" VALUE 0x1E55EC Kw_Ws16 6553500. Pres_Rail -3276800. 3276700. FORMAT "%8.0" /end CHARACTERISTIC
/begin CHARACTERISTIC Rail_pPCVCtlUpLimStrt_C "obere Stellwertbegrenzung des Raildruckreglers über Druckregelventil während der Startphase" VALUE 0x1E51AE Kw_Ws16 6553500. Pres_Rail -3276800. 3276700. FORMAT "%8.0" /end CHARACTERISTIC
/begin CHARACTERISTIC Rail_pPCVCtlUpLim_C "obere Stellwertbegrenzung des Raildruckreglers über Druckregelventil" VALUE 0x1E51B0 Kw_Ws16 6553500. Pres_Rail -3276800. 3276700. FORMAT "%8.0" /end CHARACTERISTIC
/begin CHARACTERISTIC Rail_pPCVInitI_MAP "Kennfeld für Initialisierungswert I-Anteil des PCV-Druckreglers, beim Umschalten von Zumesseinheit auf Druckregelventil" MAP 0x1E5650 Kf_Xs16_Ys16_Ws16 1800000. Pres_Rail 0.00 1800000. FORMAT "%8.0" EXTENDED_LIMITS -3276800. 3276700.
 /begin AXIS_DESCR STD_AXIS Eng_nAvrg EngN 16 0.00 6000.000 FORMAT "%8.3" EXTENDED_LIMITS -32768.00 32767.00 DEPOSIT ABSOLUTE /end AXIS_DESCR
 /begin AXIS_DESCR STD_AXIS Rail_pSetPoint Pres_Rail 16 0.00 1800000. FORMAT "%8.0" EXTENDED_LIMITS -3276800. 3276700. DEPOSIT ABSOLUTE /end AXIS_DESCR
/end CHARACTERISTIC
/begin CHARACTERISTIC Rail_pPCVSet_Vector "Bypass-Label für Rail_pPCVSet (Nicht verstellen!)" VALUE 0x1C0B40 Kw_Wu8 255.0 OneToOne 0.00 255.0 FORMAT "%5.1" /end CHARACTERISTIC
/begin CHARACTERISTIC Rail_pPCVSet_Channel "Bypass-Label, nicht editieren !" VALUE 0x1C0B41 Kw_Wu8 255.0 OneToOne 0.00 255.0 FORMAT "%5.1" /end CHARACTERISTIC
/begin CHARACTERISTIC Rail_pSetMin_C "minimaler Druck als Stellwertvorgabe" VALUE 0x1E5134 Kw_Ws16 6553500. Pres_Rail -3276800. 3276700. FORMAT "%8.0" /end CHARACTERISTIC
/begin CHARACTERISTIC Rail_stCtlLoopSel_C "Schalterauswahl fuer die Raildruckregelung" VALUE 0x1E5136 Kw_Wu8 255.0 OneToOne 0.00 255.0 FORMAT "%5.1" /end CHARACTERISTIC
/begin CHARACTERISTIC Rail_swtPCVInitI_C "Auswahl, PCV-Reglerinitialisierung mit Vorsteuerwert oder mit Sollwert" VALUE 0x1E5894 Kw_Wu8 255.0 OneToOne 0.00 255.0 FORMAT "%5.1" /end CHARACTERISTIC
/begin CHARACTERISTIC Rail_tiDeflate_C "Maximale Zeit für die Entlüftung des Niederdruckkreises" VALUE 0x1E5138 Kw_Wu16 655350.0 Time_ms 0.00 655350.0 FORMAT "%8.1" /end CHARACTERISTIC
/begin CHARACTERISTIC Rail_tiFrzIDel_C "Verzögerungszeit zum Einfrieren des I-Anteils für den Druckregler über Zumesseinheit" VALUE 0x1E564E Kw_Wu16 1000.000 Time_ms 0.00 1000.000 FORMAT "%8.3" EXTENDED_LIMITS 0.00 655350.0 /end CHARACTERISTIC
/begin CHARACTERISTIC Rail_tiMeUnCtlDT1_CUR "Zeitkonstante des DT1-Gliedes (Druckregelung über Zumesseinheit)" CURVE 0x1E538E Kl_Xs16_Ws16 16.776216 TimeDelay_s_2 0.0010000129 16.777216 FORMAT "%9.6" EXTENDED_LIMITS 0.00051201563 16.777216
 /begin AXIS_DESCR STD_AXIS Eng_nAvrg EngN 16 0.00 6000.000 FORMAT "%8.3" EXTENDED_LIMITS -32768.00 32767.00 DEPOSIT ABSOLUTE /end AXIS_DESCR
/end CHARACTERISTIC
/begin CHARACTERISTIC Rail_tiMeUnCtlPT1_CUR "Zeitkonstante des PT1-Filters (Druckregelung über Zumesseinheit)" CURVE 0x1E53D0 Kl_Xs16_Ws16 16.776216 TimeDelay_s_2 0.0010000129 16.777216 FORMAT "%9.6" EXTENDED_LIMITS 0.00051201563 16.777216
 /begin AXIS_DESCR STD_AXIS Eng_nAvrg EngN 16 0.00 6000.000 FORMAT "%8.3" EXTENDED_LIMITS -32768.00 32767.00 DEPOSIT ABSOLUTE /end AXIS_DESCR
/end CHARACTERISTIC
/begin CHARACTERISTIC Rail_tiMeUnRmpDur_CUR "Laufzeit der Rampe um das Fördervolumen der Zumesseinheit vom aktuellen Sollwert auf die Maximalförderung zu rampen" CURVE 0x1E513A Kl_Xs16_Ws16 655350.0 Time_ms -327680.0 327670.0 FORMAT "%8.1"
 /begin AXIS_DESCR STD_AXIS Eng_nAvrg EngN 10 0.00 6000.000 FORMAT "%8.3" EXTENDED_LIMITS -32768.00 32767.00 DEPOSIT ABSOLUTE /end AXIS_DESCR
/end CHARACTERISTIC
/begin CHARACTERISTIC Rail_tiPCVCtlDT1_CUR "Zeitkonstante des DT1-Gliedes für die Druckregelung über Druckregelventil" CURVE 0x1E55EE Kl_Xs16_Ws16 16.776216 TimeDelay_s_2 0.0010000129 16.777216 FORMAT "%9.6" EXTENDED_LIMITS 0.00051201563 16.777216
 /begin AXIS_DESCR STD_AXIS Eng_nAvrg EngN 16 0.00 6000.000 FORMAT "%8.3" EXTENDED_LIMITS -32768.00 32767.00 DEPOSIT ABSOLUTE /end AXIS_DESCR
/end CHARACTERISTIC
/begin CHARACTERISTIC Rail_tiSwtToMeUnCtl_C "Verzögerungszeit bis zum Umschalten auf Druckregelung über Zumesseinheit" VALUE 0x1E5164 Kw_Wu16 655350.0 Time_ms 0.00 655350.0 FORMAT "%8.1" /end CHARACTERISTIC
/begin MEASUREMENT PFltCD_pPre "Abgastemp. vor Partikelfilter [kPa]" SWORD Pres_hPa 1 100 -32768.00 32767.00 FORMAT "%8.2" ECU_ADDRESS 0x7F9AE0 /end MEASUREMENT
/begin MEASUREMENT PFlt_ddvolFlt_mp "Änderung Abgasvolumenstrom" SWORD CubMtrPerHrPerSec 1 100 -3276.800 3276.700 FORMAT "%8.3" ECU_ADDRESS 0x803688 /end MEASUREMENT
/begin MEASUREMENT PFlt_dmEG "Abgasmassenstrom [kg/h]" SWORD AirMassPerTime 1 100 -3276.800 3276.700 FORMAT "%8.3" ECU_ADDRESS 0x7F9AEC /end MEASUREMENT
/begin MEASUREMENT PFlt_dpDiffFlt_mp "Änderung Druckdifferenz" SWORD hPaPerSec 1 100 -3276.800 3276.700 FORMAT "%8.3" ECU_ADDRESS 0x80368A /end MEASUREMENT
/begin MEASUREMENT PFlt_dpDiffNegDef_mp "Untere Schwelle Änderung Differenzdrucksignal" SWORD hPaPerSec 1 100 -3276.800 3276.700 FORMAT "%8.3" ECU_ADDRESS 0x80368C /end MEASUREMENT
/begin MEASUREMENT PFlt_dpDiffPosDef_mp "Obere Schwelle Änderung Differenzdrucksignal" SWORD hPaPerSec 1 100 -3276.800 3276.700 FORMAT "%8.3" ECU_ADDRESS 0x80368E /end MEASUREMENT
/begin MEASUREMENT PFlt_dvol "berechneter Abgasvolumenstrom im Partikelfilter" SWORD CubMtrPerHr 1 100 -3276.800 3276.700 FORMAT "%8.3" ECU_ADDRESS 0x7F9AEE /end MEASUREMENT
/begin MEASUREMENT PFlt_dvolFlt_mp "gefilterter Abgasvolumenstrom" SWORD CubMtrPerHr 1 100 -3276.800 3276.700 FORMAT "%8.3" ECU_ADDRESS 0x803690 /end MEASUREMENT
/begin MEASUREMENT PFlt_facAshMs2Ld_mp "korrekturfaktor für nichtlinear Aschenverteilung[ ]" SWORD Fact 1 100 -4.000000 3.999878 FORMAT "%8.6" ECU_ADDRESS 0x80362C /end MEASUREMENT
/begin MEASUREMENT PFlt_facSotSimTemp_mp "Faktor zur Auswahl des Wertes für Akkumulation im Beladungszähler" SWORD Fact 1 100 -4.000000 3.999878 FORMAT "%8.6" ECU_ADDRESS 0x80362E /end MEASUREMENT
/begin MEASUREMENT PFlt_lSnceRgn_mp "gefahrene Strecke seit letzter erfolgreicher Regeneration" ULONG Length 1 100 0.00 4294967295.00 FORMAT "%13.2" ECU_ADDRESS 0x8035D0 /end MEASUREMENT
/begin MEASUREMENT PFlt_lSum_mp "ges. gefahrene Strecke bei der letzten erfolgr. Regeneration" ULONG Length 1 100 0.00 4294967295.00 FORMAT "%13.2" ECU_ADDRESS 0x8035D4 /end MEASUREMENT
/begin MEASUREMENT PFlt_mAshAdd_mp "Aschebeladung aus aktuellem Fahrzyklus durch Additiv [g]" ULONG mAsh_g 1 100 0.00 655.359999847 FORMAT "%13.9" ECU_ADDRESS 0x803630 /end MEASUREMENT
/begin MEASUREMENT PFlt_mAshAdj_mp "Aschebeladung nach Regeneration für Kundendiensttester" ULONG mAsh_g 1 100 0.00 655.359999847 FORMAT "%13.9" ECU_ADDRESS 0x803634 /end MEASUREMENT
/begin MEASUREMENT PFlt_mAshFl_mp "Aschebeladung aus aktuellem Fahrzyklus durch Treibstoff [g]" ULONG mAsh_g 1 100 0.00 655.359999847 FORMAT "%13.9" ECU_ADDRESS 0x803638 /end MEASUREMENT
/begin MEASUREMENT PFlt_mAshTrmTot_mp "Aschebeladung [g]" SWORD mAsh 1 100 -3276.800 3276.700 FORMAT "%8.3" ECU_ADDRESS 0x80363C /end MEASUREMENT
/begin MEASUREMENT PFlt_mAshTrm_mp "Aschebeladung Merkwert im EEPROM [g]" ULONG mAsh_g 1 100 0.00 655.359999847 FORMAT "%13.9" ECU_ADDRESS 0x803640 /end MEASUREMENT
/begin MEASUREMENT PFlt_monRgnAct_mp "Applikative Regeneration aktiv" UBYTE OneToOne 1 100 0.00 255.0 FORMAT "%5.1" ECU_ADDRESS 0x8035D8 /end MEASUREMENT
/begin MEASUREMENT PFlt_numEngPOp_mp "Regeneationsmaßnahme nach Berücksichtigung des Motorbetriebspunktes" UBYTE OneToOne 1 100 0.00 255.0 FORMAT "%5.1" ECU_ADDRESS 0x8035D9 /end MEASUREMENT
/begin MEASUREMENT PFlt_numFltEmpEu_mp "Eulerzahl für leeres Filter [-]" SWORD EulerNum 1 100 -3276.800 3276.700 FORMAT "%8.3" ECU_ADDRESS 0x803644 /end MEASUREMENT
/begin MEASUREMENT PFlt_numFltEmpRe_mp "Reynoldszahl für leeres Filter [-]" SWORD ReynoldsNum 1 100 -3276800. 3276700. FORMAT "%8.0" ECU_ADDRESS 0x803646 /end MEASUREMENT
/begin MEASUREMENT PFlt_numFltFulEu_mp "Eulerzahl für volles Filter" SWORD EulerNum 1 100 -3276.800 3276.700 FORMAT "%8.3" ECU_ADDRESS 0x803648 /end MEASUREMENT
/begin MEASUREMENT PFlt_numFltFulRe_mp "Reynoldszahl für volles Filter [-]" SWORD ReynoldsNum 1 100 -3276800. 3276700. FORMAT "%8.0" ECU_ADDRESS 0x80364A /end MEASUREMENT
/begin MEASUREMENT PFlt_numLst_mp "Regenerationsanforderung aufgrund verbr. Treibstoff, Betriebszeit oder Strecke" UBYTE OneToOne 1 100 0.00 255.0 FORMAT "%5.1" ECU_ADDRESS 0x8035DA /end MEASUREMENT
/begin MEASUREMENT PFlt_numPrio "Priorität für angeforderten Regenerationszustand" UWORD OneToOne 1 100 0.00 65535.00 FORMAT "%8.2" ECU_ADDRESS 0x7F9AF0 /end MEASUREMENT
/begin MEASUREMENT PFlt_numPrt_mp "Regenerationsanforderung aufgrund Motorschutz" UBYTE OneToOne 1 100 0.00 255.0 FORMAT "%5.1" ECU_ADDRESS 0x8035DB /end MEASUREMENT
/begin MEASUREMENT PFlt_numRgn_mp "gesamte Regenerationsanforderung" UBYTE OneToOne 1 100 0.00 255.0 FORMAT "%5.1" ECU_ADDRESS 0x8035DC /end MEASUREMENT
/begin MEASUREMENT PFlt_numRgn_mpByp_mp "Meßpunkt für Bypass" UBYTE OneToOne 1 100 0.00 255.0 FORMAT "%5.1" ECU_ADDRESS 0x8035DD /end MEASUREMENT
/begin MEASUREMENT PFlt_numSot "Partikelfilterstatus" UBYTE OneToOne 1 100 0.00 255.0 FORMAT "%5.1" ECU_ADDRESS 0x7F94E4 /end MEASUREMENT
/begin MEASUREMENT PFlt_numSotSimPres_mp "Ladezustand des Partikelfilters, abgeleitet vom Druckabfall über die Luftmasse" UBYTE OneToOne 1 100 0.00 255.0 FORMAT "%5.1" ECU_ADDRESS 0x8035DE /end MEASUREMENT
/begin MEASUREMENT PFlt_numSotSimTemp_mp "Ladezustand des Partikelfilters, abgeleitet von der Filtertemperatur" UBYTE OneToOne 1 100 0.00 255.0 FORMAT "%5.1" ECU_ADDRESS 0x8035DF /end MEASUREMENT
/begin MEASUREMENT PFlt_pAshAdj_mp "Druckdifferenz nach Regeneration wegen Asche" SWORD Pres_hPa 1 100 -32768.00 32767.00 FORMAT "%8.2" ECU_ADDRESS 0x80364C /end MEASUREMENT
/begin MEASUREMENT PFlt_pDiff "Differenzdruck über Partikelfilter [kPa]" SWORD Pres_hPa 1 100 -32768.00 32767.00 FORMAT "%8.2" ECU_ADDRESS 0x7F9AF2 /end MEASUREMENT
/begin MEASUREMENT PFlt_pDiffFlt_mp "gefilterte Druckdifferenz über Partikelfilter" SWORD Pres_hPa 1 100 -32768.00 32767.00 FORMAT "%8.2" ECU_ADDRESS 0x803692 /end MEASUREMENT
/begin MEASUREMENT PFlt_pDiffInt "Modulinterner Differenzdruck am Partikelfilter nach Plausibilitätstest" SWORD Pres_hPa 1 100 -32768.00 32767.00 FORMAT "%8.2" ECU_ADDRESS 0x7F9AF4 /end MEASUREMENT
/begin MEASUREMENT PFlt_pDiffIntFlt_mp "gefilterte Druckdifferenz" SWORD Pres_hPa 1 100 -32768.00 32767.00 FORMAT "%8.2" ECU_ADDRESS 0x80364E /end MEASUREMENT
/begin MEASUREMENT PFlt_pDiffOfsValActMid_mp "Im Nachlauf gemittelter offset des Differenzdrucks[hpa]" SWORD Pres_hPa 1 100 -32768.00 32767.00 FORMAT "%8.2" ECU_ADDRESS 0x803694 /end MEASUREMENT
/begin MEASUREMENT PFlt_pDiffOfsValAct_mp "Aktueller Offset des Differenzdrucks über Partikelfilter" SWORD Pres_hPa 1 100 -32768.00 32767.00 FORMAT "%8.2" ECU_ADDRESS 0x803696 /end MEASUREMENT
/begin MEASUREMENT PFlt_pDiffOfsValOld_mp "Bisheriger Offset des Differenzdrucks über Partikelfilter" SWORD Pres_hPa 1 100 -32768.00 32767.00 FORMAT "%8.2" ECU_ADDRESS 0x803698 /end MEASUREMENT
/begin MEASUREMENT PFlt_pDiffRaw "Unkorrigierter Differenzdruck über Partikelfilter [hpa]" SWORD Pres_hPa 1 100 -32768.00 32767.00 FORMAT "%8.2" ECU_ADDRESS 0x7F9AF6 /end MEASUREMENT
/begin MEASUREMENT PFlt_pEngPrtMax_mp "Maximaldruck Motorschutz" SWORD Pres_hPa 1 100 -32768.00 32767.00 FORMAT "%8.2" ECU_ADDRESS 0x8035E0 /end MEASUREMENT
/begin MEASUREMENT PFlt_pEngPrtMin_mp "Minimaldruck Motorschutz" SWORD Pres_hPa 1 100 -32768.00 32767.00 FORMAT "%8.2" ECU_ADDRESS 0x8035E2 /end MEASUREMENT
/begin MEASUREMENT PFlt_pPre "Druck vor Partikelfilter" SWORD Pres_hPa 1 100 -32768.00 32767.00 FORMAT "%8.2" ECU_ADDRESS 0x7F9AF8 /end MEASUREMENT
/begin MEASUREMENT PFlt_pPreInt "Modulinterner Druck vor Partikelfilter nach Plausibilitätstest" SWORD Pres_hPa 1 100 -32768.00 32767.00 FORMAT "%8.2" ECU_ADDRESS 0x7F9AFA /end MEASUREMENT
/begin MEASUREMENT PFlt_pSotDiffEmpFul_mp "Unterschied im Differenzdruck zwischen leerem und vollem Filter [hPa]" SWORD Pres_hPa 1 100 -32768.00 32767.00 FORMAT "%8.2" ECU_ADDRESS 0x803650 /end MEASUREMENT
/begin MEASUREMENT PFlt_pSotEmpCor_mp "simulierter Differenzdruck für ein leeres aber aschebeladenes Filter [hPa]" SWORD Pres_hPa 1 100 -32768.00 32767.00 FORMAT "%8.2" ECU_ADDRESS 0x803652 /end MEASUREMENT
/begin MEASUREMENT PFlt_pSotEmp_mp "simulierter Differenzdruck für ein leeres Filter [hPa]" SWORD Pres_hPa 1 100 -32768.00 32767.00 FORMAT "%8.2" ECU_ADDRESS 0x803654 /end MEASUREMENT
/begin MEASUREMENT PFlt_pSotFul_mp "simulierter Differenzdruck für ein volles Filter [hPa]" SWORD Pres_hPa 1 100 -32768.00 32767.00 FORMAT "%8.2" ECU_ADDRESS 0x803656 /end MEASUREMENT
/begin MEASUREMENT PFlt_qFl_mp "verbrauchter Treibstoff seit der letzten erfolgreichen Regeneration" SWORD Fl_L 1 100 -327.6800 327.6700 FORMAT "%8.4" ECU_ADDRESS 0x8035E4 /end MEASUREMENT
/begin MEASUREMENT PFlt_qPoI1DesAct_mp "Einspritzmenge der letzten Nacheinspritzung des aktuellen Zylinders" SWORD InjMass 1 100 -327.6800 327.6700 FORMAT "%8.4" ECU_ADDRESS 0x8036A4 /end MEASUREMENT
/begin MEASUREMENT PFlt_qPoI2NonEff_mp "nicht wirksame Einspritzmenge der PoI2" SWORD InjMass 1 100 -327.6800 327.6700 FORMAT "%8.4" ECU_ADDRESS 0x8036A6 /end MEASUREMENT
/begin MEASUREMENT PFlt_rAshAdj_mp "Aschebeladungsverhältnis nach Regeneration" SWORD Prc 1 100 -327.6800 327.6700 FORMAT "%8.4" ECU_ADDRESS 0x803658 /end MEASUREMENT
/begin MEASUREMENT PFlt_rAshLdTot_mp "Aschebeladung [%]" SWORD Prc 1 100 -327.6800 327.6700 FORMAT "%8.4" ECU_ADDRESS 0x80365A /end MEASUREMENT
/begin MEASUREMENT PFlt_rAshLd_mp "Aschebeladung [%]" SWORD Prc 1 100 -327.6800 327.6700 FORMAT "%8.4" ECU_ADDRESS 0x80365C /end MEASUREMENT
/begin MEASUREMENT PFlt_rLmbd "Lambdawert" SWORD lambda 1 100 -32.76800 32.76700 FORMAT "%8.5" ECU_ADDRESS 0x7F9AFC /end MEASUREMENT
/begin MEASUREMENT PFlt_rLmbdAprx "Lambda berechnet aus q_inj und dm_air" SWORD lambda 1 100 -32.76800 32.76700 FORMAT "%8.5" ECU_ADDRESS 0x7F9AFE /end MEASUREMENT
/begin MEASUREMENT PFlt_rOutHtg "Ansteurung der Partikelfilterheizung [%]" SWORD Prc 1 100 -327.6800 327.6700 FORMAT "%8.4" ECU_ADDRESS 0x7F9B00 /end MEASUREMENT
/begin MEASUREMENT PFlt_rSotFltCorr_mp "Korrigierter  Russbeladungskoefficient(%)" SWORD Prc 1 100 -327.6800 327.6700 FORMAT "%8.4" ECU_ADDRESS 0x80365E /end MEASUREMENT
/begin MEASUREMENT PFlt_rSotRatFlt_mp "aktuelles Filterbeladungsverhältnis gefiltert" SWORD Prc 1 100 -327.6800 327.6700 FORMAT "%8.4" ECU_ADDRESS 0x803660 /end MEASUREMENT
/begin MEASUREMENT PFlt_rSotRat_mp "aktuelle Filterbeladung [%]" SWORD Prc 1 100 -327.6800 327.6700 FORMAT "%8.4" ECU_ADDRESS 0x803662 /end MEASUREMENT
/begin MEASUREMENT PFlt_rSotSimPres "Partikelfilterbeladungskoeffizient aus Differenzdruckmessung über Volumenstrom" SWORD Prc 1 100 -327.6800 327.6700 FORMAT "%8.4" ECU_ADDRESS 0x7F9B02 /end MEASUREMENT
/begin MEASUREMENT PFlt_rSotSimPres1_mp "Partikelfilterbeladungskoeffizient nach Begrenzung [%]" SWORD Prc 1 100 -327.6800 327.6700 FORMAT "%8.4" ECU_ADDRESS 0x803664 /end MEASUREMENT
/begin MEASUREMENT PFlt_rSotSimPres2_mp "Partikelfilterbeladungskoeffizient mit Offset [%]" SWORD Prc 1 100 -327.6800 327.6700 FORMAT "%8.4" ECU_ADDRESS 0x803666 /end MEASUREMENT
/begin MEASUREMENT PFlt_rSotSimPresByp_mp "Meßpunkt für Bypass" SWORD Prc 1 100 -327.6800 327.6700 FORMAT "%8.4" ECU_ADDRESS 0x8035E6 /end MEASUREMENT
/begin MEASUREMENT PFlt_rSotSimPresCorr_mp "Korrigierter Beladungskoeffizient [%]" SWORD Prc 1 100 -327.6800 327.6700 FORMAT "%8.4" ECU_ADDRESS 0x803668 /end MEASUREMENT
/begin MEASUREMENT PFlt_rSotSimTemp "Partikelfilterbeladungszähler aus Temperaturmessung" SWORD Prc 1 100 -327.6800 327.6700 FORMAT "%8.4" ECU_ADDRESS 0x7F9B04 /end MEASUREMENT
/begin MEASUREMENT PFlt_rSotSimTemp1_mp "Akkumulationswert im Beladungszähler" SLONG Prc 1 100 -21474836.4800 21474836.4700 FORMAT "%13.4" ECU_ADDRESS 0x80366C /end MEASUREMENT
/begin MEASUREMENT PFlt_rSotSimTemp2_mp "Akkumulationswert mit Offset im Beladungszähler" SWORD Prc 1 100 -327.6800 327.6700 FORMAT "%8.4" ECU_ADDRESS 0x803670 /end MEASUREMENT
/begin MEASUREMENT PFlt_rSotSimTemp32EEP_mp "Limitierter EEPROM Abgleichwert von PFLT_MASS" SLONG Prc 1 100 -21474836.4800 21474836.4700 FORMAT "%13.4" ECU_ADDRESS 0x803674 /end MEASUREMENT
/begin MEASUREMENT PFlt_rSotSimTempByp_mp "Meßpunkt für Bypass" SWORD Prc 1 100 -327.6800 327.6700 FORMAT "%8.4" ECU_ADDRESS 0x8035E8 /end MEASUREMENT
/begin MEASUREMENT PFlt_rSotSimTempDwn1_mp "Korrektur für Subtrahend im Beladungszähler" SWORD Prc_Soot 1 100 -64.00000 63.99805 FORMAT "%8.5" ECU_ADDRESS 0x803678 /end MEASUREMENT
/begin MEASUREMENT PFlt_rSotSimTempDwn_mp "Subtrahend im Beladungszähler" SWORD Prc_Soot 1 100 -64.00000 63.99805 FORMAT "%8.5" ECU_ADDRESS 0x80367A /end MEASUREMENT
/begin MEASUREMENT PFlt_rSotSimTempUp_mp "Summand im Beladungszähler" SWORD Prc_Soot 1 100 -64.00000 63.99805 FORMAT "%8.5" ECU_ADDRESS 0x80367C /end MEASUREMENT
/begin MEASUREMENT PFlt_rSotSimTemp_mp "gewählter Wert für Akumulation im Beladungszähler" SWORD Prc_Soot 1 100 -64.00000 63.99805 FORMAT "%8.5" ECU_ADDRESS 0x80367E /end MEASUREMENT
/begin MEASUREMENT PFlt_st "von Partikelfilter angeforderter Regenerationsstatus [-]" ULONG OneToOne 1 100 0.00 4294967295.00 FORMAT "%13.2" ECU_ADDRESS 0x7F9D08 /end MEASUREMENT
/begin MEASUREMENT PFlt_stAddRequAct "bedarfsgesteuerte Additivierung aktiviert" UBYTE OneToOne 1 100 0.00 255.0 FORMAT "%5.1" ECU_ADDRESS 0x7F94E5 /end MEASUREMENT
/begin MEASUREMENT PFlt_stCnt_mp "Statuswort für  Regnerationsanf. nach Kraftstoffverbrauch, Betriebsstunden oder gefahrener Strecke" UBYTE OneToOne 1 100 0.00 255.0 FORMAT "%5.1" ECU_ADDRESS 0x8035EA /end MEASUREMENT
/begin MEASUREMENT PFlt_stEngPOp "Motorbetriebspunkt" UBYTE OneToOne 1 100 0.00 255.0 FORMAT "%5.1" ECU_ADDRESS 0x7F94E6 /end MEASUREMENT
/begin MEASUREMENT PFlt_stEngPOpByp_mp "Meßpunkt für Bypass" UBYTE OneToOne 1 100 0.00 255.0 FORMAT "%5.1" ECU_ADDRESS 0x80361C /end MEASUREMENT
/begin MEASUREMENT PFlt_stEngPOpCalc_mp "Motorstatus für Partikelfilterregeneration" SBYTE OneToOne 1 100 -128.0 127.0 FORMAT "%5.1" ECU_ADDRESS 0x80361D /end MEASUREMENT
/begin MEASUREMENT PFlt_stEngPrtActv "Status Motorschutz aktiv" UBYTE OneToOne 1 100 0.00 255.0 FORMAT "%5.1" ECU_ADDRESS 0x7F94E7 /end MEASUREMENT
/begin MEASUREMENT PFlt_stFastIntr "Schnelle Regenerations-Unterbrechung" UBYTE OneToOne 1 100 0.00 255.0 FORMAT "%5.1" ECU_ADDRESS 0x7F94E8 /end MEASUREMENT
/begin MEASUREMENT PFlt_stFidPresPerm "Entprellter Wert von Fid_PFltSotSimPresPerm[-]" UBYTE OneToOne 1 100 0.00 255.0 FORMAT "%5.1" ECU_ADDRESS 0x7F94E9 /end MEASUREMENT
/begin MEASUREMENT PFlt_stFreezePT1_mp "Bedingungen zum Einfrieren der Rußbeladungsberechnung" UBYTE OneToOne 1 100 0.00 255.0 FORMAT "%5.1" ECU_ADDRESS 0x803680 /end MEASUREMENT
/begin MEASUREMENT PFlt_stHalt "Partikelfilterregeneration Aktiv" UBYTE OneToOne 1 100 0.00 255.0 FORMAT "%5.1" ECU_ADDRESS 0x7F94EA /end MEASUREMENT
/begin MEASUREMENT PFlt_stHtgActv_mp "Bitwort mit Schalterzuständen" UBYTE OneToOne 1 100 0.00 255.0 FORMAT "%5.1" ECU_ADDRESS 0x803628 /end MEASUREMENT
/begin MEASUREMENT PFlt_stInrDes_mp "Zustand des geforderten Drehmomentes für die Regenerations-Unterbrechung" UBYTE OneToOne 1 100 0.00 255.0 FORMAT "%5.1" ECU_ADDRESS 0x8035EB /end MEASUREMENT
/begin MEASUREMENT PFlt_stIntr_mp "Statuswort Regeneration unterbrochen" UBYTE OneToOne 1 100 0.00 255.0 FORMAT "%5.1" ECU_ADDRESS 0x8035EC /end MEASUREMENT
/begin MEASUREMENT PFlt_stLck "Statusbit Lock Partikelfilterregeneration" UBYTE OneToOne 1 100 0.00 255.0 FORMAT "%5.1" ECU_ADDRESS 0x7F94EB /end MEASUREMENT
/begin MEASUREMENT PFlt_stLckTempPlaus_mp "Verriegelungsstatus Plausibilisierung Temperatursensoren" UBYTE OneToOne 1 100 0.00 255.0 FORMAT "%5.1" ECU_ADDRESS 0x80369A /end MEASUREMENT
/begin MEASUREMENT PFlt_stLckTmr_mp "Verriegelung Timer Temperaturplausibilisierung" UBYTE OneToOne 1 100 0.00 255.0 FORMAT "%5.1" ECU_ADDRESS 0x80369B /end MEASUREMENT
/begin MEASUREMENT PFlt_stPresDiffPlaus_mp "Zustand Plausibilisierung Differenzdrucksignal" UBYTE OneToOne 1 100 0.00 255.0 FORMAT "%5.1" ECU_ADDRESS 0x80369C /end MEASUREMENT
/begin MEASUREMENT PFlt_stResFlowHi_mp "Obere Schwelle Resflow-SRC überschritten" UBYTE OneToOne 1 100 0.00 255.0 FORMAT "%5.1" ECU_ADDRESS 0x80369D /end MEASUREMENT
/begin MEASUREMENT PFlt_stResFlowLo_mp "Untere Schwelle ResFlow-SRC unterschritten" UBYTE OneToOne 1 100 0.00 255.0 FORMAT "%5.1" ECU_ADDRESS 0x80369E /end MEASUREMENT
/begin MEASUREMENT PFlt_stRgnCtlSuc_mp "Status Regeneration durch Steuerung erfolgreich" UBYTE OneToOne 1 100 0.00 255.0 FORMAT "%5.1" ECU_ADDRESS 0x8035ED /end MEASUREMENT
/begin MEASUREMENT PFlt_stRgnCtl_mp "Regeneration im Steuerungsmodus[-]." UBYTE OneToOne 1 100 0.00 255.0 FORMAT "%5.1" ECU_ADDRESS 0x8035EE /end MEASUREMENT
/begin MEASUREMENT PFlt_stRgnStg_mp "Maßnahmenbitwort Regeneration" ULONG OneToOne 1 100 0.00 4294967295.00 FORMAT "%13.2" ECU_ADDRESS 0x8035F0 /end MEASUREMENT
/begin MEASUREMENT PFlt_stRgnTStM_mp "Zustand der Zustandsmaschine der Regenerationszeitbegrenzung" UBYTE OneToOne 1 100 0.00 255.0 FORMAT "%5.1" ECU_ADDRESS 0x8035F4 /end MEASUREMENT
/begin MEASUREMENT PFlt_stSotChange "Auswertung des Beladungsstatus auf Änderung" UBYTE OneToOne 1 100 0.00 255.0 FORMAT "%5.1" ECU_ADDRESS 0x7F94EF /end MEASUREMENT
/begin MEASUREMENT PFlt_stSOxDeb_mp "Entprellte Entschwefelungsbedingungen" UBYTE OneToOne 1 100 0.00 255.0 FORMAT "%5.1" ECU_ADDRESS 0x8035F5 /end MEASUREMENT
/begin MEASUREMENT PFlt_stSOxDePsng "Status Entschwefelung abgeschlossen" UBYTE OneToOne 1 100 0.00 255.0 FORMAT "%5.1" ECU_ADDRESS 0x7F94EC /end MEASUREMENT
/begin MEASUREMENT PFlt_stSOxDePsng_mp "Status Entschwefelung abgeschlossen[-]" UBYTE OneToOne 1 100 0.00 255.0 FORMAT "%5.1" ECU_ADDRESS 0x8035F6 /end MEASUREMENT
/begin MEASUREMENT PFlt_stSOxPsng "Verschwefelungszustand des Filters" UBYTE OneToOne 1 100 0.00 255.0 FORMAT "%5.1" ECU_ADDRESS 0x7F94ED /end MEASUREMENT
/begin MEASUREMENT PFlt_stSOxPsng_mp "Verschwefelungszustands[-]" UBYTE OneToOne 1 100 0.00 255.0 FORMAT "%5.1" ECU_ADDRESS 0x8035F7 /end MEASUREMENT
/begin MEASUREMENT PFlt_stSOxSim_mp "Aktuellpr Verschwefelungszustands[-]" UBYTE OneToOne 1 100 0.00 255.0 FORMAT "%5.1" ECU_ADDRESS 0x8035F8 /end MEASUREMENT
/begin MEASUREMENT PFlt_stSOx_mp "Entschwefelungbedingungen" UBYTE OneToOne 1 100 0.00 255.0 FORMAT "%5.1" ECU_ADDRESS 0x8035F9 /end MEASUREMENT
/begin MEASUREMENT PFlt_stSuc "Statuswort erfolgreiche Regeneration" UBYTE OneToOne 1 100 0.00 255.0 FORMAT "%5.1" ECU_ADDRESS 0x7F94F0 /end MEASUREMENT
/begin MEASUREMENT PFlt_stSucAftStrt_mp "Erfolgreiche Regeneration für Anzeige am Kundendiensttester" UBYTE OneToOne 1 100 0.00 255.0 FORMAT "%5.1" ECU_ADDRESS 0x803681 /end MEASUREMENT
/begin MEASUREMENT PFlt_stSuc_mp "erfolgreiche Regeneration" UBYTE OneToOne 1 100 0.00 255.0 FORMAT "%5.1" ECU_ADDRESS 0x8035FA /end MEASUREMENT
/begin MEASUREMENT PFlt_stTempPlausDone_mp "Statusbit Plausibilisierung Temperatursensoren durchgeführt" UBYTE OneToOne 1 100 0.00 255.0 FORMAT "%5.1" ECU_ADDRESS 0x80369F /end MEASUREMENT
/begin MEASUREMENT PFlt_stTxtMsg "Status-Text-Message für Partikel Filter" UBYTE OneToOne 1 100 0.00 255.0 FORMAT "%5.1" ECU_ADDRESS 0x7F94F1 /end MEASUREMENT
/begin MEASUREMENT PFlt_tAddPoI1_mp "Korrektur der Stationärtemperaturen durch PoI1" SWORD TempDiff_Kelv 1 100 -3276.800 3276.700 FORMAT "%8.3" ECU_ADDRESS 0x8036A8 /end MEASUREMENT
/begin MEASUREMENT PFlt_tAddPoI2_mp "Korrektur der Stationärtemperaturen durch PoI2" SWORD TempDiff_Kelv 1 100 -3276.800 3276.700 FORMAT "%8.3" ECU_ADDRESS 0x8036AA /end MEASUREMENT
/begin MEASUREMENT PFlt_tDiffCorr_mp "Temperaturabweichung durch instationären Betrieb" SWORD TempDiff_Kelv 1 100 -3276.800 3276.700 FORMAT "%8.3" ECU_ADDRESS 0x8036AC /end MEASUREMENT
/begin MEASUREMENT PFlt_tDwnStrm_mp "Zweite Abgastemperatur zur Überwachung" SWORD Temp_Cels 1 100 -3549.940 3003.560 FORMAT "%8.3" ECU_ADDRESS 0x8036A0 /end MEASUREMENT
/begin MEASUREMENT PFlt_tEngNorm_mp "Temperaturwert von dem Array Eng_tFld" SWORD Temp_Cels 1 100 -3549.940 3003.560 FORMAT "%8.3" ECU_ADDRESS 0x80361E /end MEASUREMENT
/begin MEASUREMENT PFlt_tFlt "Temperatur im Partikelfilter" SWORD Temp_Cels 1 100 -3549.940 3003.560 FORMAT "%8.3" ECU_ADDRESS 0x7F9B0A /end MEASUREMENT
/begin MEASUREMENT PFlt_tHtTransCor_mp "Temperaturkorrekturwert Wärmeübergang" SWORD TempDiff_Kelv 1 100 -3276.800 3276.700 FORMAT "%8.3" ECU_ADDRESS 0x8036AE /end MEASUREMENT
/begin MEASUREMENT PFlt_tiExhGsDel_mp "Verzögerungszeit Abgas" SWORD Time_s 1 100 -327.6800 327.6700 FORMAT "%8.4" ECU_ADDRESS 0x8036B0 /end MEASUREMENT
/begin MEASUREMENT PFlt_tiHtTransDT1_mp "Wärmeübergangszeit" SWORD Time_s 1 100 -327.6800 327.6700 FORMAT "%8.4" ECU_ADDRESS 0x8036B2 /end MEASUREMENT
/begin MEASUREMENT PFlt_tiOp_mp "Motorbetriebszeit bei der letzten erfolgr. Regeneration" ULONG TimeEngOn 1 100 0.00 4294967295.00 FORMAT "%13.2" ECU_ADDRESS 0x8035FC /end MEASUREMENT
/begin MEASUREMENT PFlt_tiRgnLckRest_mp "Restsperrzeit nach Reset" ULONG Time_s 1 100 0.00 42949672.9500 FORMAT "%13.4" ECU_ADDRESS 0x803600 /end MEASUREMENT
/begin MEASUREMENT PFlt_tiRgnMaxTmr_mp "Verbesserter Timer für die Regenerationszeitüberwachung" ULONG Time_s 1 100 0.00 42949672.9500 FORMAT "%13.4" ECU_ADDRESS 0x803604 /end MEASUREMENT
/begin MEASUREMENT PFlt_tiRgnMax_mp "Wert für die maximale Regenerierungsdauer" ULONG Time_s 1 100 0.00 42949672.9500 FORMAT "%13.4" ECU_ADDRESS 0x803608 /end MEASUREMENT
/begin MEASUREMENT PFlt_tiSnceRgn_mp "Motorbetriebszeit seit der letzten erfolgreichen Regeneration" ULONG TimeEngOn 1 100 0.00 4294967295.00 FORMAT "%13.2" ECU_ADDRESS 0x80360C /end MEASUREMENT
/begin MEASUREMENT PFlt_tiSOxDePsng_mp "Zeit in der die Entschwefelungsbedingung erfüllt war" ULONG Time_s 1 100 0.00 42949672.9500 FORMAT "%13.4" ECU_ADDRESS 0x803610 /end MEASUREMENT
/begin MEASUREMENT PFlt_tiSOxPsngTmr_mp "Verschwefelungszeit" ULONG Time_s 1 100 0.00 42949672.9500 FORMAT "%13.4" ECU_ADDRESS 0x803614 /end MEASUREMENT
/begin MEASUREMENT PFlt_tiSOxPsng_mp "Entschwefelungssollzeit" ULONG Time_s 1 100 0.00 42949672.9500 FORMAT "%13.4" ECU_ADDRESS 0x803618 /end MEASUREMENT
/begin MEASUREMENT PFlt_tiThresPFltNorm_mp "Schwellwert für Zeit seit Erreichen Zustand NORMAL" SWORD Time_ms 1 100 -327680.0 327670.0 FORMAT "%8.1" ECU_ADDRESS 0x803620 /end MEASUREMENT
/begin MEASUREMENT PFlt_tOxiPre "Temperatur vor Oxidationskatalysator" SWORD Temp_Cels 1 100 -3549.940 3003.560 FORMAT "%8.3" ECU_ADDRESS 0x7F9B0C /end MEASUREMENT
/begin MEASUREMENT PFlt_tOxiPreSty "Stationäre Temperatur vor Oxidationskatalysator" SWORD Temp_Cels 1 100 -3549.940 3003.560 FORMAT "%8.3" ECU_ADDRESS 0x7F9B0E /end MEASUREMENT
/begin MEASUREMENT PFlt_tPOpCalc_mp "Temperaturwert von dem Array Eng_tFld" SWORD Temp_Cels 1 100 -3549.940 3003.560 FORMAT "%8.3" ECU_ADDRESS 0x803622 /end MEASUREMENT
/begin MEASUREMENT PFlt_tPre "Abgastemp. vor Partikelfilter" SWORD Temp_Cels 1 100 -3549.940 3003.560 FORMAT "%8.3" ECU_ADDRESS 0x7F9B10 /end MEASUREMENT
/begin MEASUREMENT PFlt_tPreCorr_mp "Korrigiertes Temperatursignal vor Partikelfilter" SWORD Temp_Cels 1 100 -3549.940 3003.560 FORMAT "%8.3" ECU_ADDRESS 0x8036B4 /end MEASUREMENT
/begin MEASUREMENT PFlt_tPreInt "Modulinterner Druck vor Partikelfilter nach Plausibilitätstest" SWORD Temp_Cels 1 100 -3549.940 3003.560 FORMAT "%8.3" ECU_ADDRESS 0x7F9B12 /end MEASUREMENT
/begin MEASUREMENT PFlt_tPreSty "Stationäre Temperatur vor Partikelfilter" SWORD Temp_Cels 1 100 -3549.940 3003.560 FORMAT "%8.3" ECU_ADDRESS 0x7F9B14 /end MEASUREMENT
/begin MEASUREMENT PFlt_tPstSim_mp "Simulierte Temperatur nach Partikelfilter" SWORD Temp_Cels 1 100 -3549.940 3003.560 FORMAT "%8.3" ECU_ADDRESS 0x8036B6 /end MEASUREMENT
/begin MEASUREMENT PFlt_tSotSimTemp_mp "Temperatur zur Auswahl des Wertes zur Akkumulation im Beladungszähler" SWORD Temp_Cels 1 100 -3549.940 3003.560 FORMAT "%8.3" ECU_ADDRESS 0x803682 /end MEASUREMENT
/begin MEASUREMENT PFlt_tSurfSim_mp "modellierte Partikelfilteroberflächentemperatur" SWORD Temp_Cels 1 100 -3549.940 3003.560 FORMAT "%8.3" ECU_ADDRESS 0x8036B8 /end MEASUREMENT
/begin MEASUREMENT PFlt_tThresPFltPre3_mp "Schwellwert 3 für Temperatur im Filter" SWORD Temp_Cels 1 100 -3549.940 3003.560 FORMAT "%8.3" ECU_ADDRESS 0x803624 /end MEASUREMENT
/begin MEASUREMENT PFlt_tThresPFltPre4_mp "Schwellwert 4 für Temperatur im Filter" SWORD Temp_Cels 1 100 -3549.940 3003.560 FORMAT "%8.3" ECU_ADDRESS 0x803626 /end MEASUREMENT
/begin MEASUREMENT PFlt_tTotCor_mp "Additiver Temperaturkorrekturwert" SWORD TempDiff_Kelv 1 100 -3276.800 3276.700 FORMAT "%8.3" ECU_ADDRESS 0x8036BA /end MEASUREMENT
/begin MEASUREMENT PFlt_tUpStrm_mp "Erste Abgastemperatur zur Überwachung" SWORD Temp_Cels 1 100 -3549.940 3003.560 FORMAT "%8.3" ECU_ADDRESS 0x8036A2 /end MEASUREMENT
/begin MEASUREMENT PFlt_volAdd_mp "Additivmenge aus aktuellem Fahrzyklus [ml]" SLONG volAdd_ml_fine 1 100 -2147483.64800 2147483.64700 FORMAT "%13.5" ECU_ADDRESS 0x803684 /end MEASUREMENT
/begin MEASUREMENT PrpBrk_trqDes "Vortriebsmomentwunsch der Längsbewegung" SWORD TrqPrp 1 100 -32768.00 32767.00 FORMAT "%8.2" ECU_ADDRESS 0x7F9B16 /end MEASUREMENT
/begin MEASUREMENT PrpBrk_trqLead "Vorhaltmoment der Längsbewegung" SWORD TrqPrp 1 100 -32768.00 32767.00 FORMAT "%8.2" ECU_ADDRESS 0x7F9B18 /end MEASUREMENT
/begin MEASUREMENT PrpCtl_MaxSpdLimEEP_mp "Limitierter EEPROM Abgleichwert von MAXSPEED" SWORD Vel 1 100 -327.6800 327.6700 FORMAT "%8.4" ECU_ADDRESS 0x8036D0 /end MEASUREMENT
/begin MEASUREMENT PrpCtl_stAPPFFSet_mp "Zustand FlipFlop für Fahrpedalstellung" UBYTE OneToOne 1 100 0.00 255.0 FORMAT "%5.1" ECU_ADDRESS 0x8036D2 /end MEASUREMENT
/begin MEASUREMENT PrpCtl_stAWDFFRes_mp "Zustand FlipFlop (Reset-Eingang) für Aktivierung HGB über Allrad1" UBYTE OneToOne 1 100 0.00 255.0 FORMAT "%5.1" ECU_ADDRESS 0x8036D3 /end MEASUREMENT
/begin MEASUREMENT PrpCtl_stAWDFFSet_mp "Zustand FlipFlop (Set-Eingang) für Aktivierung HGB über Allrad1" UBYTE OneToOne 1 100 0.00 255.0 FORMAT "%5.1" ECU_ADDRESS 0x8036D4 /end MEASUREMENT
/begin MEASUREMENT PrpCtl_stAWDFid_mp "Meßpunkt für CAN-Fehler der Botschaft AWD1 oder fehlerhafte Fahrgeschwindigkeit" UBYTE OneToOne 1 100 0.00 255.0 FORMAT "%5.1" ECU_ADDRESS 0x8036D5 /end MEASUREMENT
/begin MEASUREMENT PrpCtl_stMaxActvAWD "Status Höchstgeschwindigkeitsbegrenzung über Allrad1" UBYTE OneToOne 1 100 0.00 255.0 FORMAT "%5.1" ECU_ADDRESS 0x7F94F3 /end MEASUREMENT
/begin MEASUREMENT PrpCtl_stMaxActvNiveau "Status Höchstgeschwindigkeitsbegrenzung über Niveau1" UBYTE OneToOne 1 100 0.00 255.0 FORMAT "%5.1" ECU_ADDRESS 0x7F94F4 /end MEASUREMENT
/begin MEASUREMENT PrpCtl_stNiveauFFRes_mp "Zustand FlipFlop (Reset-Eingang) für Aktivierung HGB über Niveau1" UBYTE OneToOne 1 100 0.00 255.0 FORMAT "%5.1" ECU_ADDRESS 0x8036D6 /end MEASUREMENT
/begin MEASUREMENT PrpCtl_stNiveauFFSet_mp "Zustand FlipFlop (Set-Eingang) für Aktivierung HGB über Niveau1" UBYTE OneToOne 1 100 0.00 255.0 FORMAT "%5.1" ECU_ADDRESS 0x8036D7 /end MEASUREMENT
/begin MEASUREMENT PrpCtl_stNoAPPLim_mp "Status Fahrpedalbegrenzung inaktiv" UBYTE OneToOne 1 100 0.00 255.0 FORMAT "%5.1" ECU_ADDRESS 0x8036D8 /end MEASUREMENT
/begin MEASUREMENT PrpCtl_stSPTrack_mp "Status Sollwertnachführung" UBYTE OneToOne 1 100 0.00 255.0 FORMAT "%5.1" ECU_ADDRESS 0x8036D9 /end MEASUREMENT
/begin MEASUREMENT PrpCtl_sttrqLim "Status Zustand Momentenbegrenzung" UBYTE OneToOne 1 100 0.00 255.0 FORMAT "%5.1" ECU_ADDRESS 0x7F94F5 /end MEASUREMENT
/begin MEASUREMENT PrpCtl_trqGovLim_mp "Maximale Begrenzungmoment für dem Reglers" SWORD TrqPrp 1 100 -32768.00 32767.00 FORMAT "%8.2" ECU_ADDRESS 0x8036DA /end MEASUREMENT
/begin MEASUREMENT PrpCtl_trqI_mp "Status I-Anteil" SLONG TrqPrp 1 100 -2147483648.00 2147483647.00 FORMAT "%13.2" ECU_ADDRESS 0x8036DC /end MEASUREMENT
/begin MEASUREMENT PrpCtl_trqP_mp "Status PI-Anteil" SWORD TrqPrp 1 100 -32768.00 32767.00 FORMAT "%8.2" ECU_ADDRESS 0x8036E0 /end MEASUREMENT
/begin MEASUREMENT PrpCtl_trqSpdLim "begrenztes Moment für Höchstgeschwindigkeitsbegrenzung" SWORD TrqPrp 1 100 -32768.00 32767.00 FORMAT "%8.2" ECU_ADDRESS 0x7F9B1A /end MEASUREMENT
/begin MEASUREMENT PrpCtl_vCurrTrack_mp "nachgeführter Geschwindigkeitssollwert" SWORD Vel 1 100 -327.6800 327.6700 FORMAT "%8.4" ECU_ADDRESS 0x8036E2 /end MEASUREMENT
/begin MEASUREMENT PrpCtl_vMaxAWD "Höchstgeschwindigkeit durch Allrad1" SWORD Vel 1 100 -327.6800 327.6700 FORMAT "%8.4" ECU_ADDRESS 0x7F9B1C /end MEASUREMENT
/begin MEASUREMENT PrpCtl_vMaxNiveau "Höchstgeschwindigkeit durch Niveau1" SWORD Vel 1 100 -327.6800 327.6700 FORMAT "%8.4" ECU_ADDRESS 0x7F9B1E /end MEASUREMENT
/begin MEASUREMENT Prp_rAPP "verknüpfte Fahrpedalstellung PWG und virtuelles PWG" SWORD Prc 1 100 -327.6800 327.6700 FORMAT "%8.4" ECU_ADDRESS 0x7F9B20 /end MEASUREMENT
/begin MEASUREMENT Prp_rAPPByp_mp "Meßpunkt für Bypass" SWORD Prc 1 100 -327.6800 327.6700 FORMAT "%8.4" ECU_ADDRESS 0x8036BE /end MEASUREMENT
/begin MEASUREMENT Prp_rVirtAPP "virtuelle Fahrpedalstellung bei FGR oder HGB" SWORD Prc 1 100 -327.6800 327.6700 FORMAT "%8.4" ECU_ADDRESS 0x7F9B22 /end MEASUREMENT
/begin MEASUREMENT Prp_rVirtAPPByp_mp "Meßpunkt für Bypass" SWORD Prc 1 100 -327.6800 327.6700 FORMAT "%8.4" ECU_ADDRESS 0x8036C0 /end MEASUREMENT
/begin MEASUREMENT Prp_rVirtEngPrp_mp "Virtuelle Fahrpedalstellung aus inversem Fahrverhaltenkennfeld" SWORD Prc 1 100 -327.6800 327.6700 FORMAT "%8.4" ECU_ADDRESS 0x8036C2 /end MEASUREMENT
/begin MEASUREMENT Prp_rVirtOvrRun_mp "Virtuelle Fahrpedalstellung aus der inversen Schubkennlinie" SWORD Prc 1 100 -327.6800 327.6700 FORMAT "%8.4" ECU_ADDRESS 0x8036C4 /end MEASUREMENT
/begin MEASUREMENT Prp_rVirtPerm_mp "Virtueller Fahrpedalwert" SWORD Prc 1 100 -327.6800 327.6700 FORMAT "%8.4" ECU_ADDRESS 0x8036C6 /end MEASUREMENT
/begin MEASUREMENT Prp_stACC_mp "Zustand virtueller Pedalwert aus Prp_rEng_CUR wegen ACC" UBYTE OneToOne 1 100 0.00 255.0 FORMAT "%5.1" ECU_ADDRESS 0x8036C8 /end MEASUREMENT
/begin MEASUREMENT Prp_stCrCtl_mp "Zustand virtueller Pedalwert aus Prp_rEng_CUR wegen CrCtl" UBYTE OneToOne 1 100 0.00 255.0 FORMAT "%5.1" ECU_ADDRESS 0x8036C9 /end MEASUREMENT
/begin MEASUREMENT Prp_stTrqTypePrp "Indikator ob Verlustmomentenkompensation applikativ deaktiviert ist" UBYTE OneToOne 1 100 0.00 255.0 FORMAT "%5.1" ECU_ADDRESS 0x7F94F6 /end MEASUREMENT
/begin MEASUREMENT Prp_stVirtAPP_mp "virtuellle PWG-Stellung überschreibt die gemessene" UBYTE OneToOne 1 100 0.00 255.0 FORMAT "%5.1" ECU_ADDRESS 0x8036CA /end MEASUREMENT
/begin MEASUREMENT Prp_swtCCOn "Freischaltung für FGR" UBYTE OneToOne 1 100 0.00 255.0 FORMAT "%5.1" ECU_ADDRESS 0x7F94F7 /end MEASUREMENT
/begin MEASUREMENT Prp_swtCCSel "Auswahlschalter für verbaute Art der FGR" UBYTE OneToOne 1 100 0.00 255.0 FORMAT "%5.1" ECU_ADDRESS 0x7F94F8 /end MEASUREMENT
/begin MEASUREMENT Prp_swtrAPP "Ausgabe Virtueller Fahrpedalwert nur wenn CrCtl/ACC activ" UBYTE OneToOne 1 100 0.00 255.0 FORMAT "%5.1" ECU_ADDRESS 0x7F94F9 /end MEASUREMENT
/begin MEASUREMENT Prp_trqDesCC "Momentenanforderung FGR oder ACC" SWORD TrqPrp 1 100 -32768.00 32767.00 FORMAT "%8.2" ECU_ADDRESS 0x7F9B24 /end MEASUREMENT
/begin MEASUREMENT Prp_trqEng "unnoetige message" SWORD Trq 1 100 -3276.800 3276.700 FORMAT "%8.3" ECU_ADDRESS 0x7F9B26 /end MEASUREMENT
/begin MEASUREMENT Prp_trqLead "Vorhaltmoment des Vortriebs" SWORD TrqPrp 1 100 -32768.00 32767.00 FORMAT "%8.2" ECU_ADDRESS 0x7F9B28 /end MEASUREMENT
/begin MEASUREMENT Prp_trqLeadCC "Vortriebsvorhaltemoment abhängig von Fahrgeschwindigkeitsregelung" SWORD TrqPrp 1 100 -32768.00 32767.00 FORMAT "%8.2" ECU_ADDRESS 0x7F9B2A /end MEASUREMENT
/begin MEASUREMENT Prp_trqPrp "Vortriebsmoment" SWORD TrqPrp 1 100 -32768.00 32767.00 FORMAT "%8.2" ECU_ADDRESS 0x7F9B2C /end MEASUREMENT
/begin MEASUREMENT Prp_trqRaw "Vortriebsmomentwunsch vor Führungsformer" SWORD TrqPrp 1 100 -32768.00 32767.00 FORMAT "%8.2" ECU_ADDRESS 0x7F9B2E /end MEASUREMENT
/begin MEASUREMENT Prp_trqRawLim "Grenzwert des Vortriebsmomentenrohwertes" SWORD TrqPrp 1 100 -32768.00 32767.00 FORMAT "%8.2" ECU_ADDRESS 0x7F9B30 /end MEASUREMENT
/begin MEASUREMENT Prp_trqThresPrp_mp "Drehmomentenschwelle zur Unterscheidung zwischen Zug- und Schubbetrieb" SWORD Trq 1 100 -3276.800 3276.700 FORMAT "%8.3" ECU_ADDRESS 0x8036CC /end MEASUREMENT
/begin MEASUREMENT PSPCD_stOutHWE_mp "Vorvoerderpumpe Ausgangssignals" UBYTE OneToOne 1 100 0.00 255.0 FORMAT "%5.1" ECU_ADDRESS 0x8036E4 /end MEASUREMENT
/begin MEASUREMENT PSP_stLogicOut "Quelle für Aktivierung der Vorförderpumpr (1=Ein / 0=Aus)" UBYTE OneToOne 1 100 0.00 255.0 FORMAT "%5.1" ECU_ADDRESS 0x7F94F2 /end MEASUREMENT
/begin MEASUREMENT RailCD_pAct_mp "aktueller Kraftstoffdruck" SWORD Pres_Rail 1 100 -3276800. 3276700. FORMAT "%8.0" ECU_ADDRESS 0x7FD05E /end MEASUREMENT
/begin MEASUREMENT RailCD_pPeak "maximaler Raildruck der letzten 10ms" SWORD Pres_Rail 1 100 -3276800. 3276700. FORMAT "%8.0" ECU_ADDRESS 0x7F9B32 /end MEASUREMENT
/begin MEASUREMENT RailCD_stEngStrtMov_mp "Motorbewegung bei Offset-Überwachung des Raildrucksensors festgestellt" UBYTE OneToOne 1 100 0.00 255.0 FORMAT "%5.1" ECU_ADDRESS 0x8037B4 /end MEASUREMENT
/begin MEASUREMENT RailCD_stMon_mp "Überwachungsstatus des Spannungsoffsets des Raildrucksensors" UBYTE OneToOne 1 100 0.00 255.0 FORMAT "%5.1" ECU_ADDRESS 0x8037B5 /end MEASUREMENT
/begin MEASUREMENT RailCD_stOfsTstMon "aktueller Zustand der Offset-Überwachung für den Raildrucksensor" UBYTE OneToOne 1 100 0.00 255.0 FORMAT "%5.1" ECU_ADDRESS 0x7F94FA /end MEASUREMENT
/begin MEASUREMENT RailCD_tClntLstCyc_mp "Wassertemperatur vom letzten Fahrzyklus für die Offset-Überwachung des Raildrucksensors" SWORD Temp_Cels 1 100 -3549.940 3003.560 FORMAT "%8.3" ECU_ADDRESS 0x8037B6 /end MEASUREMENT
/begin MEASUREMENT RailCD_tiOfsTstDel_mp "Verzögerungszeit = f(RailCD_pPeak) für Offset-Test des Raildrucksensors im Nachlauf" SWORD TimeRed 1 100 -5242.880 5242.720 FORMAT "%8.3" ECU_ADDRESS 0x8037B8 /end MEASUREMENT
/begin MEASUREMENT RailCD_uOfsTst "Spannungswert des Raildrucksensors während aktiver Überwachung" SWORD Volt 1 100 -160156.4 160151.5 FORMAT "%8.1" ECU_ADDRESS 0x7F9B34 /end MEASUREMENT
/begin MEASUREMENT RailCD_uPeakRaw "Rohwert des Raildrucks" SWORD Volt 1 100 -160156.4 160151.5 FORMAT "%8.1" ECU_ADDRESS 0x7F9B36 /end MEASUREMENT
/begin MEASUREMENT Rail_dvolEstAged "geschätzer Volumenstrom eines gealterten Systems" SWORD Qp_mm3_sec 1 100 -327680.0 327670.0 FORMAT "%8.1" ECU_ADDRESS 0x7F9B3A /end MEASUREMENT
/begin MEASUREMENT Rail_dvolMeUnCtlDT1_mp "DT1-Anteil des Druckreglers über Zumesseinheit" SWORD Qp_mm3_sec 1 100 -327680.0 327670.0 FORMAT "%8.1" ECU_ADDRESS 0x803734 /end MEASUREMENT
/begin MEASUREMENT Rail_dvolMeUnCtlI_mp "I-Anteil des Druckreglers über Zumesseinheit" SWORD Qp_mm3_sec 1 100 -327680.0 327670.0 FORMAT "%8.1" ECU_ADDRESS 0x803736 /end MEASUREMENT
/begin MEASUREMENT Rail_dvolMeUnCtlP_mp "P-Anteil des Druckreglers über Zumesseinheit" SWORD Qp_mm3_sec 1 100 -327680.0 327670.0 FORMAT "%8.1" ECU_ADDRESS 0x803738 /end MEASUREMENT
/begin MEASUREMENT Rail_dvolMeUnCtlUpLim "obere Stellwertbegrenzung für Druckregelung über Zumesseinheit" SWORD Qp_mm3_sec 1 100 -327680.0 327670.0 FORMAT "%8.1" ECU_ADDRESS 0x7F9B3C /end MEASUREMENT
/begin MEASUREMENT Rail_dvolMeUnSet "Sollwert (Volumenstrom) von der Raildruckregelung" SWORD Qp_mm3_sec 1 100 -327680.0 327670.0 FORMAT "%8.1" ECU_ADDRESS 0x7F9B3E /end MEASUREMENT
/begin MEASUREMENT Rail_facMeUnTiRmpVal_mp "aktueller Rampenwert der Rampe bei Umschaltung von Regelung über Zumesseinheit auf Regelung über Druckregelventil" SWORD Fact 1 100 -4.000000 3.999878 FORMAT "%8.6" ECU_ADDRESS 0x8036E6 /end MEASUREMENT
/begin MEASUREMENT Rail_MeUnCtlDKd_mp "D-Verstärkung der Druckregelung über Zumesseinheit" SLONG Kd_pRail2Q 1 100 -3276.80000000 3276.79999847 FORMAT "%13.8" ECU_ADDRESS 0x8036F0 /end MEASUREMENT
/begin MEASUREMENT Rail_MeUnCtlIKiNeg_mp "I-Verstärkung für negative Großsignale für die Druckregelung über Zumesseinheit" ULONG Ki_pRail2Q 1 100 0.00 99999.9999767 FORMAT "%13.7" ECU_ADDRESS 0x8036F4 /end MEASUREMENT
/begin MEASUREMENT Rail_MeUnCtlIKiPos_mp "I-Verstärkung für positive Großsignale für die Druckregelung über Zumesseinheit" ULONG Ki_pRail2Q 1 100 0.00 99999.9999767 FORMAT "%13.7" ECU_ADDRESS 0x8036F8 /end MEASUREMENT
/begin MEASUREMENT Rail_MeUnCtlIKi_mp "I-Verstärkung für Kleinsignale für die Druckregelung über Zumesseinheit" ULONG Ki_pRail2Q 1 100 0.00 99999.9999767 FORMAT "%13.7" ECU_ADDRESS 0x8036FC /end MEASUREMENT
/begin MEASUREMENT Rail_MeUnCtlPKpNeg_mp "P-Verstärkung für negative Großsignale für die Druckregelung über Zumesseinheit" ULONG Kp_pRail2Q 1 100 0.00 6553.59999847 FORMAT "%13.8" ECU_ADDRESS 0x803700 /end MEASUREMENT
/begin MEASUREMENT Rail_MeUnCtlPKpPos_mp "P-Verstärkung für positive Großsignale für die Druckregelung über Zumesseinheit" ULONG Kp_pRail2Q 1 100 0.00 6553.59999847 FORMAT "%13.8" ECU_ADDRESS 0x803704 /end MEASUREMENT
/begin MEASUREMENT Rail_MeUnCtlPKp_mp "P-Verstärkung für Kleinsignale für die Druckregelung über Zumesseinheit" ULONG Kp_pRail2Q 1 100 0.00 6553.59999847 FORMAT "%13.8" ECU_ADDRESS 0x803708 /end MEASUREMENT
/begin MEASUREMENT Rail_PCVCtlDKd_mp "D-Verstärkung der Druckregelung über Druckregelventil" SLONG Kd 1 100 -32768.0000000 32767.9999847 FORMAT "%13.7" ECU_ADDRESS 0x803714 /end MEASUREMENT
/begin MEASUREMENT Rail_PCVCtlIKiNeg_mp "I-Verstärkung für negative Großsignale für die Druckregelung über Druckregelventil" ULONG Ki 1 100 0.00 999999.999767 FORMAT "%13.6" ECU_ADDRESS 0x803718 /end MEASUREMENT
/begin MEASUREMENT Rail_PCVCtlIKiPos_mp "I-Verstärkung für positive Großsignale für die Druckregelung über Druckregelventil" ULONG Ki 1 100 0.00 999999.999767 FORMAT "%13.6" ECU_ADDRESS 0x80371C /end MEASUREMENT
/begin MEASUREMENT Rail_PCVCtlIKi_mp "I-Verstärkung für Kleinsignale für die Druckregelung über Druckregelventil" ULONG Ki 1 100 0.00 999999.999767 FORMAT "%13.6" ECU_ADDRESS 0x803720 /end MEASUREMENT
/begin MEASUREMENT Rail_PCVCtlPKpNeg_mp "P-Verstärkung für negative Großsignale für die Druckregelung über Druckregelventil" ULONG Kp 1 100 0.00 65535.9999847 FORMAT "%13.7" ECU_ADDRESS 0x803724 /end MEASUREMENT
/begin MEASUREMENT Rail_PCVCtlPKpPos_mp "P-Verstärkung für positive Großsignale für die Druckregelung über Druckregelventil" ULONG Kp 1 100 0.00 65535.9999847 FORMAT "%13.7" ECU_ADDRESS 0x803728 /end MEASUREMENT
/begin MEASUREMENT Rail_PCVCtlPKp_mp "P-Verstärkung für Kleinsignale für die Druckregelung über Druckregelventil" ULONG Kp 1 100 0.00 65535.9999847 FORMAT "%13.7" ECU_ADDRESS 0x80372C /end MEASUREMENT
/begin MEASUREMENT Rail_pDvt "Raildruckregler-Regelabweichung" SWORD Pres_Rail 1 100 -3276800. 3276700. FORMAT "%8.0" ECU_ADDRESS 0x7F9B46 /end MEASUREMENT
/begin MEASUREMENT Rail_pDvtFltLim_mp "gefilterte Regelabweichung des Raildrucks" SWORD Pres_Rail 1 100 -3276800. 3276700. FORMAT "%8.0" ECU_ADDRESS 0x80373A /end MEASUREMENT
/begin MEASUREMENT Rail_pPCVCtlLoLim_mp "untere Stellwertbegrenzung des Raildruckreglers über Druckregelventil" SWORD Pres_Rail 1 100 -3276800. 3276700. FORMAT "%8.0" ECU_ADDRESS 0x8036EA /end MEASUREMENT
/begin MEASUREMENT Rail_pPCVCtlUpLim_mp "obere Stellwertbegrenzung des Raildruckreglers über Druckregelventil" SWORD Pres_Rail 1 100 -3276800. 3276700. FORMAT "%8.0" ECU_ADDRESS 0x8036EC /end MEASUREMENT
/begin MEASUREMENT Rail_pPCVSet "Stellwertvorgabe für das Druckregelventil" SWORD Pres_Rail 1 100 -3276800. 3276700. FORMAT "%8.0" ECU_ADDRESS 0x7F9B48 /end MEASUREMENT
/begin MEASUREMENT Rail_pPeakFlt_mp "PT1-gefilterter Raildruck für die Druckregelung über Zumesseinheit" SWORD Pres_Rail 1 100 -3276800. 3276700. FORMAT "%8.0" ECU_ADDRESS 0x80373C /end MEASUREMENT
/begin MEASUREMENT Rail_stCtlLoop "Zustand der Steuerung Raildruckregler" UBYTE OneToOne 1 100 0.00 255.0 FORMAT "%5.1" ECU_ADDRESS 0x7F94FB /end MEASUREMENT
/begin MEASUREMENT Rail_stShOffTstAck "Quittierung für Nachlauftestanforderung" UBYTE OneToOne 1 100 0.00 255.0 FORMAT "%5.1" ECU_ADDRESS 0x7F94FD /end MEASUREMENT
/begin MEASUREMENT Rail_tiMeUnCtlDT1_mp "Zeitkonstante des DT1-Gliedes für die Druckregelung über Zumesseinheit" ULONG TimeDelay_s 1 100 0.0000010000000 4294.9673 FORMAT "%9.4" ECU_ADDRESS 0x80370C /end MEASUREMENT
/begin MEASUREMENT Rail_tiMeUnCtlPT1_mp "Zeitkonstante des PT1-Filters für die Druckregelung über Zumesseinheit" ULONG TimeDelay_s 1 100 0.0000010000000 4294.9673 FORMAT "%9.4" ECU_ADDRESS 0x803710 /end MEASUREMENT
/begin MEASUREMENT Rail_tiMeUnRmpDur_mp "Laufzeit der Rampe um das Fördervolumen der Zumesseinheit vom aktuellen Sollwert auf die Maximalförderung zu rampen" SWORD InjTime_us 1 100 -32768.00 32767.00 FORMAT "%8.2" ECU_ADDRESS 0x8036E8 /end MEASUREMENT
/begin MEASUREMENT Rail_tiPCVCtlDT1_mp "Zeitkonstante des DT1-Gliedes für die Druckregelung über Druckregelventil" ULONG TimeDelay_s 1 100 0.0000010000000 4294.9673 FORMAT "%9.4" ECU_ADDRESS 0x803730 /end MEASUREMENT
/begin FUNCTION pflt_corgn "Partikelfilterregenerationskoordinator"
 /begin DEF_CHARACTERISTIC PFlt_dtAccPedMax_C PFlt_facSOxPsng_C PFlt_facTRgnMaxRlx_C PFlt_lSumMaxDef_C PFlt_lSumMax_C PFlt_lSumSubs_C PFlt_numEngPOp1_CA PFlt_numEngPOp2_CA PFlt_numLst_C PFlt_numPrioRgnStg1_C PFlt_numPrioRgnStg2_C PFlt_numPrioRgnStg3_C PFlt_numPrioRgnStg4_C PFlt_numPrioRgnStg5_C PFlt_numPrioRgnStg6_C PFlt_numPrt_C PFlt_numSotPrio_CA PFlt_pEngPrtMaxInit_C PFlt_pEngPrtMax_MAP PFlt_pEngPrtMin_MAP PFlt_qFlMaxDef_C PFlt_qFlMax_C PFlt_qFlSubs_C PFlt_rLmbdRegMin_C PFlt_rSotSimPresAddHigh_C PFlt_rSotSimPresAddLow_C PFlt_rSotSimPresHigh1_C PFlt_rSotSimPresHigh2_C PFlt_rSotSimPresHigh3_C PFlt_rSotSimPresHigh4_C PFlt_rSotSimPresLow1_CUR PFlt_rSotSimPresLow2_CUR PFlt_rSotSimPresLow3_CUR PFlt_rSotSimPresLow4_CUR PFlt_rSotSimPresRstLow1_C PFlt_rSotSimPresRstLow2_C PFlt_rSotSimPresRstLow3_C PFlt_rSotSimPresRstLow4_C PFlt_rSotSimPresSOxHigh_CUR PFlt_rSotSimPresSOxLow_CUR PFlt_rSotSimTempHigh1_C PFlt_rSotSimTempHigh2_C PFlt_rSotSimTempHigh3_C PFlt_rSotSimTempHigh4_C PFlt_rSotSimTempLow1_C PFlt_rSotSimTempLow2_C PFlt_rSotSimTempLow3_C PFlt_rSotSimTempLow4_C PFlt_stInrRgnMsk1_C PFlt_stInrRgnMsk2_C PFlt_stLckRgnMsk_C PFlt_stRgnCtl_C PFlt_stRgnStg1_C PFlt_stRgnStg2_C PFlt_stRgnStg3_C PFlt_stRgnStg4_C PFlt_stRgnStg5_C PFlt_stRgnStg6_C PFlt_swtEngPrtSel_C PFlt_swtSOxPsngTime_C PFlt_swtTmrLckRst_C PFlt_tAccPedOff_C PFlt_tClntLowMax_C PFlt_tClntUppMax_C PFlt_tiEngOnMaxDef_C PFlt_tiEngOnMax_C PFlt_tiEngPrtPT1_C PFlt_tiEngPrt_C PFlt_tiLckRgn_C PFlt_tiLckSubs_C PFlt_tiOpSubs_C PFlt_tiRgnCtlMax_C PFlt_tiRgnCtlSpo_C PFlt_tiRgnSpo_C PFlt_tiRgnStg1_C PFlt_tiRgnStg2_C PFlt_tiRgnStg3_C PFlt_tiRgnStg4_C PFlt_tiRgnStg5_C PFlt_tiRgnStg6_C PFlt_tiSOxDebPos_C PFlt_tiSOxPsngMax_C PFlt_tiSOxPsngMin_C PFlt_tiSOxPsngSet_C PFlt_tPreMax_C PFlt_tPreOxiLowMax_C PFlt_tPreOxiUppMax_C PFlt_tPreRegMin_C PFlt_tPreTrbnMax_C PFlt_trqInrRgnLowMax1_CUR PFlt_trqInrRgnLowMax2_CUR PFlt_trqInrRgnUppMax1_CUR PFlt_trqInrRgnUppMax2_CUR PFlt_TxtMsgMsk_C /end DEF_CHARACTERISTIC
 /begin IN_MEASUREMENT Eng_nAvrg InjCtl_qSetUnBal PFlt_numRgn_mp PFlt_numSotSimPres_mp PFlt_numSotSimTemp_mp PFlt_rSotSimTemp PFlt_stEngPOp PFlt_tFlt /end IN_MEASUREMENT
/end FUNCTION
/begin FUNCTION pflt_corgn_msg "" /end FUNCTION
/begin FUNCTION pflt_corgn_uic ""
 /begin DEF_CHARACTERISTIC PFlt_numRgn_mp_Vector PFlt_numRgn_mp_Channel PFlt_rSotSimPres_Vector PFlt_rSotSimPres_Channel PFlt_rSotSimTemp_Vector PFlt_rSotSimTemp_Channel /end DEF_CHARACTERISTIC
 /begin OUT_MEASUREMENT PFlt_lSnceRgn_mp PFlt_lSum_mp PFlt_monRgnAct_mp PFlt_numEngPOp_mp PFlt_numLst_mp PFlt_numPrt_mp PFlt_numRgn_mp PFlt_numRgn_mpByp_mp PFlt_numSotSimPres_mp PFlt_numSotSimTemp_mp PFlt_pEngPrtMax_mp PFlt_pEngPrtMin_mp PFlt_qFl_mp PFlt_rSotSimPresByp_mp PFlt_rSotSimTempByp_mp PFlt_stCnt_mp PFlt_stInrDes_mp PFlt_stIntr_mp PFlt_stRgnCtlSuc_mp PFlt_stRgnCtl_mp PFlt_stRgnStg_mp PFlt_stRgnTStM_mp PFlt_stSOxDeb_mp PFlt_stSOxDePsng_mp PFlt_stSOxPsng_mp PFlt_stSOxSim_mp PFlt_stSOx_mp PFlt_stSuc_mp PFlt_tiOp_mp PFlt_tiRgnLckRest_mp PFlt_tiRgnMaxTmr_mp PFlt_tiRgnMax_mp PFlt_tiSnceRgn_mp PFlt_tiSOxDePsng_mp PFlt_tiSOxPsngTmr_mp PFlt_tiSOxPsng_mp /end OUT_MEASUREMENT
/end FUNCTION
/begin FUNCTION pflt_corgn_var_msg ""
 /begin OUT_MEASUREMENT PFlt_numPrio PFlt_numSot PFlt_st PFlt_stAddRequAct PFlt_stEngPrtActv PFlt_stFastIntr PFlt_stHalt PFlt_stLck PFlt_stSotChange PFlt_stSOxDePsng PFlt_stSOxPsng PFlt_stSuc PFlt_stTxtMsg /end OUT_MEASUREMENT
/end FUNCTION
/begin FUNCTION pflt_engpopcalc "Betriebszustandsberechnung für Partikelfilter"
 /begin DEF_CHARACTERISTIC PFlt_nAvrgHysHigh1_C PFlt_nAvrgHysHigh2_C PFlt_nAvrgHysLow1_C PFlt_nAvrgHysLow2_C PFlt_pHysHigh1_C PFlt_pHysHigh2_C PFlt_pHysHigh3_C PFlt_pHysHigh4_C PFlt_pHysHigh5_C PFlt_pHysLow1_C PFlt_pHysLow2_C PFlt_pHysLow3_C PFlt_pHysLow4_C PFlt_pHysLow5_C PFlt_rThresTransAWD_C PFlt_rThresTrans_C PFlt_stThresGear_C PFlt_swtTempNorm_C PFlt_swtTempPOpCalc_C PFlt_tClntHysHigh1_C PFlt_tClntHysHigh2_C PFlt_tClntHysHigh3_C PFlt_tClntHysHigh4_C PFlt_tClntHysHigh5_C PFlt_tClntHysLow1_C PFlt_tClntHysLow2_C PFlt_tClntHysLow3_C PFlt_tClntHysLow4_C PFlt_tClntHysLow5_C PFlt_tFltCorrHysHigh3_C PFlt_tFltCorrHysHigh4_C PFlt_tFltCorrHysLow3_C PFlt_tFltCorrHysLow4_C PFlt_tFltHysHigh1_C PFlt_tFltHysHigh2_C PFlt_tFltHysHigh3_C PFlt_tFltHysHigh4_C PFlt_tFltHysHigh5_C PFlt_tFltHysLow1_C PFlt_tFltHysLow2_C PFlt_tFltHysLow3_C PFlt_tFltHysLow4_C PFlt_tFltHysLow5_C PFlt_tFltThres_C PFlt_tiGear_C PFlt_tiPOpCalcHold_C PFlt_tiPOpCalcOn_C PFlt_tiThresNorm_MAP PFlt_tiVelVeh_C PFlt_tOxiCHysHigh3_C PFlt_tOxiCHysHigh4_C PFlt_tOxiCHysLow3_C PFlt_tOxiCHysLow4_C PFlt_tThresPre1_MAP PFlt_tThresPre2_MAP PFlt_vThresVeh_C /end DEF_CHARACTERISTIC
 /begin IN_MEASUREMENT Eng_nAvrg InjCtl_qSetUnBal PFlt_tEngNorm_mp PFlt_tFlt /end IN_MEASUREMENT
/end FUNCTION
/begin FUNCTION pflt_engpopcalc_msg "" /begin OUT_MEASUREMENT PFlt_stEngPOp /end OUT_MEASUREMENT /end FUNCTION
/begin FUNCTION pflt_engpopcalc_uic "" /begin DEF_CHARACTERISTIC PFlt_stEngPOp_Vector PFlt_stEngPOp_Channel /end DEF_CHARACTERISTIC
 /begin OUT_MEASUREMENT PFlt_stEngPOpByp_mp PFlt_stEngPOpCalc_mp PFlt_tEngNorm_mp PFlt_tiThresPFltNorm_mp PFlt_tPOpCalc_mp PFlt_tThresPFltPre3_mp PFlt_tThresPFltPre4_mp /end OUT_MEASUREMENT
/end FUNCTION
/begin FUNCTION pflt_exhgsppty "dvol + Lambda" /begin DEF_CHARACTERISTIC PFlt_pPreDfl_C PFlt_swtLmbdAprx_C /end DEF_CHARACTERISTIC /end FUNCTION
/begin FUNCTION pflt_exhgsppty_msg "" /end FUNCTION
/begin FUNCTION pflt_exhgsppty_uic "" /end FUNCTION
/begin FUNCTION pflt_exhgsppty_var_msg "" /begin OUT_MEASUREMENT PFlt_dmEG PFlt_dvol PFlt_pPreInt PFlt_rLmbd PFlt_rLmbdAprx /end OUT_MEASUREMENT /end FUNCTION
/begin FUNCTION pflt_htgactv "Partikelfilter Heizungssteuerung"
 /begin DEF_CHARACTERISTIC PFlt_rHtg1_C PFlt_rHtg2_C PFlt_rHtg3_C PFlt_stCmpHtg1_C PFlt_stCmpHtg2_C PFlt_stCmpHtg3_C /end DEF_CHARACTERISTIC
/end FUNCTION
/begin FUNCTION pflt_htgactv_msg "" /begin OUT_MEASUREMENT PFlt_rOutHtg /end OUT_MEASUREMENT /end FUNCTION
/begin FUNCTION pflt_htgactv_uic "" /begin OUT_MEASUREMENT PFlt_stHtgActv_mp /end OUT_MEASUREMENT /end FUNCTION
/begin FUNCTION pflt_masscalc "calculation of particle filter soot mass"
 /begin DEF_CHARACTERISTIC PFlt_dvolMaxSotSim_C PFlt_dvolMinSotSim_C PFlt_facAdd2Ash_C PFlt_facAshMs2Ld_C PFlt_facAshMs2Ld_CUR PFlt_facFl2Ash_C PFlt_facFltEmpConst_C PFlt_facFltEmp_CUR PFlt_facFltFulConst_C PFlt_facFltFul_CUR PFlt_facSotPresFac_C PFlt_facSotSimLmbd_CUR PFlt_facSotSimTempHi_C PFlt_facSotSimTempLo_C PFlt_facSotSimTemp_C PFlt_facSotSim_CUR PFlt_mAshfacAdjDfl_C PFlt_mAshfacAdjMax_C PFlt_mAshfacAdjMin_C PFlt_numFltEmpEu_CUR PFlt_numFltEmpRe_MAP PFlt_numFltFulEu_CUR PFlt_numFltFulRe_MAP PFlt_pDiffDfl_C PFlt_pDiffMaxSotSim_C PFlt_pFltEmpHi_MAP PFlt_pFltEmpLo_MAP PFlt_pFltFulHi_MAP PFlt_pFltFulLo_MAP PFlt_rAshLdMaxSotSim_C PFlt_rAshMs2Ld_CUR PFlt_rSotfacAdjDfl_C PFlt_rSotfacAdjMax_C PFlt_rSotfacAdjMin_C PFlt_rSotPresMax_C PFlt_rSotPresMin_C PFlt_rSotPresOfs_C PFlt_rSotSimOffset_C PFlt_rSotSimPresDfl_C PFlt_rSotSimPresSubs_C PFlt_rSotSimTemp0_MAP PFlt_rSotSimTemp1_MAP PFlt_rSotSimTemp2_MAP PFlt_rSotSimTemp3_MAP PFlt_rSotSimTemp5_MAP PFlt_rSotSimTemp6_MAP PFlt_rSotSimTempMx_C PFlt_rSotSim_CUR PFlt_SotSimTempKi_C PFlt_stDiaRgnMsk_C PFlt_stSotSimTemp1_C PFlt_stSotSimTemp2_C PFlt_stSotSimTemp3_C PFlt_swtSotMul_C PFlt_swtSotReEu_C PFlt_swtSotSimPT1Init_C PFlt_swtSotSimTempInit_C PFlt_tiOvrRunDebNeg_C PFlt_tiOvrRunDebPos_C PFlt_tiPerSotSimTemp_C PFlt_tiSotPresDiffPT1_C PFlt_tiSotRatDiffPT1_C PFlt_tiSotRatPT1_C PFlt_tiSotSimPresPerm_C PFlt_tiSotSimTempPT1_C PFlt_tSOxLvlHi_C PFlt_tSOxLvlLo_C /end DEF_CHARACTERISTIC
 /begin IN_MEASUREMENT Eng_nAvrg InjCtl_qCurr PFlt_dmEG PFlt_mAshTrmTot_mp PFlt_numFltEmpRe_mp PFlt_numFltFulRe_mp PFlt_pPreInt PFlt_rLmbd PFlt_tFlt /end IN_MEASUREMENT
/end FUNCTION
/begin FUNCTION pflt_masscalc_msg "" /begin OUT_MEASUREMENT PFlt_stFidPresPerm /end OUT_MEASUREMENT /end FUNCTION
/begin FUNCTION pflt_masscalc_uic ""
 /begin OUT_MEASUREMENT PFlt_facAshMs2Ld_mp PFlt_facSotSimTemp_mp PFlt_mAshAdd_mp PFlt_mAshAdj_mp PFlt_mAshFl_mp PFlt_mAshTrmTot_mp PFlt_mAshTrm_mp PFlt_numFltEmpEu_mp PFlt_numFltEmpRe_mp PFlt_numFltFulEu_mp PFlt_numFltFulRe_mp PFlt_pAshAdj_mp PFlt_pDiffIntFlt_mp PFlt_pSotDiffEmpFul_mp PFlt_pSotEmpCor_mp PFlt_pSotEmp_mp PFlt_pSotFul_mp PFlt_rAshAdj_mp PFlt_rAshLdTot_mp PFlt_rAshLd_mp PFlt_rSotFltCorr_mp PFlt_rSotRatFlt_mp PFlt_rSotRat_mp PFlt_rSotSimPres1_mp PFlt_rSotSimPres2_mp PFlt_rSotSimPresCorr_mp PFlt_rSotSimTemp1_mp PFlt_rSotSimTemp2_mp PFlt_rSotSimTemp32EEP_mp PFlt_rSotSimTempDwn1_mp PFlt_rSotSimTempDwn_mp PFlt_rSotSimTempUp_mp PFlt_rSotSimTemp_mp PFlt_stFreezePT1_mp PFlt_stSucAftStrt_mp PFlt_tSotSimTemp_mp PFlt_volAdd_mp /end OUT_MEASUREMENT
/end FUNCTION
/begin FUNCTION pflt_masscalc_var_msg "" /begin OUT_MEASUREMENT PFlt_pDiffInt PFlt_rSotSimPres PFlt_rSotSimTemp /end OUT_MEASUREMENT /end FUNCTION
/begin FUNCTION pflt_monitor "Überwachung des Partikelfilters"
 /begin DEF_CHARACTERISTIC PFlt_ddvolHsLnPlausNeg_C PFlt_ddvolHsLnPlausPos_C PFlt_ddvolHsLnSot_C PFlt_dvolCharMonMin_C PFlt_nTempChkTrg_C PFlt_numTimeStpPlausSens_C PFlt_pDiffCharMonMin_C PFlt_pDiffHsLnNeg_C PFlt_pDiffMax_C PFlt_pDiffMin_C PFlt_pDiffTolcMax_C PFlt_pMinNrmCldStrt_C PFlt_pPreTolcMax_C PFlt_resFlowMax_C PFlt_resFlowMin_C PFlt_resFlowTolcDynPlaus_C PFlt_stCfgTempSens_C PFlt_swtEnvTempSens_C PFlt_swtMonCharMin_C PFlt_tCldStrtDfl_C PFlt_tDiffCldMax_C PFlt_tDiffTolcMax_C PFlt_tDwnStrmTolcMax_C PFlt_tEGMax_C PFlt_tEGMin_C PFlt_tiChkTempPlausMax_C PFlt_DebCharMaxDef_C PFlt_DebCharMaxOk_C PFlt_DebCharMinDef_C PFlt_DebCharMinOk_C PFlt_DebEngPrtMaxDef_C PFlt_DebEngPrtMaxOk_C PFlt_DebPDiffDynPlausDef_C PFlt_DebPDiffDynPlausOk_C PFlt_DebHsLnPlausDef_C PFlt_DebHsLnPlausOk_C PFlt_DebPDiffMaxDef_C PFlt_DebPDiffMaxOk_C PFlt_DebPDiffMinDef_C PFlt_DebPDiffMinOk_C PFlt_DebSotPlausDef_C PFlt_DebSotPlausOk_C PFlt_DebRgnPermMaxDef_C PFlt_DebRgnPermMaxOk_C PFlt_DebTEGMaxDef_C PFlt_DebTEGMaxOk_C PFlt_DebTEGMinDef_C PFlt_DebTEGMinOk_C PFlt_tiLckChkTempPlaus_C PFlt_tiFltHsLnPT1_C PFlt_tUpStrmTolcMax_C /end DEF_CHARACTERISTIC
/end FUNCTION
/begin FUNCTION pflt_monitor_msg "" /end FUNCTION
/begin FUNCTION pflt_monitor_uic ""
 /begin OUT_MEASUREMENT PFlt_ddvolFlt_mp PFlt_dpDiffFlt_mp PFlt_dpDiffNegDef_mp PFlt_dpDiffPosDef_mp PFlt_dvolFlt_mp PFlt_pDiffFlt_mp PFlt_pDiffOfsValActMid_mp PFlt_pDiffOfsValAct_mp PFlt_pDiffOfsValOld_mp PFlt_stLckTempPlaus_mp PFlt_stLckTmr_mp PFlt_stPresDiffPlaus_mp PFlt_stResFlowHi_mp PFlt_stResFlowLo_mp PFlt_stTempPlausDone_mp PFlt_tDwnStrm_mp PFlt_tUpStrm_mp /end OUT_MEASUREMENT
/end FUNCTION
/begin FUNCTION pflt_sensadapt "Sensor Adaption" /begin DEF_CHARACTERISTIC PFlt_swtPresSensCfg_C /end DEF_CHARACTERISTIC /end FUNCTION
/begin FUNCTION pflt_sensadapt_msg ""
 /begin OUT_MEASUREMENT PFltCD_pPre PFlt_pDiff PFlt_pDiffRaw PFlt_pPre PFlt_tOxiPre PFlt_tPre /end OUT_MEASUREMENT
/end FUNCTION
/begin FUNCTION pflt_tempmod ""
 /begin DEF_CHARACTERISTIC PFlt_cpExhGs_C PFlt_CPFlt_C PFlt_facBlwBy_C PFlt_facDpn_C PFlt_facHtTransNoLin_CUR PFlt_KdDT1TempCor_C PFlt_kiITempMod_C PFlt_swtFltTemp_C PFlt_tAddPoI1_MAP PFlt_tAddPoI2_MAP PFlt_tExhGsSty_MAP PFlt_tiExhGsDel_CUR PFlt_tiFltTempPT1_C PFlt_tiHtTransDT1_CUR PFlt_tPreDfl_C PFlt_tSurfInit_C /end DEF_CHARACTERISTIC
 /begin IN_MEASUREMENT Eng_nAvrg InjCtl_qSetUnBal PFlt_dmEG PFlt_qPoI1DesAct_mp PFlt_qPoI2NonEff_mp PFlt_tDiffCorr_mp /end IN_MEASUREMENT
/end FUNCTION
/begin FUNCTION pflt_tempmod_msg "" /end FUNCTION
/begin FUNCTION pflt_tempmod_uic ""
 /begin OUT_MEASUREMENT PFlt_qPoI1DesAct_mp PFlt_qPoI2NonEff_mp PFlt_tAddPoI1_mp PFlt_tAddPoI2_mp PFlt_tDiffCorr_mp PFlt_tHtTransCor_mp PFlt_tiExhGsDel_mp PFlt_tiHtTransDT1_mp PFlt_tPreCorr_mp PFlt_tPstSim_mp PFlt_tSurfSim_mp PFlt_tTotCor_mp /end OUT_MEASUREMENT
/end FUNCTION
/begin FUNCTION pflt_tempmod_var_msg "" /begin OUT_MEASUREMENT PFlt_tFlt PFlt_tOxiPreSty PFlt_tPreInt PFlt_tPreSty /end OUT_MEASUREMENT /end FUNCTION
/begin FUNCTION prpbrk_msg "" /begin OUT_MEASUREMENT PrpBrk_trqDes PrpBrk_trqLead /end OUT_MEASUREMENT /end FUNCTION
/begin FUNCTION prpctl "Vortriebsregelung"
 /begin DEF_CHARACTERISTIC PrpCtl_tiDebvLimErrPatDef_C PrpCtl_tiDebvLimErrPatOk_C PrpCtl_rFltMin_C PrpCtl_SpdLim4IKi_C PrpCtl_SpdLim4IKiPos_C PrpCtl_SpdLim4IKiNeg_C PrpCtl_vSpdLim4IWinPos_C PrpCtl_vSpdLim4IWinNeg_C PrpCtl_SpdLim4PKp_C PrpCtl_SpdLim4PKpPos_C PrpCtl_SpdLim4PKpNeg_C PrpCtl_vSpdLim4PWinPos_C PrpCtl_vSpdLim4PWinNeg_C PrpCtl_SpdLim5IKi_C PrpCtl_SpdLim5IKiPos_C PrpCtl_SpdLim5IKiNeg_C PrpCtl_vSpdLim5IWinPos_C PrpCtl_vSpdLim5IWinNeg_C PrpCtl_SpdLim5PKp_C PrpCtl_SpdLim5PKpPos_C PrpCtl_SpdLim5PKpNeg_C PrpCtl_vSpdLim5PWinPos_C PrpCtl_vSpdLim5PWinNeg_C PrpCtl_tiSpdLimPT1_C PrpCtl_swtAWD1Rls_C PrpCtl_swtEnaLimAWD1_C PrpCtl_swtEnaLimNIVEAU1_C PrpCtl_swtNIVEAU1Rls_C PrpCtl_swtNoAPPLim_C PrpCtl_swtVehSpdLimEco_C PrpCtl_tiAPPCDMin_C PrpCtl_trqAWDLim_CUR PrpCtl_trqNIVEAULim_CUR PrpCtl_trqSpdTrackOff_C PrpCtl_vLimAWDMax_C PrpCtl_vLimAWDMin_C PrpCtl_vNiveauLimOffset_C PrpCtl_vNiveauMax_C PrpCtl_vSpdLimMax_C PrpCtl_vSpdLimThreshBck_C PrpCtl_vSpdLimThreshFree_C PrpCtl_vSpdLimThreshOff_C PrpCtl_vSpdLimThreshOn_C PrpCtl_vSpdLimTrmValLo_C PrpCtl_VSSCDAWDMax_C PrpCtl_VSSCDNiveauMax_C /end DEF_CHARACTERISTIC
 /begin IN_MEASUREMENT Eng_nAvrg /end IN_MEASUREMENT
/end FUNCTION
/begin FUNCTION prpctl_msg ""
 /begin OUT_MEASUREMENT PrpCtl_stMaxActvAWD PrpCtl_stMaxActvNiveau PrpCtl_sttrqLim PrpCtl_trqSpdLim PrpCtl_vMaxAWD PrpCtl_vMaxNiveau /end OUT_MEASUREMENT
/end FUNCTION
/begin FUNCTION prpctl_uic ""
 /begin OUT_MEASUREMENT PrpCtl_MaxSpdLimEEP_mp PrpCtl_stAPPFFSet_mp PrpCtl_stAWDFFRes_mp PrpCtl_stAWDFFSet_mp PrpCtl_stAWDFid_mp PrpCtl_stNiveauFFRes_mp PrpCtl_stNiveauFFSet_mp PrpCtl_stNoAPPLim_mp PrpCtl_stSPTrack_mp PrpCtl_trqGovLim_mp PrpCtl_trqI_mp PrpCtl_trqP_mp PrpCtl_vCurrTrack_mp /end OUT_MEASUREMENT
/end FUNCTION
/begin FUNCTION prp_demsel "Anforderungs-Auswahl"
 /begin DEF_CHARACTERISTIC Prp_swtCCOnVal_C Prp_swtCCOnType_C Prp_swtCCSelVal_C Prp_swtCCSelType_C /end DEF_CHARACTERISTIC
/end FUNCTION
/begin FUNCTION prp_demsel_msg ""
 /begin OUT_MEASUREMENT Prp_swtCCOn Prp_swtCCSel Prp_trqDesCC Prp_trqLead Prp_trqLeadCC Prp_trqRaw /end OUT_MEASUREMENT
/end FUNCTION
/begin FUNCTION prp_virtapp "virtuelle Fahrpedalstellung"
 /begin DEF_CHARACTERISTIC Prp_rEngLow_CUR Prp_rEngLow_MAP Prp_rEng_CUR Prp_rEng_MAP Prp_swtrAPP_C Prp_swtrEngCur_C Prp_trqThresEng_CUR /end DEF_CHARACTERISTIC
 /begin IN_MEASUREMENT Eng_nAvrg Prp_trqEng /end IN_MEASUREMENT
/end FUNCTION
/begin FUNCTION prp_virtapp_msg ""
 /begin OUT_MEASUREMENT Prp_rAPP Prp_rVirtAPP Prp_stTrqTypePrp Prp_swtrAPP Prp_trqEng Prp_trqPrp Prp_trqRawLim /end OUT_MEASUREMENT
/end FUNCTION
/begin FUNCTION prp_virtapp_uic ""
 /begin DEF_CHARACTERISTIC Prp_rAPP_Vector Prp_rAPP_Channel Prp_rVirtAPP_Vector Prp_rVirtAPP_Channel /end DEF_CHARACTERISTIC
 /begin OUT_MEASUREMENT Prp_rAPPByp_mp Prp_rVirtAPPByp_mp Prp_rVirtEngPrp_mp Prp_rVirtOvrRun_mp Prp_rVirtPerm_mp Prp_stACC_mp Prp_stCrCtl_mp Prp_stVirtAPP_mp Prp_trqThresPrp_mp /end OUT_MEASUREMENT
/end FUNCTION
/begin FUNCTION psp "Vorförderpumpe" /begin DEF_CHARACTERISTIC PSP_nPSPOn_C PSP_stPSPLogicOff_C PSP_tiEco_C /end DEF_CHARACTERISTIC /end FUNCTION
/begin FUNCTION pspcd "Komponententreiber Vorförderpumpe"
 /begin DEF_CHARACTERISTIC PSPCD_DebExcTempDef_C PSPCD_DebExcTempOk_C PSPCD_DebNoLoadDef_C PSPCD_DebNoLoadOk_C PSPCD_DebShortCircBatDef_C PSPCD_DebShortCircBatOk_C PSPCD_DebShortCircGndDef_C PSPCD_DebShortCircGndOk_C PSPCD_stDigInvOut_C PSPCD_tiPSPcheckDfpTmr_C PSPCD_tiPSPOFFTmr_C /end DEF_CHARACTERISTIC
/end FUNCTION
/begin FUNCTION pspcd_uic "" /begin OUT_MEASUREMENT PSPCD_stOutHWE_mp /end OUT_MEASUREMENT /end FUNCTION
/begin FUNCTION psp_msg "" /begin OUT_MEASUREMENT PSP_stLogicOut /end OUT_MEASUREMENT /end FUNCTION
/begin FUNCTION psp_uic "" /end FUNCTION
/begin FUNCTION railcd_co "Komponententreiber Rail"
 /begin DEF_CHARACTERISTIC RailCD_uSRCMin_C RailCD_uSRCMax_C RailCD_pLin_CUR RailCD_DebSRCHighDef_C RailCD_DebSRCHighOk_C RailCD_DebSRCLowDef_C RailCD_DebSRCLowOk_C /end DEF_CHARACTERISTIC
 /begin IN_MEASUREMENT RailCD_uPeakRaw /end IN_MEASUREMENT
/end FUNCTION
/begin FUNCTION railcd_co_msg "" /begin OUT_MEASUREMENT RailCD_pPeak RailCD_uPeakRaw /end OUT_MEASUREMENT /end FUNCTION
/begin FUNCTION railcd_co_uic "" /begin OUT_MEASUREMENT RailCD_pAct_mp /end OUT_MEASUREMENT /end FUNCTION
/begin FUNCTION railcd_offstst "RPS Offset Überwachung"
 /begin DEF_CHARACTERISTIC RailCD_swtOfsTst_C RailCD_tiEvalDel_C RailCD_tiOfsTstAftRun_C RailCD_tiOfsTstDel_CUR RailCD_tiOfsTstStrt_C RailCD_tiStrErrDel_C RailCD_tOfsTstAftRun_C RailCD_tOfsTstDec_C RailCD_tOfsTstInc_C RailCD_tOfsTstStrt_C RailCD_uOfsAftRunMax_C RailCD_uOfsAftRunMin_C RailCD_uOfsStrtMax_C RailCD_uOfsStrtMin_C /end DEF_CHARACTERISTIC
 /begin IN_MEASUREMENT RailCD_pPeak /end IN_MEASUREMENT
/end FUNCTION
/begin FUNCTION railcd_offstst_msg "" /begin OUT_MEASUREMENT RailCD_stOfsTstMon RailCD_uOfsTst /end OUT_MEASUREMENT /end FUNCTION
/begin FUNCTION railcd_offstst_uic ""
 /begin OUT_MEASUREMENT RailCD_stEngStrtMov_mp RailCD_stMon_mp RailCD_tClntLstCyc_mp RailCD_tiOfsTstDel_mp /end OUT_MEASUREMENT
/end FUNCTION
/begin FUNCTION rail_adcget_uic "" /end FUNCTION
/begin FUNCTION rail_ctlloop "Raildruckregler Regelkreis"
 /begin DEF_CHARACTERISTIC Rail_nCloseCtl_C Rail_nThresStrt_C Rail_numRevPlaus_C Rail_pCloseCtl_C Rail_pDiffCloseCtl_C Rail_pOpnCtl_C /end DEF_CHARACTERISTIC
/end FUNCTION
/begin FUNCTION rail_ctllooplib ""
 /begin DEF_CHARACTERISTIC Rail_dvolOff_C Rail_dvolStrt_C Rail_numRevDel_C Rail_pSetMin_C Rail_stCtlLoopSel_C Rail_tiDeflate_C Rail_tiMeUnRmpDur_CUR Rail_tiSwtToMeUnCtl_C /end DEF_CHARACTERISTIC
 /begin IN_MEASUREMENT Eng_nAvrg /end IN_MEASUREMENT
/end FUNCTION
/begin FUNCTION rail_ctllooplib_uic "" /begin OUT_MEASUREMENT Rail_facMeUnTiRmpVal_mp Rail_tiMeUnRmpDur_mp /end OUT_MEASUREMENT /end FUNCTION
/begin FUNCTION rail_ctllooplimmeun "Begrenzungen für die Druckregelung ueber Zumesseinheit" /begin DEF_CHARACTERISTIC Rail_dvolMeUnCtlLoLim_C Rail_dvolMeUnCtlUpLim_CUR /end DEF_CHARACTERISTIC /begin IN_MEASUREMENT Eng_nAvrg /end IN_MEASUREMENT /end FUNCTION
/begin FUNCTION rail_ctllooplimmeun_uic "" /end FUNCTION
/begin FUNCTION rail_ctllooplimpcv "Begrenzungen für die Druckregelung ueber Druckregelventil"
 /begin DEF_CHARACTERISTIC Rail_pPCVCtlLoLimStrt_C Rail_pPCVCtlLoLim_C Rail_pPCVCtlUpLimStrt_C Rail_pPCVCtlUpLim_C /end DEF_CHARACTERISTIC
/end FUNCTION
/begin FUNCTION rail_ctllooplimpcv_uic "" /begin OUT_MEASUREMENT Rail_pPCVCtlLoLim_mp Rail_pPCVCtlUpLim_mp /end OUT_MEASUREMENT /end FUNCTION
/begin FUNCTION rail_ctlloopmeun_msg "" /begin OUT_MEASUREMENT Rail_dvolMeUnSet /end OUT_MEASUREMENT /end FUNCTION
/begin FUNCTION rail_ctlloopparameun "Parameter für die Druckregelung ueber Zumesseinheit"
 /begin DEF_CHARACTERISTIC Rail_facOvrMeUnNegIncr_C Rail_MeUnCtlDKd_CUR Rail_MeUnCtlIKiNeg_CUR Rail_MeUnCtlIKiPos_CUR Rail_MeUnCtlIKi_CUR Rail_MeUnCtlPKpNeg_CUR Rail_MeUnCtlPKpPos_CUR Rail_MeUnCtlPKp_CUR Rail_pMeUnCtlIWinNeg_C Rail_pMeUnCtlIWinPos_C Rail_pMeUnCtlPWinNeg_C Rail_pMeUnCtlPWinPos_C Rail_pOvrMeUnThresHigh_C Rail_pOvrMeUnThresLow_C Rail_tiMeUnCtlDT1_CUR Rail_tiMeUnCtlPT1_CUR /end DEF_CHARACTERISTIC
 /begin IN_MEASUREMENT Eng_nAvrg /end IN_MEASUREMENT
/end FUNCTION
/begin FUNCTION rail_ctlloopparameun_uic ""
 /begin OUT_MEASUREMENT Rail_MeUnCtlDKd_mp Rail_MeUnCtlIKiNeg_mp Rail_MeUnCtlIKiPos_mp Rail_MeUnCtlIKi_mp Rail_MeUnCtlPKpNeg_mp Rail_MeUnCtlPKpPos_mp Rail_MeUnCtlPKp_mp Rail_tiMeUnCtlDT1_mp Rail_tiMeUnCtlPT1_mp /end OUT_MEASUREMENT
/end FUNCTION
/begin FUNCTION rail_ctlloopparapcv "Parameter für die Druckregelung ueber Druckregelventil"
 /begin DEF_CHARACTERISTIC Rail_facOvrPCVNegIncr_C Rail_PCVCtlDKd_CUR Rail_PCVCtlIKiNeg_CUR Rail_PCVCtlIKiPos_CUR Rail_PCVCtlIKi_CUR Rail_PCVCtlPKpNeg_CUR Rail_PCVCtlPKpPos_CUR Rail_PCVCtlPKp_CUR Rail_pOvrPCVThresHigh_C Rail_pOvrPCVThresLow_C Rail_pPCVCtlIWinNeg_C Rail_pPCVCtlIWinPos_C Rail_pPCVCtlPWinNeg_C Rail_pPCVCtlPWinPos_C Rail_tiPCVCtlDT1_CUR /end DEF_CHARACTERISTIC
 /begin IN_MEASUREMENT Eng_nAvrg /end IN_MEASUREMENT
/end FUNCTION
/begin FUNCTION rail_ctlloopparapcv_uic ""
 /begin OUT_MEASUREMENT Rail_PCVCtlDKd_mp Rail_PCVCtlIKiNeg_mp Rail_PCVCtlIKiPos_mp Rail_PCVCtlIKi_mp Rail_PCVCtlPKpNeg_mp Rail_PCVCtlPKpPos_mp Rail_PCVCtlPKp_mp Rail_tiPCVCtlDT1_mp /end OUT_MEASUREMENT
/end FUNCTION
/begin FUNCTION rail_ctllooppcv_msg "" /begin OUT_MEASUREMENT Rail_pPCVSet /end OUT_MEASUREMENT /end FUNCTION
/begin FUNCTION rail_ctlloop_msg ""
 /begin OUT_MEASUREMENT Rail_dvolEstAged Rail_dvolMeUnCtlUpLim Rail_pDvt Rail_stCtlLoop Rail_stShOffTstAck /end OUT_MEASUREMENT
/end FUNCTION
/begin FUNCTION rail_ctlloop_uic ""
 /begin DEF_CHARACTERISTIC Rail_dvolMeUnSet_Vector Rail_dvolMeUnSet_Channel Rail_pPCVSet_Vector Rail_pPCVSet_Channel /end DEF_CHARACTERISTIC
/end FUNCTION
/begin FUNCTION rail_ctlmeun ""
 /begin DEF_CHARACTERISTIC Rail_dvolMeUnCtlInitI_CUR Rail_nMeUnFrzI_C Rail_pDvtFltMin_C Rail_tiFrzIDel_C /end DEF_CHARACTERISTIC
 /begin IN_MEASUREMENT FlSys_t /end IN_MEASUREMENT
/end FUNCTION
/begin FUNCTION rail_ctlmeun_uic ""
 /begin OUT_MEASUREMENT Rail_dvolMeUnCtlDT1_mp Rail_dvolMeUnCtlI_mp Rail_dvolMeUnCtlP_mp Rail_pDvtFltLim_mp Rail_pPeakFlt_mp /end OUT_MEASUREMENT
/end FUNCTION
/begin FUNCTION rail_ctlpcv "" /begin DEF_CHARACTERISTIC Rail_pPCVInitI_MAP Rail_swtPCVInitI_C /end DEF_CHARACTERISTIC /begin IN_MEASUREMENT Eng_nAvrg Rail_pSetPoint /end IN_MEASUREMENT /end FUNCTION
/begin COMPU_METHOD AirMassPerTime "Luftmasse pro Zeit" RAT_FUNC "%6.3" "[Kg/h Luft]" COEFFS 0 10 0 0 0 1 /end COMPU_METHOD
/begin COMPU_METHOD CubMtrPerHr "Volumsstrom in m^3/h" RAT_FUNC "%6.3" "[m^3/h]" COEFFS 0 10 0 0 0 1 /end COMPU_METHOD
/begin COMPU_METHOD CubMtrPerHrPerSec "Volumenstromdifferenz pro Sekunde" RAT_FUNC "%6.3" "[m^3/h/s]" COEFFS 0 10 0 0 0 1 /end COMPU_METHOD
/begin COMPU_METHOD EngN "Motordrehzahl" RAT_FUNC "%6.2" "[rpm]" COEFFS 0 1 0 0 0 1 /end COMPU_METHOD
/begin COMPU_METHOD EngTempFldSel "Verbale Umrechnung für Auswahl aus dem Motortemperatur-Feld Eng_tFld" TAB_VERB "%6.3" "" COMPU_TAB_REF EngTempFldSel /end COMPU_METHOD
/begin COMPU_VTAB EngTempFldSel "Verbale Umrechnung für Auswahl aus dem Motortemperatur-Feld Eng_tFld" TAB_VERB 5 0 "Coolant_Temperature" 1 "Oil_Temperature" 2 "Engine_Temperature" 3 "Fuel_Temperature" 4 "Coolant_Temperature_CAN" /end COMPU_VTAB
/begin COMPU_METHOD EulerNum "Euler number" RAT_FUNC "%6.3" "[-]" COEFFS 0 10 0 0 0 1 /end COMPU_METHOD
/begin COMPU_METHOD facEulerToPres "Faktur um Druck in hPa zu berechnen" RAT_FUNC "%6.1" "[1/m^4]" COEFFS 0 0.0264 0 0 0 1 /end COMPU_METHOD
/begin COMPU_METHOD facMsAsh2Prc "Prozent pro Asche Masse" RAT_FUNC "%6.3" "[%/g]" COEFFS 0 8 0 0 0 1 /end COMPU_METHOD
/begin COMPU_METHOD Fact "Faktor mit Auflösung 1 / 8192, hauptsächlich für einen Faktorenbereich 0...1 verwendet" RAT_FUNC "%6.5" "[-]" COEFFS 0 8192 0 0 0 1 /end COMPU_METHOD
/begin COMPU_METHOD Fact1 "Faktor mit Auflösung 0,01 (100 mal höherer Bereich als Fact)" RAT_FUNC "%6.4" "[-]" COEFFS 0 128 0 0 0 1 /end COMPU_METHOD
/begin COMPU_METHOD Fl_L "Treibstoffmenge [l]" RAT_FUNC "%6.4" "[l]" COEFFS 0 100 0 0 0 1 /end COMPU_METHOD
/begin COMPU_METHOD hPaPerSec "Differenzdruck pro Sekunde" RAT_FUNC "%6.3" "[hPa/s]" COEFFS 0 10 0 0 0 1 /end COMPU_METHOD
/begin COMPU_METHOD InjMass "Einspritzmenge" RAT_FUNC "%6.4" "[mg/hub]" COEFFS 0 100 0 0 0 1 /end COMPU_METHOD
/begin COMPU_METHOD InjTime_us "Zeit in Microsekunden für das Einspritztiming" RAT_FUNC "%6.2" "[us]" COEFFS 0 1 0 0 0 1 /end COMPU_METHOD
/begin COMPU_METHOD Kd "Differentialverstärkung Kd (gleiche Einheit/Umrechnungsformel an Ein- und Ausgang)" RAT_FUNC "%7.6" "[1/1]" COEFFS 0 65536 0 0 0 1 /end COMPU_METHOD
/begin COMPU_METHOD Kd_1 "Differentialverstärkung Kd (gleiche Einheit/Umrechnungsregel an Ein- und Ausgang; Umrechnung für sint16-Werte)" RAT_FUNC "%6.4" "[1/1]" COEFFS 0 512 0 0 0 1 /end COMPU_METHOD
/begin COMPU_METHOD Kd_pRail2Q "Differentialverstärkung (Raildruck zu Menge)" RAT_FUNC "%8.7" "mm^3/s/hPa" COEFFS 0 655360 0 0 0 1 /end COMPU_METHOD
/begin COMPU_METHOD Kd_pRail2Q_1 "Differentialverstärkung mit Normexponent (Raildruck zu Menge)" RAT_FUNC "%7.6" "mm^3/s/hPa" COEFFS 0 40960 0 0 0 1 /end COMPU_METHOD
/begin COMPU_METHOD Ki "Integrale Verstärkung Ki (gleiche Einheit/Umrechnungsregel an Ein- und Ausgang)" RAT_FUNC "%6.5" "[1/s]" COEFFS 0 4294.967296 0 0 0 1 /end COMPU_METHOD
/begin COMPU_METHOD Ki_1 "Integrale Verstärkung Ki (gleiche Einheit/Umrechnungsregel an Ein- und Ausgang; Umrechnung für sint16-Werte)" RAT_FUNC "%6.4" "[1/s]" COEFFS 0 67.108864 0 0 0 1 /end COMPU_METHOD
/begin COMPU_METHOD Ki_pRail2Q "Integralverstärkung (Raildruck zu Menge)" RAT_FUNC "%7.6" "mm^3/s^2/hPa" COEFFS 0 42949.67296 0 0 0 1 /end COMPU_METHOD
/begin COMPU_METHOD Ki_pRail2Q_1 "Intgralverstärkung mit Normexponent (Raildruck zu Menge)" RAT_FUNC "%7.6" "mm^3/s^2/hPa" COEFFS 0 10737.41824 0 0 0 1 /end COMPU_METHOD
/begin COMPU_METHOD KI_Temp2Fact "To be filled" RAT_FUNC "%10.9" "[1/deg C*s]" COEFFS 0 53687091.2 0 0 0 1 /end COMPU_METHOD
/begin COMPU_METHOD Ki_Vel2TrqPrp "Integralverstärkung (Fahrgeschwindigkeit zu Vortriebsmoment)" RAT_FUNC "%6.4" "[Nm/(Km/h)/s]" COEFFS 0 42.94967296 0 0 0 1 /end COMPU_METHOD
/begin COMPU_METHOD Kp "proportionale Verstärkung Kp (gleiche Einheit/Umrechnungsregel an Ein- und Ausgang)" RAT_FUNC "%7.6" "[1/1]" COEFFS 0 65536 0 0 0 1 /end COMPU_METHOD
/begin COMPU_METHOD Kp_1 "proportionale Verstärkung Kp (gleiche Einheit/Umrechnungsregel an Ein- und Ausgang; Umrechnung für sint16-Werte)" RAT_FUNC "%6.4" "[1/1]" COEFFS 0 64 0 0 0 1 /end COMPU_METHOD
/begin COMPU_METHOD Kp_pRail2Q "Proportionale Verstärkung Kp (Raildruck zu Menge)" RAT_FUNC "%8.7" "mm^3/s/hPa" COEFFS 0 655360 0 0 0 1 /end COMPU_METHOD
/begin COMPU_METHOD Kp_pRail2Q_1 "Proportionale Verstärkung mit Normexponent (Raildruck zu Menge)" RAT_FUNC "%7.6" "mm^3/s/hPa" COEFFS 0 81920 0 0 0 1 /end COMPU_METHOD
/begin COMPU_METHOD Kp_Vel2TrqPrp "Proportionalverstärkung (Fahrgeschwindigkeit zu Vortriebsmoment)" RAT_FUNC "%6.4" "[Nm/(Km/h)]" COEFFS 0 655.36 0 0 0 1 /end COMPU_METHOD
/begin COMPU_METHOD lambda "Lambda" RAT_FUNC "%6.5" "[-]" COEFFS 0 1000 0 0 0 1 /end COMPU_METHOD
/begin COMPU_METHOD Length "Länge in Meter" RAT_FUNC "%6.2" "[m]" COEFFS 0 1 0 0 0 1 /end COMPU_METHOD
/begin COMPU_METHOD mAsh "Umrechnung für Aschemasse in niedrigere Auflösung (s32 auf s16)" RAT_FUNC "%6.3" "[g]" COEFFS 0 10 0 0 0 1 /end COMPU_METHOD
/begin COMPU_METHOD mAsh_g "Asche Masse" RAT_FUNC "%9.8" "[g]" COEFFS 0 6553600 0 0 0 1 /end COMPU_METHOD
/begin COMPU_METHOD OneToOne "eins zu eins (physikalischer Wert ist gleich dem internen Wert)" RAT_FUNC "%6.2" "[-]" COEFFS 0 1 0 0 0 1 /end COMPU_METHOD
/begin COMPU_METHOD Prc "Prozent, gleiche interne Auflösung wie Fact, aber Darstellung in Prozent (0...100%)" RAT_FUNC "%6.4" "[%]" COEFFS 0 100 0 0 0 1 /end COMPU_METHOD
/begin COMPU_METHOD Prc32 "Prozent für 32bit Variablen" RAT_FUNC "%9.8" "[%/sample]" COEFFS 0 6553600 0 0 0 1 /end COMPU_METHOD
/begin COMPU_METHOD Prc_Soot "Auflösung für Russmasse, höhere Auflösung als Prc (1/512)" RAT_FUNC "%6.4" "[%/sample]" COEFFS 0 512 0 0 0 1 /end COMPU_METHOD
/begin COMPU_METHOD Prc_Soot32 "Rußmengenumrechnung" RAT_FUNC "%6.4" "[%]" COEFFS 0 512 0 0 0 1 /end COMPU_METHOD
/begin COMPU_METHOD Pres_hPa "Druck (angezeigt in [hPa])" RAT_FUNC "%6.2" "[hPa]" COEFFS 0 1 0 0 0 1 /end COMPU_METHOD
/begin COMPU_METHOD Pres_Rail "Raildruck in hPa" RAT_FUNC "%6.0" "[hPa]" COEFFS 0 0.01 0 0 0 1 /end COMPU_METHOD
/begin COMPU_METHOD Qp_mm3_sec "Umrechnung für Volumenstrom" RAT_FUNC "%6.1" "mm3/s" COEFFS 0 0.1 0 0 0 1 /end COMPU_METHOD
/begin COMPU_METHOD Res_hPaHrPerCM "Strömungswiderstand [hPa h/m3]" RAT_FUNC "%6.5" "[hPa/(m^3/h)]" COEFFS 0 1000 0 0 0 1 /end COMPU_METHOD
/begin COMPU_METHOD ReynoldsNum "Reynolds Nummer um den thermischen Koeffizienten zu bestimmen" RAT_FUNC "%6.0" "[-]" COEFFS 0 0.01 0 0 0 1 /end COMPU_METHOD
/begin COMPU_METHOD TempDiff_Kelv "Offsettemperatur dargestellt in [K]" RAT_FUNC "%6.3" "[ deg C ]" COEFFS 0 10 0 0 0 1 /end COMPU_METHOD
/begin COMPU_METHOD Temp_Cels "Temperatur dargestellt in °C (gleiche interne Darstellung wie Temp_Kelv)" RAT_FUNC "%6.1" "[deg C]" COEFFS 0 10 2731.4 0 0 1 /end COMPU_METHOD
/begin COMPU_METHOD Thr_Cpty "Wärmekapazität" RAT_FUNC "%6.2" "[J/K]" COEFFS 0 1 0 0 0 1 /end COMPU_METHOD
/begin COMPU_METHOD Thr_Cpty_ExhGs "Wärmekapazität des Abgases" RAT_FUNC "%6.2" "[J/kgK]" COEFFS 0 0.1 0 0 0 1 /end COMPU_METHOD
/begin COMPU_METHOD TimeDeb "Entprellzeit in Millisekunden für Libraryfunktion Debounce" RAT_FUNC "%6.1" "[ms]" COEFFS 0 0.1 0 0 0 1 /end COMPU_METHOD
/begin COMPU_METHOD TimeDelay_s "Zeitkonstante T1 (in s) für PT1, DT1, etc." RAT_FUNC "%9.3" "[s]" COEFFS 0 0 1 0 0.00023283064365387 0 /end COMPU_METHOD
/begin COMPU_METHOD TimeDelay_s_2 "Zeitkonstante T1 (in s) für PT1, DT1, etc. normiert auf 16 bit" RAT_FUNC "%9.4" "[s]" COEFFS 0 0 1 0 0.0596046447753906 0 /end COMPU_METHOD
/begin COMPU_METHOD TimeEngOn "Motorbetriebszeit in Sekunden" RAT_FUNC "%6.2" "[s]" COEFFS 0 1 0 0 0 1 /end COMPU_METHOD
/begin COMPU_METHOD TimeRed "Zeit in Sekunden mit reduzierter Auflösung für Ein/Ausgänge von KL/KF (sint16)" RAT_FUNC "%6.3" "[s]" COEFFS 0 6.25 0 0 0 1 /end COMPU_METHOD
/begin COMPU_METHOD Time_ms "Zeit in ms für Fehlerentprellung (DSM) und SW-Timer" RAT_FUNC "%6.1" "[ms]" COEFFS 0 0.1 0 0 0 1 /end COMPU_METHOD
/begin COMPU_METHOD Time_ms_10ms "Zähler im 10ms Takt" RAT_FUNC "%6.1" "ms" COEFFS 0 0.1 0 0 0 1 /end COMPU_METHOD
/begin COMPU_METHOD Time_RtmHighRes "Zeit mit hoher Auflösung für Laufzeitmessung" RAT_FUNC "%6.5" "[ms]" COEFFS 0 1000 0 0 0 1 /end COMPU_METHOD
/begin COMPU_METHOD Time_s "Zeit in s für Fehlerentprellung (DSM) und SW-Timer" RAT_FUNC "%6.4" "[s]" COEFFS 0 100 0 0 0 1 /end COMPU_METHOD
/begin COMPU_METHOD TransR "Übersetzungsverhältnis (Getriebe etc.)" RAT_FUNC "%6.4" "[-]" COEFFS 0 100 0 0 0 1 /end COMPU_METHOD
/begin COMPU_METHOD Trq "Motormoment" RAT_FUNC "%6.3" "[Nm]" COEFFS 0 10 0 0 0 1 /end COMPU_METHOD
/begin COMPU_METHOD TrqPerSec "Motormomentengradient" RAT_FUNC "%6.2" "[Nm/s]" COEFFS 0 1 0 0 0 1 /end COMPU_METHOD
/begin COMPU_METHOD TrqPrp "Vortriebsmoment" RAT_FUNC "%6.2" "[Nm]" COEFFS 0 1 0 0 0 1 /end COMPU_METHOD
/begin COMPU_METHOD Vel "Fahrzeuggeschwindigkeit, gleiche interne Auflösung wie Vel_SI" RAT_FUNC "%6.4" "[km/h]" COEFFS 0 100 0 0 0 1 /end COMPU_METHOD
/begin COMPU_METHOD volAddfine2mAsh "Aschemasse zu Additivvolumen hohe Auflösung [g/l]" RAT_FUNC "%6.3" "[g/l]" COEFFS 0 6.5536 0 0 0 1 /end COMPU_METHOD
/begin COMPU_METHOD volAdd_ml_fine "feinere Auflösung des Additivvolumen [ml]" RAT_FUNC "%6.5" "[ml]" COEFFS 0 1000 0 0 0 1 /end COMPU_METHOD
/begin COMPU_METHOD volFl2mAsh "Aschemasse zu Treibstoffmenge [g/l]" RAT_FUNC "%8.7" "[g/l]" COEFFS 0 429496.7296 0 0 0 1 /end COMPU_METHOD
/begin COMPU_METHOD Volt "Spannung in V (von ADC)" RAT_FUNC "%6.2" "[mV]" COEFFS 0 0.2046 0 0 0 1 /end COMPU_METHOD
/begin RECORD_LAYOUT Kf_Xs16_Ys16_Ws16 NO_AXIS_PTS_X 1 SWORD NO_AXIS_PTS_Y 2 SWORD AXIS_PTS_X 3 SWORD INDEX_INCR DIRECT AXIS_PTS_Y 4 SWORD INDEX_INCR DIRECT FNC_VALUES 5 SWORD COLUMN_DIR DIRECT /end RECORD_LAYOUT
/begin RECORD_LAYOUT Kf_Xu8_Yu8_Wu8 NO_AXIS_PTS_X 1 UBYTE NO_AXIS_PTS_Y 2 UBYTE AXIS_PTS_X 3 UBYTE INDEX_INCR DIRECT AXIS_PTS_Y 4 UBYTE INDEX_INCR DIRECT FNC_VALUES 5 UBYTE COLUMN_DIR DIRECT /end RECORD_LAYOUT
/begin RECORD_LAYOUT Kl_Xs16_Ws16 NO_AXIS_PTS_X 1 SWORD AXIS_PTS_X 2 SWORD INDEX_INCR DIRECT FNC_VALUES 3 SWORD COLUMN_DIR DIRECT /end RECORD_LAYOUT
/begin RECORD_LAYOUT Kw_Ws16 FNC_VALUES 1 SWORD COLUMN_DIR DIRECT /end RECORD_LAYOUT
/begin RECORD_LAYOUT Kw_Ws32 FNC_VALUES 1 SLONG COLUMN_DIR DIRECT /end RECORD_LAYOUT
/begin RECORD_LAYOUT Kw_Wu16 FNC_VALUES 1 UWORD COLUMN_DIR DIRECT /end RECORD_LAYOUT
/begin RECORD_LAYOUT Kw_Wu32 FNC_VALUES 1 ULONG COLUMN_DIR DIRECT /end RECORD_LAYOUT
/begin RECORD_LAYOUT Kw_Wu8 FNC_VALUES 1 UBYTE COLUMN_DIR DIRECT /end RECORD_LAYOUT
/end MODULE
/end PROJECT
