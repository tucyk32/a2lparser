ASAP2_VERSION 1 3
/begin PROJECT C177 "EDC16CP"
/begin HEADER "" VERSION "VCP7A3" PROJECT_NO C177 /end HEADER
/begin MODULE DIM ""
/begin MOD_COMMON "" BYTE_ORDER MSB_FIRST ALIGNMENT_BYTE 1 ALIGNMENT_WORD 2 ALIGNMENT_LONG 4 ALIGNMENT_FLOAT32_IEEE 4 /end MOD_COMMON
/begin CHARACTERISTIC FrmMng_dAC1ID_C "Botschaftsidentifier CAN-Botschaft AC1" VALUE 0x1C0D04 Kw_Wu32 536870911.000 OneToOne 0.00 536870911.000 FORMAT "%13.3" EXTENDED_LIMITS 0.00 4294967295.00 /end CHARACTERISTIC
/begin CHARACTERISTIC FrmMng_AC1IDType_C "ID Typ standard oder extended" VALUE 0x1C0D08 Kw_Wu8 0.00 OneToOne 1.000 1.000 FORMAT "%5.3" EXTENDED_LIMITS 0.00 255.0 READ_ONLY /end CHARACTERISTIC
/begin CHARACTERISTIC FrmMng_AC1NumCAN_C "Auf welchen CAN die Botschaft ist" VALUE 0x1C0D09 Kw_Wu8 2.000 OneToOne 0.00 2.000 FORMAT "%5.3" EXTENDED_LIMITS 0.00 255.0 READ_ONLY /end CHARACTERISTIC
/begin CHARACTERISTIC FrmMng_AC1NumMsgPos_C "Message Buffer der verwendet wird" VALUE 0x1C0D0A Kw_Wu8 15.00 OneToOne 0.00 15.00 FORMAT "%5.2" EXTENDED_LIMITS 0.00 255.0 READ_ONLY /end CHARACTERISTIC
/begin CHARACTERISTIC FrmMng_AC1OpMode_C "Richtung transmit/receive" VALUE 0x1C0D0B Kw_Wu8 1.000 OneToOne 0.00 1.000 FORMAT "%5.3" EXTENDED_LIMITS 0.00 255.0 READ_ONLY /end CHARACTERISTIC
/begin CHARACTERISTIC FrmMng_dAC1SchedMesgLen_C "Applizierbare Botschaftlänge für AC1" VALUE 0x1C0D0C Kw_Wu8 8.000 OneToOne 0.00 8.000 FORMAT "%5.3" EXTENDED_LIMITS 0.00 255.0 /end CHARACTERISTIC
/begin CHARACTERISTIC FrmMng_AC1IntrEna_C "Interrupt enabled oder nicht" VALUE 0x1C0D0D Kw_Wu8 1.000 OneToOne 0.00 1.000 FORMAT "%5.3" EXTENDED_LIMITS 0.00 255.0 READ_ONLY /end CHARACTERISTIC
/begin CHARACTERISTIC FrmMng_AC1Mul_C "message Buffer ist multiplexed oder nicht" VALUE 0x1C0D0E Kw_Wu8 1.000 OneToOne 0.00 1.000 FORMAT "%5.3" EXTENDED_LIMITS 0.00 255.0 READ_ONLY /end CHARACTERISTIC
/begin CHARACTERISTIC FrmMng_AC1SchedMode_C "CAN Message Schedule Mode fuer RX und TX" VALUE 0x1C0D10 Kw_Wu8 160.0 OneToOne 16.00 176.0 FORMAT "%5.1" EXTENDED_LIMITS 0.00 255.0 READ_ONLY /end CHARACTERISTIC
/begin CHARACTERISTIC FrmMng_AC1Sched_C "Frequenz vom Transfer abhaengig vom Opmode" VALUE 0x1C0D11 Kw_Wu8 254.0 OneToOne 1.000 255.0 FORMAT "%5.1" EXTENDED_LIMITS 0.00 255.0 READ_ONLY /end CHARACTERISTIC
/begin CHARACTERISTIC FrmMng_AC1Strt_C "Message-Transfer-Aktivierung relativ zur Startzeit" VALUE 0x1C0D12 Kw_Wu8 255.0 OneToOne 0.00 255.0 FORMAT "%5.1" READ_ONLY /end CHARACTERISTIC
/begin CHARACTERISTIC FrmMng_AC1TOTmp_C "Timeout" VALUE 0x1C0D13 Kw_Wu8 5100. TimeCAN_TO_ms 20.00 5120. FORMAT "%5.0" /end CHARACTERISTIC
/begin CHARACTERISTIC FrmMng_dACC1ID_C "Identifier der ACC1-Botschaft" VALUE 0x1C0D14 Kw_Wu32 536870911.000 OneToOne 0.00 536870911.000 FORMAT "%13.3" EXTENDED_LIMITS 0.00 4294967295.00 /end CHARACTERISTIC
/begin CHARACTERISTIC FrmMng_ACC1IDType_C "ID Typ standard oder extended" VALUE 0x1C0D18 Kw_Wu8 0.00 OneToOne 1.000 1.000 FORMAT "%5.3" EXTENDED_LIMITS 0.00 255.0 READ_ONLY /end CHARACTERISTIC
/begin CHARACTERISTIC FrmMng_ACC1NumCAN_C "Auf welchen CAN die Botschaft ist" VALUE 0x1C0D19 Kw_Wu8 2.000 OneToOne 0.00 2.000 FORMAT "%5.3" EXTENDED_LIMITS 0.00 255.0 READ_ONLY /end CHARACTERISTIC
/begin CHARACTERISTIC FrmMng_ACC1NumMsgPos_C "Message Buffer der verwendet wird" VALUE 0x1C0D1A Kw_Wu8 15.00 OneToOne 0.00 15.00 FORMAT "%5.2" EXTENDED_LIMITS 0.00 255.0 READ_ONLY /end CHARACTERISTIC
/begin CHARACTERISTIC FrmMng_ACC1OpMode_C "Richtung transmit/receive" VALUE 0x1C0D1B Kw_Wu8 1.000 OneToOne 0.00 1.000 FORMAT "%5.3" EXTENDED_LIMITS 0.00 255.0 READ_ONLY /end CHARACTERISTIC
/begin CHARACTERISTIC FrmMng_dACC1SchedMesgLen_C "Applizierbare Botschaftslänge für ACC1 (Audi - ACC)" VALUE 0x1C0D1C Kw_Wu8 8.000 OneToOne 0.00 8.000 FORMAT "%5.3" EXTENDED_LIMITS 0.00 255.0 /end CHARACTERISTIC
/begin CHARACTERISTIC FrmMng_ACC1IntrEna_C "Interrupt enabled oder nicht" VALUE 0x1C0D1D Kw_Wu8 1.000 OneToOne 0.00 1.000 FORMAT "%5.3" EXTENDED_LIMITS 0.00 255.0 READ_ONLY /end CHARACTERISTIC
/begin CHARACTERISTIC FrmMng_ACC1Mul_C "message Buffer ist multiplexed oder nicht" VALUE 0x1C0D1E Kw_Wu8 1.000 OneToOne 0.00 1.000 FORMAT "%5.3" EXTENDED_LIMITS 0.00 255.0 READ_ONLY /end CHARACTERISTIC
/begin CHARACTERISTIC FrmMng_ACC1TOTmp_C "Timeout" VALUE 0x1D28B0 Kw_Wu8 5100. TimeCAN_TO_ms 20.00 5120. FORMAT "%5.0" /end CHARACTERISTIC
/begin CHARACTERISTIC FrmMng_dACCSysID_C "Botschaftsidentifier CAN-Botschaft ACC System" VALUE 0x1C0D20 Kw_Wu32 536870911.000 OneToOne 0.00 536870911.000 FORMAT "%13.3" EXTENDED_LIMITS 0.00 4294967295.00 /end CHARACTERISTIC
/begin CHARACTERISTIC FrmMng_ACCSysIDType_C "ID Typ standard oder extended" VALUE 0x1C0D24 Kw_Wu8 0.00 OneToOne 1.000 1.000 FORMAT "%5.3" EXTENDED_LIMITS 0.00 255.0 READ_ONLY /end CHARACTERISTIC
/begin CHARACTERISTIC FrmMng_ACCSysNumCAN_C "Auf welchen CAN die Botschaft ist" VALUE 0x1C0D25 Kw_Wu8 2.000 OneToOne 0.00 2.000 FORMAT "%5.3" EXTENDED_LIMITS 0.00 255.0 READ_ONLY /end CHARACTERISTIC
/begin CHARACTERISTIC FrmMng_ACCSysNumMsgPos_C "Message Buffer der verwendet wird" VALUE 0x1C0D26 Kw_Wu8 15.00 OneToOne 0.00 15.00 FORMAT "%5.2" EXTENDED_LIMITS 0.00 255.0 READ_ONLY /end CHARACTERISTIC
/begin CHARACTERISTIC FrmMng_ACCSysOpMode_C "Richtung transmit/receive" VALUE 0x1C0D27 Kw_Wu8 1.000 OneToOne 0.00 1.000 FORMAT "%5.3" EXTENDED_LIMITS 0.00 255.0 READ_ONLY /end CHARACTERISTIC
/begin CHARACTERISTIC FrmMng_dACCSysSchedMesgLen_C "applizierbare Botschaftslänge für ACCSys" VALUE 0x1C0D28 Kw_Wu8 8.000 OneToOne 0.00 8.000 FORMAT "%5.3" EXTENDED_LIMITS 0.00 255.0 /end CHARACTERISTIC
/begin CHARACTERISTIC FrmMng_ACCSysIntrEna_C "Interrupt enabled oder nicht" VALUE 0x1C0D29 Kw_Wu8 1.000 OneToOne 0.00 1.000 FORMAT "%5.3" EXTENDED_LIMITS 0.00 255.0 READ_ONLY /end CHARACTERISTIC
/begin CHARACTERISTIC FrmMng_ACCSysMul_C "message Buffer ist multiplexed oder nicht" VALUE 0x1C0D2A Kw_Wu8 1.000 OneToOne 0.00 1.000 FORMAT "%5.3" EXTENDED_LIMITS 0.00 255.0 READ_ONLY /end CHARACTERISTIC
/begin CHARACTERISTIC FrmMng_ACCSystemSchedMode_C "CAN Message Schedule Mode fuer RX und TX" VALUE 0x1C0D2C Kw_Wu8 160.0 OneToOne 16.00 176.0 FORMAT "%5.1" EXTENDED_LIMITS 0.00 255.0 READ_ONLY /end CHARACTERISTIC
/begin CHARACTERISTIC FrmMng_ACCSystemSched_C "Frequenz vom Transfer abhaengig vom Opmode" VALUE 0x1C0D2D Kw_Wu8 254.0 OneToOne 1.000 255.0 FORMAT "%5.1" EXTENDED_LIMITS 0.00 255.0 READ_ONLY /end CHARACTERISTIC
/begin CHARACTERISTIC FrmMng_ACCSystemStrt_C "Message-Transfer-Aktivierung relativ zur Startzeit" VALUE 0x1C0D2E Kw_Wu8 255.0 OneToOne 0.00 255.0 FORMAT "%5.1" READ_ONLY /end CHARACTERISTIC
/begin CHARACTERISTIC FrmMng_ACCSystemTOTmp_C "Timeout" VALUE 0x1C0D2F Kw_Wu8 5100. TimeCAN_TO_ms 20.00 5120. FORMAT "%5.0" /end CHARACTERISTIC
/begin CHARACTERISTIC FrmMng_tiAdpPT1_C "PT1 Filterzeit für die Reibmomnetendifferenzbildung" VALUE 0x1D2588 Kw_Wu32 4294.9673 TimeDelay_s 0.0000010000000 4294.9673 FORMAT "%9.4" /end CHARACTERISTIC
/begin CHARACTERISTIC FrmMng_dAIRBG1ID_C "Botschaftsidentifier CAN-Botschaft AIRBG1" VALUE 0x1C0D30 Kw_Wu32 536870911.000 OneToOne 0.00 536870911.000 FORMAT "%13.3" EXTENDED_LIMITS 0.00 4294967295.00 /end CHARACTERISTIC
/begin CHARACTERISTIC FrmMng_AIRBG1IDType_C "ID Typ standard oder extended" VALUE 0x1C0D34 Kw_Wu8 0.00 OneToOne 1.000 1.000 FORMAT "%5.3" EXTENDED_LIMITS 0.00 255.0 READ_ONLY /end CHARACTERISTIC
/begin CHARACTERISTIC FrmMng_AIRBG1NumCAN_C "Auf welchen CAN die Botschaft ist" VALUE 0x1C0D35 Kw_Wu8 2.000 OneToOne 0.00 2.000 FORMAT "%5.3" EXTENDED_LIMITS 0.00 255.0 READ_ONLY /end CHARACTERISTIC
/begin CHARACTERISTIC FrmMng_AIRBG1NumMsgPos_C "Message Buffer der verwendet wird" VALUE 0x1C0D36 Kw_Wu8 15.00 OneToOne 0.00 15.00 FORMAT "%5.2" EXTENDED_LIMITS 0.00 255.0 READ_ONLY /end CHARACTERISTIC
/begin CHARACTERISTIC FrmMng_AIRBG1OpMode_C "Richtung transmit/receive" VALUE 0x1C0D37 Kw_Wu8 1.000 OneToOne 0.00 1.000 FORMAT "%5.3" EXTENDED_LIMITS 0.00 255.0 READ_ONLY /end CHARACTERISTIC
/begin CHARACTERISTIC FrmMng_dAIRBG1SchedMesgLen_C "Applizierbare Botschaftlänge für AIRBG1" VALUE 0x1C0D38 Kw_Wu8 8.000 OneToOne 0.00 8.000 FORMAT "%5.3" EXTENDED_LIMITS 0.00 255.0 /end CHARACTERISTIC
/begin CHARACTERISTIC FrmMng_AIRBG1IntrEna_C "Interrupt enabled oder nicht" VALUE 0x1C0D39 Kw_Wu8 1.000 OneToOne 0.00 1.000 FORMAT "%5.3" EXTENDED_LIMITS 0.00 255.0 READ_ONLY /end CHARACTERISTIC
/begin CHARACTERISTIC FrmMng_AIRBG1Mul_C "message Buffer ist multiplexed oder nicht" VALUE 0x1C0D3A Kw_Wu8 1.000 OneToOne 0.00 1.000 FORMAT "%5.3" EXTENDED_LIMITS 0.00 255.0 READ_ONLY /end CHARACTERISTIC
/begin CHARACTERISTIC FrmMng_AIRBG1SchedMode_C "CAN Message Schedule Mode fuer RX und TX" VALUE 0x1C0D3C Kw_Wu8 160.0 OneToOne 16.00 176.0 FORMAT "%5.1" EXTENDED_LIMITS 0.00 255.0 READ_ONLY /end CHARACTERISTIC
/begin CHARACTERISTIC FrmMng_AIRBG1Sched_C "Frequenz vom Transfer abhaengig vom Opmode" VALUE 0x1C0D3D Kw_Wu8 254.0 OneToOne 1.000 255.0 FORMAT "%5.1" EXTENDED_LIMITS 0.00 255.0 READ_ONLY /end CHARACTERISTIC
/begin CHARACTERISTIC FrmMng_AIRBG1Strt_C "Message-Transfer-Aktivierung relativ zur Startzeit" VALUE 0x1C0D3E Kw_Wu8 255.0 OneToOne 0.00 255.0 FORMAT "%5.1" READ_ONLY /end CHARACTERISTIC
/begin CHARACTERISTIC FrmMng_AIRBG1TOTmp_C "Timeout" VALUE 0x1C0D3F Kw_Wu8 5100. TimeCAN_TO_ms 20.00 5120. FORMAT "%5.0" /end CHARACTERISTIC
/begin CHARACTERISTIC FrmMng_dAWD1ID_C "Message Identifier der CAN Botschaft Allrad1" VALUE 0x1C0D40 Kw_Wu32 536870911.000 OneToOne 0.00 536870911.000 FORMAT "%13.3" EXTENDED_LIMITS 0.00 4294967295.00 /end CHARACTERISTIC
/begin CHARACTERISTIC FrmMng_AWD1IDType_C "ID Typ standard oder extended" VALUE 0x1C0D44 Kw_Wu8 0.00 OneToOne 1.000 1.000 FORMAT "%5.3" EXTENDED_LIMITS 0.00 255.0 READ_ONLY /end CHARACTERISTIC
/begin CHARACTERISTIC FrmMng_AWD1NumCAN_C "Auf welchen CAN die Botschaft ist" VALUE 0x1C0D45 Kw_Wu8 2.000 OneToOne 0.00 2.000 FORMAT "%5.3" EXTENDED_LIMITS 0.00 255.0 READ_ONLY /end CHARACTERISTIC
/begin CHARACTERISTIC FrmMng_AWD1NumMsgPos_C "Message Buffer der verwendet wird" VALUE 0x1C0D46 Kw_Wu8 15.00 OneToOne 0.00 15.00 FORMAT "%5.2" EXTENDED_LIMITS 0.00 255.0 READ_ONLY /end CHARACTERISTIC
/begin CHARACTERISTIC FrmMng_AWD1OpMode_C "Richtung transmit/receive" VALUE 0x1C0D47 Kw_Wu8 1.000 OneToOne 0.00 1.000 FORMAT "%5.3" EXTENDED_LIMITS 0.00 255.0 READ_ONLY /end CHARACTERISTIC
/begin CHARACTERISTIC FrmMng_dAWD1SchedMesgLen_C "Applizierbare Botschaftlänge für AWD1" VALUE 0x1C0D48 Kw_Wu8 8.000 OneToOne 0.00 8.000 FORMAT "%5.3" EXTENDED_LIMITS 0.00 255.0 /end CHARACTERISTIC
/begin CHARACTERISTIC FrmMng_AWD1IntrEna_C "Interrupt enabled oder nicht" VALUE 0x1C0D49 Kw_Wu8 1.000 OneToOne 0.00 1.000 FORMAT "%5.3" EXTENDED_LIMITS 0.00 255.0 READ_ONLY /end CHARACTERISTIC
/begin CHARACTERISTIC FrmMng_AWD1Mul_C "message Buffer ist multiplexed oder nicht" VALUE 0x1C0D4A Kw_Wu8 1.000 OneToOne 0.00 1.000 FORMAT "%5.3" EXTENDED_LIMITS 0.00 255.0 READ_ONLY /end CHARACTERISTIC
/begin CHARACTERISTIC FrmMng_AWD1SchedMode_C "CAN Message Schedule Mode fuer RX und TX" VALUE 0x1C0D4C Kw_Wu8 160.0 OneToOne 16.00 176.0 FORMAT "%5.1" EXTENDED_LIMITS 0.00 255.0 READ_ONLY /end CHARACTERISTIC
/begin CHARACTERISTIC FrmMng_AWD1Sched_C "Frequenz vom Transfer abhaengig vom Opmode" VALUE 0x1C0D4D Kw_Wu8 254.0 OneToOne 1.000 255.0 FORMAT "%5.1" EXTENDED_LIMITS 0.00 255.0 READ_ONLY /end CHARACTERISTIC
/begin CHARACTERISTIC FrmMng_AWD1Strt_C "Message-Transfer-Aktivierung relativ zur Startzeit" VALUE 0x1C0D4E Kw_Wu8 255.0 OneToOne 0.00 255.0 FORMAT "%5.1" READ_ONLY /end CHARACTERISTIC
/begin CHARACTERISTIC FrmMng_AWD1TOTmp_C "Timeout" VALUE 0x1C0D4F Kw_Wu8 5100. TimeCAN_TO_ms 20.00 5120. FORMAT "%5.0" /end CHARACTERISTIC
/begin CHARACTERISTIC FrmMng_dBEM1ID_C "CAN Botschafts-ID für BEM1-Botschaft" VALUE 0x1C0D50 Kw_Wu32 536870911.000 OneToOne 0.00 536870911.000 FORMAT "%13.3" EXTENDED_LIMITS 0.00 4294967295.00 /end CHARACTERISTIC
/begin CHARACTERISTIC FrmMng_BEM1IDType_C "ID Typ standard oder extended" VALUE 0x1C0D54 Kw_Wu8 0.00 OneToOne 1.000 1.000 FORMAT "%5.3" EXTENDED_LIMITS 0.00 255.0 READ_ONLY /end CHARACTERISTIC
/begin CHARACTERISTIC FrmMng_BEM1NumCAN_C "Auf welchen CAN die Botschaft ist" VALUE 0x1C0D55 Kw_Wu8 2.000 OneToOne 0.00 2.000 FORMAT "%5.3" EXTENDED_LIMITS 0.00 255.0 READ_ONLY /end CHARACTERISTIC
/begin CHARACTERISTIC FrmMng_BEM1NumMsgPos_C "Message Buffer der verwendet wird" VALUE 0x1C0D56 Kw_Wu8 15.00 OneToOne 0.00 15.00 FORMAT "%5.2" EXTENDED_LIMITS 0.00 255.0 READ_ONLY /end CHARACTERISTIC
/begin CHARACTERISTIC FrmMng_BEM1OpMode_C "Richtung transmit/receive" VALUE 0x1C0D57 Kw_Wu8 1.000 OneToOne 0.00 1.000 FORMAT "%5.3" EXTENDED_LIMITS 0.00 255.0 READ_ONLY /end CHARACTERISTIC
/begin CHARACTERISTIC FrmMng_dBEM1SchedMesgLen_C "CAN Botschaftslänge fü BEM1-Botschaft" VALUE 0x1C0D58 Kw_Wu8 8.000 OneToOne 0.00 8.000 FORMAT "%5.3" EXTENDED_LIMITS 0.00 255.0 /end CHARACTERISTIC
/begin CHARACTERISTIC FrmMng_BEM1IntrEna_C "Interrupt enabled oder nicht" VALUE 0x1C0D59 Kw_Wu8 1.000 OneToOne 0.00 1.000 FORMAT "%5.3" EXTENDED_LIMITS 0.00 255.0 READ_ONLY /end CHARACTERISTIC
/begin CHARACTERISTIC FrmMng_BEM1Mul_C "message Buffer ist multiplexed oder nicht" VALUE 0x1C0D5A Kw_Wu8 1.000 OneToOne 0.00 1.000 FORMAT "%5.3" EXTENDED_LIMITS 0.00 255.0 READ_ONLY /end CHARACTERISTIC
/begin CHARACTERISTIC FrmMng_BEM1SchedMode_C "CAN Message Schedule Mode fuer RX und TX" VALUE 0x1C0D5C Kw_Wu8 160.0 OneToOne 16.00 176.0 FORMAT "%5.1" EXTENDED_LIMITS 0.00 255.0 READ_ONLY /end CHARACTERISTIC
/begin CHARACTERISTIC FrmMng_BEM1Sched_C "Frequenz vom Transfer abhaengig vom Opmode" VALUE 0x1C0D5D Kw_Wu8 254.0 OneToOne 1.000 255.0 FORMAT "%5.1" EXTENDED_LIMITS 0.00 255.0 READ_ONLY /end CHARACTERISTIC
/begin CHARACTERISTIC FrmMng_BEM1Strt_C "Message-Transfer-Aktivierung relativ zur Startzeit" VALUE 0x1C0D5E Kw_Wu8 255.0 OneToOne 0.00 255.0 FORMAT "%5.1" READ_ONLY /end CHARACTERISTIC
/begin CHARACTERISTIC FrmMng_BEM1TOTmp_C "Timeout" VALUE 0x1C0D5F Kw_Wu8 5100. TimeCAN_TO_ms 20.00 5120. FORMAT "%5.0" /end CHARACTERISTIC
/begin CHARACTERISTIC FrmMng_dBRK1ID_C "Botschaftsidentifier CAN-Botschaft BRK1" VALUE 0x1C0D60 Kw_Wu32 536870911.000 OneToOne 0.00 536870911.000 FORMAT "%13.3" EXTENDED_LIMITS 0.00 4294967295.00 /end CHARACTERISTIC
/begin CHARACTERISTIC FrmMng_BRK1IDType_C "ID Typ standard oder extended" VALUE 0x1C0D64 Kw_Wu8 0.00 OneToOne 1.000 1.000 FORMAT "%5.3" EXTENDED_LIMITS 0.00 255.0 READ_ONLY /end CHARACTERISTIC
/begin CHARACTERISTIC FrmMng_BRK1NumCAN_C "Auf welchen CAN die Botschaft ist" VALUE 0x1C0D65 Kw_Wu8 2.000 OneToOne 0.00 2.000 FORMAT "%5.3" EXTENDED_LIMITS 0.00 255.0 READ_ONLY /end CHARACTERISTIC
/begin CHARACTERISTIC FrmMng_BRK1NumMsgPos_C "Message Buffer der verwendet wird" VALUE 0x1C0D66 Kw_Wu8 15.00 OneToOne 0.00 15.00 FORMAT "%5.2" EXTENDED_LIMITS 0.00 255.0 READ_ONLY /end CHARACTERISTIC
/begin CHARACTERISTIC FrmMng_BRK1OpMode_C "Richtung transmit/receive" VALUE 0x1C0D67 Kw_Wu8 1.000 OneToOne 0.00 1.000 FORMAT "%5.3" EXTENDED_LIMITS 0.00 255.0 READ_ONLY /end CHARACTERISTIC
/begin CHARACTERISTIC FrmMng_dBRK1SchedMesgLen_C "Applizierbare Botschaftlänge für BRK1" VALUE 0x1C0D68 Kw_Wu8 8.000 OneToOne 0.00 8.000 FORMAT "%5.3" EXTENDED_LIMITS 0.00 255.0 /end CHARACTERISTIC
/begin CHARACTERISTIC FrmMng_BRK1IntrEna_C "Interrupt enabled oder nicht" VALUE 0x1C0D69 Kw_Wu8 1.000 OneToOne 0.00 1.000 FORMAT "%5.3" EXTENDED_LIMITS 0.00 255.0 READ_ONLY /end CHARACTERISTIC
/begin CHARACTERISTIC FrmMng_BRK1Mul_C "message Buffer ist multiplexed oder nicht" VALUE 0x1C0D6A Kw_Wu8 1.000 OneToOne 0.00 1.000 FORMAT "%5.3" EXTENDED_LIMITS 0.00 255.0 READ_ONLY /end CHARACTERISTIC
/begin CHARACTERISTIC FrmMng_BRK1SchedMode_C "CAN Message Schedule Mode fuer RX und TX" VALUE 0x1C0D6C Kw_Wu8 160.0 OneToOne 16.00 176.0 FORMAT "%5.1" EXTENDED_LIMITS 0.00 255.0 READ_ONLY /end CHARACTERISTIC
/begin CHARACTERISTIC FrmMng_BRK1Sched_C "Frequenz vom Transfer abhaengig vom Opmode" VALUE 0x1C0D6D Kw_Wu8 254.0 OneToOne 1.000 255.0 FORMAT "%5.1" EXTENDED_LIMITS 0.00 255.0 READ_ONLY /end CHARACTERISTIC
/begin CHARACTERISTIC FrmMng_BRK1Strt_C "Message-Transfer-Aktivierung relativ zur Startzeit" VALUE 0x1C0D6E Kw_Wu8 255.0 OneToOne 0.00 255.0 FORMAT "%5.1" READ_ONLY /end CHARACTERISTIC
/begin CHARACTERISTIC FrmMng_BRK1TOTmp_C "Timeout" VALUE 0x1C0D6F Kw_Wu8 5100. TimeCAN_TO_ms 20.00 5120. FORMAT "%5.0" /end CHARACTERISTIC
/begin CHARACTERISTIC FrmMng_dBRK2ID_C "Botschaftsidentifier CAN-Botschaft BRK2" VALUE 0x1C0D70 Kw_Wu32 536870911.000 OneToOne 0.00 536870911.000 FORMAT "%13.3" EXTENDED_LIMITS 0.00 4294967295.00 /end CHARACTERISTIC
/begin CHARACTERISTIC FrmMng_BRK2IDType_C "ID Typ standard oder extended" VALUE 0x1C0D74 Kw_Wu8 0.00 OneToOne 1.000 1.000 FORMAT "%5.3" EXTENDED_LIMITS 0.00 255.0 READ_ONLY /end CHARACTERISTIC
/begin CHARACTERISTIC FrmMng_BRK2NumCAN_C "Auf welchen CAN die Botschaft ist" VALUE 0x1C0D75 Kw_Wu8 2.000 OneToOne 0.00 2.000 FORMAT "%5.3" EXTENDED_LIMITS 0.00 255.0 READ_ONLY /end CHARACTERISTIC
/begin CHARACTERISTIC FrmMng_BRK2NumMsgPos_C "Message Buffer der verwendet wird" VALUE 0x1C0D76 Kw_Wu8 15.00 OneToOne 0.00 15.00 FORMAT "%5.2" EXTENDED_LIMITS 0.00 255.0 READ_ONLY /end CHARACTERISTIC
/begin CHARACTERISTIC FrmMng_BRK2OpMode_C "Richtung transmit/receive" VALUE 0x1C0D77 Kw_Wu8 1.000 OneToOne 0.00 1.000 FORMAT "%5.3" EXTENDED_LIMITS 0.00 255.0 READ_ONLY /end CHARACTERISTIC
/begin CHARACTERISTIC FrmMng_dBRK2SchedMesgLen_C "Applizierbare Botschaftlänge für BRK2" VALUE 0x1C0D78 Kw_Wu8 8.000 OneToOne 0.00 8.000 FORMAT "%5.3" EXTENDED_LIMITS 0.00 255.0 /end CHARACTERISTIC
/begin CHARACTERISTIC FrmMng_BRK2IntrEna_C "Interrupt enabled oder nicht" VALUE 0x1C0D79 Kw_Wu8 1.000 OneToOne 0.00 1.000 FORMAT "%5.3" EXTENDED_LIMITS 0.00 255.0 READ_ONLY /end CHARACTERISTIC
/begin CHARACTERISTIC FrmMng_BRK2Mul_C "message Buffer ist multiplexed oder nicht" VALUE 0x1C0D7A Kw_Wu8 1.000 OneToOne 0.00 1.000 FORMAT "%5.3" EXTENDED_LIMITS 0.00 255.0 READ_ONLY /end CHARACTERISTIC
/begin CHARACTERISTIC FrmMng_BRK2SchedMode_C "CAN Message Schedule Mode fuer RX und TX" VALUE 0x1C0D7C Kw_Wu8 160.0 OneToOne 16.00 176.0 FORMAT "%5.1" EXTENDED_LIMITS 0.00 255.0 READ_ONLY /end CHARACTERISTIC
/begin CHARACTERISTIC FrmMng_BRK2Sched_C "Frequenz vom Transfer abhaengig vom Opmode" VALUE 0x1C0D7D Kw_Wu8 254.0 OneToOne 1.000 255.0 FORMAT "%5.1" EXTENDED_LIMITS 0.00 255.0 READ_ONLY /end CHARACTERISTIC
/begin CHARACTERISTIC FrmMng_BRK2Strt_C "Message-Transfer-Aktivierung relativ zur Startzeit" VALUE 0x1C0D7E Kw_Wu8 255.0 OneToOne 0.00 255.0 FORMAT "%5.1" READ_ONLY /end CHARACTERISTIC
/begin CHARACTERISTIC FrmMng_BRK2TOTmp_C "Timeout" VALUE 0x1C0D7F Kw_Wu8 5100. TimeCAN_TO_ms 20.00 5120. FORMAT "%5.0" /end CHARACTERISTIC
/begin CHARACTERISTIC FrmMng_dBRK8ID_C "Botschaftsidentifier CAN-Botschaft BRK8" VALUE 0x1C0D80 Kw_Wu32 536870911.000 OneToOne 0.00 536870911.000 FORMAT "%13.3" EXTENDED_LIMITS 0.00 4294967295.00 /end CHARACTERISTIC
/begin CHARACTERISTIC FrmMng_BRK8IDType_C "ID Typ standard oder extended" VALUE 0x1C0D84 Kw_Wu8 0.00 OneToOne 1.000 1.000 FORMAT "%5.3" EXTENDED_LIMITS 0.00 255.0 READ_ONLY /end CHARACTERISTIC
/begin CHARACTERISTIC FrmMng_BRK8NumCAN_C "Auf welchen CAN die Botschaft ist" VALUE 0x1C0D85 Kw_Wu8 2.000 OneToOne 0.00 2.000 FORMAT "%5.3" EXTENDED_LIMITS 0.00 255.0 READ_ONLY /end CHARACTERISTIC
/begin CHARACTERISTIC FrmMng_BRK8NumMsgPos_C "Message Buffer der verwendet wird" VALUE 0x1C0D86 Kw_Wu8 15.00 OneToOne 0.00 15.00 FORMAT "%5.2" EXTENDED_LIMITS 0.00 255.0 READ_ONLY /end CHARACTERISTIC
/begin CHARACTERISTIC FrmMng_BRK8OpMode_C "Richtung transmit/receive" VALUE 0x1C0D87 Kw_Wu8 1.000 OneToOne 0.00 1.000 FORMAT "%5.3" EXTENDED_LIMITS 0.00 255.0 READ_ONLY /end CHARACTERISTIC
/begin CHARACTERISTIC FrmMng_dBRK8SchedMesgLen_C "Applizierbare Botschaftlänge für BRK8" VALUE 0x1C0D88 Kw_Wu8 8.000 OneToOne 0.00 8.000 FORMAT "%5.3" EXTENDED_LIMITS 0.00 255.0 /end CHARACTERISTIC
/begin CHARACTERISTIC FrmMng_BRK8IntrEna_C "Interrupt enabled oder nicht" VALUE 0x1C0D89 Kw_Wu8 1.000 OneToOne 0.00 1.000 FORMAT "%5.3" EXTENDED_LIMITS 0.00 255.0 READ_ONLY /end CHARACTERISTIC
/begin CHARACTERISTIC FrmMng_BRK8Mul_C "message Buffer ist multiplexed oder nicht" VALUE 0x1C0D8A Kw_Wu8 1.000 OneToOne 0.00 1.000 FORMAT "%5.3" EXTENDED_LIMITS 0.00 255.0 READ_ONLY /end CHARACTERISTIC
/begin CHARACTERISTIC FrmMng_BRK8SchedMode_C "CAN Message Schedule Mode fuer RX und TX" VALUE 0x1C0D8C Kw_Wu8 160.0 OneToOne 16.00 176.0 FORMAT "%5.1" EXTENDED_LIMITS 0.00 255.0 READ_ONLY /end CHARACTERISTIC
/begin CHARACTERISTIC FrmMng_BRK8Sched_C "Frequenz vom Transfer abhaengig vom Opmode" VALUE 0x1C0D8D Kw_Wu8 254.0 OneToOne 1.000 255.0 FORMAT "%5.1" EXTENDED_LIMITS 0.00 255.0 READ_ONLY /end CHARACTERISTIC
/begin CHARACTERISTIC FrmMng_BRK8Strt_C "Message-Transfer-Aktivierung relativ zur Startzeit" VALUE 0x1C0D8E Kw_Wu8 255.0 OneToOne 0.00 255.0 FORMAT "%5.1" READ_ONLY /end CHARACTERISTIC
/begin CHARACTERISTIC FrmMng_BRK8TOTmp_C "Timeout" VALUE 0x1C0D8F Kw_Wu8 5100. TimeCAN_TO_ms 20.00 5120. FORMAT "%5.0" /end CHARACTERISTIC
/begin CHARACTERISTIC FrmMng_BUF1MsgID_C "Botschaftsidentifier CAN-Botschaft BUF1" VALUE 0x1C0D90 Kw_Wu32 536870911.000 OneToOne 0.00 536870911.000 FORMAT "%13.3" EXTENDED_LIMITS 0.00 4294967295.00 READ_ONLY /end CHARACTERISTIC
/begin CHARACTERISTIC FrmMng_BUF1IDType_C "ID Typ standard oder extended" VALUE 0x1C0D94 Kw_Wu8 0.00 OneToOne 1.000 1.000 FORMAT "%5.3" EXTENDED_LIMITS 0.00 255.0 READ_ONLY /end CHARACTERISTIC
/begin CHARACTERISTIC FrmMng_BUF1NumCAN_C "Auf welchen CAN die Botschaft ist" VALUE 0x1C0D95 Kw_Wu8 2.000 OneToOne 0.00 2.000 FORMAT "%5.3" EXTENDED_LIMITS 0.00 255.0 READ_ONLY /end CHARACTERISTIC
/begin CHARACTERISTIC FrmMng_BUF1NumMsgPos_C "Message Buffer der verwendet wird" VALUE 0x1C0D96 Kw_Wu8 15.00 OneToOne 0.00 15.00 FORMAT "%5.2" EXTENDED_LIMITS 0.00 255.0 READ_ONLY /end CHARACTERISTIC
/begin CHARACTERISTIC FrmMng_BUF1OpMode_C "Richtung transmit/receive" VALUE 0x1C0D97 Kw_Wu8 1.000 OneToOne 0.00 1.000 FORMAT "%5.3" EXTENDED_LIMITS 0.00 255.0 READ_ONLY /end CHARACTERISTIC
/begin CHARACTERISTIC FrmMng_dBuf1Len_cu8 "Laenge der Messagedaten in Byte" VALUE 0x1C0D98 Kw_Wu8 8.000 OneToOne 0.00 8.000 FORMAT "%5.3" EXTENDED_LIMITS 0.00 255.0 READ_ONLY /end CHARACTERISTIC
/begin CHARACTERISTIC FrmMng_BUF1IntrEna_C "Interrupt enabled oder nicht" VALUE 0x1C0D99 Kw_Wu8 1.000 OneToOne 0.00 1.000 FORMAT "%5.3" EXTENDED_LIMITS 0.00 255.0 READ_ONLY /end CHARACTERISTIC
/begin CHARACTERISTIC FrmMng_BUF1Mul_C "message Buffer ist multiplexed oder nicht" VALUE 0x1C0D9A Kw_Wu8 1.000 OneToOne 0.00 1.000 FORMAT "%5.3" EXTENDED_LIMITS 0.00 255.0 READ_ONLY /end CHARACTERISTIC
/begin CHARACTERISTIC FrmMng_dCCTLID_C "Botschaftsidentifier CAN-Botschaft CCTL" VALUE 0x1C0D9C Kw_Wu32 536870911.000 OneToOne 0.00 536870911.000 FORMAT "%13.3" EXTENDED_LIMITS 0.00 4294967295.00 /end CHARACTERISTIC
/begin CHARACTERISTIC FrmMng_CCTLIDType_C "ID Typ standard oder extended" VALUE 0x1C0DA0 Kw_Wu8 0.00 OneToOne 1.000 1.000 FORMAT "%5.3" EXTENDED_LIMITS 0.00 255.0 READ_ONLY /end CHARACTERISTIC
/begin CHARACTERISTIC FrmMng_CCTLNumCAN_C "Auf welchen CAN die Botschaft ist" VALUE 0x1C0DA1 Kw_Wu8 2.000 OneToOne 0.00 2.000 FORMAT "%5.3" EXTENDED_LIMITS 0.00 255.0 READ_ONLY /end CHARACTERISTIC
/begin CHARACTERISTIC FrmMng_CCTLNumMsgPos_C "Message Buffer der verwendet wird" VALUE 0x1C0DA2 Kw_Wu8 15.00 OneToOne 0.00 15.00 FORMAT "%5.2" EXTENDED_LIMITS 0.00 255.0 READ_ONLY /end CHARACTERISTIC
/begin CHARACTERISTIC FrmMng_CCTLOpMode_C "Richtung transmit/receive" VALUE 0x1C0DA3 Kw_Wu8 1.000 OneToOne 0.00 1.000 FORMAT "%5.3" EXTENDED_LIMITS 0.00 255.0 READ_ONLY /end CHARACTERISTIC
/begin CHARACTERISTIC FrmMng_dCCTLSchedMesgLen_C "Applizierbare Botschaftlänge für CCTL" VALUE 0x1C0DA4 Kw_Wu8 8.000 OneToOne 0.00 8.000 FORMAT "%5.3" EXTENDED_LIMITS 0.00 255.0 /end CHARACTERISTIC
/begin CHARACTERISTIC FrmMng_CCTLIntrEna_C "Interrupt enabled oder nicht" VALUE 0x1C0DA5 Kw_Wu8 1.000 OneToOne 0.00 1.000 FORMAT "%5.3" EXTENDED_LIMITS 0.00 255.0 READ_ONLY /end CHARACTERISTIC
/begin CHARACTERISTIC FrmMng_CCTLMul_C "message Buffer ist multiplexed oder nicht" VALUE 0x1C0DA6 Kw_Wu8 1.000 OneToOne 0.00 1.000 FORMAT "%5.3" EXTENDED_LIMITS 0.00 255.0 READ_ONLY /end CHARACTERISTIC
/begin CHARACTERISTIC FrmMng_CCTLSchedMode_C "CAN Message Schedule Mode fuer RX und TX" VALUE 0x1C0DA8 Kw_Wu8 160.0 OneToOne 16.00 176.0 FORMAT "%5.1" EXTENDED_LIMITS 0.00 255.0 READ_ONLY /end CHARACTERISTIC
/begin CHARACTERISTIC FrmMng_CCTLSched_C "Frequenz vom Transfer abhaengig vom Opmode" VALUE 0x1C0DA9 Kw_Wu8 254.0 OneToOne 1.000 255.0 FORMAT "%5.1" EXTENDED_LIMITS 0.00 255.0 READ_ONLY /end CHARACTERISTIC
/begin CHARACTERISTIC FrmMng_CCTLStrt_C "Message-Transfer-Aktivierung relativ zur Startzeit" VALUE 0x1C0DAA Kw_Wu8 255.0 OneToOne 0.00 255.0 FORMAT "%5.1" READ_ONLY /end CHARACTERISTIC
/begin CHARACTERISTIC FrmMng_CCTLTOTmp_C "Timeout" VALUE 0x1C0DAB Kw_Wu8 5100. TimeCAN_TO_ms 20.00 5120. FORMAT "%5.0" /end CHARACTERISTIC
/begin CHARACTERISTIC FrmMng_dCHRGR1ID_C "Botschaftsidentifier CAN-Botschaft CHRGR1" VALUE 0x1C0DAC Kw_Wu32 536870911.000 OneToOne 0.00 536870911.000 FORMAT "%13.3" EXTENDED_LIMITS 0.00 4294967295.00 /end CHARACTERISTIC
/begin CHARACTERISTIC FrmMng_CHRGR1IDType_C "ID Typ standard oder extended" VALUE 0x1C0DB0 Kw_Wu8 0.00 OneToOne 1.000 1.000 FORMAT "%5.3" EXTENDED_LIMITS 0.00 255.0 READ_ONLY /end CHARACTERISTIC
/begin CHARACTERISTIC FrmMng_CHRGR1NumCAN_C "Auf welchen CAN die Botschaft ist" VALUE 0x1C0DB1 Kw_Wu8 2.000 OneToOne 0.00 2.000 FORMAT "%5.3" EXTENDED_LIMITS 0.00 255.0 READ_ONLY /end CHARACTERISTIC
/begin CHARACTERISTIC FrmMng_CHRGR1NumMsgPos_C "Message Buffer der verwendet wird" VALUE 0x1C0DB2 Kw_Wu8 15.00 OneToOne 0.00 15.00 FORMAT "%5.2" EXTENDED_LIMITS 0.00 255.0 READ_ONLY /end CHARACTERISTIC
/begin CHARACTERISTIC FrmMng_CHRGR1OpMode_C "Richtung transmit/receive" VALUE 0x1C0DB3 Kw_Wu8 1.000 OneToOne 0.00 1.000 FORMAT "%5.3" EXTENDED_LIMITS 0.00 255.0 READ_ONLY /end CHARACTERISTIC
/begin CHARACTERISTIC FrmMng_dCHRGR1SchedMesgLen_C "Applizierbare Botschaftlänge für CHRGR1" VALUE 0x1C0DB4 Kw_Wu8 8.000 OneToOne 0.00 8.000 FORMAT "%5.3" EXTENDED_LIMITS 0.00 255.0 /end CHARACTERISTIC
/begin CHARACTERISTIC FrmMng_CHRGR1IntrEna_C "Interrupt enabled oder nicht" VALUE 0x1C0DB5 Kw_Wu8 1.000 OneToOne 0.00 1.000 FORMAT "%5.3" EXTENDED_LIMITS 0.00 255.0 READ_ONLY /end CHARACTERISTIC
/begin CHARACTERISTIC FrmMng_CHRGR1Mul_C "message Buffer ist multiplexed oder nicht" VALUE 0x1C0DB6 Kw_Wu8 1.000 OneToOne 0.00 1.000 FORMAT "%5.3" EXTENDED_LIMITS 0.00 255.0 READ_ONLY /end CHARACTERISTIC
/begin CHARACTERISTIC FrmMng_CHRGR1SchedMode_C "CAN Message Schedule Mode fuer RX und TX" VALUE 0x1C0DB8 Kw_Wu8 160.0 OneToOne 16.00 176.0 FORMAT "%5.1" EXTENDED_LIMITS 0.00 255.0 READ_ONLY /end CHARACTERISTIC
/begin CHARACTERISTIC FrmMng_CHRGR1Sched_C "Frequenz vom Transfer abhaengig vom Opmode" VALUE 0x1C0DB9 Kw_Wu8 254.0 OneToOne 1.000 255.0 FORMAT "%5.1" EXTENDED_LIMITS 0.00 255.0 READ_ONLY /end CHARACTERISTIC
/begin CHARACTERISTIC FrmMng_CHRGR1Strt_C "Message-Transfer-Aktivierung relativ zur Startzeit" VALUE 0x1C0DBA Kw_Wu8 255.0 OneToOne 0.00 255.0 FORMAT "%5.1" READ_ONLY /end CHARACTERISTIC
/begin CHARACTERISTIC FrmMng_CHRGR1TOTmp_C "Timeout" VALUE 0x1C0DBB Kw_Wu8 5100. TimeCAN_TO_ms 20.00 5120. FORMAT "%5.0" /end CHARACTERISTIC
/begin CHARACTERISTIC FrmMng_dCHRGR2ID_C "Botschaftsidentifier CAN-Botschaft CHRGR2" VALUE 0x1C0DBC Kw_Wu32 536870911.000 OneToOne 0.00 536870911.000 FORMAT "%13.3" EXTENDED_LIMITS 0.00 4294967295.00 /end CHARACTERISTIC
/begin CHARACTERISTIC FrmMng_CHRGR2IDType_C "ID Typ standard oder extended" VALUE 0x1C0DC0 Kw_Wu8 0.00 OneToOne 1.000 1.000 FORMAT "%5.3" EXTENDED_LIMITS 0.00 255.0 READ_ONLY /end CHARACTERISTIC
/begin CHARACTERISTIC FrmMng_CHRGR2NumCAN_C "Auf welchen CAN die Botschaft ist" VALUE 0x1C0DC1 Kw_Wu8 2.000 OneToOne 0.00 2.000 FORMAT "%5.3" EXTENDED_LIMITS 0.00 255.0 READ_ONLY /end CHARACTERISTIC
/begin CHARACTERISTIC FrmMng_CHRGR2NumMsgPos_C "Message Buffer der verwendet wird" VALUE 0x1C0DC2 Kw_Wu8 15.00 OneToOne 0.00 15.00 FORMAT "%5.2" EXTENDED_LIMITS 0.00 255.0 READ_ONLY /end CHARACTERISTIC
/begin CHARACTERISTIC FrmMng_CHRGR2OpMode_C "Richtung transmit/receive" VALUE 0x1C0DC3 Kw_Wu8 1.000 OneToOne 0.00 1.000 FORMAT "%5.3" EXTENDED_LIMITS 0.00 255.0 READ_ONLY /end CHARACTERISTIC
/begin CHARACTERISTIC FrmMng_dCHRGR2SchedMesgLen_C "Applizierbare Botschaftlänge für CHRGR2" VALUE 0x1C0DC4 Kw_Wu8 8.000 OneToOne 0.00 8.000 FORMAT "%5.3" EXTENDED_LIMITS 0.00 255.0 /end CHARACTERISTIC
/begin CHARACTERISTIC FrmMng_CHRGR2IntrEna_C "Interrupt enabled oder nicht" VALUE 0x1C0DC5 Kw_Wu8 1.000 OneToOne 0.00 1.000 FORMAT "%5.3" EXTENDED_LIMITS 0.00 255.0 READ_ONLY /end CHARACTERISTIC
/begin CHARACTERISTIC FrmMng_CHRGR2Mul_C "message Buffer ist multiplexed oder nicht" VALUE 0x1C0DC6 Kw_Wu8 1.000 OneToOne 0.00 1.000 FORMAT "%5.3" EXTENDED_LIMITS 0.00 255.0 READ_ONLY /end CHARACTERISTIC
/begin CHARACTERISTIC FrmMng_CHRGR2SchedMode_C "CAN Message Schedule Mode fuer RX und TX" VALUE 0x1C0DC8 Kw_Wu8 160.0 OneToOne 16.00 176.0 FORMAT "%5.1" EXTENDED_LIMITS 0.00 255.0 READ_ONLY /end CHARACTERISTIC
/begin CHARACTERISTIC FrmMng_CHRGR2Sched_C "Frequenz vom Transfer abhaengig vom Opmode" VALUE 0x1C0DC9 Kw_Wu8 254.0 OneToOne 1.000 255.0 FORMAT "%5.1" EXTENDED_LIMITS 0.00 255.0 READ_ONLY /end CHARACTERISTIC
/begin CHARACTERISTIC FrmMng_CHRGR2Strt_C "Message-Transfer-Aktivierung relativ zur Startzeit" VALUE 0x1C0DCA Kw_Wu8 255.0 OneToOne 0.00 255.0 FORMAT "%5.1" READ_ONLY /end CHARACTERISTIC
/begin CHARACTERISTIC FrmMng_CHRGR2TOTmp_C "Timeout" VALUE 0x1C0DCB Kw_Wu8 5100. TimeCAN_TO_ms 20.00 5120. FORMAT "%5.0" /end CHARACTERISTIC
/begin CHARACTERISTIC FrmMng_ctEngActr_OffVal_C "Zähler für die Anzahl von Abschaltanforderungen für Turbolader 1 und 2 über CAN" VALUE 0x1D28B4 Kw_Wu8 255.0 OneToOne 0.00 255.0 FORMAT "%5.1" /end CHARACTERISTIC
/begin CHARACTERISTIC FrmMng_ctEngActr_RstVal_C "Zähler für die Anzahl von Resetanforderungen für Turbolader 1 und 2 über CAN" VALUE 0x1D28B5 Kw_Wu8 255.0 OneToOne 0.00 255.0 FORMAT "%5.1" /end CHARACTERISTIC
/begin CHARACTERISTIC FrmMng_ctMulEng2_C "Multiplexzähler Botschaft Motor2" VALUE 0x1D258C Kw_Wu16 65535.00 OneToOne 0.00 65535.00 FORMAT "%8.2" /end CHARACTERISTIC
/begin CHARACTERISTIC FrmMng_ctMulEng5_C "Multiplexzähler Botschaft Motor5" VALUE 0x1D258E Kw_Wu16 65535.00 OneToOne 0.00 65535.00 FORMAT "%8.2" /end CHARACTERISTIC
/begin CHARACTERISTIC FrmMng_dAirIndSys_C "Luftansaugsystem" VALUE 0x1D2590 Kw_Wu8 1.000 OneToOne 0.00 1.000 FORMAT "%5.3" EXTENDED_LIMITS 0.00 255.0 /end CHARACTERISTIC
/begin CHARACTERISTIC FrmMng_dAvrgOilLvl_C "Anzahl Mittelung schneller Ölstands-Mittelwert" VALUE 0x1D2778 Kw_Wu16 1500.000 OneToOne 0.00 1500.000 FORMAT "%8.3" EXTENDED_LIMITS 0.00 65535.00 /end CHARACTERISTIC
/begin CHARACTERISTIC FrmMng_dAvrgOilLvl_Offset_C "Offset Umrechung SG -> CAN für Anzahl Mittelung schneller Ölstands-Mittelwert" VALUE 0x1D277A Kw_Ws16 65535.00 OneToOne -32768.00 32767.00 FORMAT "%8.2" /end CHARACTERISTIC
/begin CHARACTERISTIC FrmMng_facDAvrgOilLvl_Slope_C "Steigung Umrechnung CAN -> SG für Anzahl Mittelung schneller Ölfüllstands-Mittelwert" VALUE 0x1D277C Kw_Ws16 65535.00 OneToOne -32768.00 32767.00 FORMAT "%8.2" /end CHARACTERISTIC
/begin CHARACTERISTIC FrmMng_DebChrgr1ANegDevDef_C "Zeit bis Fehler Chrgr1 Lage neg. Regelabweichung defekt" VALUE 0x1D2522 Kw_Wu16 655350.0 Time_ms 0.00 655350.0 FORMAT "%8.1" /end CHARACTERISTIC
/begin CHARACTERISTIC FrmMng_DebChrgr1ANegDevOk_C "Zeit bis Fehler Chrgr1 Lage neg. Regelabweichung geheilt" VALUE 0x1D2524 Kw_Wu16 655350.0 Time_ms 0.00 655350.0 FORMAT "%8.1" /end CHARACTERISTIC
/begin CHARACTERISTIC FrmMng_DebChrgr1APosDevDef_C "Zeit bis Fehler Chrgr1 Lage pos. Regelabweichung defekt" VALUE 0x1D2526 Kw_Wu16 655350.0 Time_ms 0.00 655350.0 FORMAT "%8.1" /end CHARACTERISTIC
/begin CHARACTERISTIC FrmMng_DebChrgr1APosDevOk_C "Zeit bis Fehler Chrgr1 Lage pos. Regelabweichung geheilt" VALUE 0x1D2528 Kw_Wu16 655350.0 Time_ms 0.00 655350.0 FORMAT "%8.1" /end CHARACTERISTIC
/begin CHARACTERISTIC FrmMng_DebChrgr1CDataErrDef_C "Zeit bis Fehler Chrgr1 Daten-Fehler" VALUE 0x1D252A Kw_Wu16 655350.0 Time_ms 0.00 655350.0 FORMAT "%8.1" /end CHARACTERISTIC
/begin CHARACTERISTIC FrmMng_DebChrgr1CDataErrOk_C "Zeit bis Daten-Fehler Chrgr1 geheilt" VALUE 0x1D252C Kw_Wu16 655350.0 Time_ms 0.00 655350.0 FORMAT "%8.1" /end CHARACTERISTIC
/begin CHARACTERISTIC FrmMng_DebChrgr1CInDef_C "Zeit bis Chrgr1 Tastverhältins Fehler defekt" VALUE 0x1D252E Kw_Wu16 655350.0 Time_ms 0.00 655350.0 FORMAT "%8.1" /end CHARACTERISTIC
/begin CHARACTERISTIC FrmMng_DebChrgr1CInOk_C "Zeit bis Chrgr1 Tastverhältnis Fehler geheilt" VALUE 0x1D2530 Kw_Wu16 655350.0 Time_ms 0.00 655350.0 FORMAT "%8.1" /end CHARACTERISTIC
/begin CHARACTERISTIC FrmMng_DebChrgr1CSigErrDef_C "Zeit bis Fehler Chrgr1 Sensor Signal defekt" VALUE 0x1D2532 Kw_Wu16 655350.0 Time_ms 0.00 655350.0 FORMAT "%8.1" /end CHARACTERISTIC
/begin CHARACTERISTIC FrmMng_DebChrgr1CSigErrOk_C "Zeit bis Fehler Chrgr1 Sensorsignal geheilt" VALUE 0x1D2534 Kw_Wu16 655350.0 Time_ms 0.00 655350.0 FORMAT "%8.1" /end CHARACTERISTIC
/begin CHARACTERISTIC FrmMng_DebChrgr1CSRCHighDef_C "Zeit bis Fehler Chrgr1 Treiberstrom zu hoch defekt" VALUE 0x1D2536 Kw_Wu16 655350.0 Time_ms 0.00 655350.0 FORMAT "%8.1" /end CHARACTERISTIC
/begin CHARACTERISTIC FrmMng_DebChrgr1CSRCHighOk_C "Zeit bis Fehler Chrgr1 Treiberstrom zu hoch geheilt" VALUE 0x1D2538 Kw_Wu16 655350.0 Time_ms 0.00 655350.0 FORMAT "%8.1" /end CHARACTERISTIC
/begin CHARACTERISTIC FrmMng_DebCHRGR1DLCDef_C "Entprellzeit für DLC-Fehler der Botschaft-CHRGR1" VALUE 0x1D253A Kw_Wu16 655350.0 Time_ms 0.00 655350.0 FORMAT "%8.1" /end CHARACTERISTIC
/begin CHARACTERISTIC FrmMng_DebCHRGR1DLCOk_C "Heilungszeit für DLC-Fehler der Botschaft-CHRGR1" VALUE 0x1D253C Kw_Wu16 655350.0 Time_ms 0.00 655350.0 FORMAT "%8.1" /end CHARACTERISTIC
/begin CHARACTERISTIC FrmMng_DebChrgr1NCanDef_C "Zeit bis Fehler Chrgr1 CAN Kommunikation defekt" VALUE 0x1D253E Kw_Wu16 655350.0 Time_ms 0.00 655350.0 FORMAT "%8.1" /end CHARACTERISTIC
/begin CHARACTERISTIC FrmMng_DebChrgr1NCanOk_C "Zeit bis Fehler Chrgr1 CAN Kommunikation geheilt" VALUE 0x1D2540 Kw_Wu16 655350.0 Time_ms 0.00 655350.0 FORMAT "%8.1" /end CHARACTERISTIC
/begin CHARACTERISTIC FrmMng_DebChrgr1TExTempDef_C "Zeit bis Fehler Chrgr1 Übertemperatur defekt" VALUE 0x1D2542 Kw_Wu16 655350.0 Time_ms 0.00 655350.0 FORMAT "%8.1" /end CHARACTERISTIC
/begin CHARACTERISTIC FrmMng_DebChrgr1TExTempOk_C "Zeit bis Fehler Chrgr1 Übertemperatur geheilt" VALUE 0x1D2544 Kw_Wu16 655350.0 Time_ms 0.00 655350.0 FORMAT "%8.1" /end CHARACTERISTIC
/begin CHARACTERISTIC FrmMng_DebCHRGR1TODef_C "Zeit bis CHRGR1 Time Out Fehler defekt" VALUE 0x1D2546 Kw_Wu16 655350.0 Time_ms 0.00 655350.0 FORMAT "%8.1" /end CHARACTERISTIC
/begin CHARACTERISTIC FrmMng_DebCHRGR1TOOk_C "Zeit bis Fehler CHRGR1 Time Out geheilt" VALUE 0x1D2548 Kw_Wu16 655350.0 Time_ms 0.00 655350.0 FORMAT "%8.1" /end CHARACTERISTIC
/begin CHARACTERISTIC FrmMng_DebChrgr1VSRCDef_C "Zeit bis Fehler Chrgr1 SRC Versorgungsspannung defekt" VALUE 0x1D254A Kw_Wu16 655350.0 Time_ms 0.00 655350.0 FORMAT "%8.1" /end CHARACTERISTIC
/begin CHARACTERISTIC FrmMng_DebChrgr1VSRCOk_C "Zeit bis Fehler Chrgr1 SRC Versorgungsspannung geheilt" VALUE 0x1D254C Kw_Wu16 655350.0 Time_ms 0.00 655350.0 FORMAT "%8.1" /end CHARACTERISTIC
/begin CHARACTERISTIC FrmMng_DebChrgr2ANegDevDef_C "Zeit bis Fehler Chrgr2 Lage neg. Regelabweichung defekt" VALUE 0x1D254E Kw_Wu16 655350.0 Time_ms 0.00 655350.0 FORMAT "%8.1" /end CHARACTERISTIC
/begin CHARACTERISTIC FrmMng_DebChrgr2ANegDevOk_C "Zeit bis Fehler Chrgr2 Lage neg. Regelabweichung geheilt" VALUE 0x1D2550 Kw_Wu16 655350.0 Time_ms 0.00 655350.0 FORMAT "%8.1" /end CHARACTERISTIC
/begin CHARACTERISTIC FrmMng_DebChrgr2APosDevDef_C "Zeit bis Fehler Chrgr2 Lage pos. Regelabweichung defekt" VALUE 0x1D2552 Kw_Wu16 655350.0 Time_ms 0.00 655350.0 FORMAT "%8.1" /end CHARACTERISTIC
/begin CHARACTERISTIC FrmMng_DebChrgr2APosDevOk_C "Zeit bis Fehler Chrgr2 Lage pos. Regelabweichung geheilt" VALUE 0x1D2554 Kw_Wu16 655350.0 Time_ms 0.00 655350.0 FORMAT "%8.1" /end CHARACTERISTIC
/begin CHARACTERISTIC FrmMng_DebChrgr2CDataErrDef_C "Zeit bis Fehler Chrgr2 Daten-Fehler" VALUE 0x1D2556 Kw_Wu16 655350.0 Time_ms 0.00 655350.0 FORMAT "%8.1" /end CHARACTERISTIC
/begin CHARACTERISTIC FrmMng_DebChrgr2CDataErrOk_C "Zeit bis Daten-Fehler Chrgr2 geheilt" VALUE 0x1D2558 Kw_Wu16 655350.0 Time_ms 0.00 655350.0 FORMAT "%8.1" /end CHARACTERISTIC
/begin CHARACTERISTIC FrmMng_DebChrgr2CInDef_C "Zeit bis Chrgr2 Tastverhältins Fehler defekt" VALUE 0x1D255A Kw_Wu16 655350.0 Time_ms 0.00 655350.0 FORMAT "%8.1" /end CHARACTERISTIC
/begin CHARACTERISTIC FrmMng_DebChrgr2CInOk_C "Zeit bis Chrgr2 Tastverhältnis Fehler geheilt" VALUE 0x1D255C Kw_Wu16 655350.0 Time_ms 0.00 655350.0 FORMAT "%8.1" /end CHARACTERISTIC
/begin CHARACTERISTIC FrmMng_DebChrgr2CSigErrDef_C "Zeit bis Fehler Chrgr2 Sensor Signal defekt" VALUE 0x1D255E Kw_Wu16 655350.0 Time_ms 0.00 655350.0 FORMAT "%8.1" /end CHARACTERISTIC
/begin CHARACTERISTIC FrmMng_DebChrgr2CSigErrOk_C "Zeit bis Fehler Chrgr2 Sensorsignal geheilt" VALUE 0x1D2560 Kw_Wu16 655350.0 Time_ms 0.00 655350.0 FORMAT "%8.1" /end CHARACTERISTIC
/begin CHARACTERISTIC FrmMng_DebChrgr2CSRCHighDef_C "Zeit bis Fehler Chrgr2 Treiberstrom zu hoch defekt" VALUE 0x1D2562 Kw_Wu16 655350.0 Time_ms 0.00 655350.0 FORMAT "%8.1" /end CHARACTERISTIC
/begin CHARACTERISTIC FrmMng_DebChrgr2CSRCHighOk_C "Zeit bis Fehler Chrgr2 Treiberstrom zu hoch geheilt" VALUE 0x1D2564 Kw_Wu16 655350.0 Time_ms 0.00 655350.0 FORMAT "%8.1" /end CHARACTERISTIC
/begin CHARACTERISTIC FrmMng_DebCHRGR2DLCDef_C "Entprellzeit für DLC-Fehler der Botschaft-CHRGR2" VALUE 0x1D2566 Kw_Wu16 655350.0 Time_ms 0.00 655350.0 FORMAT "%8.1" /end CHARACTERISTIC
/begin CHARACTERISTIC FrmMng_DebCHRGR2DLCOk_C "Heilungszeit für DLC-Fehler der Botschaft-CHRGR2" VALUE 0x1D2568 Kw_Wu16 655350.0 Time_ms 0.00 655350.0 FORMAT "%8.1" /end CHARACTERISTIC
/begin CHARACTERISTIC FrmMng_DebChrgr2NCanDef_C "Zeit bis Fehler Chrgr2 CAN Kommunikation defekt" VALUE 0x1D256A Kw_Wu16 655350.0 Time_ms 0.00 655350.0 FORMAT "%8.1" /end CHARACTERISTIC
/begin CHARACTERISTIC FrmMng_DebChrgr2NCanOk_C "Zeit bis Fehler Chrgr2 CAN Kommunikation geheilt" VALUE 0x1D256C Kw_Wu16 655350.0 Time_ms 0.00 655350.0 FORMAT "%8.1" /end CHARACTERISTIC
/begin CHARACTERISTIC FrmMng_DebChrgr2TExTempDef_C "Zeit bis Fehler Chrgr2 Übertemperatur defekt" VALUE 0x1D256E Kw_Wu16 655350.0 Time_ms 0.00 655350.0 FORMAT "%8.1" /end CHARACTERISTIC
/begin CHARACTERISTIC FrmMng_DebChrgr2TExTempOk_C "Zeit bis Fehler Chrgr2 Übertemperatur geheilt" VALUE 0x1D2570 Kw_Wu16 655350.0 Time_ms 0.00 655350.0 FORMAT "%8.1" /end CHARACTERISTIC
/begin CHARACTERISTIC FrmMng_DebCHRGR2TODef_C "Zeit bis CHRGR2 Time Out Fehler defekt" VALUE 0x1D2572 Kw_Wu16 655350.0 Time_ms 0.00 655350.0 FORMAT "%8.1" /end CHARACTERISTIC
/begin CHARACTERISTIC FrmMng_DebCHRGR2TOOk_C "Zeit bis Fehler CHRGR2 Time Out geheilt" VALUE 0x1D2574 Kw_Wu16 655350.0 Time_ms 0.00 655350.0 FORMAT "%8.1" /end CHARACTERISTIC
/begin CHARACTERISTIC FrmMng_DebChrgr2VSRCDef_C "Zeit bis Fehler Chrgr2 SRC Versorgungsspannung defekt" VALUE 0x1D2576 Kw_Wu16 655350.0 Time_ms 0.00 655350.0 FORMAT "%8.1" /end CHARACTERISTIC
/begin CHARACTERISTIC FrmMng_DebChrgr2VSRCOk_C "Zeit bis Fehler Chrgr2 SRC Versorgungsspannung geheilt" VALUE 0x1D2578 Kw_Wu16 655350.0 Time_ms 0.00 655350.0 FORMAT "%8.1" /end CHARACTERISTIC
/begin CHARACTERISTIC FrmMng_DebTOSDLCDef_C "tprellzeit für DLC-Fehler der Botschaft-TOS" VALUE 0x1D24CC Kw_Wu16 655350.0 Time_ms 0.00 655350.0 FORMAT "%8.1" /end CHARACTERISTIC
/begin CHARACTERISTIC FrmMng_DebTOSDLCOk_C "Heilungszeit für DLC-Fehler der Botschaft-TOS" VALUE 0x1D24CE Kw_Wu16 655350.0 Time_ms 0.00 655350.0 FORMAT "%8.1" /end CHARACTERISTIC
/begin CHARACTERISTIC FrmMng_DebTOSTODef_C "Entprellzeit für Timeout von TOG-Botschaft" VALUE 0x1D24D0 Kw_Wu16 655350.0 Time_ms 0.00 655350.0 FORMAT "%8.1" /end CHARACTERISTIC
/begin CHARACTERISTIC FrmMng_DebTOSTOOk_C "Heilungszeit für Timeout von TOG-Botschaft" VALUE 0x1D24D2 Kw_Wu16 655350.0 Time_ms 0.00 655350.0 FORMAT "%8.1" /end CHARACTERISTIC
/begin CHARACTERISTIC FrmMng_DebTSC1CNTDef_C "Entprellzeit für Botschaftszähler-Fehler Getriebe 1 Botschaft" VALUE 0x1D24DE Kw_Wu16 655350.0 Time_ms 0.00 655350.0 FORMAT "%8.1" /end CHARACTERISTIC
/begin CHARACTERISTIC FrmMng_DebTSC1CNTOk_C "Heilzeit für Botschaftszähler-Fehler Getriebe 1 Botschaft" VALUE 0x1D24E0 Kw_Wu16 655350.0 Time_ms 0.00 655350.0 FORMAT "%8.1" /end CHARACTERISTIC
/begin CHARACTERISTIC FrmMng_DebTSC1DLCDef_C "Entprellzeit für DLC-Fehler der Botschaft-TSC1" VALUE 0x1D24E2 Kw_Wu16 655350.0 Time_ms 0.00 655350.0 FORMAT "%8.1" /end CHARACTERISTIC
/begin CHARACTERISTIC FrmMng_DebTSC1DLCOk_C "Heilungszeit für DLC-Fehler der Botschaft-TSC1" VALUE 0x1D24E4 Kw_Wu16 655350.0 Time_ms 0.00 655350.0 FORMAT "%8.1" /end CHARACTERISTIC
/begin CHARACTERISTIC FrmMng_DebTSC1TODef_C "Zeit bis EGS1TO Fehler defekt" VALUE 0x1D24E6 Kw_Wu16 655350.0 Time_ms 0.00 655350.0 FORMAT "%8.1" /end CHARACTERISTIC
/begin CHARACTERISTIC FrmMng_DebTSC1TOOk_C "Zeit bis Fehler EGS1TO geheilt" VALUE 0x1D24E8 Kw_Wu16 655350.0 Time_ms 0.00 655350.0 FORMAT "%8.1" /end CHARACTERISTIC
/begin CHARACTERISTIC FrmMng_DebTSC2CNTDef_C "Entprellzeit für Botschaftszähler-Fehler Getriebe 2 Botschaft" VALUE 0x1D24EA Kw_Wu16 655350.0 Time_ms 0.00 655350.0 FORMAT "%8.1" /end CHARACTERISTIC
/begin CHARACTERISTIC FrmMng_DebTSC2CNTOk_C "Heilzeit für Botschaftszähler-Fehler Getriebe 2 Botschaft" VALUE 0x1D24EC Kw_Wu16 655350.0 Time_ms 0.00 655350.0 FORMAT "%8.1" /end CHARACTERISTIC
/begin CHARACTERISTIC FrmMng_DebTSC2DLCDef_C "Entprellzeit für DLC-Fehler der Botschaft-TSC2" VALUE 0x1D24EE Kw_Wu16 655350.0 Time_ms 0.00 655350.0 FORMAT "%8.1" /end CHARACTERISTIC
/begin CHARACTERISTIC FrmMng_DebTSC2DLCOk_C "Heilungszeit für DLC-Fehler der Botschaft-TSC2" VALUE 0x1D24F0 Kw_Wu16 655350.0 Time_ms 0.00 655350.0 FORMAT "%8.1" /end CHARACTERISTIC
/begin CHARACTERISTIC FrmMng_DebTSC2TODef_C "Zeit bis EGS2TO Fehler defekt" VALUE 0x1D24F2 Kw_Wu16 655350.0 Time_ms 0.00 655350.0 FORMAT "%8.1" /end CHARACTERISTIC
/begin CHARACTERISTIC FrmMng_DebTSC2TOOk_C "Zeit bis Fehler EGS2TO geheilt" VALUE 0x1D24F4 Kw_Wu16 655350.0 Time_ms 0.00 655350.0 FORMAT "%8.1" /end CHARACTERISTIC
/begin CHARACTERISTIC FrmMng_DebTSC3CNTDef_C "Entprellzeit für Botschaftszähler-Fehler Getriebe 3" VALUE 0x1D24F6 Kw_Wu16 655350.0 Time_ms 0.00 655350.0 FORMAT "%8.1" /end CHARACTERISTIC
/begin CHARACTERISTIC FrmMng_DebTSC3CNTOk_C "Heilzeit für Botschaftszähler-Fehler Getriebe 3 Botschaft" VALUE 0x1D24F8 Kw_Wu16 655350.0 Time_ms 0.00 655350.0 FORMAT "%8.1" /end CHARACTERISTIC
/begin CHARACTERISTIC FrmMng_DebTSC3CSDef_C "Fehlerentprell-Ereignisse für TSC3  Checksummenfehler" VALUE 0x1D24FA Kw_Wu16 65535.00 OneToOne 0.00 65535.00 FORMAT "%8.2" /end CHARACTERISTIC
/begin CHARACTERISTIC FrmMng_DebTSC3CSOk_C "Fehlerheilungs-Ereignisse für TSC3 Checksummenfehler" VALUE 0x1D24FC Kw_Wu16 65535.00 OneToOne 0.00 65535.00 FORMAT "%8.2" READ_ONLY /end CHARACTERISTIC
/begin CHARACTERISTIC FrmMng_DebTSC3DLCDef_C "Entprellzeit für DLC-Fehler der Botschaft-TSC3" VALUE 0x1D24FE Kw_Wu16 655350.0 Time_ms 0.00 655350.0 FORMAT "%8.1" /end CHARACTERISTIC
/begin CHARACTERISTIC FrmMng_DebTSC3DLCOk_C "Heilungszeit für DLC-Fehler der Botschaft-TSC3" VALUE 0x1D2500 Kw_Wu16 655350.0 Time_ms 0.00 655350.0 FORMAT "%8.1" /end CHARACTERISTIC
/begin CHARACTERISTIC FrmMng_DebTSC3TODef_C "Zeit bis TSC3Time Out Fehler defekt" VALUE 0x1D2502 Kw_Wu16 655350.0 Time_ms 0.00 655350.0 FORMAT "%8.1" /end CHARACTERISTIC
/begin CHARACTERISTIC FrmMng_DebTSC3TOOk_C "Zeit bis Fehler TSC3 Time Out geheilt" VALUE 0x1D2504 Kw_Wu16 655350.0 Time_ms 0.00 655350.0 FORMAT "%8.1" /end CHARACTERISTIC
/begin CHARACTERISTIC FrmMng_dEngActr_ErrVal_C "Fehlerkennzeichnungswert für el. Steller des Turboladers" VALUE 0x1D28B6 Kw_Wu16 102.3000 DtyCycCan 0.00 102.3000 FORMAT "%8.4" EXTENDED_LIMITS 0.00 6553.500 /end CHARACTERISTIC
/begin CHARACTERISTIC FrmMng_dEngActr_OffVal_C "Abschaltanforderungswert für Turbolader über CAN" VALUE 0x1D28B8 Kw_Wu16 102.3000 DtyCycCan 0.00 102.3000 FORMAT "%8.4" EXTENDED_LIMITS 0.00 6553.500 /end CHARACTERISTIC
/begin CHARACTERISTIC FrmMng_dEngActr_RstVal_C "Reseterlaubniswert für Turbolader über CAN" VALUE 0x1D28BA Kw_Wu16 102.3000 DtyCycCan 0.00 102.3000 FORMAT "%8.4" EXTENDED_LIMITS 0.00 6553.500 /end CHARACTERISTIC
/begin CHARACTERISTIC FrmMng_dEqu_Offset_C "CAN - Offset für das Ruß-/Verschleißäquivalent" VALUE 0x1D277E Kw_Ws16 0.001310700 Fact_WearSootIdx -0.0006553600 0.0006553400 FORMAT "%12.10" /end CHARACTERISTIC
/begin CHARACTERISTIC FrmMng_facDEqu_Slope_C "CAN - Slope für das Ruß./Verschleißäquivalent" VALUE 0x1D2780 Kw_Ws16 0.001310700 Fact_WearSootIdx -0.0006553600 0.0006553400 FORMAT "%12.10" /end CHARACTERISTIC
/begin CHARACTERISTIC FrmMng_dDIA1ID_C "CAN-Botschafts ID für Diagnose1-Botschaft" VALUE 0x1C0DCC Kw_Wu32 536870911.000 OneToOne 0.00 536870911.000 FORMAT "%13.3" EXTENDED_LIMITS 0.00 4294967295.00 /end CHARACTERISTIC
/begin CHARACTERISTIC FrmMng_DIA1IDType_C "ID Typ standard oder extended" VALUE 0x1C0DD0 Kw_Wu8 0.00 OneToOne 1.000 1.000 FORMAT "%5.3" EXTENDED_LIMITS 0.00 255.0 READ_ONLY /end CHARACTERISTIC
/begin CHARACTERISTIC FrmMng_DIA1NumCAN_C "Auf welchen CAN die Botschaft ist" VALUE 0x1C0DD1 Kw_Wu8 2.000 OneToOne 0.00 2.000 FORMAT "%5.3" EXTENDED_LIMITS 0.00 255.0 READ_ONLY /end CHARACTERISTIC
/begin CHARACTERISTIC FrmMng_DIA1NumMsgPos_C "Message Buffer der verwendet wird" VALUE 0x1C0DD2 Kw_Wu8 15.00 OneToOne 0.00 15.00 FORMAT "%5.2" EXTENDED_LIMITS 0.00 255.0 READ_ONLY /end CHARACTERISTIC
/begin CHARACTERISTIC FrmMng_DIA1OpMode_C "Richtung transmit/receive" VALUE 0x1C0DD3 Kw_Wu8 1.000 OneToOne 0.00 1.000 FORMAT "%5.3" EXTENDED_LIMITS 0.00 255.0 READ_ONLY /end CHARACTERISTIC
/begin CHARACTERISTIC FrmMng_dDIA1SchedMesgLen_C "CAN Botschaftslänge für Diagnose1-Botschaft" VALUE 0x1C0DD4 Kw_Wu8 8.000 OneToOne 0.00 8.000 FORMAT "%5.3" EXTENDED_LIMITS 0.00 255.0 /end CHARACTERISTIC
/begin CHARACTERISTIC FrmMng_DIA1IntrEna_C "Interrupt enabled oder nicht" VALUE 0x1C0DD5 Kw_Wu8 1.000 OneToOne 0.00 1.000 FORMAT "%5.3" EXTENDED_LIMITS 0.00 255.0 READ_ONLY /end CHARACTERISTIC
/begin CHARACTERISTIC FrmMng_DIA1Mul_C "message Buffer ist multiplexed oder nicht" VALUE 0x1C0DD6 Kw_Wu8 1.000 OneToOne 0.00 1.000 FORMAT "%5.3" EXTENDED_LIMITS 0.00 255.0 READ_ONLY /end CHARACTERISTIC
/begin CHARACTERISTIC FrmMng_DIA1SchedMode_C "CAN Message Schedule Mode fuer RX und TX" VALUE 0x1C0DD8 Kw_Wu8 160.0 OneToOne 16.00 176.0 FORMAT "%5.1" EXTENDED_LIMITS 0.00 255.0 READ_ONLY /end CHARACTERISTIC
/begin CHARACTERISTIC FrmMng_DIA1Sched_C "Frequenz vom Transfer abhaengig vom Opmode" VALUE 0x1C0DD9 Kw_Wu8 254.0 OneToOne 1.000 255.0 FORMAT "%5.1" EXTENDED_LIMITS 0.00 255.0 READ_ONLY /end CHARACTERISTIC
/begin CHARACTERISTIC FrmMng_DIA1Strt_C "Message-Transfer-Aktivierung relativ zur Startzeit" VALUE 0x1C0DDA Kw_Wu8 255.0 OneToOne 0.00 255.0 FORMAT "%5.1" READ_ONLY /end CHARACTERISTIC
/begin CHARACTERISTIC FrmMng_DIA1TOTmp_C "Timeout" VALUE 0x1C0DDB Kw_Wu8 5100. TimeCAN_TO_ms 20.00 5120. FORMAT "%5.0" /end CHARACTERISTIC
/begin CHARACTERISTIC FrmMng_dMinNumOilLvlDiff_C "Mindestanzahl der Ölstandsdifferenzauswertungen" VALUE 0x1D2782 Kw_Wu16 7000.000 OneToOne 500.0000 7500.000 FORMAT "%8.3" EXTENDED_LIMITS 0.00 65535.00 /end CHARACTERISTIC
/begin CHARACTERISTIC FrmMng_dMulinfo2_0_C "Multiplex Info 0, Botschaft Motor2" VALUE 0x1D2591 Kw_Wu8 33.00 OneToOne 12.00 45.00 FORMAT "%5.2" EXTENDED_LIMITS 0.00 255.0 /end CHARACTERISTIC
/begin CHARACTERISTIC FrmMng_dMulinfo2_1_C "Multiplex Info 1, Botschaft Motor2" VALUE 0x1D2592 Kw_Wu8 63.00 OneToOne 0.00 63.00 FORMAT "%5.2" EXTENDED_LIMITS 0.00 255.0 /end CHARACTERISTIC
/begin CHARACTERISTIC FrmMng_dMulinfo2_2_C "Multiplex Info 2, Botschaft Motor2" VALUE 0x1D2593 Kw_Wu8 63.00 OneToOne 0.00 63.00 FORMAT "%5.2" EXTENDED_LIMITS 0.00 255.0 /end CHARACTERISTIC
/begin CHARACTERISTIC FrmMng_dnLI_C "Weite des Drehzahlintervalls" VALUE 0x1D2594 Kw_Ws16 6000.000 EngN 0.00 6000.000 FORMAT "%8.3" EXTENDED_LIMITS -32768.00 32767.00 /end CHARACTERISTIC
/begin CHARACTERISTIC FrmMng_dNrVlv_C "Anzahl der Ventile" VALUE 0x1D2784 Kw_Wu8 7.000 OneToOne 0.00 7.000 FORMAT "%5.3" EXTENDED_LIMITS 0.00 255.0 /end CHARACTERISTIC
/begin CHARACTERISTIC FrmMng_dOilload_C "Bewertungsfaktor Verschleißindex" VALUE 0x1D2786 Kw_Wu16 6.296875 Fact1 0.00 6.296875 FORMAT "%8.6" EXTENDED_LIMITS 0.00 511.9922 /end CHARACTERISTIC
/begin CHARACTERISTIC FrmMng_dOilload_Offset_C "Offset Umrechung SG->CAN für Bewertungsfaktor Verschleißindex" VALUE 0x1D2788 Kw_Ws16 511.9922 Fact1 -256.0000 255.9922 FORMAT "%8.4" /end CHARACTERISTIC
/begin CHARACTERISTIC FrmMng_facDOilload_Slope_C "Steigung Umrechung SG->CAN für Bewertungsfaktor Verschleißindex" VALUE 0x1D278A Kw_Ws16 7.999878 Fact -4.000000 3.999878 FORMAT "%8.6" /end CHARACTERISTIC
/begin CHARACTERISTIC FrmMng_dOilLvlDiff_Offset_C "Offset für die Mindestanzahl der Ölstandsdifferenzauswertungen" VALUE 0x1D278C Kw_Ws16 65535.00 OneToOne -32768.00 32767.00 FORMAT "%8.2" /end CHARACTERISTIC
/begin CHARACTERISTIC FrmMng_facDOilLvlDiff_Slope_C "Slope für die minimal notwendigen Ölstandsdifferenzauswertungen" VALUE 0x1D278E Kw_Ws16 65535.00 OneToOne -32768.00 32767.00 FORMAT "%8.2" /end CHARACTERISTIC
/begin CHARACTERISTIC FrmMng_dSlpFillCrv_C "Steigung der Befüllungskennlinie" VALUE 0x1D2790 Kw_Wu16 0.2550049 RatVolLength 0.00 0.2550049 FORMAT "%9.7" EXTENDED_LIMITS 0.00 7.999878 /end CHARACTERISTIC
/begin CHARACTERISTIC FrmMng_dSlpFillCrv_Offset_C "Offset Umrechung SG->CAN für Steigung der Befüllungskennlinie" VALUE 0x1D2792 Kw_Ws16 7.999878 RatVolLength -4.000000 3.999878 FORMAT "%8.6" /end CHARACTERISTIC
/begin CHARACTERISTIC FrmMng_facDSlpFillCrv_Slope_C "Steigung Umrechung SG->CAN für Steigung der Befüllungskennlinie" VALUE 0x1D2794 Kw_Ws16 7.999878 Fact -4.000000 3.999878 FORMAT "%8.6" /end CHARACTERISTIC
/begin CHARACTERISTIC FrmMng_dSootTurbo_C "Bewertungsfaktor Ruß oder Turbo" VALUE 0x1D2796 Kw_Wu16 6.296875 Fact1 0.00 6.296875 FORMAT "%8.6" EXTENDED_LIMITS 0.00 511.9922 /end CHARACTERISTIC
/begin CHARACTERISTIC FrmMng_dSootTurbo_Offset_C "Offset Umrechung SG->CAN für Bewertungsfaktor Ruß oder Turbo" VALUE 0x1D2798 Kw_Ws16 511.9922 Fact1 -256.0000 255.9922 FORMAT "%8.4" /end CHARACTERISTIC
/begin CHARACTERISTIC FrmMng_facDSootTurbo_Slope_C "Steigung Umrechung SG->CAN für Bewertungsfaktor Ruß oder Turbo" VALUE 0x1D279A Kw_Ws16 7.999878 Fact -4.000000 3.999878 FORMAT "%8.6" /end CHARACTERISTIC
/begin CHARACTERISTIC FrmMng_dDSP1ID_C "Botschaftsidentifier CAN-Botschaft DSP1" VALUE 0x1C0DDC Kw_Wu32 536870911.000 OneToOne 0.00 536870911.000 FORMAT "%13.3" EXTENDED_LIMITS 0.00 4294967295.00 /end CHARACTERISTIC
/begin CHARACTERISTIC FrmMng_DSP1IDType_C "ID Typ standard oder extended" VALUE 0x1C0DE0 Kw_Wu8 0.00 OneToOne 1.000 1.000 FORMAT "%5.3" EXTENDED_LIMITS 0.00 255.0 READ_ONLY /end CHARACTERISTIC
/begin CHARACTERISTIC FrmMng_DSP1NumCAN_C "Auf welchen CAN die Botschaft ist" VALUE 0x1C0DE1 Kw_Wu8 2.000 OneToOne 0.00 2.000 FORMAT "%5.3" EXTENDED_LIMITS 0.00 255.0 READ_ONLY /end CHARACTERISTIC
/begin CHARACTERISTIC FrmMng_DSP1NumMsgPos_C "Message Buffer der verwendet wird" VALUE 0x1C0DE2 Kw_Wu8 15.00 OneToOne 0.00 15.00 FORMAT "%5.2" EXTENDED_LIMITS 0.00 255.0 READ_ONLY /end CHARACTERISTIC
/begin CHARACTERISTIC FrmMng_DSP1OpMode_C "Richtung transmit/receive" VALUE 0x1C0DE3 Kw_Wu8 1.000 OneToOne 0.00 1.000 FORMAT "%5.3" EXTENDED_LIMITS 0.00 255.0 READ_ONLY /end CHARACTERISTIC
/begin CHARACTERISTIC FrmMng_dDSP1SchedMesgLen_C "Applizierbare Botschaftslänge für DSP1" VALUE 0x1C0DE4 Kw_Wu8 8.000 OneToOne 0.00 8.000 FORMAT "%5.3" EXTENDED_LIMITS 0.00 255.0 /end CHARACTERISTIC
/begin CHARACTERISTIC FrmMng_DSP1IntrEna_C "Interrupt enabled oder nicht" VALUE 0x1C0DE5 Kw_Wu8 1.000 OneToOne 0.00 1.000 FORMAT "%5.3" EXTENDED_LIMITS 0.00 255.0 READ_ONLY /end CHARACTERISTIC
/begin CHARACTERISTIC FrmMng_DSP1Mul_C "message Buffer ist multiplexed oder nicht" VALUE 0x1C0DE6 Kw_Wu8 1.000 OneToOne 0.00 1.000 FORMAT "%5.3" EXTENDED_LIMITS 0.00 255.0 READ_ONLY /end CHARACTERISTIC
/begin CHARACTERISTIC FrmMng_DSP1SchedMode_C "CAN Message Schedule Mode RX und TX" VALUE 0x1C0DE8 Kw_Wu8 160.0 OneToOne 16.00 176.0 FORMAT "%5.1" EXTENDED_LIMITS 0.00 255.0 READ_ONLY /end CHARACTERISTIC
/begin CHARACTERISTIC FrmMng_DSP1Sched_C "Frequenz vom Transfer abhaengig vom Opmode" VALUE 0x1C0DE9 Kw_Wu8 254.0 OneToOne 1.000 255.0 FORMAT "%5.1" EXTENDED_LIMITS 0.00 255.0 READ_ONLY /end CHARACTERISTIC
/begin CHARACTERISTIC FrmMng_DSP1Strt_C "Message-Transfer-Aktivierung relativ zur Startzeit" VALUE 0x1C0DEA Kw_Wu8 255.0 OneToOne 0.00 255.0 FORMAT "%5.1" READ_ONLY /end CHARACTERISTIC
/begin CHARACTERISTIC FrmMng_DSP1TOTmp_C "bei fehlender Botschaft: Anzahl der Taskdurchläufe bis zum erkennen eines vorläufigen Timeouts" VALUE 0x1C0DEB Kw_Wu8 5100. TimeCAN_TO_ms 20.00 5120. FORMAT "%5.0" /end CHARACTERISTIC
/begin CHARACTERISTIC FrmMng_dDSP2ID_C "Botschaftsidentifier CAN-Botschaft DSP2" VALUE 0x1C0DEC Kw_Wu32 536870911.000 OneToOne 0.00 536870911.000 FORMAT "%13.3" EXTENDED_LIMITS 0.00 4294967295.00 /end CHARACTERISTIC
/begin CHARACTERISTIC FrmMng_DSP2IDType_C "ID Typ standard oder extended" VALUE 0x1C0DF0 Kw_Wu8 0.00 OneToOne 1.000 1.000 FORMAT "%5.3" EXTENDED_LIMITS 0.00 255.0 READ_ONLY /end CHARACTERISTIC
/begin CHARACTERISTIC FrmMng_DSP2NumCAN_C "Auf welchen CAN die Botschaft ist" VALUE 0x1C0DF1 Kw_Wu8 2.000 OneToOne 0.00 2.000 FORMAT "%5.3" EXTENDED_LIMITS 0.00 255.0 READ_ONLY /end CHARACTERISTIC
/begin CHARACTERISTIC FrmMng_DSP2NumMsgPos_C "Message Buffer der verwendet wird" VALUE 0x1C0DF2 Kw_Wu8 15.00 OneToOne 0.00 15.00 FORMAT "%5.2" EXTENDED_LIMITS 0.00 255.0 READ_ONLY /end CHARACTERISTIC
/begin CHARACTERISTIC FrmMng_DSP2OpMode_C "Richtung transmit/receive" VALUE 0x1C0DF3 Kw_Wu8 1.000 OneToOne 0.00 1.000 FORMAT "%5.3" EXTENDED_LIMITS 0.00 255.0 READ_ONLY /end CHARACTERISTIC
/begin CHARACTERISTIC FrmMng_dDSP2SchedMesgLen_C "Applizierbare Botschaftslänge für DSP2" VALUE 0x1C0DF4 Kw_Wu8 8.000 OneToOne 0.00 8.000 FORMAT "%5.3" EXTENDED_LIMITS 0.00 255.0 /end CHARACTERISTIC
/begin CHARACTERISTIC FrmMng_DSP2IntrEna_C "Interrupt enabled oder nicht" VALUE 0x1C0DF5 Kw_Wu8 1.000 OneToOne 0.00 1.000 FORMAT "%5.3" EXTENDED_LIMITS 0.00 255.0 READ_ONLY /end CHARACTERISTIC
/begin CHARACTERISTIC FrmMng_DSP2Mul_C "message Buffer ist mulitpledxed oder not" VALUE 0x1C0DF6 Kw_Wu8 1.000 OneToOne 0.00 1.000 FORMAT "%5.3" EXTENDED_LIMITS 0.00 255.0 READ_ONLY /end CHARACTERISTIC
/begin CHARACTERISTIC FrmMng_DSP2SchedMode_C "CAN Message Schedule Mode fuer RX und TX" VALUE 0x1C0DF8 Kw_Wu8 160.0 OneToOne 16.00 176.0 FORMAT "%5.1" EXTENDED_LIMITS 0.00 255.0 READ_ONLY /end CHARACTERISTIC
/begin CHARACTERISTIC FrmMng_DSP2Sched_C "Frequenz vom Transfer abhaengig vom Opmode" VALUE 0x1C0DF9 Kw_Wu8 254.0 OneToOne 1.000 255.0 FORMAT "%5.1" EXTENDED_LIMITS 0.00 255.0 READ_ONLY /end CHARACTERISTIC
/begin CHARACTERISTIC FrmMng_DSP2Strt_C "Message-Transfer-Aktivierung relativ zur Startzeit" VALUE 0x1C0DFA Kw_Wu8 255.0 OneToOne 0.00 255.0 FORMAT "%5.1" READ_ONLY /end CHARACTERISTIC
/begin CHARACTERISTIC FrmMng_DSP2TOTmp_C "bei fehlender Botschaft: Anzahl der Taskdurchläufe bis zum erkennen eines vorläufigen Timeouts" VALUE 0x1C0DFB Kw_Wu8 5100. TimeCAN_TO_ms 20.00 5120. FORMAT "%5.0" /end CHARACTERISTIC
/begin CHARACTERISTIC FrmMng_dtrqFrcCanMax_C "oberer Grenze für die Reibmomentendifferenz des Can" VALUE 0x1D2596 Kw_Ws16 6553.500 Trq -3276.800 3276.700 FORMAT "%8.3" /end CHARACTERISTIC
/begin CHARACTERISTIC FrmMng_dtrqFrcCanMin_C "untere Grenze für die Reibmomentendifferenz des Can" VALUE 0x1D2598 Kw_Ws16 6553.500 Trq -3276.800 3276.700 FORMAT "%8.3" /end CHARACTERISTIC
/begin CHARACTERISTIC FrmMng_dtrqFrcMax_C "oberer Grenze für die Reibmomentendifferenz" VALUE 0x1D259A Kw_Ws16 6553.500 Trq -3276.800 3276.700 FORMAT "%8.3" /end CHARACTERISTIC
/begin CHARACTERISTIC FrmMng_dtrqFrcMin_C "untere Grenze für die Reibmomentendifferenz" VALUE 0x1D259C Kw_Ws16 6553.500 Trq -3276.800 3276.700 FORMAT "%8.3" /end CHARACTERISTIC
/begin CHARACTERISTIC FrmMng_dTrqReso_C "Index für Hang und ausgeglichen für Umwandlung von kann in physische Werte" VALUE 0x1D2888 Kw_Wu8 3.000 OneToOne 0.00 3.000 FORMAT "%5.3" EXTENDED_LIMITS 0.00 255.0 /end CHARACTERISTIC
/begin CHARACTERISTIC FrmMng_dTrq_Offset_C "Offset Umrechung SG->CAN für Momentengradienten" VALUE 0x1D2506 Kw_Ws16 65535.00 TrqPerSec -32768.00 32767.00 FORMAT "%8.2" /end CHARACTERISTIC
/begin CHARACTERISTIC FrmMng_facDTrq_Slope_C "Steigung Umrechung SG->CAN für Momentengradienten" VALUE 0x1D2508 Kw_Ws16 511.9922 Fact1 -256.0000 255.9922 FORMAT "%8.4" /end CHARACTERISTIC
/begin CHARACTERISTIC FrmMng_dENG1ID_C "Botschaftsidentifier CAN-Botschaft ENG1" VALUE 0x1C0DFC Kw_Wu32 536870911.000 OneToOne 0.00 536870911.000 FORMAT "%13.3" EXTENDED_LIMITS 0.00 4294967295.00 /end CHARACTERISTIC
/begin CHARACTERISTIC FrmMng_ENG1IDType_C "ID Typ standard oder extended" VALUE 0x1C0E00 Kw_Wu8 0.00 OneToOne 1.000 1.000 FORMAT "%5.3" EXTENDED_LIMITS 0.00 255.0 READ_ONLY /end CHARACTERISTIC
/begin CHARACTERISTIC FrmMng_ENG1NumCAN_C "Auf welchen CAN die Botschaft ist" VALUE 0x1C0E01 Kw_Wu8 2.000 OneToOne 0.00 2.000 FORMAT "%5.3" EXTENDED_LIMITS 0.00 255.0 READ_ONLY /end CHARACTERISTIC
/begin CHARACTERISTIC FrmMng_ENG1NumMsgPos_C "Message Buffer der verwendet wird" VALUE 0x1C0E02 Kw_Wu8 15.00 OneToOne 0.00 15.00 FORMAT "%5.2" EXTENDED_LIMITS 0.00 255.0 READ_ONLY /end CHARACTERISTIC
/begin CHARACTERISTIC FrmMng_ENG1OpMode_C "Richtung transmit/receive" VALUE 0x1C0E03 Kw_Wu8 1.000 OneToOne 0.00 1.000 FORMAT "%5.3" EXTENDED_LIMITS 0.00 255.0 READ_ONLY /end CHARACTERISTIC
/begin CHARACTERISTIC FrmMng_dENG1SchedMesgLen_C "Applizierbare Botschaftlänge für ENG1" VALUE 0x1C0E04 Kw_Wu8 8.000 OneToOne 0.00 8.000 FORMAT "%5.3" EXTENDED_LIMITS 0.00 255.0 /end CHARACTERISTIC
/begin CHARACTERISTIC FrmMng_ENG1IntrEna_C "Interrupt enabled oder nicht" VALUE 0x1C0E05 Kw_Wu8 1.000 OneToOne 0.00 1.000 FORMAT "%5.3" EXTENDED_LIMITS 0.00 255.0 READ_ONLY /end CHARACTERISTIC
/begin CHARACTERISTIC FrmMng_ENG1Mul_C "message Buffer ist multiplexed oder nicht" VALUE 0x1C0E06 Kw_Wu8 1.000 OneToOne 0.00 1.000 FORMAT "%5.3" EXTENDED_LIMITS 0.00 255.0 READ_ONLY /end CHARACTERISTIC
/begin CHARACTERISTIC FrmMng_dENG2ID_C "Botschaftsidentifier CAN-Botschaft ENG2" VALUE 0x1C0E08 Kw_Wu32 536870911.000 OneToOne 0.00 536870911.000 FORMAT "%13.3" EXTENDED_LIMITS 0.00 4294967295.00 /end CHARACTERISTIC
/begin CHARACTERISTIC FrmMng_ENG2IDType_C "ID Typ standard oder extended" VALUE 0x1C0E0C Kw_Wu8 0.00 OneToOne 1.000 1.000 FORMAT "%5.3" EXTENDED_LIMITS 0.00 255.0 READ_ONLY /end CHARACTERISTIC
/begin CHARACTERISTIC FrmMng_ENG2NumCAN_C "Auf welchen CAN die Botschaft ist" VALUE 0x1C0E0D Kw_Wu8 2.000 OneToOne 0.00 2.000 FORMAT "%5.3" EXTENDED_LIMITS 0.00 255.0 READ_ONLY /end CHARACTERISTIC
/begin CHARACTERISTIC FrmMng_ENG2NumMsgPos_C "Message Buffer der verwendet wird" VALUE 0x1C0E0E Kw_Wu8 15.00 OneToOne 0.00 15.00 FORMAT "%5.2" EXTENDED_LIMITS 0.00 255.0 READ_ONLY /end CHARACTERISTIC
/begin CHARACTERISTIC FrmMng_ENG2OpMode_C "Richtung transmit/receive" VALUE 0x1C0E0F Kw_Wu8 1.000 OneToOne 0.00 1.000 FORMAT "%5.3" EXTENDED_LIMITS 0.00 255.0 READ_ONLY /end CHARACTERISTIC
/begin CHARACTERISTIC FrmMng_dENG2SchedMesgLen_C "Applizierbare Botschaftlänge für ENG2" VALUE 0x1C0E10 Kw_Wu8 8.000 OneToOne 0.00 8.000 FORMAT "%5.3" EXTENDED_LIMITS 0.00 255.0 /end CHARACTERISTIC
/begin CHARACTERISTIC FrmMng_ENG2IntrEna_C "Interrupt enabled oder nicht" VALUE 0x1C0E11 Kw_Wu8 1.000 OneToOne 0.00 1.000 FORMAT "%5.3" EXTENDED_LIMITS 0.00 255.0 READ_ONLY /end CHARACTERISTIC
/begin CHARACTERISTIC FrmMng_ENG2Mul_C "message Buffer ist multiplexed oder nicht" VALUE 0x1C0E12 Kw_Wu8 1.000 OneToOne 0.00 1.000 FORMAT "%5.3" EXTENDED_LIMITS 0.00 255.0 READ_ONLY /end CHARACTERISTIC
/begin CHARACTERISTIC FrmMng_dENG3ID_C "Botschaftsidentifier CAN-Botschaft ENG3" VALUE 0x1C0E14 Kw_Wu32 536870911.000 OneToOne 0.00 536870911.000 FORMAT "%13.3" EXTENDED_LIMITS 0.00 4294967295.00 /end CHARACTERISTIC
/begin CHARACTERISTIC FrmMng_ENG3IDType_C "ID Typ standard oder extended" VALUE 0x1C0E18 Kw_Wu8 0.00 OneToOne 1.000 1.000 FORMAT "%5.3" EXTENDED_LIMITS 0.00 255.0 READ_ONLY /end CHARACTERISTIC
/begin CHARACTERISTIC FrmMng_ENG3NumCAN_C "Auf welchen CAN die Botschaft ist" VALUE 0x1C0E19 Kw_Wu8 2.000 OneToOne 0.00 2.000 FORMAT "%5.3" EXTENDED_LIMITS 0.00 255.0 READ_ONLY /end CHARACTERISTIC
/begin CHARACTERISTIC FrmMng_ENG3NumMsgPos_C "Message Buffer der verwendet wird" VALUE 0x1C0E1A Kw_Wu8 15.00 OneToOne 0.00 15.00 FORMAT "%5.2" EXTENDED_LIMITS 0.00 255.0 READ_ONLY /end CHARACTERISTIC
/begin CHARACTERISTIC FrmMng_ENG3OpMode_C "Richtung transmit/receive" VALUE 0x1C0E1B Kw_Wu8 1.000 OneToOne 0.00 1.000 FORMAT "%5.3" EXTENDED_LIMITS 0.00 255.0 READ_ONLY /end CHARACTERISTIC
/begin CHARACTERISTIC FrmMng_dENG3SchedMesgLen_C "Applizierbare Botschaftlänge für ENG3" VALUE 0x1C0E1C Kw_Wu8 8.000 OneToOne 0.00 8.000 FORMAT "%5.3" EXTENDED_LIMITS 0.00 255.0 /end CHARACTERISTIC
/begin CHARACTERISTIC FrmMng_ENG3IntrEna_C "Interrupt enabled oder nicht" VALUE 0x1C0E1D Kw_Wu8 1.000 OneToOne 0.00 1.000 FORMAT "%5.3" EXTENDED_LIMITS 0.00 255.0 READ_ONLY /end CHARACTERISTIC
/begin CHARACTERISTIC FrmMng_ENG3Mul_C "message Buffer ist multiplexed oder nicht" VALUE 0x1C0E1E Kw_Wu8 1.000 OneToOne 0.00 1.000 FORMAT "%5.3" EXTENDED_LIMITS 0.00 255.0 READ_ONLY /end CHARACTERISTIC
/begin CHARACTERISTIC FrmMng_dENG5ID_C "Botschaftsidentifier CAN-Botschaft ENG5" VALUE 0x1C0E20 Kw_Wu32 536870911.000 OneToOne 0.00 536870911.000 FORMAT "%13.3" EXTENDED_LIMITS 0.00 4294967295.00 /end CHARACTERISTIC
/begin CHARACTERISTIC FrmMng_ENG5IDType_C "ID Typ standard oder extended" VALUE 0x1C0E24 Kw_Wu8 0.00 OneToOne 1.000 1.000 FORMAT "%5.3" EXTENDED_LIMITS 0.00 255.0 READ_ONLY /end CHARACTERISTIC
/begin CHARACTERISTIC FrmMng_ENG5NumCAN_C "Auf welchen CAN die Botschaft ist" VALUE 0x1C0E25 Kw_Wu8 2.000 OneToOne 0.00 2.000 FORMAT "%5.3" EXTENDED_LIMITS 0.00 255.0 READ_ONLY /end CHARACTERISTIC
/begin CHARACTERISTIC FrmMng_ENG5NumMsgPos_C "Message Buffer der verwendet wird" VALUE 0x1C0E26 Kw_Wu8 15.00 OneToOne 0.00 15.00 FORMAT "%5.2" EXTENDED_LIMITS 0.00 255.0 READ_ONLY /end CHARACTERISTIC
/begin CHARACTERISTIC FrmMng_ENG5OpMode_C "Richtung transmit/receive" VALUE 0x1C0E27 Kw_Wu8 1.000 OneToOne 0.00 1.000 FORMAT "%5.3" EXTENDED_LIMITS 0.00 255.0 READ_ONLY /end CHARACTERISTIC
/begin CHARACTERISTIC FrmMng_dENG5SchedMesgLen_C "Applizierbare Botschaftlänge für ENG5" VALUE 0x1C0E28 Kw_Wu8 8.000 OneToOne 0.00 8.000 FORMAT "%5.3" EXTENDED_LIMITS 0.00 255.0 /end CHARACTERISTIC
/begin CHARACTERISTIC FrmMng_ENG5IntrEna_C "Interrupt enabled oder nicht" VALUE 0x1C0E29 Kw_Wu8 1.000 OneToOne 0.00 1.000 FORMAT "%5.3" EXTENDED_LIMITS 0.00 255.0 READ_ONLY /end CHARACTERISTIC
/begin CHARACTERISTIC FrmMng_ENG5Mul_C "message Buffer ist multiplexed oder nicht" VALUE 0x1C0E2A Kw_Wu8 1.000 OneToOne 0.00 1.000 FORMAT "%5.3" EXTENDED_LIMITS 0.00 255.0 READ_ONLY /end CHARACTERISTIC
/begin CHARACTERISTIC FrmMng_dENG6ID_C "Botschaftsidentifier CAN-Botschaft ENG6" VALUE 0x1C0E2C Kw_Wu32 536870911.000 OneToOne 0.00 536870911.000 FORMAT "%13.3" EXTENDED_LIMITS 0.00 4294967295.00 /end CHARACTERISTIC
/begin CHARACTERISTIC FrmMng_ENG6IDType_C "ID Typ standard oder extended" VALUE 0x1C0E30 Kw_Wu8 0.00 OneToOne 1.000 1.000 FORMAT "%5.3" EXTENDED_LIMITS 0.00 255.0 READ_ONLY /end CHARACTERISTIC
/begin CHARACTERISTIC FrmMng_ENG6NumCAN_C "Auf welchen CAN die Botschaft ist" VALUE 0x1C0E31 Kw_Wu8 2.000 OneToOne 0.00 2.000 FORMAT "%5.3" EXTENDED_LIMITS 0.00 255.0 READ_ONLY /end CHARACTERISTIC
/begin CHARACTERISTIC FrmMng_ENG6NumMsgPos_C "Message Buffer der verwendet wird" VALUE 0x1C0E32 Kw_Wu8 15.00 OneToOne 0.00 15.00 FORMAT "%5.2" EXTENDED_LIMITS 0.00 255.0 READ_ONLY /end CHARACTERISTIC
/begin CHARACTERISTIC FrmMng_ENG6OpMode_C "Richtung transmit/receive" VALUE 0x1C0E33 Kw_Wu8 1.000 OneToOne 0.00 1.000 FORMAT "%5.3" EXTENDED_LIMITS 0.00 255.0 READ_ONLY /end CHARACTERISTIC
/begin CHARACTERISTIC FrmMng_dENG6SchedMesgLen_C "Applizierbare Botschaftlänge für ENG6" VALUE 0x1C0E34 Kw_Wu8 8.000 OneToOne 0.00 8.000 FORMAT "%5.3" EXTENDED_LIMITS 0.00 255.0 /end CHARACTERISTIC
/begin CHARACTERISTIC FrmMng_ENG6IntrEna_C "Interrupt enabled oder nicht" VALUE 0x1C0E35 Kw_Wu8 1.000 OneToOne 0.00 1.000 FORMAT "%5.3" EXTENDED_LIMITS 0.00 255.0 READ_ONLY /end CHARACTERISTIC
/begin CHARACTERISTIC FrmMng_ENG6Mul_C "message Buffer ist multiplexed oder nicht" VALUE 0x1C0E36 Kw_Wu8 1.000 OneToOne 0.00 1.000 FORMAT "%5.3" EXTENDED_LIMITS 0.00 255.0 READ_ONLY /end CHARACTERISTIC
/begin CHARACTERISTIC FrmMng_dENG7ID_C "Botschaftsidentifier CAN-Botschaft ENG7" VALUE 0x1C0E38 Kw_Wu32 536870911.000 OneToOne 0.00 536870911.000 FORMAT "%13.3" EXTENDED_LIMITS 0.00 4294967295.00 /end CHARACTERISTIC
/begin CHARACTERISTIC FrmMng_ENG7IDType_C "ID Typ standard oder extended" VALUE 0x1C0E3C Kw_Wu8 0.00 OneToOne 1.000 1.000 FORMAT "%5.3" EXTENDED_LIMITS 0.00 255.0 READ_ONLY /end CHARACTERISTIC
/begin CHARACTERISTIC FrmMng_ENG7NumCAN_C "Auf welchen CAN die Botschaft ist" VALUE 0x1C0E3D Kw_Wu8 2.000 OneToOne 0.00 2.000 FORMAT "%5.3" EXTENDED_LIMITS 0.00 255.0 READ_ONLY /end CHARACTERISTIC
/begin CHARACTERISTIC FrmMng_ENG7NumMsgPos_C "Message Buffer der verwendet wird" VALUE 0x1C0E3E Kw_Wu8 15.00 OneToOne 0.00 15.00 FORMAT "%5.2" EXTENDED_LIMITS 0.00 255.0 READ_ONLY /end CHARACTERISTIC
/begin CHARACTERISTIC FrmMng_ENG7OpMode_C "Richtung transmit/receive" VALUE 0x1C0E3F Kw_Wu8 1.000 OneToOne 0.00 1.000 FORMAT "%5.3" EXTENDED_LIMITS 0.00 255.0 READ_ONLY /end CHARACTERISTIC
/begin CHARACTERISTIC FrmMng_dENG7SchedMesgLen_C "Applizierbare Botschaftlänge für ENG7" VALUE 0x1C0E40 Kw_Wu8 8.000 OneToOne 0.00 8.000 FORMAT "%5.3" EXTENDED_LIMITS 0.00 255.0 /end CHARACTERISTIC
/begin CHARACTERISTIC FrmMng_ENG7IntrEna_C "Interrupt enabled oder nicht" VALUE 0x1C0E41 Kw_Wu8 1.000 OneToOne 0.00 1.000 FORMAT "%5.3" EXTENDED_LIMITS 0.00 255.0 READ_ONLY /end CHARACTERISTIC
/begin CHARACTERISTIC FrmMng_ENG7Mul_C "message Buffer ist multiplexed oder nicht" VALUE 0x1C0E42 Kw_Wu8 1.000 OneToOne 0.00 1.000 FORMAT "%5.3" EXTENDED_LIMITS 0.00 255.0 READ_ONLY /end CHARACTERISTIC
/begin CHARACTERISTIC FrmMng_dENGACTR1ID_C "Botschaftsidentifier CAN-Botschaft ENGACTR1" VALUE 0x1C0E44 Kw_Wu32 536870911.000 OneToOne 0.00 536870911.000 FORMAT "%13.3" EXTENDED_LIMITS 0.00 4294967295.00 /end CHARACTERISTIC
/begin CHARACTERISTIC FrmMng_ENGACTR1IDType_C "ID Typ standard oder extended" VALUE 0x1C0E48 Kw_Wu8 0.00 OneToOne 1.000 1.000 FORMAT "%5.3" EXTENDED_LIMITS 0.00 255.0 READ_ONLY /end CHARACTERISTIC
/begin CHARACTERISTIC FrmMng_ENGACTR1NumCAN_C "Auf welchen CAN die Botschaft ist" VALUE 0x1C0E49 Kw_Wu8 2.000 OneToOne 0.00 2.000 FORMAT "%5.3" EXTENDED_LIMITS 0.00 255.0 READ_ONLY /end CHARACTERISTIC
/begin CHARACTERISTIC FrmMng_ENGACTR1NumMsgPos_C "Message Buffer der verwendet wird" VALUE 0x1C0E4A Kw_Wu8 15.00 OneToOne 0.00 15.00 FORMAT "%5.2" EXTENDED_LIMITS 0.00 255.0 READ_ONLY /end CHARACTERISTIC
/begin CHARACTERISTIC FrmMng_ENGACTR1OpMode_C "Richtung transmit/receive" VALUE 0x1C0E4B Kw_Wu8 1.000 OneToOne 0.00 1.000 FORMAT "%5.3" EXTENDED_LIMITS 0.00 255.0 READ_ONLY /end CHARACTERISTIC
/begin CHARACTERISTIC FrmMng_dENGACTR1SchedMesgLen_C "Applizierbare Botschaftlänge für EngActr1" VALUE 0x1C0E4C Kw_Wu8 8.000 OneToOne 0.00 8.000 FORMAT "%5.3" EXTENDED_LIMITS 0.00 255.0 /end CHARACTERISTIC
/begin CHARACTERISTIC FrmMng_ENGACTR1IntrEna_C "Interrupt enabled oder nicht" VALUE 0x1C0E4D Kw_Wu8 1.000 OneToOne 0.00 1.000 FORMAT "%5.3" EXTENDED_LIMITS 0.00 255.0 READ_ONLY /end CHARACTERISTIC
/begin CHARACTERISTIC FrmMng_ENGACTR1Mul_C "message Buffer ist multiplexed oder nicht" VALUE 0x1C0E4E Kw_Wu8 1.000 OneToOne 0.00 1.000 FORMAT "%5.3" EXTENDED_LIMITS 0.00 255.0 READ_ONLY /end CHARACTERISTIC
/begin CHARACTERISTIC FrmMng_dENGFLXID_C "Botschaftsidentifier CAN-Botschaft ENGFLX" VALUE 0x1C0E50 Kw_Wu32 536870911.000 OneToOne 0.00 536870911.000 FORMAT "%13.3" EXTENDED_LIMITS 0.00 4294967295.00 /end CHARACTERISTIC
/begin CHARACTERISTIC FrmMng_ENGFLXIDType_C "ID Typ standard oder extended" VALUE 0x1C0E54 Kw_Wu8 0.00 OneToOne 1.000 1.000 FORMAT "%5.3" EXTENDED_LIMITS 0.00 255.0 READ_ONLY /end CHARACTERISTIC
/begin CHARACTERISTIC FrmMng_ENGFLXNumCAN_C "Auf welchen CAN die Botschaft ist" VALUE 0x1C0E55 Kw_Wu8 2.000 OneToOne 0.00 2.000 FORMAT "%5.3" EXTENDED_LIMITS 0.00 255.0 READ_ONLY /end CHARACTERISTIC
/begin CHARACTERISTIC FrmMng_ENGFLXNumMsgPos_C "Message Buffer der verwendet wird" VALUE 0x1C0E56 Kw_Wu8 15.00 OneToOne 0.00 15.00 FORMAT "%5.2" EXTENDED_LIMITS 0.00 255.0 READ_ONLY /end CHARACTERISTIC
/begin CHARACTERISTIC FrmMng_ENGFLXOpMode_C "Richtung transmit/receive" VALUE 0x1C0E57 Kw_Wu8 1.000 OneToOne 0.00 1.000 FORMAT "%5.3" EXTENDED_LIMITS 0.00 255.0 READ_ONLY /end CHARACTERISTIC
/begin CHARACTERISTIC FrmMng_dENGFLXSchedMesgLen_C "Applizierbare Botschaftlänge für ENGFLX" VALUE 0x1C0E58 Kw_Wu8 8.000 OneToOne 0.00 8.000 FORMAT "%5.3" EXTENDED_LIMITS 0.00 255.0 /end CHARACTERISTIC
/begin CHARACTERISTIC FrmMng_ENGFLXIntrEna_C "Interrupt enabled oder nicht" VALUE 0x1C0E59 Kw_Wu8 1.000 OneToOne 0.00 1.000 FORMAT "%5.3" EXTENDED_LIMITS 0.00 255.0 READ_ONLY /end CHARACTERISTIC
/begin CHARACTERISTIC FrmMng_ENGFLXMul_C "message Buffer ist multiplexed oder nicht" VALUE 0x1C0E5A Kw_Wu8 1.000 OneToOne 0.00 1.000 FORMAT "%5.3" EXTENDED_LIMITS 0.00 255.0 READ_ONLY /end CHARACTERISTIC
/begin CHARACTERISTIC FrmMng_dENGTRQ1ID_C "Botschaftsidentifier CAN-Botschaft ENGTRQ1" VALUE 0x1C0E5C Kw_Wu32 536870911.000 OneToOne 0.00 536870911.000 FORMAT "%13.3" EXTENDED_LIMITS 0.00 4294967295.00 /end CHARACTERISTIC
/begin CHARACTERISTIC FrmMng_ENGTRQ1IDType_C "ID Typ standard oder extended" VALUE 0x1C0E60 Kw_Wu8 0.00 OneToOne 1.000 1.000 FORMAT "%5.3" EXTENDED_LIMITS 0.00 255.0 READ_ONLY /end CHARACTERISTIC
/begin CHARACTERISTIC FrmMng_ENGTRQ1NumCAN_C "Auf welchen CAN die Botschaft ist" VALUE 0x1C0E61 Kw_Wu8 2.000 OneToOne 0.00 2.000 FORMAT "%5.3" EXTENDED_LIMITS 0.00 255.0 READ_ONLY /end CHARACTERISTIC
/begin CHARACTERISTIC FrmMng_ENGTRQ1NumMsgPos_C "Message Buffer der verwendet wird" VALUE 0x1C0E62 Kw_Wu8 15.00 OneToOne 0.00 15.00 FORMAT "%5.2" EXTENDED_LIMITS 0.00 255.0 READ_ONLY /end CHARACTERISTIC
/begin CHARACTERISTIC FrmMng_ENGTRQ1OpMode_C "Richtung transmit/receive" VALUE 0x1C0E63 Kw_Wu8 1.000 OneToOne 0.00 1.000 FORMAT "%5.3" EXTENDED_LIMITS 0.00 255.0 READ_ONLY /end CHARACTERISTIC
/begin CHARACTERISTIC FrmMng_dENGTRQ1SchedMesgLen_C "Applizierbare Botschaftlänge für ENGTRQ1" VALUE 0x1C0E64 Kw_Wu8 8.000 OneToOne 0.00 8.000 FORMAT "%5.3" EXTENDED_LIMITS 0.00 255.0 /end CHARACTERISTIC
/begin CHARACTERISTIC FrmMng_ENGTRQ1IntrEna_C "Interrupt enabled oder nicht" VALUE 0x1C0E65 Kw_Wu8 1.000 OneToOne 0.00 1.000 FORMAT "%5.3" EXTENDED_LIMITS 0.00 255.0 READ_ONLY /end CHARACTERISTIC
/begin CHARACTERISTIC FrmMng_ENGTRQ1Mul_C "message Buffer ist multiplexed oder nicht" VALUE 0x1C0E66 Kw_Wu8 1.000 OneToOne 0.00 1.000 FORMAT "%5.3" EXTENDED_LIMITS 0.00 255.0 READ_ONLY /end CHARACTERISTIC
/begin CHARACTERISTIC FrmMng_dENGTRQ2ID_C "Botschaftsidentifier CAN-Botschaft ENGTRQ2" VALUE 0x1C0E68 Kw_Wu32 536870911.000 OneToOne 0.00 536870911.000 FORMAT "%13.3" EXTENDED_LIMITS 0.00 4294967295.00 /end CHARACTERISTIC
/begin CHARACTERISTIC FrmMng_ENGTRQ2IDType_C "ID Typ standard oder extended" VALUE 0x1C0E6C Kw_Wu8 0.00 OneToOne 1.000 1.000 FORMAT "%5.3" EXTENDED_LIMITS 0.00 255.0 READ_ONLY /end CHARACTERISTIC
/begin CHARACTERISTIC FrmMng_ENGTRQ2NumCAN_C "Auf welchen CAN die Botschaft ist" VALUE 0x1C0E6D Kw_Wu8 2.000 OneToOne 0.00 2.000 FORMAT "%5.3" EXTENDED_LIMITS 0.00 255.0 READ_ONLY /end CHARACTERISTIC
/begin CHARACTERISTIC FrmMng_ENGTRQ2NumMsgPos_C "Message Buffer der verwendet wird" VALUE 0x1C0E6E Kw_Wu8 15.00 OneToOne 0.00 15.00 FORMAT "%5.2" EXTENDED_LIMITS 0.00 255.0 READ_ONLY /end CHARACTERISTIC
/begin CHARACTERISTIC FrmMng_ENGTRQ2OpMode_C "Richtung transmit/receive" VALUE 0x1C0E6F Kw_Wu8 1.000 OneToOne 0.00 1.000 FORMAT "%5.3" EXTENDED_LIMITS 0.00 255.0 READ_ONLY /end CHARACTERISTIC
/begin CHARACTERISTIC FrmMng_dENGTRQ2SchedMesgLen_C "Applizierbare Botschaftlänge für ENGTRQ2" VALUE 0x1C0E70 Kw_Wu8 8.000 OneToOne 0.00 8.000 FORMAT "%5.3" EXTENDED_LIMITS 0.00 255.0 /end CHARACTERISTIC
/begin CHARACTERISTIC FrmMng_ENGTRQ2IntrEna_C "Interrupt enabled oder nicht" VALUE 0x1C0E71 Kw_Wu8 1.000 OneToOne 0.00 1.000 FORMAT "%5.3" EXTENDED_LIMITS 0.00 255.0 READ_ONLY /end CHARACTERISTIC
/begin CHARACTERISTIC FrmMng_ENGTRQ2Mul_C "message Buffer ist multiplexed oder nicht" VALUE 0x1C0E72 Kw_Wu8 1.000 OneToOne 0.00 1.000 FORMAT "%5.3" EXTENDED_LIMITS 0.00 255.0 READ_ONLY /end CHARACTERISTIC
/begin CHARACTERISTIC FrmMng_dENGTRQ3ID_C "Botschaftsidentifier CAN-Botschaft ENGTRQ3" VALUE 0x1C0E74 Kw_Wu32 536870911.000 OneToOne 0.00 536870911.000 FORMAT "%13.3" EXTENDED_LIMITS 0.00 4294967295.00 /end CHARACTERISTIC
/begin CHARACTERISTIC FrmMng_ENGTRQ3IDType_C "ID Typ standard oder extended" VALUE 0x1C0E78 Kw_Wu8 0.00 OneToOne 1.000 1.000 FORMAT "%5.3" EXTENDED_LIMITS 0.00 255.0 READ_ONLY /end CHARACTERISTIC
/begin CHARACTERISTIC FrmMng_ENGTRQ3NumCAN_C "Auf welchen CAN die Botschaft ist" VALUE 0x1C0E79 Kw_Wu8 2.000 OneToOne 0.00 2.000 FORMAT "%5.3" EXTENDED_LIMITS 0.00 255.0 READ_ONLY /end CHARACTERISTIC
/begin CHARACTERISTIC FrmMng_ENGTRQ3NumMsgPos_C "Message Buffer der verwendet wird" VALUE 0x1C0E7A Kw_Wu8 15.00 OneToOne 0.00 15.00 FORMAT "%5.2" EXTENDED_LIMITS 0.00 255.0 READ_ONLY /end CHARACTERISTIC
/begin CHARACTERISTIC FrmMng_ENGTRQ3OpMode_C "Richtung transmit/receive" VALUE 0x1C0E7B Kw_Wu8 1.000 OneToOne 0.00 1.000 FORMAT "%5.3" EXTENDED_LIMITS 0.00 255.0 READ_ONLY /end CHARACTERISTIC
/begin CHARACTERISTIC FrmMng_dENGTRQ3SchedMesgLen_C "Applizierbare Botschaftlänge für ENGTRQ3" VALUE 0x1C0E7C Kw_Wu8 8.000 OneToOne 0.00 8.000 FORMAT "%5.3" EXTENDED_LIMITS 0.00 255.0 /end CHARACTERISTIC
/begin CHARACTERISTIC FrmMng_ENGTRQ3IntrEna_C "Interrupt enabled oder nicht" VALUE 0x1C0E7D Kw_Wu8 1.000 OneToOne 0.00 1.000 FORMAT "%5.3" EXTENDED_LIMITS 0.00 255.0 READ_ONLY /end CHARACTERISTIC
/begin CHARACTERISTIC FrmMng_ENGTRQ3Mul_C "message Buffer ist multiplexed oder nicht" VALUE 0x1C0E7E Kw_Wu8 1.000 OneToOne 0.00 1.000 FORMAT "%5.3" EXTENDED_LIMITS 0.00 255.0 READ_ONLY /end CHARACTERISTIC
/begin CHARACTERISTIC FrmMng_dESCUID_C "Botschaftsidentifier CAN-Botschaft ESCU" VALUE 0x1C0E80 Kw_Wu32 536870911.000 OneToOne 0.00 536870911.000 FORMAT "%13.3" EXTENDED_LIMITS 0.00 4294967295.00 /end CHARACTERISTIC
/begin CHARACTERISTIC FrmMng_ESCUIDType_C "ID Typ standard oder extended" VALUE 0x1C0E84 Kw_Wu8 0.00 OneToOne 1.000 1.000 FORMAT "%5.3" EXTENDED_LIMITS 0.00 255.0 READ_ONLY /end CHARACTERISTIC
/begin CHARACTERISTIC FrmMng_ESCUNumCAN_C "Auf welchen CAN die Botschaft ist" VALUE 0x1C0E85 Kw_Wu8 2.000 OneToOne 0.00 2.000 FORMAT "%5.3" EXTENDED_LIMITS 0.00 255.0 READ_ONLY /end CHARACTERISTIC
/begin CHARACTERISTIC FrmMng_ESCUNumMsgPos_C "Message Buffer der verwendet wird" VALUE 0x1C0E86 Kw_Wu8 15.00 OneToOne 0.00 15.00 FORMAT "%5.2" EXTENDED_LIMITS 0.00 255.0 READ_ONLY /end CHARACTERISTIC
/begin CHARACTERISTIC FrmMng_ESCUOpMode_C "Richtung transmit/receive" VALUE 0x1C0E87 Kw_Wu8 1.000 OneToOne 0.00 1.000 FORMAT "%5.3" EXTENDED_LIMITS 0.00 255.0 READ_ONLY /end CHARACTERISTIC
/begin CHARACTERISTIC FrmMng_dESCUSchedMesgLen_C "Applizierbare Botschaftlänge für ESCU" VALUE 0x1C0E88 Kw_Wu8 8.000 OneToOne 0.00 8.000 FORMAT "%5.3" EXTENDED_LIMITS 0.00 255.0 /end CHARACTERISTIC
/begin CHARACTERISTIC FrmMng_ESCUIntrEna_C "Interrupt enabled oder nicht" VALUE 0x1C0E89 Kw_Wu8 1.000 OneToOne 0.00 1.000 FORMAT "%5.3" EXTENDED_LIMITS 0.00 255.0 READ_ONLY /end CHARACTERISTIC
/begin CHARACTERISTIC FrmMng_ESCUMul_C "message Buffer ist multiplexed oder nicht" VALUE 0x1C0E8A Kw_Wu8 1.000 OneToOne 0.00 1.000 FORMAT "%5.3" EXTENDED_LIMITS 0.00 255.0 READ_ONLY /end CHARACTERISTIC
/begin CHARACTERISTIC FrmMng_ESCUSchedMode_C "CAN Message Schedule Mode fuer RX und TX" VALUE 0x1C0E8C Kw_Wu8 160.0 OneToOne 16.00 176.0 FORMAT "%5.1" EXTENDED_LIMITS 0.00 255.0 READ_ONLY /end CHARACTERISTIC
/begin CHARACTERISTIC FrmMng_ESCUSched_C "Frequenz vom Transfer abhaengig vom Opmode" VALUE 0x1C0E8D Kw_Wu8 254.0 OneToOne 1.000 255.0 FORMAT "%5.1" EXTENDED_LIMITS 0.00 255.0 READ_ONLY /end CHARACTERISTIC
/begin CHARACTERISTIC FrmMng_ESCUStrt_C "Message-Transfer-Aktivierung relativ zur Startzeit" VALUE 0x1C0E8E Kw_Wu8 255.0 OneToOne 0.00 255.0 FORMAT "%5.1" READ_ONLY /end CHARACTERISTIC
/begin CHARACTERISTIC FrmMng_ESCUTOTmp_C "Timeout" VALUE 0x1C0E8F Kw_Wu8 5100. TimeCAN_TO_ms 20.00 5120. FORMAT "%5.0" /end CHARACTERISTIC
/begin CHARACTERISTIC FrmMng_facTRQInrTrq_Slope_CA "Array von Steigungen für Momenten-Umrechnung" VAL_BLK 0x1D288A Kwb_Ws16 7.999878 Fact -4.000000 3.999878 FORMAT "%8.6" NUMBER 4 /end CHARACTERISTIC
/begin CHARACTERISTIC FrmMng_dGW1ID_C "CAN-Botschafts ID für Gateway1-Botschaft" VALUE 0x1C0E90 Kw_Wu32 536870911.000 OneToOne 0.00 536870911.000 FORMAT "%13.3" EXTENDED_LIMITS 0.00 4294967295.00 /end CHARACTERISTIC
/begin CHARACTERISTIC FrmMng_GW1IDType_C "ID Typ standard oder extended" VALUE 0x1C0E94 Kw_Wu8 0.00 OneToOne 1.000 1.000 FORMAT "%5.3" EXTENDED_LIMITS 0.00 255.0 READ_ONLY /end CHARACTERISTIC
/begin CHARACTERISTIC FrmMng_GW1NumCAN_C "Auf welchen CAN die Botschaft ist" VALUE 0x1C0E95 Kw_Wu8 2.000 OneToOne 0.00 2.000 FORMAT "%5.3" EXTENDED_LIMITS 0.00 255.0 READ_ONLY /end CHARACTERISTIC
/begin CHARACTERISTIC FrmMng_GW1NumMsgPos_C "Message Buffer der verwendet wird" VALUE 0x1C0E96 Kw_Wu8 15.00 OneToOne 0.00 15.00 FORMAT "%5.2" EXTENDED_LIMITS 0.00 255.0 READ_ONLY /end CHARACTERISTIC
/begin CHARACTERISTIC FrmMng_GW1OpMode_C "Richtung transmit/receive" VALUE 0x1C0E97 Kw_Wu8 1.000 OneToOne 0.00 1.000 FORMAT "%5.3" EXTENDED_LIMITS 0.00 255.0 READ_ONLY /end CHARACTERISTIC
/begin CHARACTERISTIC FrmMng_dGW1SchedMesgLen_C "CAN Botschaftslänge für Gateway1-Botschaft" VALUE 0x1C0E98 Kw_Wu8 8.000 OneToOne 0.00 8.000 FORMAT "%5.3" EXTENDED_LIMITS 0.00 255.0 /end CHARACTERISTIC
/begin CHARACTERISTIC FrmMng_GW1IntrEna_C "Interrupt enabled oder nicht" VALUE 0x1C0E99 Kw_Wu8 1.000 OneToOne 0.00 1.000 FORMAT "%5.3" EXTENDED_LIMITS 0.00 255.0 READ_ONLY /end CHARACTERISTIC
/begin CHARACTERISTIC FrmMng_GW1Mul_C "message Buffer ist multiplexed oder nicht" VALUE 0x1C0E9A Kw_Wu8 1.000 OneToOne 0.00 1.000 FORMAT "%5.3" EXTENDED_LIMITS 0.00 255.0 READ_ONLY /end CHARACTERISTIC
/begin CHARACTERISTIC FrmMng_GW1SchedMode_C "CAN Message Schedule Mode fuer RX und TX" VALUE 0x1C0E9C Kw_Wu8 160.0 OneToOne 16.00 176.0 FORMAT "%5.1" EXTENDED_LIMITS 0.00 255.0 READ_ONLY /end CHARACTERISTIC
/begin CHARACTERISTIC FrmMng_GW1Sched_C "Frequenz vom Transfer abhaengig vom Opmode" VALUE 0x1C0E9D Kw_Wu8 254.0 OneToOne 1.000 255.0 FORMAT "%5.1" EXTENDED_LIMITS 0.00 255.0 READ_ONLY /end CHARACTERISTIC
/begin CHARACTERISTIC FrmMng_GW1Strt_C "Message-Transfer-Aktivierung relativ zur Startzeit" VALUE 0x1C0E9E Kw_Wu8 255.0 OneToOne 0.00 255.0 FORMAT "%5.1" READ_ONLY /end CHARACTERISTIC
/begin CHARACTERISTIC FrmMng_GW1TOTmp_C "Timeout" VALUE 0x1C0E9F Kw_Wu8 5100. TimeCAN_TO_ms 20.00 5120. FORMAT "%5.0" /end CHARACTERISTIC
/begin CHARACTERISTIC FrmMng_lDrvDist_Offset_C "Offset für die minimal notwendige Fahrweite für die Ölstandsdifferenzauswertungen" VALUE 0x1D279C Kw_Ws16 1638375. Dist -819200.0 819175.0 FORMAT "%8.1" /end CHARACTERISTIC
/begin CHARACTERISTIC FrmMng_facLDrvDist_Slope_C "Slope für minimal notendige Fahrweite für die Ölstandsdifferenzauswertungen" VALUE 0x1D279E Kw_Ws16 65535.00 OneToOne -32768.00 32767.00 FORMAT "%8.2" /end CHARACTERISTIC
/begin CHARACTERISTIC FrmMng_lMaxRng_C "Maximal Kilometer bis zum Service" VALUE 0x1D27A0 Kw_Wu8 127000. Dist1 0.00 127000. FORMAT "%5.0" EXTENDED_LIMITS 0.00 127500. /end CHARACTERISTIC
/begin CHARACTERISTIC FrmMng_lMinDrvDist_C "Mindestfahrweite für die Ölstandsdifferenzauswertungen" VALUE 0x1D27A1 Kw_Wu8 350.0 Dist 25.00 375.0 FORMAT "%5.1" EXTENDED_LIMITS 0.00 6375. /end CHARACTERISTIC
/begin CHARACTERISTIC FrmMng_lMinRng_C "Mindest Kilometer bis zum Service" VALUE 0x1D27A2 Kw_Wu8 127000. Dist1 0.00 127000. FORMAT "%5.0" EXTENDED_LIMITS 0.00 127500. /end CHARACTERISTIC
/begin CHARACTERISTIC FrmMng_lOil_MAP "Ölniveauschwelle in Abhängigkeit von Eng_nAvrg und CTSCD_tClnt" MAP 0x1D27A4 Kf_Xs16_Ys16_Ws16 63.75000 Length_mm 0.00 63.75000 FORMAT "%8.5" EXTENDED_LIMITS -256.0000 255.9922
 /begin AXIS_DESCR STD_AXIS Eng_nAvrg EngN 8 0.00 6000.000 FORMAT "%8.3" EXTENDED_LIMITS -32768.00 32767.00 DEPOSIT ABSOLUTE /end AXIS_DESCR
 /begin AXIS_DESCR STD_AXIS OTSCD_tEngOil Temp_Cels 8 -50.14000 199.8600 FORMAT "%8.4" EXTENDED_LIMITS -3549.940 3003.560 DEPOSIT ABSOLUTE /end AXIS_DESCR
/end CHARACTERISTIC
/begin CHARACTERISTIC FrmMng_lRNG_Offset_C "Offset für die Minimal / Maximal Kilometer bis zum Service" VALUE 0x1D2848 Kw_Ws16 32767500. Dist1 -16384000. 16383500. FORMAT "%8.0" /end CHARACTERISTIC
/begin CHARACTERISTIC FrmMng_facLRNG_Slope_C "Slope für die minimalen / maximalen Kilometer bis zum Service" VALUE 0x1D284A Kw_Ws16 65535.00 OneToOne -32768.00 32767.00 FORMAT "%8.2" /end CHARACTERISTIC
/begin CHARACTERISTIC FrmMng_l_Offset_C "Offset Umrechung SG->CAN für Ölniveauschwelle" VALUE 0x1D284C Kw_Ws16 511.9922 Length_mm -256.0000 255.9922 FORMAT "%8.4" /end CHARACTERISTIC
/begin CHARACTERISTIC FrmMng_facL_Slope_C "Steigung Umrechung SG->CAN für Ölniveauschwelle" VALUE 0x1D284E Kw_Ws16 7.999878 Fact -4.000000 3.999878 FORMAT "%8.6" /end CHARACTERISTIC
/begin CHARACTERISTIC FrmMng_MaxDiffTSC1_C "Maximale Zählerdifferenz für Botschaftszähler Getriebe1" VALUE 0x1D250A Kw_Wu8 255.0 OneToOne 0.00 255.0 FORMAT "%5.1" /end CHARACTERISTIC
/begin CHARACTERISTIC FrmMng_MaxDiffTSC2_C "Maximale Zählerdifferenz für Botschaftszähler Getriebe2" VALUE 0x1D250B Kw_Wu8 255.0 OneToOne 0.00 255.0 FORMAT "%5.1" /end CHARACTERISTIC
/begin CHARACTERISTIC FrmMng_MaxDiffTSC3_C "Maximale Zählerdifferenz für Botschaftszähler Getriebe3" VALUE 0x1D250C Kw_Wu8 255.0 OneToOne 0.00 255.0 FORMAT "%5.1" /end CHARACTERISTIC
/begin CHARACTERISTIC FrmMng_MaxEngGrad_C "Max-Begrenzungswert für Motordrehzahlgradient" VALUE 0x1D259E Kw_Ws16 65535.00 OneToOne -32768.00 32767.00 FORMAT "%8.2" /end CHARACTERISTIC
/begin CHARACTERISTIC FrmMng_MaxPerTSC1_C "Maximale Perioden für Botschaftszähler Getriebe1" VALUE 0x1D250D Kw_Wu8 255.0 OneToOne 0.00 255.0 FORMAT "%5.1" /end CHARACTERISTIC
/begin CHARACTERISTIC FrmMng_MaxPerTSC2_C "Maximale Periodenzahl für Botschaftszähler Getriebe2" VALUE 0x1D250E Kw_Wu8 255.0 OneToOne 0.00 255.0 FORMAT "%5.1" /end CHARACTERISTIC
/begin CHARACTERISTIC FrmMng_MaxPerTSC3_C "Maximale Perioden für Botschaftszähler Getriebe3" VALUE 0x1D250F Kw_Wu8 255.0 OneToOne 0.00 255.0 FORMAT "%5.1" /end CHARACTERISTIC
/begin CHARACTERISTIC FrmMng_MinEngGrad_C "Min-Begrenzungswert für Motordrehzahlgradient" VALUE 0x1D25A0 Kw_Ws16 65535.00 OneToOne -32768.00 32767.00 FORMAT "%8.2" /end CHARACTERISTIC
/begin CHARACTERISTIC FrmMng_nDes_C "Motorwunschdrehzahl" VALUE 0x1D28B2 Kw_Wu16 255.0000 OneToOne 0.00 255.0000 FORMAT "%8.4" EXTENDED_LIMITS 0.00 65535.00 /end CHARACTERISTIC
/begin CHARACTERISTIC FrmMng_nDes_MAP "Motorwunschdrehzahl in Abhängigkeit von EngM_ctRevSta und CTSCD_tClnt" MAP 0x1D25A2 Kf_Xs16_Ys16_Ws16 6000.000 EngN 0.00 6000.000 FORMAT "%8.3" EXTENDED_LIMITS -32768.00 32767.00
 /begin AXIS_DESCR STD_AXIS EngM_ctRevSta OneToOne 6 0.00 32767.00 FORMAT "%8.2" EXTENDED_LIMITS -32768.00 32767.00 DEPOSIT ABSOLUTE /end AXIS_DESCR
 /begin AXIS_DESCR STD_AXIS CTSCD_tClnt Temp_Cels 10 -50.14000 199.8600 FORMAT "%8.4" EXTENDED_LIMITS -3549.940 3003.560 DEPOSIT ABSOLUTE /end AXIS_DESCR
/end CHARACTERISTIC
/begin CHARACTERISTIC FrmMng_nEngPrt_MAP "Motorwunschdrehzahl in Abhängigkeit von VSSCD_v und EngPrt_facPrtLimCorr" MAP 0x1D263E Kf_Xs16_Ys16_Ws16 6000.000 EngN 0.00 6000.000 FORMAT "%8.3" EXTENDED_LIMITS -32768.00 32767.00
 /begin AXIS_DESCR STD_AXIS VSSCD_v Vel 10 0.00 300.0000 FORMAT "%8.4" EXTENDED_LIMITS -327.6800 327.6700 DEPOSIT ABSOLUTE /end AXIS_DESCR
 /begin AXIS_DESCR STD_AXIS EngPrt_facPrtLimCorr Fact 10 0.00 4.000000 FORMAT "%8.6" EXTENDED_LIMITS -4.000000 3.999878 DEPOSIT ABSOLUTE /end AXIS_DESCR
/end CHARACTERISTIC
/begin CHARACTERISTIC FrmMng_dNIVEAU1ID_C "Botschaftsidentifier CAN-Botschaft NIVEAU1" VALUE 0x1C0EA0 Kw_Wu32 536870911.000 OneToOne 0.00 536870911.000 FORMAT "%13.3" EXTENDED_LIMITS 0.00 4294967295.00 /end CHARACTERISTIC
/begin CHARACTERISTIC FrmMng_NIVEAU1IDType_C "ID Typ standard oder extended" VALUE 0x1C0EA4 Kw_Wu8 0.00 OneToOne 1.000 1.000 FORMAT "%5.3" EXTENDED_LIMITS 0.00 255.0 READ_ONLY /end CHARACTERISTIC
/begin CHARACTERISTIC FrmMng_NIVEAU1NumCAN_C "Auf welchen CAN die Botschaft ist" VALUE 0x1C0EA5 Kw_Wu8 2.000 OneToOne 0.00 2.000 FORMAT "%5.3" EXTENDED_LIMITS 0.00 255.0 READ_ONLY /end CHARACTERISTIC
/begin CHARACTERISTIC FrmMng_NIVEAU1NumMsgPos_C "Message Buffer der verwendet wird" VALUE 0x1C0EA6 Kw_Wu8 15.00 OneToOne 0.00 15.00 FORMAT "%5.2" EXTENDED_LIMITS 0.00 255.0 READ_ONLY /end CHARACTERISTIC
/begin CHARACTERISTIC FrmMng_NIVEAU1OpMode_C "Richtung transmit/receive" VALUE 0x1C0EA7 Kw_Wu8 1.000 OneToOne 0.00 1.000 FORMAT "%5.3" EXTENDED_LIMITS 0.00 255.0 READ_ONLY /end CHARACTERISTIC
/begin CHARACTERISTIC FrmMng_dNIVEAU1SchedMesgLen_C "applizierbare Botschaftslänge für NIVEAU1" VALUE 0x1C0EA8 Kw_Wu8 8.000 OneToOne 0.00 8.000 FORMAT "%5.3" EXTENDED_LIMITS 0.00 255.0 /end CHARACTERISTIC
/begin CHARACTERISTIC FrmMng_NIVEAU1IntrEna_C "Interrupt enabled oder nicht" VALUE 0x1C0EA9 Kw_Wu8 1.000 OneToOne 0.00 1.000 FORMAT "%5.3" EXTENDED_LIMITS 0.00 255.0 READ_ONLY /end CHARACTERISTIC
/begin CHARACTERISTIC FrmMng_NIVEAU1Mul_C "message Buffer ist multiplexed oder nicht" VALUE 0x1C0EAA Kw_Wu8 1.000 OneToOne 0.00 1.000 FORMAT "%5.3" EXTENDED_LIMITS 0.00 255.0 READ_ONLY /end CHARACTERISTIC
/begin CHARACTERISTIC FrmMng_NIVEAU1SchedMode_C "CAN Message Schedule Mode fuer RX und TX" VALUE 0x1C0EAC Kw_Wu8 160.0 OneToOne 16.00 176.0 FORMAT "%5.1" EXTENDED_LIMITS 0.00 255.0 READ_ONLY /end CHARACTERISTIC
/begin CHARACTERISTIC FrmMng_NIVEAU1Sched_C "Frequenz vom Transfer abhaengig vom Opmode" VALUE 0x1C0EAD Kw_Wu8 254.0 OneToOne 1.000 255.0 FORMAT "%5.1" EXTENDED_LIMITS 0.00 255.0 READ_ONLY /end CHARACTERISTIC
/begin CHARACTERISTIC FrmMng_NIVEAU1Strt_C "Message-Transfer-Aktivierung relativ zur Startzeit" VALUE 0x1C0EAE Kw_Wu8 255.0 OneToOne 0.00 255.0 FORMAT "%5.1" READ_ONLY /end CHARACTERISTIC
/begin CHARACTERISTIC FrmMng_NIVEAU1TOTmp_C "Timeout" VALUE 0x1C0EAF Kw_Wu8 5100. TimeCAN_TO_ms 20.00 5120. FORMAT "%5.0" /end CHARACTERISTIC
/begin CHARACTERISTIC FrmMng_n_Offset_C "Offset Umrechung SG->CAN für Drehzahl" VALUE 0x1D2732 Kw_Ws16 65535.00 EngN -32768.00 32767.00 FORMAT "%8.2" /end CHARACTERISTIC
/begin CHARACTERISTIC FrmMng_facN_Slope_C "Steigung Umrechung SG->CAN für Drehzahl" VALUE 0x1D2734 Kw_Ws16 7.999878 Fact -4.000000 3.999878 FORMAT "%8.6" /end CHARACTERISTIC
/begin CHARACTERISTIC FrmMng_pBoost_Offset_C "CAN-Umrechnungsparameter Offset für Ladedruck" VALUE 0x1D2736 Kw_Ws16 65535.00 Pres_hPa -32768.00 32767.00 FORMAT "%8.2" /end CHARACTERISTIC
/begin CHARACTERISTIC FrmMng_facPBoost_Slope_C "CAN-Umrechnungsparameter Steigung für Ladedruck" VALUE 0x1D2738 Kw_Ws16 7.999878 Fact -4.000000 3.999878 FORMAT "%8.6" /end CHARACTERISTIC
/begin CHARACTERISTIC FrmMng_pwrKW_Offset_C "Offset Umrechung SG->CAN für max. Leistung" VALUE 0x1D2850 Kw_Ws16 655.3500 Pwr_kW -327.6800 327.6700 FORMAT "%8.4" /end CHARACTERISTIC
/begin CHARACTERISTIC FrmMng_facpwrKW_Slope_C "Steigung Umrechung SG->CAN für max. Leistung" VALUE 0x1D2852 Kw_Ws16 7.999878 Fact -4.000000 3.999878 FORMAT "%8.6" /end CHARACTERISTIC
/begin CHARACTERISTIC FrmMng_pwrMax_C "maximale Motorleistung" VALUE 0x1D2854 Kw_Wu16 655.3500 Pwr_kW 0.00 655.3500 FORMAT "%8.4" /end CHARACTERISTIC
/begin CHARACTERISTIC FrmMng_rAlt_Offset_C "Offset Umrechung SG->CAN für Generatorlast" VALUE 0x1D273A Kw_Ws16 655.3500 Prc -327.6800 327.6700 FORMAT "%8.4" /end CHARACTERISTIC
/begin CHARACTERISTIC FrmMng_facRAlt_Slope_C "Steigung Umrechung SG->CAN für Generatorlast" VALUE 0x1D273C Kw_Ws16 7.999878 Fact -4.000000 3.999878 FORMAT "%8.6" /end CHARACTERISTIC
/begin CHARACTERISTIC FrmMng_rChrgrExTemp_C "Tastverhältnis-Schwellenwert für Übertemperatur" VALUE 0x1D257A Kw_Ws16 100.0000 DtyCyc 0.00 100.0000 FORMAT "%8.4" EXTENDED_LIMITS -327.6800 327.6700 /end CHARACTERISTIC
/begin CHARACTERISTIC FrmMng_rChrgrStrt_C "Tastverhältnis-Schwellenwert für Kaltstart" VALUE 0x1D257C Kw_Ws16 100.0000 DtyCyc 0.00 100.0000 FORMAT "%8.4" EXTENDED_LIMITS -327.6800 327.6700 /end CHARACTERISTIC
/begin CHARACTERISTIC FrmMng_rCurInf_C "Motordrehzahlbeeinflussung" VALUE 0x1D273E Kw_Wu16 100.0000 Prc 0.00 100.0000 FORMAT "%8.4" EXTENDED_LIMITS 0.00 655.3500 /end CHARACTERISTIC
/begin CHARACTERISTIC FrmMng_rEcoDflVal_C "AccPed Ersatzwert über CAN" VALUE 0x1D2740 Kw_Ws16 655.3500 Prc -327.6800 327.6700 FORMAT "%8.4" /end CHARACTERISTIC
/begin CHARACTERISTIC FrmMng_rEngActr_Offset_C "Offset für Umwandlung von gesendetem/empfangenem Turbolader Tastverhältnis" VALUE 0x1D28BC Kw_Ws16 100.0000 DtyCyc 0.00 100.0000 FORMAT "%8.4" EXTENDED_LIMITS -327.6800 327.6700 /end CHARACTERISTIC
/begin CHARACTERISTIC FrmMng_facEngActr_Slope_C "Steigung für Umwandlung von gesendetem/empfangenem Turbolader Tastverhältnis" VALUE 0x1D28BE Kw_Ws16 2.000000 Fact 0.00 2.000000 FORMAT "%8.6" EXTENDED_LIMITS -4.000000 3.999878 /end CHARACTERISTIC
/begin CHARACTERISTIC FrmMng_rGlw_Offset_C "Offset für Glühkerzenstatus über CAN" VALUE 0x1D2742 Kw_Ws16 655.3500 DtyCyc -327.6800 327.6700 FORMAT "%8.4" /end CHARACTERISTIC
/begin CHARACTERISTIC FrmMng_facRGlw_Slope_C "Steigung für Glühkerzenstatus über CAN" VALUE 0x1D2744 Kw_Ws16 511.9922 Fact1 -256.0000 255.9922 FORMAT "%8.4" /end CHARACTERISTIC
/begin CHARACTERISTIC FrmMng_rICur_Offset_C "Offset Umrechung SG->CAN für Drehzahl" VALUE 0x1D2746 Kw_Ws16 655.3500 Prc -327.6800 327.6700 FORMAT "%8.4" /end CHARACTERISTIC
/begin CHARACTERISTIC FrmMng_facRICur_Slope_C "Steigung Umrechung SG->CAN für Drehzahl" VALUE 0x1D2748 Kw_Ws16 7.999878 Fact -4.000000 3.999878 FORMAT "%8.6" /end CHARACTERISTIC
/begin CHARACTERISTIC FrmMng_rSlpRes_Offset_C "CAN Umrechnungsparameter Offset für Fahrwiderstandsindex : CAN -> ECU" VALUE 0x1D2510 Kw_Ws16 65.53500 PrcHigh -32.76800 32.76700 FORMAT "%8.5" /end CHARACTERISTIC
/begin CHARACTERISTIC FrmMng_facRSlpRes_Slope_C "CAN Umrechnungsparameter Steigung für Fahrwiederindex : CAN -> ECU" VALUE 0x1D2512 Kw_Ws16 7.999878 Fact -4.000000 3.999878 FORMAT "%8.6" /end CHARACTERISTIC
/begin CHARACTERISTIC FrmMng_dRXIMMCTLID_C "CAN-Identifier für Empfangsbotschaft der Wegfahrsperre" VALUE 0x1C0EB0 Kw_Wu32 536870911.000 OneToOne 0.00 536870911.000 FORMAT "%13.3" EXTENDED_LIMITS 0.00 4294967295.00 /end CHARACTERISTIC
/begin CHARACTERISTIC FrmMng_RXIMMCTLIDType_C "ID Typ standard oder extended" VALUE 0x1C0EB4 Kw_Wu8 0.00 OneToOne 1.000 1.000 FORMAT "%5.3" EXTENDED_LIMITS 0.00 255.0 READ_ONLY /end CHARACTERISTIC
/begin CHARACTERISTIC FrmMng_RXIMMCTLNumCAN_C "Auf welchen CAN die Botschaft ist" VALUE 0x1C0EB5 Kw_Wu8 2.000 OneToOne 0.00 2.000 FORMAT "%5.3" EXTENDED_LIMITS 0.00 255.0 READ_ONLY /end CHARACTERISTIC
/begin CHARACTERISTIC FrmMng_RXIMMCTLNumMsgPos_C "Message Buffer der verwendet wird" VALUE 0x1C0EB6 Kw_Wu8 15.00 OneToOne 0.00 15.00 FORMAT "%5.2" EXTENDED_LIMITS 0.00 255.0 READ_ONLY /end CHARACTERISTIC
/begin CHARACTERISTIC FrmMng_RXIMMCTLOpMode_C "Richtung transmit/receive" VALUE 0x1C0EB7 Kw_Wu8 1.000 OneToOne 0.00 1.000 FORMAT "%5.3" EXTENDED_LIMITS 0.00 255.0 READ_ONLY /end CHARACTERISTIC
/begin CHARACTERISTIC FrmMng_dRXIMMCTLLen_cu8 "Laenge der Messagedaten in Byte" VALUE 0x1C0EB8 Kw_Wu8 8.000 OneToOne 0.00 8.000 FORMAT "%5.3" EXTENDED_LIMITS 0.00 255.0 /end CHARACTERISTIC
/begin CHARACTERISTIC FrmMng_RXIMMCTLIntrEna_C "Interrupt enabled oder nicht" VALUE 0x1C0EB9 Kw_Wu8 1.000 OneToOne 0.00 1.000 FORMAT "%5.3" EXTENDED_LIMITS 0.00 255.0 READ_ONLY /end CHARACTERISTIC
/begin CHARACTERISTIC FrmMng_RXIMMCTLMul_C "message Buffer ist multiplexed oder nicht" VALUE 0x1C0EBA Kw_Wu8 1.000 OneToOne 0.00 1.000 FORMAT "%5.3" EXTENDED_LIMITS 0.00 255.0 READ_ONLY /end CHARACTERISTIC
/begin CHARACTERISTIC FrmMng_r_Offset_C "Offset Umrechung SG->CAN für Verhältnisse" VALUE 0x1D2856 Kw_Ws16 65535.00 OneToOne -32768.00 32767.00 FORMAT "%8.2" /end CHARACTERISTIC
/begin CHARACTERISTIC FrmMng_facR_Slope_C "Steigung Umrechung SG->CAN für Verhältnisse" VALUE 0x1D2858 Kw_Ws16 7.999878 Fact -4.000000 3.999878 FORMAT "%8.6" /end CHARACTERISTIC
/begin CHARACTERISTIC FrmMng_stCANVer_C "Versionsnummer des CAN- Layouts" VALUE 0x1D274A Kw_Wu8 6.000 OneToOne 0.00 6.000 FORMAT "%5.3" EXTENDED_LIMITS 0.00 255.0 /end CHARACTERISTIC
/begin CHARACTERISTIC FrmMng_stEGTRgnMsk_C "Bitmaske für die Abhängigkeit vom Abgasnachbehandlungsstatus" VALUE 0x1D274C Kw_Wu32 4294967295.00 OneToOne 0.00 4294967295.00 FORMAT "%13.2" /end CHARACTERISTIC
/begin CHARACTERISTIC FrmMng_stExhGsType_C "Abgastyp" VALUE 0x1D2750 Kw_Wu8 3.000 OneToOne 0.00 3.000 FORMAT "%5.3" EXTENDED_LIMITS 0.00 255.0 /end CHARACTERISTIC
/begin CHARACTERISTIC FrmMng_dSTIGNID_C "Botschaftsidentifier CAN-Botschaft StIgn (ZAS1)" VALUE 0x1C0EBC Kw_Wu32 536870911.000 OneToOne 0.00 536870911.000 FORMAT "%13.3" EXTENDED_LIMITS 0.00 4294967295.00 /end CHARACTERISTIC
/begin CHARACTERISTIC FrmMng_STIGNIDType_C "ID Typ standard oder extended" VALUE 0x1C0EC0 Kw_Wu8 0.00 OneToOne 1.000 1.000 FORMAT "%5.3" EXTENDED_LIMITS 0.00 255.0 READ_ONLY /end CHARACTERISTIC
/begin CHARACTERISTIC FrmMng_STIGNNumCAN_C "Auf welchen CAN die Botschaft ist" VALUE 0x1C0EC1 Kw_Wu8 2.000 OneToOne 0.00 2.000 FORMAT "%5.3" EXTENDED_LIMITS 0.00 255.0 READ_ONLY /end CHARACTERISTIC
/begin CHARACTERISTIC FrmMng_STIGNNumMsgPos_C "Message Buffer der verwendet wird" VALUE 0x1C0EC2 Kw_Wu8 15.00 OneToOne 0.00 15.00 FORMAT "%5.2" EXTENDED_LIMITS 0.00 255.0 READ_ONLY /end CHARACTERISTIC
/begin CHARACTERISTIC FrmMng_STIGNOpMode_C "Richtung transmit/receive" VALUE 0x1C0EC3 Kw_Wu8 1.000 OneToOne 0.00 1.000 FORMAT "%5.3" EXTENDED_LIMITS 0.00 255.0 READ_ONLY /end CHARACTERISTIC
/begin CHARACTERISTIC FrmMng_dSTIGNSchedMesgLen_C "Applizierbare Botschaftlänge für STIGN" VALUE 0x1C0EC4 Kw_Wu8 8.000 OneToOne 0.00 8.000 FORMAT "%5.3" EXTENDED_LIMITS 0.00 255.0 /end CHARACTERISTIC
/begin CHARACTERISTIC FrmMng_STIGNIntrEna_C "Interrupt enabled oder nicht" VALUE 0x1C0EC5 Kw_Wu8 1.000 OneToOne 0.00 1.000 FORMAT "%5.3" EXTENDED_LIMITS 0.00 255.0 READ_ONLY /end CHARACTERISTIC
/begin CHARACTERISTIC FrmMng_STIGNMul_C "message Buffer ist multiplexed oder nicht" VALUE 0x1C0EC6 Kw_Wu8 1.000 OneToOne 0.00 1.000 FORMAT "%5.3" EXTENDED_LIMITS 0.00 255.0 READ_ONLY /end CHARACTERISTIC
/begin CHARACTERISTIC FrmMng_STIGNSchedMode_C "CAN Message Schedule Mode fuer RX und TX" VALUE 0x1C0EC8 Kw_Wu8 160.0 OneToOne 16.00 176.0 FORMAT "%5.1" EXTENDED_LIMITS 0.00 255.0 READ_ONLY /end CHARACTERISTIC
/begin CHARACTERISTIC FrmMng_STIGNSched_C "Frequenz vom Transfer abhaengig vom Opmode" VALUE 0x1C0EC9 Kw_Wu8 254.0 OneToOne 1.000 255.0 FORMAT "%5.1" EXTENDED_LIMITS 0.00 255.0 READ_ONLY /end CHARACTERISTIC
/begin CHARACTERISTIC FrmMng_STIGNStrt_C "Message-Transfer-Aktivierung relativ zur Startzeit" VALUE 0x1C0ECA Kw_Wu8 255.0 OneToOne 0.00 255.0 FORMAT "%5.1" READ_ONLY /end CHARACTERISTIC
/begin CHARACTERISTIC FrmMng_STIGNTOTmp_C "Timeout" VALUE 0x1C0ECB Kw_Wu8 5100. TimeCAN_TO_ms 20.00 5120. FORMAT "%5.0" /end CHARACTERISTIC
/begin CHARACTERISTIC FrmMng_stOvrFlowDet_C "Überfüllungserkennung aktiv" VALUE 0x1D285A Kw_Wu8 1.000 OneToOne 0.00 1.000 FORMAT "%5.3" EXTENDED_LIMITS 0.00 255.0 /end CHARACTERISTIC
/begin CHARACTERISTIC FrmMng_stSendEng6_B1_Vector "Konfigurationslabel für Bypass Freischnitt" VALUE 0x1C0A7C Kw_Wu8 255.0 OneToOne 0.00 255.0 FORMAT "%5.1" /end CHARACTERISTIC
/begin CHARACTERISTIC FrmMng_stSendEng6_B1_Channel "Konfigurationslabel für Bypass Freischnitt" VALUE 0x1C0A7D Kw_Wu8 255.0 OneToOne 0.00 255.0 FORMAT "%5.1" /end CHARACTERISTIC
/begin CHARACTERISTIC FrmMng_stSendEng6_B2_Vector "Konfigurationslabel für Bypass Freischnitt" VALUE 0x1C0A7E Kw_Wu8 255.0 OneToOne 0.00 255.0 FORMAT "%5.1" /end CHARACTERISTIC
/begin CHARACTERISTIC FrmMng_stSendEng6_B2_Channel "Konfigurationslabel für Bypass Freischnitt" VALUE 0x1C0A7F Kw_Wu8 255.0 OneToOne 0.00 255.0 FORMAT "%5.1" /end CHARACTERISTIC
/begin CHARACTERISTIC FrmMng_stSendEng6_B3_Vector "Konfigurationslabel für Bypass Freischnitt" VALUE 0x1C0A80 Kw_Wu8 255.0 OneToOne 0.00 255.0 FORMAT "%5.1" /end CHARACTERISTIC
/begin CHARACTERISTIC FrmMng_stSendEng6_B3_Channel "Konfigurationslabel für Bypass Freischnitt" VALUE 0x1C0A81 Kw_Wu8 255.0 OneToOne 0.00 255.0 FORMAT "%5.1" /end CHARACTERISTIC
/begin CHARACTERISTIC FrmMng_stSendEng6_B4_Vector "Konfigurationslabel für Bypass Freischnitt" VALUE 0x1C0A82 Kw_Wu8 255.0 OneToOne 0.00 255.0 FORMAT "%5.1" /end CHARACTERISTIC
/begin CHARACTERISTIC FrmMng_stSendEng6_B4_Channel "Konfigurationslabel für Bypass Freischnitt" VALUE 0x1C0A83 Kw_Wu8 255.0 OneToOne 0.00 255.0 FORMAT "%5.1" /end CHARACTERISTIC
/begin CHARACTERISTIC FrmMng_stSendEng6_B5_Vector "Konfigurationslabel für Bypass Freischnitt" VALUE 0x1C0A84 Kw_Wu8 255.0 OneToOne 0.00 255.0 FORMAT "%5.1" /end CHARACTERISTIC
/begin CHARACTERISTIC FrmMng_stSendEng6_B5_Channel "Konfigurationslabel für Bypass Freischnitt" VALUE 0x1C0A85 Kw_Wu8 255.0 OneToOne 0.00 255.0 FORMAT "%5.1" /end CHARACTERISTIC
/begin CHARACTERISTIC FrmMng_stSendEng6_B6_Vector "Konfigurationslabel für Bypass Freischnitt" VALUE 0x1C0A86 Kw_Wu8 255.0 OneToOne 0.00 255.0 FORMAT "%5.1" /end CHARACTERISTIC
/begin CHARACTERISTIC FrmMng_stSendEng6_B6_Channel "Konfigurationslabel für Bypass Freischnitt" VALUE 0x1C0A87 Kw_Wu8 255.0 OneToOne 0.00 255.0 FORMAT "%5.1" /end CHARACTERISTIC
/begin CHARACTERISTIC FrmMng_stSendEng6_B7_Vector "Konfigurationslabel für Bypass Freischnitt" VALUE 0x1C0A88 Kw_Wu8 255.0 OneToOne 0.00 255.0 FORMAT "%5.1" /end CHARACTERISTIC
/begin CHARACTERISTIC FrmMng_stSendEng6_B7_Channel "Konfigurationslabel für Bypass Freischnitt" VALUE 0x1C0A89 Kw_Wu8 255.0 OneToOne 0.00 255.0 FORMAT "%5.1" /end CHARACTERISTIC
/begin CHARACTERISTIC FrmMng_stSendEng6_B8_Vector "Konfigurationslabel für Bypass Freischnitt" VALUE 0x1C0A8A Kw_Wu8 255.0 OneToOne 0.00 255.0 FORMAT "%5.1" /end CHARACTERISTIC
/begin CHARACTERISTIC FrmMng_stSendEng6_B8_Channel "Konfigurationslabel für Bypass Freischnitt" VALUE 0x1C0A8B Kw_Wu8 255.0 OneToOne 0.00 255.0 FORMAT "%5.1" /end CHARACTERISTIC
/begin CHARACTERISTIC FrmMng_stSendEngTrq1_B1_Vector "Konfigurationslabel für Bypass Freischnitt" VALUE 0x1C0A8C Kw_Wu8 255.0 OneToOne 0.00 255.0 FORMAT "%5.1" /end CHARACTERISTIC
/begin CHARACTERISTIC FrmMng_stSendEngTrq1_B1_Channel "Konfigurationslabel für Bypass Freischnitt" VALUE 0x1C0A8D Kw_Wu8 255.0 OneToOne 0.00 255.0 FORMAT "%5.1" /end CHARACTERISTIC
/begin CHARACTERISTIC FrmMng_stSendEngTrq1_B2_Vector "Konfigurationslabel für Bypass Freischnitt" VALUE 0x1C0A8E Kw_Wu8 255.0 OneToOne 0.00 255.0 FORMAT "%5.1" /end CHARACTERISTIC
/begin CHARACTERISTIC FrmMng_stSendEngTrq1_B2_Channel "Konfigurationslabel für Bypass Freischnitt" VALUE 0x1C0A8F Kw_Wu8 255.0 OneToOne 0.00 255.0 FORMAT "%5.1" /end CHARACTERISTIC
/begin CHARACTERISTIC FrmMng_stSendEngTrq1_B3_Vector "Konfigurationslabel für Bypass Freischnitt" VALUE 0x1C0A90 Kw_Wu8 255.0 OneToOne 0.00 255.0 FORMAT "%5.1" /end CHARACTERISTIC
/begin CHARACTERISTIC FrmMng_stSendEngTrq1_B3_Channel "Konfigurationslabel für Bypass Freischnitt" VALUE 0x1C0A91 Kw_Wu8 255.0 OneToOne 0.00 255.0 FORMAT "%5.1" /end CHARACTERISTIC
/begin CHARACTERISTIC FrmMng_stSendEngTrq1_B4_Vector "Konfigurationslabel für Bypass Freischnitt" VALUE 0x1C0A92 Kw_Wu8 255.0 OneToOne 0.00 255.0 FORMAT "%5.1" /end CHARACTERISTIC
/begin CHARACTERISTIC FrmMng_stSendEngTrq1_B4_Channel "Konfigurationslabel für Bypass Freischnitt" VALUE 0x1C0A93 Kw_Wu8 255.0 OneToOne 0.00 255.0 FORMAT "%5.1" /end CHARACTERISTIC
/begin CHARACTERISTIC FrmMng_stSendEngTrq1_B5_Vector "Konfigurationslabel für Bypass Freischnitt" VALUE 0x1C0A94 Kw_Wu8 255.0 OneToOne 0.00 255.0 FORMAT "%5.1" /end CHARACTERISTIC
/begin CHARACTERISTIC FrmMng_stSendEngTrq1_B5_Channel "Konfigurationslabel für Bypass Freischnitt" VALUE 0x1C0A95 Kw_Wu8 255.0 OneToOne 0.00 255.0 FORMAT "%5.1" /end CHARACTERISTIC
/begin CHARACTERISTIC FrmMng_stSendEngTrq1_B6_Vector "Konfigurationslabel für Bypass Freischnitt" VALUE 0x1C0A96 Kw_Wu8 255.0 OneToOne 0.00 255.0 FORMAT "%5.1" /end CHARACTERISTIC
/begin CHARACTERISTIC FrmMng_stSendEngTrq1_B6_Channel "Konfigurationslabel für Bypass Freischnitt" VALUE 0x1C0A97 Kw_Wu8 255.0 OneToOne 0.00 255.0 FORMAT "%5.1" /end CHARACTERISTIC
/begin CHARACTERISTIC FrmMng_stSendEngTrq1_B7_Vector "Konfigurationslabel für Bypass Freischnitt" VALUE 0x1C0A98 Kw_Wu8 255.0 OneToOne 0.00 255.0 FORMAT "%5.1" /end CHARACTERISTIC
/begin CHARACTERISTIC FrmMng_stSendEngTrq1_B7_Channel "Konfigurationslabel für Bypass Freischnitt" VALUE 0x1C0A99 Kw_Wu8 255.0 OneToOne 0.00 255.0 FORMAT "%5.1" /end CHARACTERISTIC
/begin CHARACTERISTIC FrmMng_stSendEngTrq1_B8_Vector "Konfigurationslabel für Bypass Freischnitt" VALUE 0x1C0A9A Kw_Wu8 255.0 OneToOne 0.00 255.0 FORMAT "%5.1" /end CHARACTERISTIC
/begin CHARACTERISTIC FrmMng_stSendEngTrq1_B8_Channel "Konfigurationslabel für Bypass Freischnitt" VALUE 0x1C0A9B Kw_Wu8 255.0 OneToOne 0.00 255.0 FORMAT "%5.1" /end CHARACTERISTIC
/begin CHARACTERISTIC FrmMng_stSendEngTrq2_B1_Vector "Konfigurationslabel für Bypass Freischnitt" VALUE 0x1C0A9C Kw_Wu8 255.0 OneToOne 0.00 255.0 FORMAT "%5.1" /end CHARACTERISTIC
/begin CHARACTERISTIC FrmMng_stSendEngTrq2_B1_Channel "Konfigurationslabel für Bypass Freischnitt" VALUE 0x1C0A9D Kw_Wu8 255.0 OneToOne 0.00 255.0 FORMAT "%5.1" /end CHARACTERISTIC
/begin CHARACTERISTIC FrmMng_stSendEngTrq2_B2_Vector "Konfigurationslabel für Bypass Freischnitt" VALUE 0x1C0A9E Kw_Wu8 255.0 OneToOne 0.00 255.0 FORMAT "%5.1" /end CHARACTERISTIC
/begin CHARACTERISTIC FrmMng_stSendEngTrq2_B2_Channel "Konfigurationslabel für Bypass Freischnitt" VALUE 0x1C0A9F Kw_Wu8 255.0 OneToOne 0.00 255.0 FORMAT "%5.1" /end CHARACTERISTIC
/begin CHARACTERISTIC FrmMng_stSendEngTrq2_B3_Vector "Konfigurationslabel für Bypass Freischnitt" VALUE 0x1C0AA0 Kw_Wu8 255.0 OneToOne 0.00 255.0 FORMAT "%5.1" /end CHARACTERISTIC
/begin CHARACTERISTIC FrmMng_stSendEngTrq2_B3_Channel "Konfigurationslabel für Bypass Freischnitt" VALUE 0x1C0AA1 Kw_Wu8 255.0 OneToOne 0.00 255.0 FORMAT "%5.1" /end CHARACTERISTIC
/begin CHARACTERISTIC FrmMng_stSendEngTrq2_B4_Vector "Konfigurationslabel für Bypass Freischnitt" VALUE 0x1C0AA2 Kw_Wu8 255.0 OneToOne 0.00 255.0 FORMAT "%5.1" /end CHARACTERISTIC
/begin CHARACTERISTIC FrmMng_stSendEngTrq2_B4_Channel "Konfigurationslabel für Bypass message" VALUE 0x1C0AA3 Kw_Wu8 255.0 OneToOne 0.00 255.0 FORMAT "%5.1" /end CHARACTERISTIC
/begin CHARACTERISTIC FrmMng_stSendEngTrq2_B5_Vector "Konfigurationslabel für Bypass Freischnitt" VALUE 0x1C0AA4 Kw_Wu8 255.0 OneToOne 0.00 255.0 FORMAT "%5.1" /end CHARACTERISTIC
/begin CHARACTERISTIC FrmMng_stSendEngTrq2_B5_Channel "Konfigurationslabel für Bypass Freischnitt" VALUE 0x1C0AA5 Kw_Wu8 255.0 OneToOne 0.00 255.0 FORMAT "%5.1" /end CHARACTERISTIC
/begin CHARACTERISTIC FrmMng_stSendEngTrq2_B6_Vector "Konfigurationslabel für Bypass Freischnitt" VALUE 0x1C0AA6 Kw_Wu8 255.0 OneToOne 0.00 255.0 FORMAT "%5.1" /end CHARACTERISTIC
/begin CHARACTERISTIC FrmMng_stSendEngTrq2_B6_Channel "Konfigurationslabel für Bypass Freischnitt" VALUE 0x1C0AA7 Kw_Wu8 255.0 OneToOne 0.00 255.0 FORMAT "%5.1" /end CHARACTERISTIC
/begin CHARACTERISTIC FrmMng_stSendEngTrq2_B7_Vector "Konfigurationslabel für Bypass Freischnitt" VALUE 0x1C0AA8 Kw_Wu8 255.0 OneToOne 0.00 255.0 FORMAT "%5.1" /end CHARACTERISTIC
/begin CHARACTERISTIC FrmMng_stSendEngTrq2_B7_Channel "Konfigurationslabel für Bypass Freischnitt" VALUE 0x1C0AA9 Kw_Wu8 255.0 OneToOne 0.00 255.0 FORMAT "%5.1" /end CHARACTERISTIC
/begin CHARACTERISTIC FrmMng_stSendEngTrq2_B8_Vector "Konfigurationslabel für Bypass Freischnitt" VALUE 0x1C0AAA Kw_Wu8 255.0 OneToOne 0.00 255.0 FORMAT "%5.1" /end CHARACTERISTIC
/begin CHARACTERISTIC FrmMng_stSendEngTrq2_B8_Channel "Konfigurationslabel für Bypass Freischnitt" VALUE 0x1C0AAB Kw_Wu8 255.0 OneToOne 0.00 255.0 FORMAT "%5.1" /end CHARACTERISTIC
/begin CHARACTERISTIC FrmMng_stSendEngTrq3_B1_Vector "Konfigurationslabel für Bypass Freischnitt" VALUE 0x1C0AAC Kw_Wu8 255.0 OneToOne 0.00 255.0 FORMAT "%5.1" /end CHARACTERISTIC
/begin CHARACTERISTIC FrmMng_stSendEngTrq3_B1_Channel "Konfigurationslabel für Bypass Freischnitt" VALUE 0x1C0AAD Kw_Wu8 255.0 OneToOne 0.00 255.0 FORMAT "%5.1" /end CHARACTERISTIC
/begin CHARACTERISTIC FrmMng_stSendEngTrq3_B2_Vector "Konfigurationslabel für Bypass Freischnitt" VALUE 0x1C0AAE Kw_Wu8 255.0 OneToOne 0.00 255.0 FORMAT "%5.1" /end CHARACTERISTIC
/begin CHARACTERISTIC FrmMng_stSendEngTrq3_B2_Channel "Konfigurationslabel für Bypass Freischnitt" VALUE 0x1C0AAF Kw_Wu8 255.0 OneToOne 0.00 255.0 FORMAT "%5.1" /end CHARACTERISTIC
/begin CHARACTERISTIC FrmMng_stSendEngTrq3_B3_Vector "Konfigurationslabel für Bypass Freischnitt" VALUE 0x1C0AB0 Kw_Wu8 255.0 OneToOne 0.00 255.0 FORMAT "%5.1" /end CHARACTERISTIC
/begin CHARACTERISTIC FrmMng_stSendEngTrq3_B3_Channel "Konfigurationslabel für Bypass Freischnitt" VALUE 0x1C0AB1 Kw_Wu8 255.0 OneToOne 0.00 255.0 FORMAT "%5.1" /end CHARACTERISTIC
/begin CHARACTERISTIC FrmMng_stSendEngTrq3_B4_Vector "Konfigurationslabel für Bypass Freischnitt" VALUE 0x1C0AB2 Kw_Wu8 255.0 OneToOne 0.00 255.0 FORMAT "%5.1" /end CHARACTERISTIC
/begin CHARACTERISTIC FrmMng_stSendEngTrq3_B4_Channel "Konfigurationslabel für Bypass Freischnitt" VALUE 0x1C0AB3 Kw_Wu8 255.0 OneToOne 0.00 255.0 FORMAT "%5.1" /end CHARACTERISTIC
/begin CHARACTERISTIC FrmMng_stSendEngTrq3_B5_Vector "Konfigurationslabel für Bypass Freischnitt" VALUE 0x1C0AB4 Kw_Wu8 255.0 OneToOne 0.00 255.0 FORMAT "%5.1" /end CHARACTERISTIC
/begin CHARACTERISTIC FrmMng_stSendEngTrq3_B5_Channel "Konfigurationslabel für Bypass Freischnitt" VALUE 0x1C0AB5 Kw_Wu8 255.0 OneToOne 0.00 255.0 FORMAT "%5.1" /end CHARACTERISTIC
/begin CHARACTERISTIC FrmMng_stSendEngTrq3_B6_Vector "Konfigurationslabel für Bypass Freischnitt" VALUE 0x1C0AB6 Kw_Wu8 255.0 OneToOne 0.00 255.0 FORMAT "%5.1" /end CHARACTERISTIC
/begin CHARACTERISTIC FrmMng_stSendEngTrq3_B6_Channel "Konfigurationslabel für Bypass Freischnitt" VALUE 0x1C0AB7 Kw_Wu8 255.0 OneToOne 0.00 255.0 FORMAT "%5.1" /end CHARACTERISTIC
/begin CHARACTERISTIC FrmMng_stSendEngTrq3_B7_Vector "Konfigurationslabel für Bypass Freischnitt" VALUE 0x1C0AB8 Kw_Wu8 255.0 OneToOne 0.00 255.0 FORMAT "%5.1" /end CHARACTERISTIC
/begin CHARACTERISTIC FrmMng_stSendEngTrq3_B7_Channel "Konfigurationslabel für Bypass Freischnitt" VALUE 0x1C0AB9 Kw_Wu8 255.0 OneToOne 0.00 255.0 FORMAT "%5.1" /end CHARACTERISTIC
/begin CHARACTERISTIC FrmMng_stSendEngTrq3_B8_Vector "Konfigurationslabel für Bypass Freischnitt" VALUE 0x1C0ABA Kw_Wu8 255.0 OneToOne 0.00 255.0 FORMAT "%5.1" /end CHARACTERISTIC
/begin CHARACTERISTIC FrmMng_stSendEngTrq3_B8_Channel "Konfigurationslabel für Bypass Freischnitt" VALUE 0x1C0ABB Kw_Wu8 255.0 OneToOne 0.00 255.0 FORMAT "%5.1" /end CHARACTERISTIC
/begin CHARACTERISTIC FrmMng_stTRQ_C "Status doppelte Momente" VALUE 0x1D2751 Kw_Wu8 1.000 OneToOne 0.00 1.000 FORMAT "%5.3" EXTENDED_LIMITS 0.00 255.0 /end CHARACTERISTIC
/begin CHARACTERISTIC FrmMng_swtCHRGR1Ena_C "Freischaltung für CAN-Botschaft CHRGR1" VALUE 0x1D257E Kw_Wu8 1.000 OneToOne 0.00 1.000 FORMAT "%5.3" EXTENDED_LIMITS 0.00 255.0 /end CHARACTERISTIC
/begin CHARACTERISTIC FrmMng_swtCHRGR2Ena_C "Freischaltung für CAN-Botschaft CHRGR2" VALUE 0x1D257F Kw_Wu8 1.000 OneToOne 0.00 1.000 FORMAT "%5.3" EXTENDED_LIMITS 0.00 255.0 /end CHARACTERISTIC
/begin CHARACTERISTIC FrmMng_swtConvAdp_C "Schalter für die LFR Adaption" VALUE 0x1D2752 Kw_Wu8 1.000 OneToOne 0.00 1.000 FORMAT "%5.3" EXTENDED_LIMITS 0.00 255.0 /end CHARACTERISTIC
/begin CHARACTERISTIC FrmMng_swtENG1Ena_C "Freischaltung für CAN-Botschaft Motor1" VALUE 0x1D2753 Kw_Wu8 1.000 OneToOne 0.00 1.000 FORMAT "%5.3" EXTENDED_LIMITS 0.00 255.0 /end CHARACTERISTIC
/begin CHARACTERISTIC FrmMng_swtENG2Ena_C "Freischaltung für CAN-Botschaft Motor2" VALUE 0x1D2754 Kw_Wu8 1.000 OneToOne 0.00 1.000 FORMAT "%5.3" EXTENDED_LIMITS 0.00 255.0 /end CHARACTERISTIC
/begin CHARACTERISTIC FrmMng_swtENG3Ena_C "Freischaltung für CAN-Botschaft Motor3" VALUE 0x1D2755 Kw_Wu8 1.000 OneToOne 0.00 1.000 FORMAT "%5.3" EXTENDED_LIMITS 0.00 255.0 /end CHARACTERISTIC
/begin CHARACTERISTIC FrmMng_swtENG5Ena_C "Freischaltung für CAN-Botschaft Motor5" VALUE 0x1D2756 Kw_Wu8 1.000 OneToOne 0.00 1.000 FORMAT "%5.3" EXTENDED_LIMITS 0.00 255.0 /end CHARACTERISTIC
/begin CHARACTERISTIC FrmMng_swtENG6Ena_C "Freischaltung für CAN-Botschaft Motor6" VALUE 0x1D2757 Kw_Wu8 1.000 OneToOne 0.00 1.000 FORMAT "%5.3" EXTENDED_LIMITS 0.00 255.0 /end CHARACTERISTIC
/begin CHARACTERISTIC FrmMng_swtENG7Ena_C "Freischaltung für CAN-Botschaft Motor7" VALUE 0x1D2758 Kw_Wu8 1.000 OneToOne 0.00 1.000 FORMAT "%5.3" EXTENDED_LIMITS 0.00 255.0 /end CHARACTERISTIC
/begin CHARACTERISTIC FrmMng_swtENGACTR1Ena_C "Freischaltung für CAN-Botschaft ENGACTR1" VALUE 0x1D28C0 Kw_Wu8 1.000 OneToOne 0.00 1.000 FORMAT "%5.3" EXTENDED_LIMITS 0.00 255.0 /end CHARACTERISTIC
/begin CHARACTERISTIC FrmMng_swtENGFLXEna_C "Freischaltung für CAN-Botschaft Motor Flexia" VALUE 0x1D285B Kw_Wu8 1.000 OneToOne 0.00 1.000 FORMAT "%5.3" EXTENDED_LIMITS 0.00 255.0 /end CHARACTERISTIC
/begin CHARACTERISTIC FrmMng_swtENGTRQ1Ena_C "Freischaltung für CAN-Botschaft ENGTRQ1" VALUE 0x1D2892 Kw_Wu8 1.000 OneToOne 0.00 1.000 FORMAT "%5.3" EXTENDED_LIMITS 0.00 255.0 /end CHARACTERISTIC
/begin CHARACTERISTIC FrmMng_swtENGTRQ2Ena_C "Freischaltung für CAN-Botschaft ENGTRQ2" VALUE 0x1D2893 Kw_Wu8 1.000 OneToOne 0.00 1.000 FORMAT "%5.3" EXTENDED_LIMITS 0.00 255.0 /end CHARACTERISTIC
/begin CHARACTERISTIC FrmMng_swtENGTRQ3Ena_C "Freischaltung für CAN-Botschaft ENGTRQ3" VALUE 0x1D2894 Kw_Wu8 1.000 OneToOne 0.00 1.000 FORMAT "%5.3" EXTENDED_LIMITS 0.00 255.0 /end CHARACTERISTIC
/begin CHARACTERISTIC FrmMng_swtFrcAdp_C "Adaption des mechanischen Verlustmoments" VALUE 0x1D2759 Kw_Wu8 1.000 OneToOne 0.00 1.000 FORMAT "%5.3" EXTENDED_LIMITS 0.00 255.0 /end CHARACTERISTIC
/begin CHARACTERISTIC FrmMng_swtGearbxVer_C "Schalter zum Ausblenden des erhöhenden Getriebeeingriffs" VALUE 0x1D275A Kw_Wu8 1.000 OneToOne 0.00 1.000 FORMAT "%5.3" EXTENDED_LIMITS 0.00 255.0 /end CHARACTERISTIC
/begin CHARACTERISTIC FrmMng_swtTOSEna_C "Freischaltung TOG-Empfangsbotschaft" VALUE 0x1D24D4 Kw_Wu8 1.000 OneToOne 0.00 1.000 FORMAT "%5.3" EXTENDED_LIMITS 0.00 255.0 /end CHARACTERISTIC
/begin CHARACTERISTIC FrmMng_swtTrqErr_C "Auswahl der Ursachen für Drehmoment ungenau" VALUE 0x1D275B Kw_Wu8 127.0 OneToOne 0.00 127.0 FORMAT "%5.1" EXTENDED_LIMITS 0.00 255.0 /end CHARACTERISTIC
/begin CHARACTERISTIC FrmMng_swtTrqFrc_C "Auswahl der Ursachen für Fehlerkennzeichenwert 0xFF" VALUE 0x1D275C Kw_Wu8 127.0 OneToOne 0.00 127.0 FORMAT "%5.1" EXTENDED_LIMITS 0.00 255.0 /end CHARACTERISTIC
/begin CHARACTERISTIC FrmMng_swtTSC1Ena_C "Freischaltung für CAN-Botschaft Getriebe1" VALUE 0x1D2514 Kw_Wu8 1.000 OneToOne 0.00 1.000 FORMAT "%5.3" EXTENDED_LIMITS 0.00 255.0 /end CHARACTERISTIC
/begin CHARACTERISTIC FrmMng_swtTSC2Ena_C "Freischaltung für CAN-Botschaft Getriebe2" VALUE 0x1D2515 Kw_Wu8 1.000 OneToOne 0.00 1.000 FORMAT "%5.3" EXTENDED_LIMITS 0.00 255.0 /end CHARACTERISTIC
/begin CHARACTERISTIC FrmMng_swtTSC3Ena_C "Freischaltung für CAN-Botschaft Getriebe3" VALUE 0x1D2516 Kw_Wu8 1.000 OneToOne 0.00 1.000 FORMAT "%5.3" EXTENDED_LIMITS 0.00 255.0 /end CHARACTERISTIC
/begin CHARACTERISTIC FrmMng_swtTSC3NeutDisbl_C "Schalter zur Deaktivierung der Aktualisierung von FrmMng_trqTSC3 auf neutralen Momentenwert" VALUE 0x1D2517 Kw_Wu8 1.000 OneToOne 0.00 1.000 FORMAT "%5.3" EXTENDED_LIMITS 0.00 255.0 /end CHARACTERISTIC
/begin CHARACTERISTIC FrmMng_swtTSC3Type_C "Switch Typs Botschaft Getriebe3" VALUE 0x1D2518 Kw_Wu8 2.000 OneToOne 0.00 2.000 FORMAT "%5.3" EXTENDED_LIMITS 0.00 255.0 /end CHARACTERISTIC
/begin CHARACTERISTIC FrmMng_tChrgrStrt_C "Motortemperatur Schwellenwert für Kaltstart" VALUE 0x1D2580 Kw_Ws16 200.0000 Temp_Cels -50.14000 149.8600 FORMAT "%8.4" EXTENDED_LIMITS -3549.940 3003.560 /end CHARACTERISTIC
/begin CHARACTERISTIC FrmMng_tiAdpStrtDly_C "Verzögerungszeit nach Start" VALUE 0x1D275E Kw_Wu16 655350.0 Time_ms 0.00 655350.0 FORMAT "%8.1" /end CHARACTERISTIC
/begin CHARACTERISTIC FrmMng_tiChrgrStrt_C "Verzögerungszeit nach Kaltstart" VALUE 0x1D2582 Kw_Wu16 10000.00 Time_ms 0.00 10000.00 FORMAT "%8.2" EXTENDED_LIMITS 0.00 655350.0 /end CHARACTERISTIC
/begin CHARACTERISTIC FrmMng_tiFillLvl_Offset_C "Offset für die Füllstandszeit" VALUE 0x1D24D6 Kw_Ws16 6553.500 Time_RtmLowRes -3276.800 3276.700 FORMAT "%8.3" /end CHARACTERISTIC
/begin CHARACTERISTIC FrmMng_facTiFillLvl_Slope_C "Slope für die Füllstandszeit" VALUE 0x1D24D8 Kw_Ws16 7.999878 Fact -4.000000 3.999878 FORMAT "%8.6" /end CHARACTERISTIC
/begin CHARACTERISTIC FrmMng_tiLdResp_Offset_C "CAN-Umrechnungsparameter-Offset für die Lastreaktionszeit des Generators" VALUE 0x1D2760 Kw_Ws16 655.3500 Time_s -327.6800 327.6700 FORMAT "%8.4" /end CHARACTERISTIC
/begin CHARACTERISTIC FrmMng_facTiLdResp_Slope_C "CAN-Umrechnungsparameter-Steigung für die Lastreaktionszeit des Generators" VALUE 0x1D2762 Kw_Ws16 511.9922 Fact1 -256.0000 255.9922 FORMAT "%8.4" /end CHARACTERISTIC
/begin CHARACTERISTIC FrmMng_tiMaxRng_C "Maximaler Zeitintervall bis zum Service" VALUE 0x1D285C Kw_Wu8 63.00 OneToOne 0.00 63.00 FORMAT "%5.2" EXTENDED_LIMITS 0.00 255.0 /end CHARACTERISTIC
/begin CHARACTERISTIC FrmMng_tiMinRng_C "Minimaler Zeitintervall bis zum Service" VALUE 0x1D285D Kw_Wu8 63.00 OneToOne 0.00 63.00 FORMAT "%5.2" EXTENDED_LIMITS 0.00 255.0 /end CHARACTERISTIC
/begin CHARACTERISTIC FrmMng_tiOilTemp_Offset_C "Offset für die Ölstandstemperaturzeit" VALUE 0x1D24DA Kw_Ws16 8191.875 Time_HighRes -4096.000 4095.875 FORMAT "%8.3" /end CHARACTERISTIC
/begin CHARACTERISTIC FrmMng_facTiOilTemp_Slope_C "Slope für die Ölstandstemperaturzeit" VALUE 0x1D24DC Kw_Ws16 7.999878 Fact -4.000000 3.999878 FORMAT "%8.6" /end CHARACTERISTIC
/begin CHARACTERISTIC FrmMng_ti_Offset_C "Offset Umrechung SG->CAN für Zeit" VALUE 0x1D251A Kw_Ws16 655350.0 Time_ms -327680.0 327670.0 FORMAT "%8.1" /end CHARACTERISTIC
/begin CHARACTERISTIC FrmMng_facTi_Slope_C "Steigung Umrechung SG->CAN für Zeit" VALUE 0x1D251C Kw_Ws16 511.9922 Fact1 -256.0000 255.9922 FORMAT "%8.4" /end CHARACTERISTIC
/begin CHARACTERISTIC FrmMng_dTOSID_C "CAN Botschafts-ID für TOG-Botschaft" VALUE 0x1C0ECC Kw_Wu32 536870911.000 OneToOne 0.00 536870911.000 FORMAT "%13.3" EXTENDED_LIMITS 0.00 4294967295.00 /end CHARACTERISTIC
/begin CHARACTERISTIC FrmMng_TOSIDType_C "ID Typ standard oder extended" VALUE 0x1C0ED0 Kw_Wu8 0.00 OneToOne 1.000 1.000 FORMAT "%5.3" EXTENDED_LIMITS 0.00 255.0 READ_ONLY /end CHARACTERISTIC
/begin CHARACTERISTIC FrmMng_TOSNumCAN_C "Auf welchen CAN die Botschaft ist" VALUE 0x1C0ED1 Kw_Wu8 2.000 OneToOne 0.00 2.000 FORMAT "%5.3" EXTENDED_LIMITS 0.00 255.0 READ_ONLY /end CHARACTERISTIC
/begin CHARACTERISTIC FrmMng_TOSNumMsgPos_C "Message Buffer der verwendet wird" VALUE 0x1C0ED2 Kw_Wu8 15.00 OneToOne 0.00 15.00 FORMAT "%5.2" EXTENDED_LIMITS 0.00 255.0 READ_ONLY /end CHARACTERISTIC
/begin CHARACTERISTIC FrmMng_TOSOpMode_C "Richtung transmit/receive" VALUE 0x1C0ED3 Kw_Wu8 1.000 OneToOne 0.00 1.000 FORMAT "%5.3" EXTENDED_LIMITS 0.00 255.0 READ_ONLY /end CHARACTERISTIC
/begin CHARACTERISTIC FrmMng_dTOSSchedMesgLen_C "CAN Botschaftslänge für TOG-Botschaft" VALUE 0x1C0ED4 Kw_Wu8 8.000 OneToOne 0.00 8.000 FORMAT "%5.3" EXTENDED_LIMITS 0.00 255.0 /end CHARACTERISTIC
/begin CHARACTERISTIC FrmMng_TOSIntrEna_C "Interrupt enabled oder nicht" VALUE 0x1C0ED5 Kw_Wu8 1.000 OneToOne 0.00 1.000 FORMAT "%5.3" EXTENDED_LIMITS 0.00 255.0 READ_ONLY /end CHARACTERISTIC
/begin CHARACTERISTIC FrmMng_TOSMul_C "message Buffer ist multiplexed oder nicht" VALUE 0x1C0ED6 Kw_Wu8 1.000 OneToOne 0.00 1.000 FORMAT "%5.3" EXTENDED_LIMITS 0.00 255.0 READ_ONLY /end CHARACTERISTIC
/begin CHARACTERISTIC FrmMng_TOSSchedMode_C "CAN Message Schedule Mode fuer RX und TX" VALUE 0x1C0ED8 Kw_Wu8 160.0 OneToOne 16.00 176.0 FORMAT "%5.1" EXTENDED_LIMITS 0.00 255.0 READ_ONLY /end CHARACTERISTIC
/begin CHARACTERISTIC FrmMng_TOSSched_C "Frequenz vom Transfer abhaengig vom Opmode" VALUE 0x1C0ED9 Kw_Wu8 254.0 OneToOne 1.000 255.0 FORMAT "%5.1" EXTENDED_LIMITS 0.00 255.0 READ_ONLY /end CHARACTERISTIC
/begin CHARACTERISTIC FrmMng_TOSStrt_C "Message-Transfer-Aktivierung relativ zur Startzeit" VALUE 0x1C0EDA Kw_Wu8 255.0 OneToOne 0.00 255.0 FORMAT "%5.1" READ_ONLY /end CHARACTERISTIC
/begin CHARACTERISTIC FrmMng_TOSTOTmp_C "Timeout" VALUE 0x1C0EDB Kw_Wu8 5100. TimeCAN_TO_ms 20.00 5120. FORMAT "%5.0" /end CHARACTERISTIC
/begin CHARACTERISTIC FrmMng_trFct_Offset_C "Offset für Umrechnung SG -> CAN für Übertragungsfunktion" VALUE 0x1D251E Kw_Ws16 65535.00 OneToOne -32768.00 32767.00 FORMAT "%8.2" /end CHARACTERISTIC
/begin CHARACTERISTIC FrmMng_facTrFct_Slope_C "Steigung für Umwandlung SG -> CAN für Übertragungsfunktion" VALUE 0x1D2520 Kw_Ws16 7.999878 Fact -4.000000 3.999878 FORMAT "%8.6" /end CHARACTERISTIC
/begin CHARACTERISTIC FrmMng_trqEngTrqPrp_Offset_CA "Array von Offset-Werten für die Umrechnung des Antriebsmoments" VAL_BLK 0x1D2898 Kwb_Ws32 429496729.500 Trq -214748364.800 214748364.700 FORMAT "%13.3" NUMBER 4 /end CHARACTERISTIC
/begin CHARACTERISTIC FrmMng_trqGearbxMax_C "maximal versendetes Getriebemoment" VALUE 0x1D2764 Kw_Ws16 1500.000 Trq -500.0000 1000.000 FORMAT "%8.3" EXTENDED_LIMITS -3276.800 3276.700 /end CHARACTERISTIC
/begin CHARACTERISTIC FrmMng_trqInrTrq_Offset_CA "Array von Offset Werten zur Umrechnung von Trq --> InrTrq" VAL_BLK 0x1D28A8 Kwb_Ws16 6553.500 Trq -3276.800 3276.700 FORMAT "%8.3" NUMBER 4 /end CHARACTERISTIC
/begin CHARACTERISTIC FrmMng_trqMulinfo5_0_C "Multiplex Info 0, Botschaft Motor5, maximales Moment" VALUE 0x1D2766 Kw_Wu16 630.0000 Trq 0.00 630.0000 FORMAT "%8.4" EXTENDED_LIMITS 0.00 6553.500 /end CHARACTERISTIC
/begin CHARACTERISTIC FrmMng_dTSC1ID_C "Botschaftsidentifier CAN-Botschaft TSC1" VALUE 0x1C0EDC Kw_Wu32 536870911.000 OneToOne 0.00 536870911.000 FORMAT "%13.3" EXTENDED_LIMITS 0.00 4294967295.00 /end CHARACTERISTIC
/begin CHARACTERISTIC FrmMng_TSC1IDType_C "ID Typ standard oder extended" VALUE 0x1C0EE0 Kw_Wu8 0.00 OneToOne 1.000 1.000 FORMAT "%5.3" EXTENDED_LIMITS 0.00 255.0 READ_ONLY /end CHARACTERISTIC
/begin CHARACTERISTIC FrmMng_TSC1NumCAN_C "Auf welchen CAN die Botschaft ist" VALUE 0x1C0EE1 Kw_Wu8 2.000 OneToOne 0.00 2.000 FORMAT "%5.3" EXTENDED_LIMITS 0.00 255.0 READ_ONLY /end CHARACTERISTIC
/begin CHARACTERISTIC FrmMng_TSC1NumMsgPos_C "Message Buffer der verwendet wird" VALUE 0x1C0EE2 Kw_Wu8 15.00 OneToOne 0.00 15.00 FORMAT "%5.2" EXTENDED_LIMITS 0.00 255.0 READ_ONLY /end CHARACTERISTIC
/begin CHARACTERISTIC FrmMng_TSC1OpMode_C "Richtung transmit/receive" VALUE 0x1C0EE3 Kw_Wu8 1.000 OneToOne 0.00 1.000 FORMAT "%5.3" EXTENDED_LIMITS 0.00 255.0 READ_ONLY /end CHARACTERISTIC
/begin CHARACTERISTIC FrmMng_dTSC1SchedMesgLen_C "Applizierbare Botschaftlänge für TSC1" VALUE 0x1C0EE4 Kw_Wu8 8.000 OneToOne 0.00 8.000 FORMAT "%5.3" EXTENDED_LIMITS 0.00 255.0 /end CHARACTERISTIC
/begin CHARACTERISTIC FrmMng_TSC1IntrEna_C "Interrupt enabled oder nicht" VALUE 0x1C0EE5 Kw_Wu8 1.000 OneToOne 0.00 1.000 FORMAT "%5.3" EXTENDED_LIMITS 0.00 255.0 READ_ONLY /end CHARACTERISTIC
/begin CHARACTERISTIC FrmMng_TSC1Mul_C "message Buffer ist multiplexed oder nicht" VALUE 0x1C0EE6 Kw_Wu8 1.000 OneToOne 0.00 1.000 FORMAT "%5.3" EXTENDED_LIMITS 0.00 255.0 READ_ONLY /end CHARACTERISTIC
/begin CHARACTERISTIC FrmMng_TSC1SchedMode_C "CAN Message Schedule Mode fuer RX und TX" VALUE 0x1C0EE8 Kw_Wu8 160.0 OneToOne 16.00 176.0 FORMAT "%5.1" EXTENDED_LIMITS 0.00 255.0 READ_ONLY /end CHARACTERISTIC
/begin CHARACTERISTIC FrmMng_TSC1Sched_C "Frequenz vom Transfer abhaengig vom Opmode" VALUE 0x1C0EE9 Kw_Wu8 254.0 OneToOne 1.000 255.0 FORMAT "%5.1" EXTENDED_LIMITS 0.00 255.0 READ_ONLY /end CHARACTERISTIC
/begin CHARACTERISTIC FrmMng_TSC1Strt_C "Message-Transfer-Aktivierung relativ zur Startzeit" VALUE 0x1C0EEA Kw_Wu8 255.0 OneToOne 0.00 255.0 FORMAT "%5.1" READ_ONLY /end CHARACTERISTIC
/begin CHARACTERISTIC FrmMng_TSC1TOTmp_C "Timeout" VALUE 0x1C0EEB Kw_Wu8 5100. TimeCAN_TO_ms 20.00 5120. FORMAT "%5.0" /end CHARACTERISTIC
/begin CHARACTERISTIC FrmMng_dTSC2ID_C "Botschaftsidentifier CAN-Botschaft TSC2" VALUE 0x1C0EEC Kw_Wu32 536870911.000 OneToOne 0.00 536870911.000 FORMAT "%13.3" EXTENDED_LIMITS 0.00 4294967295.00 /end CHARACTERISTIC
/begin CHARACTERISTIC FrmMng_TSC2IDType_C "ID Typ standard oder extended" VALUE 0x1C0EF0 Kw_Wu8 0.00 OneToOne 1.000 1.000 FORMAT "%5.3" EXTENDED_LIMITS 0.00 255.0 READ_ONLY /end CHARACTERISTIC
/begin CHARACTERISTIC FrmMng_TSC2NumCAN_C "Auf welchen CAN die Botschaft ist" VALUE 0x1C0EF1 Kw_Wu8 2.000 OneToOne 0.00 2.000 FORMAT "%5.3" EXTENDED_LIMITS 0.00 255.0 READ_ONLY /end CHARACTERISTIC
/begin CHARACTERISTIC FrmMng_TSC2NumMsgPos_C "Message Buffer der verwendet wird" VALUE 0x1C0EF2 Kw_Wu8 15.00 OneToOne 0.00 15.00 FORMAT "%5.2" EXTENDED_LIMITS 0.00 255.0 READ_ONLY /end CHARACTERISTIC
/begin CHARACTERISTIC FrmMng_TSC2OpMode_C "Richtung transmit/receive" VALUE 0x1C0EF3 Kw_Wu8 1.000 OneToOne 0.00 1.000 FORMAT "%5.3" EXTENDED_LIMITS 0.00 255.0 READ_ONLY /end CHARACTERISTIC
/begin CHARACTERISTIC FrmMng_dTSC2SchedMesgLen_C "Applizierbare Botschaftlänge für TSC2" VALUE 0x1C0EF4 Kw_Wu8 8.000 OneToOne 0.00 8.000 FORMAT "%5.3" EXTENDED_LIMITS 0.00 255.0 /end CHARACTERISTIC
/begin CHARACTERISTIC FrmMng_TSC2IntrEna_C "Interrupt enabled oder nicht" VALUE 0x1C0EF5 Kw_Wu8 1.000 OneToOne 0.00 1.000 FORMAT "%5.3" EXTENDED_LIMITS 0.00 255.0 READ_ONLY /end CHARACTERISTIC
/begin CHARACTERISTIC FrmMng_TSC2Mul_C "message Buffer ist multiplexed oder nicht" VALUE 0x1C0EF6 Kw_Wu8 1.000 OneToOne 0.00 1.000 FORMAT "%5.3" EXTENDED_LIMITS 0.00 255.0 READ_ONLY /end CHARACTERISTIC
/begin CHARACTERISTIC FrmMng_TSC2SchedMode_C "CAN Message Schedule Mode fuer RX und TX" VALUE 0x1C0EF8 Kw_Wu8 160.0 OneToOne 16.00 176.0 FORMAT "%5.1" EXTENDED_LIMITS 0.00 255.0 READ_ONLY /end CHARACTERISTIC
/begin CHARACTERISTIC FrmMng_TSC2Sched_C "Frequenz vom Transfer abhaengig vom Opmode" VALUE 0x1C0EF9 Kw_Wu8 254.0 OneToOne 1.000 255.0 FORMAT "%5.1" EXTENDED_LIMITS 0.00 255.0 READ_ONLY /end CHARACTERISTIC
/begin CHARACTERISTIC FrmMng_TSC2Strt_C "Message-Transfer-Aktivierung relativ zur Startzeit" VALUE 0x1C0EFA Kw_Wu8 255.0 OneToOne 0.00 255.0 FORMAT "%5.1" READ_ONLY /end CHARACTERISTIC
/begin CHARACTERISTIC FrmMng_TSC2TOTmp_C "Timeout" VALUE 0x1C0EFB Kw_Wu8 5100. TimeCAN_TO_ms 20.00 5120. FORMAT "%5.0" /end CHARACTERISTIC
/begin CHARACTERISTIC FrmMng_dTSC3ID_C "Botschaftsidentifier CAN-Botschaft TSC3" VALUE 0x1C0EFC Kw_Wu32 536870911.000 OneToOne 0.00 536870911.000 FORMAT "%13.3" EXTENDED_LIMITS 0.00 4294967295.00 /end CHARACTERISTIC
/begin CHARACTERISTIC FrmMng_TSC3IDType_C "ID Typ standard oder extended" VALUE 0x1C0F00 Kw_Wu8 0.00 OneToOne 1.000 1.000 FORMAT "%5.3" EXTENDED_LIMITS 0.00 255.0 READ_ONLY /end CHARACTERISTIC
/begin CHARACTERISTIC FrmMng_TSC3NumCAN_C "Auf welchen CAN die Botschaft ist" VALUE 0x1C0F01 Kw_Wu8 2.000 OneToOne 0.00 2.000 FORMAT "%5.3" EXTENDED_LIMITS 0.00 255.0 READ_ONLY /end CHARACTERISTIC
/begin CHARACTERISTIC FrmMng_TSC3NumMsgPos_C "Message Buffer der verwendet wird" VALUE 0x1C0F02 Kw_Wu8 15.00 OneToOne 0.00 15.00 FORMAT "%5.2" EXTENDED_LIMITS 0.00 255.0 READ_ONLY /end CHARACTERISTIC
/begin CHARACTERISTIC FrmMng_TSC3OpMode_C "Richtung transmit/receive" VALUE 0x1C0F03 Kw_Wu8 1.000 OneToOne 0.00 1.000 FORMAT "%5.3" EXTENDED_LIMITS 0.00 255.0 READ_ONLY /end CHARACTERISTIC
/begin CHARACTERISTIC FrmMng_dTSC3SchedMesgLen_C "Applizierbare Botschaftlänge für TSC3" VALUE 0x1C0F04 Kw_Wu8 8.000 OneToOne 0.00 8.000 FORMAT "%5.3" EXTENDED_LIMITS 0.00 255.0 /end CHARACTERISTIC
/begin CHARACTERISTIC FrmMng_TSC3IntrEna_C "Interrupt enabled oder nicht" VALUE 0x1C0F05 Kw_Wu8 1.000 OneToOne 0.00 1.000 FORMAT "%5.3" EXTENDED_LIMITS 0.00 255.0 READ_ONLY /end CHARACTERISTIC
/begin CHARACTERISTIC FrmMng_TSC3Mul_C "message Buffer ist multiplexed oder nicht" VALUE 0x1C0F06 Kw_Wu8 1.000 OneToOne 0.00 1.000 FORMAT "%5.3" EXTENDED_LIMITS 0.00 255.0 READ_ONLY /end CHARACTERISTIC
/begin CHARACTERISTIC FrmMng_TSC3SchedMode_C "CAN Message Schedule Mode fuer RX und TX" VALUE 0x1C0F08 Kw_Wu8 160.0 OneToOne 16.00 176.0 FORMAT "%5.1" EXTENDED_LIMITS 0.00 255.0 READ_ONLY /end CHARACTERISTIC
/begin CHARACTERISTIC FrmMng_TSC3Sched_C "Frequenz vom Transfer abhaengig vom Opmode" VALUE 0x1C0F09 Kw_Wu8 254.0 OneToOne 1.000 255.0 FORMAT "%5.1" EXTENDED_LIMITS 0.00 255.0 READ_ONLY /end CHARACTERISTIC
/begin CHARACTERISTIC FrmMng_TSC3Strt_C "Message-Transfer-Aktivierung relativ zur Startzeit" VALUE 0x1C0F0A Kw_Wu8 255.0 OneToOne 0.00 255.0 FORMAT "%5.1" READ_ONLY /end CHARACTERISTIC
/begin CHARACTERISTIC FrmMng_TSC3TOTmp_C "Timeout" VALUE 0x1C0F0B Kw_Wu8 5100. TimeCAN_TO_ms 20.00 5120. FORMAT "%5.0" /end CHARACTERISTIC
/begin CHARACTERISTIC FrmMng_dTXIMMCTLID_C "CAN-Identifier für Sendebotschaft der Wegfahrsperre" VALUE 0x1C0F0C Kw_Wu32 536870911.000 OneToOne 0.00 536870911.000 FORMAT "%13.3" EXTENDED_LIMITS 0.00 4294967295.00 /end CHARACTERISTIC
/begin CHARACTERISTIC FrmMng_TXIMMCTLIDType_C "ID Typ standard oder extended" VALUE 0x1C0F10 Kw_Wu8 0.00 OneToOne 1.000 1.000 FORMAT "%5.3" EXTENDED_LIMITS 0.00 255.0 READ_ONLY /end CHARACTERISTIC
/begin CHARACTERISTIC FrmMng_TXIMMCTLNumCAN_C "Auf welchen CAN die Botschaft ist" VALUE 0x1C0F11 Kw_Wu8 2.000 OneToOne 0.00 2.000 FORMAT "%5.3" EXTENDED_LIMITS 0.00 255.0 READ_ONLY /end CHARACTERISTIC
/begin CHARACTERISTIC FrmMng_TXIMMCTLNumMsgPos_C "Message Buffer der verwendet wird" VALUE 0x1C0F12 Kw_Wu8 15.00 OneToOne 0.00 15.00 FORMAT "%5.2" EXTENDED_LIMITS 0.00 255.0 READ_ONLY /end CHARACTERISTIC
/begin CHARACTERISTIC FrmMng_TXIMMCTLOpMode_C "Richtung transmit/receive" VALUE 0x1C0F13 Kw_Wu8 1.000 OneToOne 0.00 1.000 FORMAT "%5.3" EXTENDED_LIMITS 0.00 255.0 READ_ONLY /end CHARACTERISTIC
/begin CHARACTERISTIC FrmMng_dTXIMMCTLSchedMesgLen_C "Applizierbare Botschaftlänge für TXIMMCTL" VALUE 0x1C0F14 Kw_Wu8 8.000 OneToOne 0.00 8.000 FORMAT "%5.3" EXTENDED_LIMITS 0.00 255.0 /end CHARACTERISTIC
/begin CHARACTERISTIC FrmMng_TXIMMCTLIntrEna_C "Interrupt enabled oder nicht" VALUE 0x1C0F15 Kw_Wu8 1.000 OneToOne 0.00 1.000 FORMAT "%5.3" EXTENDED_LIMITS 0.00 255.0 READ_ONLY /end CHARACTERISTIC
/begin CHARACTERISTIC FrmMng_TXIMMCTLMul_C "message Buffer ist multiplexed oder nicht" VALUE 0x1C0F16 Kw_Wu8 1.000 OneToOne 0.00 1.000 FORMAT "%5.3" EXTENDED_LIMITS 0.00 255.0 READ_ONLY /end CHARACTERISTIC
/begin CHARACTERISTIC FrmMng_vChrgrExTemp_C "Geschwindigkeits Schwellenwert für Übertemperatur" VALUE 0x1D2584 Kw_Ws16 300.0000 Vel 0.00 300.0000 FORMAT "%8.4" EXTENDED_LIMITS -327.6800 327.6700 /end CHARACTERISTIC
/begin CHARACTERISTIC FrmMng_vDes_Offset_C "Offset Umrechung SG->CAN für Fahrgeschwindigkeit" VALUE 0x1D2768 Kw_Ws16 655.3500 Vel -327.6800 327.6700 FORMAT "%8.4" /end CHARACTERISTIC
/begin CHARACTERISTIC FrmMng_facVDes_Slope_C "Steigung Umrechung SG->CAN für Fahrgeschwindigkeit" VALUE 0x1D276A Kw_Ws16 511.9922 Fact1 -256.0000 255.9922 FORMAT "%8.4" /end CHARACTERISTIC
/begin CHARACTERISTIC FrmMng_volCubCap_C "Hubraum" VALUE 0x1D285E Kw_Wu16 12.70000 Vol 0.00 12.70000 FORMAT "%8.5" EXTENDED_LIMITS 0.00 655.3500 /end CHARACTERISTIC
/begin CHARACTERISTIC FrmMng_volCubCap_Offset_C "Offset Umrechung SG->CAN für Hubraum" VALUE 0x1D2860 Kw_Ws16 655.3500 Vol -327.6800 327.6700 FORMAT "%8.4" /end CHARACTERISTIC
/begin CHARACTERISTIC FrmMng_facVolCubCap_Slope_C "Steigung Umrechung SG->CAN für Hubraum" VALUE 0x1D2862 Kw_Ws16 7.999878 Fact -4.000000 3.999878 FORMAT "%8.6" /end CHARACTERISTIC
/begin CHARACTERISTIC FrmMng_volFlCons_Offset_C "Offset Umrechung SG->CAN für Kraftstoffverbrauch" VALUE 0x1D276C Kw_Ws16 65535.00 FlConsum_ul -32768.00 32767.00 FORMAT "%8.2" /end CHARACTERISTIC
/begin CHARACTERISTIC FrmMng_facVolFlCons_Slope_C "Steigung Umrechung SG->CAN für Kraftstoffverbrauch" VALUE 0x1D276E Kw_Ws16 7.999878 Fact -4.000000 3.999878 FORMAT "%8.6" /end CHARACTERISTIC
/begin CHARACTERISTIC FrmMng_volNormCylEng5_Offset_C "Offset Umrechung SG->CAN für normierten Verbrauch pro Zylinder" VALUE 0x1D2770 Kw_Ws16 65535.00 VolPCyl -32768.00 32767.00 FORMAT "%8.2" /end CHARACTERISTIC
/begin CHARACTERISTIC FrmMng_facVolNormCylEng5_Slope_C "Steigung Umrechung SG->CAN für normierter Verbrauch pro Zylinder" VALUE 0x1D2772 Kw_Ws16 511.9922 Fact1 -256.0000 255.9922 FORMAT "%8.4" /end CHARACTERISTIC
/begin CHARACTERISTIC FrmMng_volNormCyl_C "Normierter Kraftstoffverbrauch pro Zylinder" VALUE 0x1D2774 Kw_Wu16 2550.000 VolPCyl 0.00 2550.000 FORMAT "%8.3" EXTENDED_LIMITS 0.00 65535.00 /end CHARACTERISTIC
/begin CHARACTERISTIC FrmMng_volNormCyl_Offset_C "Offset Umrechung SG->CAN für normierter Verbrauch pro Zylinder" VALUE 0x1D2864 Kw_Ws16 65535.00 VolPCyl -32768.00 32767.00 FORMAT "%8.2" /end CHARACTERISTIC
/begin CHARACTERISTIC FrmMng_facVolNormCyl_Slope_C "Steigung Umrechung SG->CAN für normierter Verbrauch pro Zylinder" VALUE 0x1D2866 Kw_Ws16 511.9922 Fact1 -256.0000 255.9922 FORMAT "%8.4" /end CHARACTERISTIC
/begin CHARACTERISTIC FrmMng_volOilLvlMax_C "Schwellwert für Maximum Ölstand" VALUE 0x1D2868 Kw_Ws16 3100.000 volFillLvl_ml 0.00 3100.000 FORMAT "%8.3" EXTENDED_LIMITS -32768.00 32767.00 /end CHARACTERISTIC
/begin CHARACTERISTIC FrmMng_volOilLvlMax_Offset_C "Offset für Umrechnung SG -> CAN für Schwellwert Maximum Ölstand" VALUE 0x1D286A Kw_Ws16 65535.00 volFillLvl_ml -32768.00 32767.00 FORMAT "%8.2" /end CHARACTERISTIC
/begin CHARACTERISTIC FrmMng_facVolOilLvlMax_Slope_C "Steigung Umrechnung SG -> CAN für Schwellwert Maximum-Ölstand" VALUE 0x1D286C Kw_Ws16 511.9922 Fact1 -256.0000 255.9922 FORMAT "%8.4" /end CHARACTERISTIC
/begin CHARACTERISTIC FrmMng_volOilOfsMax_C "Maximum Öl-Offset" VALUE 0x1D286E Kw_Ws16 750.0000 volFillLvl_ml 0.00 750.0000 FORMAT "%8.4" EXTENDED_LIMITS -32768.00 32767.00 /end CHARACTERISTIC
/begin CHARACTERISTIC FrmMng_volOilOfsMax_Offset_C "Offset für Umrechnung SG -> CAN für Maximum Öl-Offset" VALUE 0x1D2870 Kw_Ws16 65535.00 volFillLvl_ml -32768.00 32767.00 FORMAT "%8.2" /end CHARACTERISTIC
/begin CHARACTERISTIC FrmMng_facVolOilOfsMax_Slope_C "Steigung Umrechung SG -> CAN für Maximum Ölstands-Offset" VALUE 0x1D2872 Kw_Ws16 511.9922 Fact1 -256.0000 255.9922 FORMAT "%8.4" /end CHARACTERISTIC
/begin CHARACTERISTIC FrmMng_volOilWrnThresOfs_C "Offset für die Ölwarnschwelle" VALUE 0x1D2874 Kw_Ws16 630.0000 volFillLvl_ml 0.00 630.0000 FORMAT "%8.4" EXTENDED_LIMITS -32768.00 32767.00 /end CHARACTERISTIC
/begin CHARACTERISTIC FrmMng_volOilWrnThresTolc_C "Toleranz für die Ölwarnschwelle" VALUE 0x1D2876 Kw_Ws16 630.0000 volFillLvl_ml 0.00 630.0000 FORMAT "%8.4" EXTENDED_LIMITS -32768.00 32767.00 /end CHARACTERISTIC
/begin CHARACTERISTIC FrmMng_volOilWrnThres_Offset_C "Offset Umrechung SG->CAN für Ölwarnungschwelle" VALUE 0x1D2878 Kw_Ws16 65535.00 volFillLvl_ml -32768.00 32767.00 FORMAT "%8.2" /end CHARACTERISTIC
/begin CHARACTERISTIC FrmMng_facVolOilWrnThres_Slope_C "Steigung Umrechung SG->CAN für Ölwarnungschewelle" VALUE 0x1D287A Kw_Ws16 511.9922 Fact1 -256.0000 255.9922 FORMAT "%8.4" /end CHARACTERISTIC
/begin CHARACTERISTIC FrmMng_volOvrFlowHys_C "Überfüllschwellen-Hysterese" VALUE 0x1D287C Kw_Ws16 750.0000 volFillLvl_ml 0.00 750.0000 FORMAT "%8.4" EXTENDED_LIMITS -32768.00 32767.00 /end CHARACTERISTIC
/begin CHARACTERISTIC FrmMng_volOvrFlowHys_Offset_C "Offset für Umrechnung SG -> CAN für Überfüllschwellen-Hysterese" VALUE 0x1D287E Kw_Ws16 65535.00 volFillLvl_ml -32768.00 32767.00 FORMAT "%8.2" /end CHARACTERISTIC
/begin CHARACTERISTIC FrmMng_facVolOvrFlowHys_Slope_C "Steigung Umrechnung SG -> CAN für Überfllungsschwelle-Hysterse" VALUE 0x1D2880 Kw_Ws16 511.9922 Fact1 -256.0000 255.9922 FORMAT "%8.4" /end CHARACTERISTIC
/begin CHARACTERISTIC FrmMng_volSTMV_Offset_C "Offset für den Kurzzeitmittelwert" VALUE 0x1D2882 Kw_Ws16 65535.00 volFillLvl_ml -32768.00 32767.00 FORMAT "%8.2" /end CHARACTERISTIC
/begin CHARACTERISTIC FrmMng_facVolSTMV_Slope_C "Slope für den Kurzzeitmittelwert" VALUE 0x1D2884 Kw_Ws16 511.9922 Fact1 -256.0000 255.9922 FORMAT "%8.4" /end CHARACTERISTIC
/begin MEASUREMENT FrmMng_ctAlvAAG_mp "Botschaftszähler der AAG Botschaft" UBYTE OneToOne 1 100 0.00 255.0 FORMAT "%5.1" ECU_ADDRESS 0x802E4C /end MEASUREMENT
/begin MEASUREMENT FrmMng_ctAlvACC_mp "Meßpunkt für Botschaftszähler für CAN Botschaft ACC-System" UBYTE OneToOne 1 100 0.00 255.0 FORMAT "%5.1" ECU_ADDRESS 0x802E4D /end MEASUREMENT
/begin MEASUREMENT FrmMng_ctAlvAirbag_mp "Botschaftszähler der Airbag Botschaft" UBYTE OneToOne 1 100 0.00 255.0 FORMAT "%5.1" ECU_ADDRESS 0x802E4E /end MEASUREMENT
/begin MEASUREMENT FrmMng_ctAlvAWD1_mp "Meßpunkt für Botschaftszähler für CAN Botschaft Allrad1" UBYTE OneToOne 1 100 0.00 255.0 FORMAT "%5.1" ECU_ADDRESS 0x802E4F /end MEASUREMENT
/begin MEASUREMENT FrmMng_ctAlvBEM1_mp "Botschaftszähler der Energiemanager 1 Botschaft" UBYTE OneToOne 1 100 0.00 255.0 FORMAT "%5.1" ECU_ADDRESS 0x802E50 /end MEASUREMENT
/begin MEASUREMENT FrmMng_ctAlvBRK1_mp "Meßpunkt für Botschaftszähler für CAN Botschaft Bremse1" UBYTE OneToOne 1 100 0.00 255.0 FORMAT "%5.1" ECU_ADDRESS 0x802E51 /end MEASUREMENT
/begin MEASUREMENT FrmMng_ctAlvBRK8_mp "Meßpunkt für Botschaftszähler für CAN Botschaft Bremse8" UBYTE OneToOne 1 100 0.00 255.0 FORMAT "%5.1" ECU_ADDRESS 0x802E52 /end MEASUREMENT
/begin MEASUREMENT FrmMng_ctAlvCCTL_mp "Meßpunkt für Botschaftszähler für CAN Botschaft GRA" UBYTE OneToOne 1 100 0.00 255.0 FORMAT "%5.1" ECU_ADDRESS 0x802E53 /end MEASUREMENT
/begin MEASUREMENT FrmMng_ctAlvDSP1_mp "Meßpunkt für Botschaftszähler für CAN Botschaft Kombi1" UBYTE OneToOne 1 100 0.00 255.0 FORMAT "%5.1" ECU_ADDRESS 0x802E54 /end MEASUREMENT
/begin MEASUREMENT FrmMng_ctAlvILM_mp "Botschaftszähler der ILM Botschaft" UBYTE OneToOne 1 100 0.00 255.0 FORMAT "%5.1" ECU_ADDRESS 0x802E55 /end MEASUREMENT
/begin MEASUREMENT FrmMng_ctAlvNiveau1_mp "Botschaftszähler der Niveau1 Botschaft" UBYTE OneToOne 1 100 0.00 255.0 FORMAT "%5.1" ECU_ADDRESS 0x802E56 /end MEASUREMENT
/begin MEASUREMENT FrmMng_ctAlvTSC1_mp "Meßpunkt für Botschaftszähler für CAN Botschaft Getriebe1" UBYTE OneToOne 1 100 0.00 255.0 FORMAT "%5.1" ECU_ADDRESS 0x802E57 /end MEASUREMENT
/begin MEASUREMENT FrmMng_ctAlvTSC2_mp "Meßpunkt für Botschaftszähler für CAN Botschaft Getriebe2" UBYTE OneToOne 1 100 0.00 255.0 FORMAT "%5.1" ECU_ADDRESS 0x802E58 /end MEASUREMENT
/begin MEASUREMENT FrmMng_ctAlvTSC3_mp "Meßpunkt für Botschaftszähler für CAN Botschaft Getriebe3" UBYTE OneToOne 1 100 0.00 255.0 FORMAT "%5.1" ECU_ADDRESS 0x802E59 /end MEASUREMENT
/begin MEASUREMENT FrmMng_ctChrgr1_Off_mp "Messpunkt für Zähler der Abschaltanforderung Turbolader 1" UBYTE OneToOne 1 100 0.00 255.0 FORMAT "%5.1" ECU_ADDRESS 0x802E38 /end MEASUREMENT
/begin MEASUREMENT FrmMng_ctChrgr2_Off_mp "Messpunkt für Zähler der Abschaltanforderung Turbolader 2" UBYTE OneToOne 1 100 0.00 255.0 FORMAT "%5.1" ECU_ADDRESS 0x802E39 /end MEASUREMENT
/begin MEASUREMENT FrmMng_ctChrgr_Rst_mp "Messpunkt für den Zähler der Restartwerte" UBYTE OneToOne 1 100 0.00 255.0 FORMAT "%5.1" ECU_ADDRESS 0x802E3A /end MEASUREMENT
/begin MEASUREMENT FrmMng_dBPACDOut1_mp "CAN Wert des Tastverhältnisses für BPA 1" UWORD DtyCycCan 1 100 0.00 6553.500 FORMAT "%8.3" ECU_ADDRESS 0x802E3C /end MEASUREMENT
/begin MEASUREMENT FrmMng_dBPACDOut2_mp "CAN Wert des Tastverhältnisses für BPA 2" UWORD DtyCycCan 1 100 0.00 6553.500 FORMAT "%8.3" ECU_ADDRESS 0x802E3E /end MEASUREMENT
/begin MEASUREMENT FrmMng_dtrqFrcLimCan_mp "Meßpunkt für die beschränkte Reibmomentendifferenz des Can" SWORD Trq 1 100 -3276.800 3276.700 FORMAT "%8.3" ECU_ADDRESS 0x802E5A /end MEASUREMENT
/begin MEASUREMENT FrmMng_dtrqFrcLim_mp "Meßpunkt für die beschränkte Reibmomentendifferenz" SWORD Trq 1 100 -3276.800 3276.700 FORMAT "%8.3" ECU_ADDRESS 0x802E5C /end MEASUREMENT
/begin MEASUREMENT FrmMng_dtrqFrc_mp "Meßpunkt für die Reibmomentendifferenz" SWORD Trq 1 100 -3276.800 3276.700 FORMAT "%8.3" ECU_ADDRESS 0x802E5E /end MEASUREMENT
/begin MEASUREMENT FrmMng_lOil_mp "Ölniveauschwelle" SWORD Length_mm 1 100 -256.0000 255.9922 FORMAT "%8.4" ECU_ADDRESS 0x802E60 /end MEASUREMENT
/begin MEASUREMENT FrmMng_nDes_mp "Motorwunschdrehzahl" UWORD EngN 1 100 0.00 65535.00 FORMAT "%8.2" ECU_ADDRESS 0x802E62 /end MEASUREMENT
/begin MEASUREMENT FrmMng_nSetpoint "Leerlaufsolldrehzahl empfangen vom Slave über CAN" SWORD EngN 1 100 -32768.00 32767.00 FORMAT "%8.2" ECU_ADDRESS 0x7F9880 /end MEASUREMENT
/begin MEASUREMENT FrmMng_rBPACDIn1 "Positionsistwert des Ladedruckstellers 1 über CAN" SWORD DtyCyc 1 100 -327.6800 327.6700 FORMAT "%8.4" ECU_ADDRESS 0x7F988E /end MEASUREMENT
/begin MEASUREMENT FrmMng_rBPACDIn2 "Positionsistwert des Ladedruckstellers 1 über CAN" SWORD DtyCyc 1 100 -327.6800 327.6700 FORMAT "%8.4" ECU_ADDRESS 0x7F9890 /end MEASUREMENT
/begin MEASUREMENT FrmMng_rBPACDOut1_mp "Tastverhältnis für BPA 1" UWORD DtyCycCan 1 100 0.00 6553.500 FORMAT "%8.3" ECU_ADDRESS 0x802E40 /end MEASUREMENT
/begin MEASUREMENT FrmMng_rBPACDOut2_mp "Tastverhältnis für BPA 2" UWORD DtyCycCan 1 100 0.00 6553.500 FORMAT "%8.3" ECU_ADDRESS 0x802E42 /end MEASUREMENT
/begin MEASUREMENT FrmMng_rtrqACCDes_mp "Meßpunkt des Prozentwertes des gewünschten ACC-Momentes" SWORD rTrqCAN 1 100 -12850.20 12849.81 FORMAT "%8.2" ECU_ADDRESS 0x802E64 /end MEASUREMENT
/begin MEASUREMENT FrmMng_rtrqConvLoss_mp "Meßpunkt für Verhältnis Wandlerverlustmoment / Maximalmoment" SWORD rTrqCAN 1 100 -12850.20 12849.81 FORMAT "%8.2" ECU_ADDRESS 0x802E66 /end MEASUREMENT
/begin MEASUREMENT FrmMng_rtrqDCS_mp "Meßpunkt für Verhältnis MSR-Anforderungsmoment / Maximalmoment" SWORD rTrqCAN 1 100 -12850.20 12849.81 FORMAT "%8.2" ECU_ADDRESS 0x802E68 /end MEASUREMENT
/begin MEASUREMENT FrmMng_rtrqFrcCan_mp "Meßpunkt des Reibmomntenverhältnisses der CAN Botschaft Motor 1" SWORD rTrqCAN 1 100 -12850.20 12849.81 FORMAT "%8.2" ECU_ADDRESS 0x802E6A /end MEASUREMENT
/begin MEASUREMENT FrmMng_rtrqGearbxCur_mp "Meßpunkt fuer Getriebe-Istmoment (CAN-Wert)" SWORD rTrqCAN 1 100 -12850.20 12849.81 FORMAT "%8.2" ECU_ADDRESS 0x802E6C /end MEASUREMENT
/begin MEASUREMENT FrmMng_rtrqGearbxDes_mp "Meßpunkt fuer Getriebe-Sollmoment (CAN-Wert)" SWORD rTrqCAN 1 100 -12850.20 12849.81 FORMAT "%8.2" ECU_ADDRESS 0x802E6E /end MEASUREMENT
/begin MEASUREMENT FrmMng_rtrqInrEngNoExtDem_mp "Meßpunkt für Verhältnis inneres Motormoment ohne externe Momente / Maximalmoment" SWORD rTrqCAN 1 100 -12850.20 12849.81 FORMAT "%8.2" ECU_ADDRESS 0x802E70 /end MEASUREMENT
/begin MEASUREMENT FrmMng_rtrqInrEng_mp "Meßpunkt für Verhältnis inneres Motormoment / Maximalmoment" SWORD rTrqCAN 1 100 -12850.20 12849.81 FORMAT "%8.2" ECU_ADDRESS 0x802E72 /end MEASUREMENT
/begin MEASUREMENT FrmMng_rtrqLimAWD_mp "Rohwert des Begrenzungsmoment des AWD Steuergerätes" SWORD rTrqCAN 1 100 -12850.20 12849.81 FORMAT "%8.2" ECU_ADDRESS 0x802E74 /end MEASUREMENT
/begin MEASUREMENT FrmMng_rtrqLim_mp "Meßpunkt für Verhältnis Begrenzungsmoment / Maximalmoment" SWORD rTrqCAN 1 100 -12850.20 12849.81 FORMAT "%8.2" ECU_ADDRESS 0x802E76 /end MEASUREMENT
/begin MEASUREMENT FrmMng_rtrqRelDrvDem_mp "Meßpunkt für Verhältnis relatives Fahrerwunschmoment / Maximalmoment" SWORD rTrqCAN 1 100 -12850.20 12849.81 FORMAT "%8.2" ECU_ADDRESS 0x802E78 /end MEASUREMENT
/begin MEASUREMENT FrmMng_rtrqRmpACC_mp "Rampenwert für Moment bei ShortTOError(AUDI-ACCRX)" ULONG rRmpTrq 1 100 0.00 25700401.1460 FORMAT "%13.4" ECU_ADDRESS 0x802E7C /end MEASUREMENT
/begin MEASUREMENT FrmMng_rtrqTCS_mp "Meßpunkt für Verhältnis ASR-Anforderungsmoment / Maximalmoment" SWORD rTrqCAN 1 100 -12850.20 12849.81 FORMAT "%8.2" ECU_ADDRESS 0x802E80 /end MEASUREMENT
/begin MEASUREMENT FrmMng_rtrqTSC_mp "Meßpunkt für Verhältnis EGS-Anforderungsmoment / Maximalmoment" SWORD rTrqCAN 1 100 -12850.20 12849.81 FORMAT "%8.2" ECU_ADDRESS 0x802E82 /end MEASUREMENT
/begin MEASUREMENT FrmMng_rtrqWheel_mp "Meßpunkt für Verhältnis Radmoment / Maximalmoment" SWORD rTrqCAN 1 100 -12850.20 12849.81 FORMAT "%8.2" ECU_ADDRESS 0x802E84 /end MEASUREMENT
/begin MEASUREMENT FrmMng_rvLimAWD_mp "Rohwert der Höchstgeschwindigkeit" UBYTE OneToOne 1 100 0.00 255.0 FORMAT "%5.1" ECU_ADDRESS 0x802E86 /end MEASUREMENT
/begin MEASUREMENT FrmMng_stBEMB1_mp "Meßpunkt für Byte 1 in BEM" UBYTE OneToOne 1 100 0.00 255.0 FORMAT "%5.1" ECU_ADDRESS 0x802E87 /end MEASUREMENT
/begin MEASUREMENT FrmMng_stBEMB2_mp "Meßpunkt für Byte 2 in BEM" UBYTE OneToOne 1 100 0.00 255.0 FORMAT "%5.1" ECU_ADDRESS 0x802E88 /end MEASUREMENT
/begin MEASUREMENT FrmMng_stBEMB3_mp "Meßpunkt für Byte 3 in BEM" UBYTE OneToOne 1 100 0.00 255.0 FORMAT "%5.1" ECU_ADDRESS 0x802E89 /end MEASUREMENT
/begin MEASUREMENT FrmMng_stBEMB4_mp "Meßpunkt für Byte 4 in BEM" UBYTE OneToOne 1 100 0.00 255.0 FORMAT "%5.1" ECU_ADDRESS 0x802E8A /end MEASUREMENT
/begin MEASUREMENT FrmMng_stBEMB5_mp "Meßpunkt für Byte5 in BEM" UBYTE OneToOne 1 100 0.00 255.0 FORMAT "%5.1" ECU_ADDRESS 0x802E8B /end MEASUREMENT
/begin MEASUREMENT FrmMng_stBEMB6_mp "Meßpunkt für Byte 6 in BEM" UBYTE OneToOne 1 100 0.00 255.0 FORMAT "%5.1" ECU_ADDRESS 0x802E8C /end MEASUREMENT
/begin MEASUREMENT FrmMng_stBEMB7_mp "Meßpunkt für Byte 7 in BEM" UBYTE OneToOne 1 100 0.00 255.0 FORMAT "%5.1" ECU_ADDRESS 0x802E8D /end MEASUREMENT
/begin MEASUREMENT FrmMng_stBEMB8_mp "Meßpunkt für Byte 8 in BEM" UBYTE OneToOne 1 100 0.00 255.0 FORMAT "%5.1" ECU_ADDRESS 0x802E8E /end MEASUREMENT
/begin MEASUREMENT FrmMng_stChrgr1A_mp "Status des Fehlerflags vom Fehlerpfad Chrgr1A" UBYTE OneToOne 1 100 0.00 255.0 FORMAT "%5.1" ECU_ADDRESS 0x802E44 /end MEASUREMENT
/begin MEASUREMENT FrmMng_stChrgr1Err1 "Fehlerstatus 1 des Laders 1" UBYTE OneToOne 1 100 0.00 255.0 FORMAT "%5.1" ECU_ADDRESS 0x7F93F8 /end MEASUREMENT
/begin MEASUREMENT FrmMng_stChrgr1Err2 "Fehlerstatus 2 des Laders 1" UBYTE OneToOne 1 100 0.00 255.0 FORMAT "%5.1" ECU_ADDRESS 0x7F93F9 /end MEASUREMENT
/begin MEASUREMENT FrmMng_stChrgr1ExTemp1_mp "Anzeige für Fehlerbehandlung chrgr 1 Zustand 1 ist erfüllt" UBYTE OneToOne 1 100 0.00 255.0 FORMAT "%5.1" ECU_ADDRESS 0x802E31 /end MEASUREMENT
/begin MEASUREMENT FrmMng_stChrgr1ExTemp2_mp "Anzeige für Fehlerbehandlung chrgr 1 Zustand 2 ist erfüllt" UBYTE OneToOne 1 100 0.00 255.0 FORMAT "%5.1" ECU_ADDRESS 0x802E32 /end MEASUREMENT
/begin MEASUREMENT FrmMng_stChrgr1Strt_mp "Fehlerbehandlung Lader 1 nach Kaltstart ist erlaubt" UBYTE OneToOne 1 100 0.00 255.0 FORMAT "%5.1" ECU_ADDRESS 0x802E33 /end MEASUREMENT
/begin MEASUREMENT FrmMng_stChrgr1_Off_mp "Senden des Abschaltwertes für Lader 1 ist erlaubt" UBYTE OneToOne 1 100 0.00 255.0 FORMAT "%5.1" ECU_ADDRESS 0x802E45 /end MEASUREMENT
/begin MEASUREMENT FrmMng_stChrgr2A_mp "Status des Fehlerflags vom Fehlerpfad Chrgr2A" UBYTE OneToOne 1 100 0.00 255.0 FORMAT "%5.1" ECU_ADDRESS 0x802E46 /end MEASUREMENT
/begin MEASUREMENT FrmMng_stChrgr2Err1 "Fehlerstatus 1 des Laders 2" UBYTE OneToOne 1 100 0.00 255.0 FORMAT "%5.1" ECU_ADDRESS 0x7F93FA /end MEASUREMENT
/begin MEASUREMENT FrmMng_stChrgr2Err2 "Fehlerstatus 2 des Laders 2" UBYTE OneToOne 1 100 0.00 255.0 FORMAT "%5.1" ECU_ADDRESS 0x7F93FB /end MEASUREMENT
/begin MEASUREMENT FrmMng_stChrgr2ExTemp1_mp "Anzeige für Fehlerbehandlung chrgr 2 Zustand 1 ist erfüllt" UBYTE OneToOne 1 100 0.00 255.0 FORMAT "%5.1" ECU_ADDRESS 0x802E34 /end MEASUREMENT
/begin MEASUREMENT FrmMng_stChrgr2ExTemp2_mp "Anzeige für Fehlerbehandlung chrgr 2 Zustand 2 ist erfüllt" UBYTE OneToOne 1 100 0.00 255.0 FORMAT "%5.1" ECU_ADDRESS 0x802E35 /end MEASUREMENT
/begin MEASUREMENT FrmMng_stChrgr2Strt_mp "Fehlerbehandlung Lader 2 nach Kaltstart ist erlaubt" UBYTE OneToOne 1 100 0.00 255.0 FORMAT "%5.1" ECU_ADDRESS 0x802E36 /end MEASUREMENT
/begin MEASUREMENT FrmMng_stChrgr2_Off_mp "Senden des Abschaltwertes für Lader 2 ist erlaubt" UBYTE OneToOne 1 100 0.00 255.0 FORMAT "%5.1" ECU_ADDRESS 0x802E47 /end MEASUREMENT
/begin MEASUREMENT FrmMng_stChrgrPCRGovDevOff "Status für die Abschaltung der Erkennung auf Regelabweichung im PCR" UBYTE OneToOne 1 100 0.00 255.0 FORMAT "%5.1" ECU_ADDRESS 0x7F93FC /end MEASUREMENT
/begin MEASUREMENT FrmMng_stClg_mp "Meßpunkt des Status Kennfeldkühlung" UBYTE OneToOne 1 100 0.00 255.0 FORMAT "%5.1" ECU_ADDRESS 0x802E8F /end MEASUREMENT
/begin MEASUREMENT FrmMng_stEngActr_Ena_mp "Messpunkt Botschaft ENGACTR1 (Motor_Steller1) ist eingeschaltet" UBYTE OneToOne 1 100 0.00 255.0 FORMAT "%5.1" ECU_ADDRESS 0x802E48 /end MEASUREMENT
/begin MEASUREMENT FrmMng_stEngActr_Rst_mp "Messpunkt Senden des Restart-Wertes ist freigeschalten" UBYTE OneToOne 1 100 0.00 255.0 FORMAT "%5.1" ECU_ADDRESS 0x802E49 /end MEASUREMENT
/begin MEASUREMENT FrmMng_stEngTrqErr_mp "Meßpunkt für Momentenangaben ungenau" UBYTE OneToOne 1 100 0.00 255.0 FORMAT "%5.1" ECU_ADDRESS 0x802E90 /end MEASUREMENT
/begin MEASUREMENT FrmMng_stGW1AAGErr_mp "Can-Fehlerstatusleiste Botschaft AAG" UBYTE OneToOne 1 100 0.00 255.0 FORMAT "%5.1" ECU_ADDRESS 0x802E91 /end MEASUREMENT
/begin MEASUREMENT FrmMng_stGW1ILMErr_mp "Can-Fehlerstatusleiste Botschaft ILM" UBYTE OneToOne 1 100 0.00 255.0 FORMAT "%5.1" ECU_ADDRESS 0x802E92 /end MEASUREMENT
/begin MEASUREMENT FrmMng_stMsgErrChrgr1 "Fehlerstatus Botschaft CHRGR1" UBYTE OneToOne 1 100 0.00 255.0 FORMAT "%5.1" ECU_ADDRESS 0x7F941B /end MEASUREMENT
/begin MEASUREMENT FrmMng_stMsgErrChrgr2 "Fehlerstatus Botschaft CHRGR2" UBYTE OneToOne 1 100 0.00 255.0 FORMAT "%5.1" ECU_ADDRESS 0x7F941C /end MEASUREMENT
/begin MEASUREMENT FrmMng_stMsgMSnSetpGov "Fehlerstatus von frmmng_rxtgovms und frmmng_txtgovms Prozeß" UBYTE OneToOne 1 100 0.00 255.0 FORMAT "%5.1" ECU_ADDRESS 0x7F9429 /end MEASUREMENT
/begin MEASUREMENT FrmMng_stSendEng6_B1Byp_mp "Meßpunkt für Bypass message" UBYTE OneToOne 1 100 0.00 255.0 FORMAT "%5.1" ECU_ADDRESS 0x802E93 /end MEASUREMENT
/begin MEASUREMENT FrmMng_stSendEng6_B2Byp_mp "Meßpunkt für Bypass Freischnitt" UBYTE OneToOne 1 100 0.00 255.0 FORMAT "%5.1" ECU_ADDRESS 0x802E94 /end MEASUREMENT
/begin MEASUREMENT FrmMng_stSendEng6_B3Byp_mp "Meßpunkt für Bypass Freischnitt" UBYTE OneToOne 1 100 0.00 255.0 FORMAT "%5.1" ECU_ADDRESS 0x802E95 /end MEASUREMENT
/begin MEASUREMENT FrmMng_stSendEng6_B4Byp_mp "Meßpunkt für Bypass Freischnitt" UBYTE OneToOne 1 100 0.00 255.0 FORMAT "%5.1" ECU_ADDRESS 0x802E96 /end MEASUREMENT
/begin MEASUREMENT FrmMng_stSendEng6_B5Byp_mp "Meßpunkt für Bypass Freischnitt" UBYTE OneToOne 1 100 0.00 255.0 FORMAT "%5.1" ECU_ADDRESS 0x802E97 /end MEASUREMENT
/begin MEASUREMENT FrmMng_stSendEng6_B6Byp_mp "Meßpunkt für Bypass Freischnitt" UBYTE OneToOne 1 100 0.00 255.0 FORMAT "%5.1" ECU_ADDRESS 0x802E98 /end MEASUREMENT
/begin MEASUREMENT FrmMng_stSendEng6_B7Byp_mp "Meßpunkt für Bypass Freischnitt" UBYTE OneToOne 1 100 0.00 255.0 FORMAT "%5.1" ECU_ADDRESS 0x802E99 /end MEASUREMENT
/begin MEASUREMENT FrmMng_stSendEng6_B8Byp_mp "Meßpunkt für Bypass Freischnitt" UBYTE OneToOne 1 100 0.00 255.0 FORMAT "%5.1" ECU_ADDRESS 0x802E9A /end MEASUREMENT
/begin MEASUREMENT FrmMng_stSendEngTrq1_B1Byp_mp "Meßpunkt für Bypass Freischnitt" UBYTE OneToOne 1 100 0.00 255.0 FORMAT "%5.1" ECU_ADDRESS 0x802E9B /end MEASUREMENT
/begin MEASUREMENT FrmMng_stSendEngTrq1_B2Byp_mp "Meßpunkt für Bypass Freischnitt" UBYTE OneToOne 1 100 0.00 255.0 FORMAT "%5.1" ECU_ADDRESS 0x802E9C /end MEASUREMENT
/begin MEASUREMENT FrmMng_stSendEngTrq1_B3Byp_mp "Meßpunkt für Bypass Freischnitt" UBYTE OneToOne 1 100 0.00 255.0 FORMAT "%5.1" ECU_ADDRESS 0x802E9D /end MEASUREMENT
/begin MEASUREMENT FrmMng_stSendEngTrq1_B4Byp_mp "Meßpunkt für Bypass Freischnitt" UBYTE OneToOne 1 100 0.00 255.0 FORMAT "%5.1" ECU_ADDRESS 0x802E9E /end MEASUREMENT
/begin MEASUREMENT FrmMng_stSendEngTrq1_B5Byp_mp "Meßpunkt für Bypass Freischnitt" UBYTE OneToOne 1 100 0.00 255.0 FORMAT "%5.1" ECU_ADDRESS 0x802E9F /end MEASUREMENT
/begin MEASUREMENT FrmMng_stSendEngTrq1_B6Byp_mp "Meßpunkt für Bypass Freischnitt" UBYTE OneToOne 1 100 0.00 255.0 FORMAT "%5.1" ECU_ADDRESS 0x802EA0 /end MEASUREMENT
/begin MEASUREMENT FrmMng_stSendEngTrq1_B7Byp_mp "Meßpunkt für Bypass Freischnitt" UBYTE OneToOne 1 100 0.00 255.0 FORMAT "%5.1" ECU_ADDRESS 0x802EA1 /end MEASUREMENT
/begin MEASUREMENT FrmMng_stSendEngTrq1_B8Byp_mp "Meßpunkt für Bypass Freischnitt" UBYTE OneToOne 1 100 0.00 255.0 FORMAT "%5.1" ECU_ADDRESS 0x802EA2 /end MEASUREMENT
/begin MEASUREMENT FrmMng_stSendEngTrq2_B1Byp_mp "Meßpunkt für Bypass Freischnitt" UBYTE OneToOne 1 100 0.00 255.0 FORMAT "%5.1" ECU_ADDRESS 0x802EA3 /end MEASUREMENT
/begin MEASUREMENT FrmMng_stSendEngTrq2_B2Byp_mp "Meßpunkt für Bypass Freischnitt" UBYTE OneToOne 1 100 0.00 255.0 FORMAT "%5.1" ECU_ADDRESS 0x802EA4 /end MEASUREMENT
/begin MEASUREMENT FrmMng_stSendEngTrq2_B3Byp_mp "Meßpunkt für Bypass Freischnitt" UBYTE OneToOne 1 100 0.00 255.0 FORMAT "%5.1" ECU_ADDRESS 0x802EA5 /end MEASUREMENT
/begin MEASUREMENT FrmMng_stSendEngTrq2_B4Byp_mp "Meßpunkt für Bypass message" UBYTE OneToOne 1 100 0.00 255.0 FORMAT "%5.1" ECU_ADDRESS 0x802EA6 /end MEASUREMENT
/begin MEASUREMENT FrmMng_stSendEngTrq2_B5Byp_mp "Meßpunkt für Bypass Freischnitt" UBYTE OneToOne 1 100 0.00 255.0 FORMAT "%5.1" ECU_ADDRESS 0x802EA7 /end MEASUREMENT
/begin MEASUREMENT FrmMng_stSendEngTrq2_B6Byp_mp "Meßpunkt für Bypass Freischnitt" UBYTE OneToOne 1 100 0.00 255.0 FORMAT "%5.1" ECU_ADDRESS 0x802EA8 /end MEASUREMENT
/begin MEASUREMENT FrmMng_stSendEngTrq2_B7Byp_mp "Meßpunkt für Bypass Freischnitt" UBYTE OneToOne 1 100 0.00 255.0 FORMAT "%5.1" ECU_ADDRESS 0x802EA9 /end MEASUREMENT
/begin MEASUREMENT FrmMng_stSendEngTrq2_B8Byp_mp "Meßpunkt für Bypass Freischnitt" UBYTE OneToOne 1 100 0.00 255.0 FORMAT "%5.1" ECU_ADDRESS 0x802EAA /end MEASUREMENT
/begin MEASUREMENT FrmMng_stSendEngTrq3_B1Byp_mp "Meßpunkt für Bypass Freischnitt" UBYTE OneToOne 1 100 0.00 255.0 FORMAT "%5.1" ECU_ADDRESS 0x802EAB /end MEASUREMENT
/begin MEASUREMENT FrmMng_stSendEngTrq3_B2Byp_mp "Meßpunkt für Bypass Freischnitt" UBYTE OneToOne 1 100 0.00 255.0 FORMAT "%5.1" ECU_ADDRESS 0x802EAC /end MEASUREMENT
/begin MEASUREMENT FrmMng_stSendEngTrq3_B3Byp_mp "Meßpunkt für Bypass Freischnitt" UBYTE OneToOne 1 100 0.00 255.0 FORMAT "%5.1" ECU_ADDRESS 0x802EAD /end MEASUREMENT
/begin MEASUREMENT FrmMng_stSendEngTrq3_B4Byp_mp "Meßpunkt für Bypass Freischnitt" UBYTE OneToOne 1 100 0.00 255.0 FORMAT "%5.1" ECU_ADDRESS 0x802EAE /end MEASUREMENT
/begin MEASUREMENT FrmMng_stSendEngTrq3_B5Byp_mp "Meßpunkt für Bypass Freischnitt" UBYTE OneToOne 1 100 0.00 255.0 FORMAT "%5.1" ECU_ADDRESS 0x802EAF /end MEASUREMENT
/begin MEASUREMENT FrmMng_stSendEngTrq3_B6Byp_mp "Meßpunkt für Bypass Freischnitt" UBYTE OneToOne 1 100 0.00 255.0 FORMAT "%5.1" ECU_ADDRESS 0x802EB0 /end MEASUREMENT
/begin MEASUREMENT FrmMng_stSendEngTrq3_B7Byp_mp "Meßpunkt für Bypass Freischnitt" UBYTE OneToOne 1 100 0.00 255.0 FORMAT "%5.1" ECU_ADDRESS 0x802EB1 /end MEASUREMENT
/begin MEASUREMENT FrmMng_stSendEngTrq3_B8Byp_mp "Meßpunkt für Bypass Freischnitt" UBYTE OneToOne 1 100 0.00 255.0 FORMAT "%5.1" ECU_ADDRESS 0x802EB2 /end MEASUREMENT
/begin MEASUREMENT FrmMng_trqDesCC "Vortriebsmoment gesendet vom Slave über CAN" SWORD TrqPrp 1 100 -32768.00 32767.00 FORMAT "%8.2" ECU_ADDRESS 0x7F98D8 /end MEASUREMENT
/begin MEASUREMENT FrmMng_trqFrcCan_mp "Reibmoment -> CAN" SWORD Trq 1 100 -3276.800 3276.700 FORMAT "%8.3" ECU_ADDRESS 0x802EB4 /end MEASUREMENT
/begin MEASUREMENT FrmMng_trqFrcRaw_mp "Rohwert des Reibmomentes" SWORD Trq 1 100 -3276.800 3276.700 FORMAT "%8.3" ECU_ADDRESS 0x802EB6 /end MEASUREMENT
/begin MEASUREMENT FrmMng_trqGearbx1_mp "Meßpunkt 1 fuer Getriebemoment" SWORD Trq 1 100 -3276.800 3276.700 FORMAT "%8.3" ECU_ADDRESS 0x802EB8 /end MEASUREMENT
/begin MEASUREMENT FrmMng_trqGearbx2_mp "Meßpunkt 2 für Getriebemoment" SWORD Trq 1 100 -3276.800 3276.700 FORMAT "%8.3" ECU_ADDRESS 0x802EBA /end MEASUREMENT
/begin MEASUREMENT FrmMng_trqGearbx3_mp "Meßpunkt 3 für Getriebemoment" SWORD Trq 1 100 -3276.800 3276.700 FORMAT "%8.3" ECU_ADDRESS 0x802EBC /end MEASUREMENT
/begin MEASUREMENT FrmMng_trqGearbxCur1_mp "Meßpunkt 1 für Ist-Getriebemoment" SWORD Trq 1 100 -3276.800 3276.700 FORMAT "%8.3" ECU_ADDRESS 0x802EBE /end MEASUREMENT
/begin MEASUREMENT FrmMng_trqGearbxCur2_mp "Meßpunkt 2 für Ist-Getriebemoment" SWORD Trq 1 100 -3276.800 3276.700 FORMAT "%8.3" ECU_ADDRESS 0x802EC0 /end MEASUREMENT
/begin MEASUREMENT FrmMng_trqGearbxDes_mp "Meßpunkt fuer Getriebe-Sollmoment" SWORD Trq 1 100 -3276.800 3276.700 FORMAT "%8.3" ECU_ADDRESS 0x802EC2 /end MEASUREMENT
/begin MEASUREMENT FrmMng_trqInrEng_mp "Meßpunkt für inneres Motormoment" SWORD Trq 1 100 -3276.800 3276.700 FORMAT "%8.3" ECU_ADDRESS 0x802EC4 /end MEASUREMENT
/begin MEASUREMENT FrmMng_trqLeadCC "Vortriebsvorhaltemoment vom Slave über CAN" SWORD TrqPrp 1 100 -32768.00 32767.00 FORMAT "%8.2" ECU_ADDRESS 0x7F98E4 /end MEASUREMENT
/begin MEASUREMENT FrmMng_trqRelDrvDem4_mp "Meßpunkt 4 für relatives Fahrerwunschmoment" SWORD Trq 1 100 -3276.800 3276.700 FORMAT "%8.3" ECU_ADDRESS 0x802EC6 /end MEASUREMENT
/begin MEASUREMENT FrmMng_trqTSC3Trgt_mp "Meßpunkt für Rohwerte -FrmMng_trqTSC3Trgt message" SWORD Trq 1 100 -3276.800 3276.700 FORMAT "%8.3" ECU_ADDRESS 0x802EC8 /end MEASUREMENT
/begin MEASUREMENT FrmMng_trqWheel1_mp "Meßpunkt 1 für Radmoment" SWORD Trq 1 100 -3276.800 3276.700 FORMAT "%8.3" ECU_ADDRESS 0x802ECA /end MEASUREMENT
/begin MEASUREMENT FrmMng_trqWheel2_mp "Meßpunkt 2 für Radmoment" SWORD TrqPrp 1 100 -32768.00 32767.00 FORMAT "%8.2" ECU_ADDRESS 0x802ECC /end MEASUREMENT
/begin MEASUREMENT FrmMng_trqWheel3_mp "Meßpunkt 3 für Radmoment" SWORD TrqPrp 1 100 -32768.00 32767.00 FORMAT "%8.2" ECU_ADDRESS 0x802ECE /end MEASUREMENT
/begin MEASUREMENT FrmMng_trqWheel4_mp "Meßpunkt 4 für Radmoment" SWORD TrqPrp 1 100 -32768.00 32767.00 FORMAT "%8.2" ECU_ADDRESS 0x802ED0 /end MEASUREMENT
/begin MEASUREMENT FrmMng_trqWheel5_mp "Meßpunkt 5 für Radmoment" SWORD TrqPrp 1 100 -32768.00 32767.00 FORMAT "%8.2" ECU_ADDRESS 0x802ED2 /end MEASUREMENT
/begin FUNCTION frmmng_rectos "Frame Manager Prozeß für die TOG-Empfangsbotschaft vom CAN"
 /begin DEF_CHARACTERISTIC FrmMng_DebTOSDLCDef_C FrmMng_DebTOSDLCOk_C FrmMng_DebTOSTODef_C FrmMng_DebTOSTOOk_C FrmMng_swtTOSEna_C FrmMng_tiFillLvl_Offset_C FrmMng_facTiFillLvl_Slope_C FrmMng_tiOilTemp_Offset_C FrmMng_facTiOilTemp_Slope_C /end DEF_CHARACTERISTIC
/end FUNCTION
/begin FUNCTION frmmng_rectsc "Frame Manager Prozeß für die Getriebe-Empfangsbotschaft vom CAN"
 /begin DEF_CHARACTERISTIC FrmMng_DebTSC1CNTDef_C FrmMng_DebTSC1CNTOk_C FrmMng_DebTSC1DLCDef_C FrmMng_DebTSC1DLCOk_C FrmMng_DebTSC1TODef_C FrmMng_DebTSC1TOOk_C FrmMng_DebTSC2CNTDef_C FrmMng_DebTSC2CNTOk_C FrmMng_DebTSC2DLCDef_C FrmMng_DebTSC2DLCOk_C FrmMng_DebTSC2TODef_C FrmMng_DebTSC2TOOk_C FrmMng_DebTSC3CNTDef_C FrmMng_DebTSC3CNTOk_C FrmMng_DebTSC3CSDef_C FrmMng_DebTSC3CSOk_C FrmMng_DebTSC3DLCDef_C FrmMng_DebTSC3DLCOk_C FrmMng_DebTSC3TODef_C FrmMng_DebTSC3TOOk_C FrmMng_dTrq_Offset_C FrmMng_facDTrq_Slope_C FrmMng_MaxDiffTSC1_C FrmMng_MaxDiffTSC2_C FrmMng_MaxDiffTSC3_C FrmMng_MaxPerTSC1_C FrmMng_MaxPerTSC2_C FrmMng_MaxPerTSC3_C FrmMng_rSlpRes_Offset_C FrmMng_facRSlpRes_Slope_C FrmMng_swtTSC1Ena_C FrmMng_swtTSC2Ena_C FrmMng_swtTSC3Ena_C FrmMng_swtTSC3NeutDisbl_C FrmMng_swtTSC3Type_C FrmMng_ti_Offset_C FrmMng_facTi_Slope_C FrmMng_trFct_Offset_C FrmMng_facTrFct_Slope_C /end DEF_CHARACTERISTIC
/end FUNCTION
/begin FUNCTION frmmng_rx20msms "" /end FUNCTION
/begin FUNCTION frmmng_rx20msms_msg "" /end FUNCTION
/begin FUNCTION frmmng_rx20msms_uic "" /end FUNCTION
/begin FUNCTION frmmng_rxchrgr "Frame Manager Prozess für die CHRGR1- und CHRGR2-Empfangsbotschaft vom CAN"
 /begin DEF_CHARACTERISTIC FrmMng_DebChrgr1ANegDevDef_C FrmMng_DebChrgr1ANegDevOk_C FrmMng_DebChrgr1APosDevDef_C FrmMng_DebChrgr1APosDevOk_C FrmMng_DebChrgr1CDataErrDef_C FrmMng_DebChrgr1CDataErrOk_C FrmMng_DebChrgr1CInDef_C FrmMng_DebChrgr1CInOk_C FrmMng_DebChrgr1CSigErrDef_C FrmMng_DebChrgr1CSigErrOk_C FrmMng_DebChrgr1CSRCHighDef_C FrmMng_DebChrgr1CSRCHighOk_C FrmMng_DebCHRGR1DLCDef_C FrmMng_DebCHRGR1DLCOk_C FrmMng_DebChrgr1NCanDef_C FrmMng_DebChrgr1NCanOk_C FrmMng_DebChrgr1TExTempDef_C FrmMng_DebChrgr1TExTempOk_C FrmMng_DebCHRGR1TODef_C FrmMng_DebCHRGR1TOOk_C FrmMng_DebChrgr1VSRCDef_C FrmMng_DebChrgr1VSRCOk_C FrmMng_DebChrgr2ANegDevDef_C FrmMng_DebChrgr2ANegDevOk_C FrmMng_DebChrgr2APosDevDef_C FrmMng_DebChrgr2APosDevOk_C FrmMng_DebChrgr2CDataErrDef_C FrmMng_DebChrgr2CDataErrOk_C FrmMng_DebChrgr2CInDef_C FrmMng_DebChrgr2CInOk_C FrmMng_DebChrgr2CSigErrDef_C FrmMng_DebChrgr2CSigErrOk_C FrmMng_DebChrgr2CSRCHighDef_C FrmMng_DebChrgr2CSRCHighOk_C FrmMng_DebCHRGR2DLCDef_C FrmMng_DebCHRGR2DLCOk_C FrmMng_DebChrgr2NCanDef_C FrmMng_DebChrgr2NCanOk_C FrmMng_DebChrgr2TExTempDef_C FrmMng_DebChrgr2TExTempOk_C FrmMng_DebCHRGR2TODef_C FrmMng_DebCHRGR2TOOk_C FrmMng_DebChrgr2VSRCDef_C FrmMng_DebChrgr2VSRCOk_C FrmMng_rChrgrExTemp_C FrmMng_rChrgrStrt_C FrmMng_swtCHRGR1Ena_C FrmMng_swtCHRGR2Ena_C FrmMng_tChrgrStrt_C FrmMng_tiChrgrStrt_C FrmMng_vChrgrExTemp_C /end DEF_CHARACTERISTIC
/end FUNCTION
/begin FUNCTION frmmng_rxchrgr_msg ""
 /begin OUT_MEASUREMENT FrmMng_rBPACDIn1 FrmMng_rBPACDIn2 FrmMng_stChrgr1Err1 FrmMng_stChrgr1Err2 FrmMng_stChrgr2Err1 FrmMng_stChrgr2Err2 FrmMng_stChrgrPCRGovDevOff FrmMng_stMsgErrChrgr1 FrmMng_stMsgErrChrgr2 /end OUT_MEASUREMENT
/end FUNCTION
/begin FUNCTION frmmng_rxchrgr_uic ""
 /begin OUT_MEASUREMENT FrmMng_stChrgr1ExTemp1_mp FrmMng_stChrgr1ExTemp2_mp FrmMng_stChrgr1Strt_mp FrmMng_stChrgr2ExTemp1_mp FrmMng_stChrgr2ExTemp2_mp FrmMng_stChrgr2Strt_mp /end OUT_MEASUREMENT
/end FUNCTION
/begin FUNCTION frmmng_rxnsyncms_msg "" /end FUNCTION
/begin FUNCTION frmmng_rxnsyncms_uic "" /end FUNCTION
/begin FUNCTION frmmng_rxtgovms "" /end FUNCTION
/begin FUNCTION frmmng_rxtgovms_msg ""
 /begin OUT_MEASUREMENT FrmMng_nSetpoint FrmMng_stMsgMSnSetpGov FrmMng_trqDesCC FrmMng_trqLeadCC /end OUT_MEASUREMENT
/end FUNCTION
/begin FUNCTION frmmng_rxtgovms_uic "" /end FUNCTION
/begin FUNCTION frmmng_sendeng ""
 /begin DEF_CHARACTERISTIC FrmMng_tiAdpPT1_C FrmMng_ctMulEng2_C FrmMng_ctMulEng5_C FrmMng_dAirIndSys_C FrmMng_dMulinfo2_0_C FrmMng_dMulinfo2_1_C FrmMng_dMulinfo2_2_C FrmMng_dnLI_C FrmMng_dtrqFrcCanMax_C FrmMng_dtrqFrcCanMin_C FrmMng_dtrqFrcMax_C FrmMng_dtrqFrcMin_C FrmMng_MaxEngGrad_C FrmMng_MinEngGrad_C FrmMng_nDes_MAP FrmMng_nEngPrt_MAP FrmMng_n_Offset_C FrmMng_facN_Slope_C FrmMng_pBoost_Offset_C FrmMng_facPBoost_Slope_C FrmMng_rAlt_Offset_C FrmMng_facRAlt_Slope_C FrmMng_rCurInf_C FrmMng_rEcoDflVal_C FrmMng_rGlw_Offset_C FrmMng_facRGlw_Slope_C FrmMng_rICur_Offset_C FrmMng_facRICur_Slope_C FrmMng_stCANVer_C FrmMng_stEGTRgnMsk_C FrmMng_stExhGsType_C FrmMng_stTRQ_C FrmMng_swtConvAdp_C FrmMng_swtENG1Ena_C FrmMng_swtENG2Ena_C FrmMng_swtENG3Ena_C FrmMng_swtENG5Ena_C FrmMng_swtENG6Ena_C FrmMng_swtENG7Ena_C FrmMng_swtFrcAdp_C FrmMng_swtGearbxVer_C FrmMng_swtTrqErr_C FrmMng_swtTrqFrc_C FrmMng_tiAdpStrtDly_C FrmMng_tiLdResp_Offset_C FrmMng_facTiLdResp_Slope_C FrmMng_trqGearbxMax_C FrmMng_trqMulinfo5_0_C FrmMng_vDes_Offset_C FrmMng_facVDes_Slope_C FrmMng_volFlCons_Offset_C FrmMng_facVolFlCons_Slope_C FrmMng_volNormCylEng5_Offset_C FrmMng_facVolNormCylEng5_Slope_C FrmMng_volNormCyl_C /end DEF_CHARACTERISTIC
 /begin IN_MEASUREMENT CTSCD_tClnt EngM_ctRevSta EngPrt_facPrtLimCorr VSSCD_v /end IN_MEASUREMENT
/end FUNCTION
/begin FUNCTION frmmng_sendengflx "CAN Sendeprozeß für Botschaft MotorFlexia"
 /begin DEF_CHARACTERISTIC FrmMng_dAvrgOilLvl_C FrmMng_dAvrgOilLvl_Offset_C FrmMng_facDAvrgOilLvl_Slope_C FrmMng_dEqu_Offset_C FrmMng_facDEqu_Slope_C FrmMng_dMinNumOilLvlDiff_C FrmMng_dNrVlv_C FrmMng_dOilload_C FrmMng_dOilload_Offset_C FrmMng_facDOilload_Slope_C FrmMng_dOilLvlDiff_Offset_C FrmMng_facDOilLvlDiff_Slope_C FrmMng_dSlpFillCrv_C FrmMng_dSlpFillCrv_Offset_C FrmMng_facDSlpFillCrv_Slope_C FrmMng_dSootTurbo_C FrmMng_dSootTurbo_Offset_C FrmMng_facDSootTurbo_Slope_C FrmMng_lDrvDist_Offset_C FrmMng_facLDrvDist_Slope_C FrmMng_lMaxRng_C FrmMng_lMinDrvDist_C FrmMng_lMinRng_C FrmMng_lOil_MAP FrmMng_lRNG_Offset_C FrmMng_facLRNG_Slope_C FrmMng_l_Offset_C FrmMng_facL_Slope_C FrmMng_pwrKW_Offset_C FrmMng_facpwrKW_Slope_C FrmMng_pwrMax_C FrmMng_r_Offset_C FrmMng_facR_Slope_C FrmMng_stOvrFlowDet_C FrmMng_swtENGFLXEna_C FrmMng_tiMaxRng_C FrmMng_tiMinRng_C FrmMng_volCubCap_C FrmMng_volCubCap_Offset_C FrmMng_facVolCubCap_Slope_C FrmMng_volNormCyl_Offset_C FrmMng_facVolNormCyl_Slope_C FrmMng_volOilLvlMax_C FrmMng_volOilLvlMax_Offset_C FrmMng_facVolOilLvlMax_Slope_C FrmMng_volOilOfsMax_C FrmMng_volOilOfsMax_Offset_C FrmMng_facVolOilOfsMax_Slope_C FrmMng_volOilWrnThresOfs_C FrmMng_volOilWrnThresTolc_C FrmMng_volOilWrnThres_Offset_C FrmMng_facVolOilWrnThres_Slope_C FrmMng_volOvrFlowHys_C FrmMng_volOvrFlowHys_Offset_C FrmMng_facVolOvrFlowHys_Slope_C FrmMng_volSTMV_Offset_C FrmMng_facVolSTMV_Slope_C /end DEF_CHARACTERISTIC
 /begin IN_MEASUREMENT Eng_nAvrg OTSCD_tEngOil /end IN_MEASUREMENT
/end FUNCTION
/begin FUNCTION frmmng_sendengtrq ""
 /begin DEF_CHARACTERISTIC FrmMng_dTrqReso_C FrmMng_facTRQInrTrq_Slope_CA FrmMng_swtENGTRQ1Ena_C FrmMng_swtENGTRQ2Ena_C FrmMng_swtENGTRQ3Ena_C FrmMng_trqEngTrqPrp_Offset_CA FrmMng_trqInrTrq_Offset_CA /end DEF_CHARACTERISTIC
/end FUNCTION
/begin FUNCTION frmmng_sys ""
 /begin DEF_CHARACTERISTIC FrmMng_dAC1ID_C FrmMng_AC1IDType_C FrmMng_AC1NumCAN_C FrmMng_AC1NumMsgPos_C FrmMng_AC1OpMode_C FrmMng_dAC1SchedMesgLen_C FrmMng_AC1IntrEna_C FrmMng_AC1Mul_C FrmMng_AC1SchedMode_C FrmMng_AC1Sched_C FrmMng_AC1Strt_C FrmMng_AC1TOTmp_C FrmMng_dACC1ID_C FrmMng_ACC1IDType_C FrmMng_ACC1NumCAN_C FrmMng_ACC1NumMsgPos_C FrmMng_ACC1OpMode_C FrmMng_dACC1SchedMesgLen_C FrmMng_ACC1IntrEna_C FrmMng_ACC1Mul_C FrmMng_ACC1TOTmp_C FrmMng_dACCSysID_C FrmMng_ACCSysIDType_C FrmMng_ACCSysNumCAN_C FrmMng_ACCSysNumMsgPos_C FrmMng_ACCSysOpMode_C FrmMng_dACCSysSchedMesgLen_C FrmMng_ACCSysIntrEna_C FrmMng_ACCSysMul_C FrmMng_ACCSystemSchedMode_C FrmMng_ACCSystemSched_C FrmMng_ACCSystemStrt_C FrmMng_ACCSystemTOTmp_C FrmMng_dAIRBG1ID_C FrmMng_AIRBG1IDType_C FrmMng_AIRBG1NumCAN_C FrmMng_AIRBG1NumMsgPos_C FrmMng_AIRBG1OpMode_C FrmMng_dAIRBG1SchedMesgLen_C FrmMng_AIRBG1IntrEna_C FrmMng_AIRBG1Mul_C FrmMng_AIRBG1SchedMode_C FrmMng_AIRBG1Sched_C FrmMng_AIRBG1Strt_C FrmMng_AIRBG1TOTmp_C FrmMng_dAWD1ID_C FrmMng_AWD1IDType_C FrmMng_AWD1NumCAN_C FrmMng_AWD1NumMsgPos_C FrmMng_AWD1OpMode_C FrmMng_dAWD1SchedMesgLen_C FrmMng_AWD1IntrEna_C FrmMng_AWD1Mul_C FrmMng_AWD1SchedMode_C FrmMng_AWD1Sched_C FrmMng_AWD1Strt_C FrmMng_AWD1TOTmp_C FrmMng_dBEM1ID_C FrmMng_BEM1IDType_C FrmMng_BEM1NumCAN_C FrmMng_BEM1NumMsgPos_C FrmMng_BEM1OpMode_C FrmMng_dBEM1SchedMesgLen_C FrmMng_BEM1IntrEna_C FrmMng_BEM1Mul_C FrmMng_BEM1SchedMode_C FrmMng_BEM1Sched_C FrmMng_BEM1Strt_C FrmMng_BEM1TOTmp_C FrmMng_dBRK1ID_C FrmMng_BRK1IDType_C FrmMng_BRK1NumCAN_C FrmMng_BRK1NumMsgPos_C FrmMng_BRK1OpMode_C FrmMng_dBRK1SchedMesgLen_C FrmMng_BRK1IntrEna_C FrmMng_BRK1Mul_C FrmMng_BRK1SchedMode_C FrmMng_BRK1Sched_C FrmMng_BRK1Strt_C FrmMng_BRK1TOTmp_C FrmMng_dBRK2ID_C FrmMng_BRK2IDType_C FrmMng_BRK2NumCAN_C FrmMng_BRK2NumMsgPos_C FrmMng_BRK2OpMode_C FrmMng_dBRK2SchedMesgLen_C FrmMng_BRK2IntrEna_C FrmMng_BRK2Mul_C FrmMng_BRK2SchedMode_C FrmMng_BRK2Sched_C FrmMng_BRK2Strt_C FrmMng_BRK2TOTmp_C FrmMng_dBRK8ID_C FrmMng_BRK8IDType_C FrmMng_BRK8NumCAN_C FrmMng_BRK8NumMsgPos_C FrmMng_BRK8OpMode_C FrmMng_dBRK8SchedMesgLen_C FrmMng_BRK8IntrEna_C FrmMng_BRK8Mul_C FrmMng_BRK8SchedMode_C FrmMng_BRK8Sched_C FrmMng_BRK8Strt_C FrmMng_BRK8TOTmp_C FrmMng_BUF1MsgID_C FrmMng_BUF1IDType_C FrmMng_BUF1NumCAN_C FrmMng_BUF1NumMsgPos_C FrmMng_BUF1OpMode_C FrmMng_dBuf1Len_cu8 FrmMng_BUF1IntrEna_C FrmMng_BUF1Mul_C FrmMng_dCCTLID_C FrmMng_CCTLIDType_C FrmMng_CCTLNumCAN_C FrmMng_CCTLNumMsgPos_C FrmMng_CCTLOpMode_C FrmMng_dCCTLSchedMesgLen_C FrmMng_CCTLIntrEna_C FrmMng_CCTLMul_C FrmMng_CCTLSchedMode_C FrmMng_CCTLSched_C FrmMng_CCTLStrt_C FrmMng_CCTLTOTmp_C FrmMng_dCHRGR1ID_C FrmMng_CHRGR1IDType_C FrmMng_CHRGR1NumCAN_C FrmMng_CHRGR1NumMsgPos_C FrmMng_CHRGR1OpMode_C FrmMng_dCHRGR1SchedMesgLen_C FrmMng_CHRGR1IntrEna_C FrmMng_CHRGR1Mul_C FrmMng_CHRGR1SchedMode_C FrmMng_CHRGR1Sched_C FrmMng_CHRGR1Strt_C FrmMng_CHRGR1TOTmp_C FrmMng_dCHRGR2ID_C FrmMng_CHRGR2IDType_C FrmMng_CHRGR2NumCAN_C FrmMng_CHRGR2NumMsgPos_C FrmMng_CHRGR2OpMode_C FrmMng_dCHRGR2SchedMesgLen_C FrmMng_CHRGR2IntrEna_C FrmMng_CHRGR2Mul_C FrmMng_CHRGR2SchedMode_C FrmMng_CHRGR2Sched_C FrmMng_CHRGR2Strt_C FrmMng_CHRGR2TOTmp_C FrmMng_dDIA1ID_C FrmMng_DIA1IDType_C FrmMng_DIA1NumCAN_C FrmMng_DIA1NumMsgPos_C FrmMng_DIA1OpMode_C FrmMng_dDIA1SchedMesgLen_C FrmMng_DIA1IntrEna_C FrmMng_DIA1Mul_C FrmMng_DIA1SchedMode_C FrmMng_DIA1Sched_C FrmMng_DIA1Strt_C FrmMng_DIA1TOTmp_C FrmMng_dDSP1ID_C FrmMng_DSP1IDType_C FrmMng_DSP1NumCAN_C FrmMng_DSP1NumMsgPos_C FrmMng_DSP1OpMode_C FrmMng_dDSP1SchedMesgLen_C FrmMng_DSP1IntrEna_C FrmMng_DSP1Mul_C FrmMng_DSP1SchedMode_C FrmMng_DSP1Sched_C FrmMng_DSP1Strt_C FrmMng_DSP1TOTmp_C FrmMng_dDSP2ID_C FrmMng_DSP2IDType_C FrmMng_DSP2NumCAN_C FrmMng_DSP2NumMsgPos_C FrmMng_DSP2OpMode_C FrmMng_dDSP2SchedMesgLen_C FrmMng_DSP2IntrEna_C FrmMng_DSP2Mul_C FrmMng_DSP2SchedMode_C FrmMng_DSP2Sched_C FrmMng_DSP2Strt_C FrmMng_DSP2TOTmp_C FrmMng_dENG1ID_C FrmMng_ENG1IDType_C FrmMng_ENG1NumCAN_C FrmMng_ENG1NumMsgPos_C FrmMng_ENG1OpMode_C FrmMng_dENG1SchedMesgLen_C FrmMng_ENG1IntrEna_C FrmMng_ENG1Mul_C FrmMng_dENG2ID_C FrmMng_ENG2IDType_C FrmMng_ENG2NumCAN_C FrmMng_ENG2NumMsgPos_C FrmMng_ENG2OpMode_C FrmMng_dENG2SchedMesgLen_C FrmMng_ENG2IntrEna_C FrmMng_ENG2Mul_C FrmMng_dENG3ID_C FrmMng_ENG3IDType_C FrmMng_ENG3NumCAN_C FrmMng_ENG3NumMsgPos_C FrmMng_ENG3OpMode_C FrmMng_dENG3SchedMesgLen_C FrmMng_ENG3IntrEna_C FrmMng_ENG3Mul_C FrmMng_dENG5ID_C FrmMng_ENG5IDType_C FrmMng_ENG5NumCAN_C FrmMng_ENG5NumMsgPos_C FrmMng_ENG5OpMode_C FrmMng_dENG5SchedMesgLen_C FrmMng_ENG5IntrEna_C FrmMng_ENG5Mul_C FrmMng_dENG6ID_C FrmMng_ENG6IDType_C FrmMng_ENG6NumCAN_C FrmMng_ENG6NumMsgPos_C FrmMng_ENG6OpMode_C FrmMng_dENG6SchedMesgLen_C FrmMng_ENG6IntrEna_C FrmMng_ENG6Mul_C FrmMng_dENG7ID_C FrmMng_ENG7IDType_C FrmMng_ENG7NumCAN_C FrmMng_ENG7NumMsgPos_C FrmMng_ENG7OpMode_C FrmMng_dENG7SchedMesgLen_C FrmMng_ENG7IntrEna_C FrmMng_ENG7Mul_C FrmMng_dENGACTR1ID_C FrmMng_ENGACTR1IDType_C FrmMng_ENGACTR1NumCAN_C FrmMng_ENGACTR1NumMsgPos_C FrmMng_ENGACTR1OpMode_C FrmMng_dENGACTR1SchedMesgLen_C FrmMng_ENGACTR1IntrEna_C FrmMng_ENGACTR1Mul_C FrmMng_dENGFLXID_C FrmMng_ENGFLXIDType_C FrmMng_ENGFLXNumCAN_C FrmMng_ENGFLXNumMsgPos_C FrmMng_ENGFLXOpMode_C FrmMng_dENGFLXSchedMesgLen_C FrmMng_ENGFLXIntrEna_C FrmMng_ENGFLXMul_C FrmMng_dENGTRQ1ID_C FrmMng_ENGTRQ1IDType_C FrmMng_ENGTRQ1NumCAN_C FrmMng_ENGTRQ1NumMsgPos_C FrmMng_ENGTRQ1OpMode_C FrmMng_dENGTRQ1SchedMesgLen_C FrmMng_ENGTRQ1IntrEna_C FrmMng_ENGTRQ1Mul_C FrmMng_dENGTRQ2ID_C FrmMng_ENGTRQ2IDType_C FrmMng_ENGTRQ2NumCAN_C FrmMng_ENGTRQ2NumMsgPos_C FrmMng_ENGTRQ2OpMode_C FrmMng_dENGTRQ2SchedMesgLen_C FrmMng_ENGTRQ2IntrEna_C FrmMng_ENGTRQ2Mul_C FrmMng_dENGTRQ3ID_C FrmMng_ENGTRQ3IDType_C FrmMng_ENGTRQ3NumCAN_C FrmMng_ENGTRQ3NumMsgPos_C FrmMng_ENGTRQ3OpMode_C FrmMng_dENGTRQ3SchedMesgLen_C FrmMng_ENGTRQ3IntrEna_C FrmMng_ENGTRQ3Mul_C FrmMng_dESCUID_C FrmMng_ESCUIDType_C FrmMng_ESCUNumCAN_C FrmMng_ESCUNumMsgPos_C FrmMng_ESCUOpMode_C FrmMng_dESCUSchedMesgLen_C FrmMng_ESCUIntrEna_C FrmMng_ESCUMul_C FrmMng_ESCUSchedMode_C FrmMng_ESCUSched_C FrmMng_ESCUStrt_C FrmMng_ESCUTOTmp_C FrmMng_dGW1ID_C FrmMng_GW1IDType_C FrmMng_GW1NumCAN_C FrmMng_GW1NumMsgPos_C FrmMng_GW1OpMode_C FrmMng_dGW1SchedMesgLen_C FrmMng_GW1IntrEna_C FrmMng_GW1Mul_C FrmMng_GW1SchedMode_C FrmMng_GW1Sched_C FrmMng_GW1Strt_C FrmMng_GW1TOTmp_C FrmMng_nDes_C FrmMng_dNIVEAU1ID_C FrmMng_NIVEAU1IDType_C FrmMng_NIVEAU1NumCAN_C FrmMng_NIVEAU1NumMsgPos_C FrmMng_NIVEAU1OpMode_C FrmMng_dNIVEAU1SchedMesgLen_C FrmMng_NIVEAU1IntrEna_C FrmMng_NIVEAU1Mul_C FrmMng_NIVEAU1SchedMode_C FrmMng_NIVEAU1Sched_C FrmMng_NIVEAU1Strt_C FrmMng_NIVEAU1TOTmp_C FrmMng_dRXIMMCTLID_C FrmMng_RXIMMCTLIDType_C FrmMng_RXIMMCTLNumCAN_C FrmMng_RXIMMCTLNumMsgPos_C FrmMng_RXIMMCTLOpMode_C FrmMng_dRXIMMCTLLen_cu8 FrmMng_RXIMMCTLIntrEna_C FrmMng_RXIMMCTLMul_C FrmMng_dSTIGNID_C FrmMng_STIGNIDType_C FrmMng_STIGNNumCAN_C FrmMng_STIGNNumMsgPos_C FrmMng_STIGNOpMode_C FrmMng_dSTIGNSchedMesgLen_C FrmMng_STIGNIntrEna_C FrmMng_STIGNMul_C FrmMng_STIGNSchedMode_C FrmMng_STIGNSched_C FrmMng_STIGNStrt_C FrmMng_STIGNTOTmp_C FrmMng_dTOSID_C FrmMng_TOSIDType_C FrmMng_TOSNumCAN_C FrmMng_TOSNumMsgPos_C FrmMng_TOSOpMode_C FrmMng_dTOSSchedMesgLen_C FrmMng_TOSIntrEna_C FrmMng_TOSMul_C FrmMng_TOSSchedMode_C FrmMng_TOSSched_C FrmMng_TOSStrt_C FrmMng_TOSTOTmp_C FrmMng_dTSC1ID_C FrmMng_TSC1IDType_C FrmMng_TSC1NumCAN_C FrmMng_TSC1NumMsgPos_C FrmMng_TSC1OpMode_C FrmMng_dTSC1SchedMesgLen_C FrmMng_TSC1IntrEna_C FrmMng_TSC1Mul_C FrmMng_TSC1SchedMode_C FrmMng_TSC1Sched_C FrmMng_TSC1Strt_C FrmMng_TSC1TOTmp_C FrmMng_dTSC2ID_C FrmMng_TSC2IDType_C FrmMng_TSC2NumCAN_C FrmMng_TSC2NumMsgPos_C FrmMng_TSC2OpMode_C FrmMng_dTSC2SchedMesgLen_C FrmMng_TSC2IntrEna_C FrmMng_TSC2Mul_C FrmMng_TSC2SchedMode_C FrmMng_TSC2Sched_C FrmMng_TSC2Strt_C FrmMng_TSC2TOTmp_C FrmMng_dTSC3ID_C FrmMng_TSC3IDType_C FrmMng_TSC3NumCAN_C FrmMng_TSC3NumMsgPos_C FrmMng_TSC3OpMode_C FrmMng_dTSC3SchedMesgLen_C FrmMng_TSC3IntrEna_C FrmMng_TSC3Mul_C FrmMng_TSC3SchedMode_C FrmMng_TSC3Sched_C FrmMng_TSC3Strt_C FrmMng_TSC3TOTmp_C FrmMng_dTXIMMCTLID_C FrmMng_TXIMMCTLIDType_C FrmMng_TXIMMCTLNumCAN_C FrmMng_TXIMMCTLNumMsgPos_C FrmMng_TXIMMCTLOpMode_C FrmMng_dTXIMMCTLSchedMesgLen_C FrmMng_TXIMMCTLIntrEna_C FrmMng_TXIMMCTLMul_C /end DEF_CHARACTERISTIC
/end FUNCTION
/begin FUNCTION frmmng_tx20msms "" /end FUNCTION
/begin FUNCTION frmmng_tx20msms_msg "" /end FUNCTION
/begin FUNCTION frmmng_tx20msms_uic "" /end FUNCTION
/begin FUNCTION frmmng_txengactr "Frame Manager Prozess für die EngActr1-Sendebotschaft zum CAN"
 /begin DEF_CHARACTERISTIC FrmMng_ctEngActr_OffVal_C FrmMng_ctEngActr_RstVal_C FrmMng_dEngActr_ErrVal_C FrmMng_dEngActr_OffVal_C FrmMng_dEngActr_RstVal_C FrmMng_rEngActr_Offset_C FrmMng_facEngActr_Slope_C FrmMng_swtENGACTR1Ena_C /end DEF_CHARACTERISTIC
/end FUNCTION
/begin FUNCTION frmmng_txengactr_uic ""
 /begin OUT_MEASUREMENT FrmMng_ctChrgr1_Off_mp FrmMng_ctChrgr2_Off_mp FrmMng_ctChrgr_Rst_mp FrmMng_dBPACDOut1_mp FrmMng_dBPACDOut2_mp FrmMng_rBPACDOut1_mp FrmMng_rBPACDOut2_mp FrmMng_stChrgr1A_mp FrmMng_stChrgr1_Off_mp FrmMng_stChrgr2A_mp FrmMng_stChrgr2_Off_mp FrmMng_stEngActr_Ena_mp FrmMng_stEngActr_Rst_mp /end OUT_MEASUREMENT
/end FUNCTION
/begin FUNCTION frmmng_txnsyncms_msg "" /end FUNCTION
/begin FUNCTION frmmng_txnsyncms_uic "" /end FUNCTION
/begin FUNCTION frmmng_txtgovms "" /end FUNCTION
/begin FUNCTION frmmng_txtgovms_msg "" /end FUNCTION
/begin FUNCTION frmmng_txtgovms_uic "" /end FUNCTION
/begin FUNCTION frmmng_uic ""
 /begin DEF_CHARACTERISTIC FrmMng_stSendEng6_B1_Vector FrmMng_stSendEng6_B1_Channel FrmMng_stSendEng6_B2_Vector FrmMng_stSendEng6_B2_Channel FrmMng_stSendEng6_B3_Vector FrmMng_stSendEng6_B3_Channel FrmMng_stSendEng6_B4_Vector FrmMng_stSendEng6_B4_Channel FrmMng_stSendEng6_B5_Vector FrmMng_stSendEng6_B5_Channel FrmMng_stSendEng6_B6_Vector FrmMng_stSendEng6_B6_Channel FrmMng_stSendEng6_B7_Vector FrmMng_stSendEng6_B7_Channel FrmMng_stSendEng6_B8_Vector FrmMng_stSendEng6_B8_Channel FrmMng_stSendEngTrq1_B1_Vector FrmMng_stSendEngTrq1_B1_Channel FrmMng_stSendEngTrq1_B2_Vector FrmMng_stSendEngTrq1_B2_Channel FrmMng_stSendEngTrq1_B3_Vector FrmMng_stSendEngTrq1_B3_Channel FrmMng_stSendEngTrq1_B4_Vector FrmMng_stSendEngTrq1_B4_Channel FrmMng_stSendEngTrq1_B5_Vector FrmMng_stSendEngTrq1_B5_Channel FrmMng_stSendEngTrq1_B6_Vector FrmMng_stSendEngTrq1_B6_Channel FrmMng_stSendEngTrq1_B7_Vector FrmMng_stSendEngTrq1_B7_Channel FrmMng_stSendEngTrq1_B8_Vector FrmMng_stSendEngTrq1_B8_Channel FrmMng_stSendEngTrq2_B1_Vector FrmMng_stSendEngTrq2_B1_Channel FrmMng_stSendEngTrq2_B2_Vector FrmMng_stSendEngTrq2_B2_Channel FrmMng_stSendEngTrq2_B3_Vector FrmMng_stSendEngTrq2_B3_Channel FrmMng_stSendEngTrq2_B4_Vector FrmMng_stSendEngTrq2_B4_Channel FrmMng_stSendEngTrq2_B5_Vector FrmMng_stSendEngTrq2_B5_Channel FrmMng_stSendEngTrq2_B6_Vector FrmMng_stSendEngTrq2_B6_Channel FrmMng_stSendEngTrq2_B7_Vector FrmMng_stSendEngTrq2_B7_Channel FrmMng_stSendEngTrq2_B8_Vector FrmMng_stSendEngTrq2_B8_Channel FrmMng_stSendEngTrq3_B1_Vector FrmMng_stSendEngTrq3_B1_Channel FrmMng_stSendEngTrq3_B2_Vector FrmMng_stSendEngTrq3_B2_Channel FrmMng_stSendEngTrq3_B3_Vector FrmMng_stSendEngTrq3_B3_Channel FrmMng_stSendEngTrq3_B4_Vector FrmMng_stSendEngTrq3_B4_Channel FrmMng_stSendEngTrq3_B5_Vector FrmMng_stSendEngTrq3_B5_Channel FrmMng_stSendEngTrq3_B6_Vector FrmMng_stSendEngTrq3_B6_Channel FrmMng_stSendEngTrq3_B7_Vector FrmMng_stSendEngTrq3_B7_Channel FrmMng_stSendEngTrq3_B8_Vector FrmMng_stSendEngTrq3_B8_Channel /end DEF_CHARACTERISTIC
 /begin OUT_MEASUREMENT FrmMng_ctAlvAAG_mp FrmMng_ctAlvACC_mp FrmMng_ctAlvAirbag_mp FrmMng_ctAlvAWD1_mp FrmMng_ctAlvBEM1_mp FrmMng_ctAlvBRK1_mp FrmMng_ctAlvBRK8_mp FrmMng_ctAlvCCTL_mp FrmMng_ctAlvDSP1_mp FrmMng_ctAlvILM_mp FrmMng_ctAlvNiveau1_mp FrmMng_ctAlvTSC1_mp FrmMng_ctAlvTSC2_mp FrmMng_ctAlvTSC3_mp FrmMng_dtrqFrcLimCan_mp FrmMng_dtrqFrcLim_mp FrmMng_dtrqFrc_mp FrmMng_lOil_mp FrmMng_nDes_mp FrmMng_rtrqACCDes_mp FrmMng_rtrqConvLoss_mp FrmMng_rtrqDCS_mp FrmMng_rtrqFrcCan_mp FrmMng_rtrqGearbxCur_mp FrmMng_rtrqGearbxDes_mp FrmMng_rtrqInrEngNoExtDem_mp FrmMng_rtrqInrEng_mp FrmMng_rtrqLimAWD_mp FrmMng_rtrqLim_mp FrmMng_rtrqRelDrvDem_mp FrmMng_rtrqRmpACC_mp FrmMng_rtrqTCS_mp FrmMng_rtrqTSC_mp FrmMng_rtrqWheel_mp FrmMng_rvLimAWD_mp FrmMng_stBEMB1_mp FrmMng_stBEMB2_mp FrmMng_stBEMB3_mp FrmMng_stBEMB4_mp FrmMng_stBEMB5_mp FrmMng_stBEMB6_mp FrmMng_stBEMB7_mp FrmMng_stBEMB8_mp FrmMng_stClg_mp FrmMng_stEngTrqErr_mp FrmMng_stGW1AAGErr_mp FrmMng_stGW1ILMErr_mp FrmMng_stSendEng6_B1Byp_mp FrmMng_stSendEng6_B2Byp_mp FrmMng_stSendEng6_B3Byp_mp FrmMng_stSendEng6_B4Byp_mp FrmMng_stSendEng6_B5Byp_mp FrmMng_stSendEng6_B6Byp_mp FrmMng_stSendEng6_B7Byp_mp FrmMng_stSendEng6_B8Byp_mp FrmMng_stSendEngTrq1_B1Byp_mp FrmMng_stSendEngTrq1_B2Byp_mp FrmMng_stSendEngTrq1_B3Byp_mp FrmMng_stSendEngTrq1_B4Byp_mp FrmMng_stSendEngTrq1_B5Byp_mp FrmMng_stSendEngTrq1_B6Byp_mp FrmMng_stSendEngTrq1_B7Byp_mp FrmMng_stSendEngTrq1_B8Byp_mp FrmMng_stSendEngTrq2_B1Byp_mp FrmMng_stSendEngTrq2_B2Byp_mp FrmMng_stSendEngTrq2_B3Byp_mp FrmMng_stSendEngTrq2_B4Byp_mp FrmMng_stSendEngTrq2_B5Byp_mp FrmMng_stSendEngTrq2_B6Byp_mp FrmMng_stSendEngTrq2_B7Byp_mp FrmMng_stSendEngTrq2_B8Byp_mp FrmMng_stSendEngTrq3_B1Byp_mp FrmMng_stSendEngTrq3_B2Byp_mp FrmMng_stSendEngTrq3_B3Byp_mp FrmMng_stSendEngTrq3_B4Byp_mp FrmMng_stSendEngTrq3_B5Byp_mp FrmMng_stSendEngTrq3_B6Byp_mp FrmMng_stSendEngTrq3_B7Byp_mp FrmMng_stSendEngTrq3_B8Byp_mp FrmMng_trqFrcCan_mp FrmMng_trqFrcRaw_mp FrmMng_trqGearbx1_mp FrmMng_trqGearbx2_mp FrmMng_trqGearbx3_mp FrmMng_trqGearbxCur1_mp FrmMng_trqGearbxCur2_mp FrmMng_trqGearbxDes_mp FrmMng_trqInrEng_mp FrmMng_trqRelDrvDem4_mp FrmMng_trqTSC3Trgt_mp FrmMng_trqWheel1_mp FrmMng_trqWheel2_mp FrmMng_trqWheel3_mp FrmMng_trqWheel4_mp FrmMng_trqWheel5_mp /end OUT_MEASUREMENT
/end FUNCTION
/begin COMPU_METHOD Dist "Umrechnungsformel für die Strecke in km" RAT_FUNC "%6.1" "[km]" COEFFS 0 0.04 0 0 0 1 /end COMPU_METHOD
/begin COMPU_METHOD Dist1 "Umrechnungsformel für Strecke in km" RAT_FUNC "%6.0" "[km]" COEFFS 0 0.002 0 0 0 1 /end COMPU_METHOD
/begin COMPU_METHOD DtyCyc "Tastverhaeltnis" RAT_FUNC "%6.4" "[%]" COEFFS 0 100 0 0 0 1 /end COMPU_METHOD
/begin COMPU_METHOD DtyCycCan "Tastverhältnis CAN-Wert" RAT_FUNC "%6.3" "[%]" COEFFS 0 10 0 0 0 1 /end COMPU_METHOD
/begin COMPU_METHOD EngN "Motordrehzahl" RAT_FUNC "%6.2" "[rpm]" COEFFS 0 1 0 0 0 1 /end COMPU_METHOD
/begin COMPU_METHOD Fact "Faktor mit Auflösung 1 / 8192, hauptsächlich für einen Faktorenbereich 0...1 verwendet" RAT_FUNC "%6.5" "[-]" COEFFS 0 8192 0 0 0 1 /end COMPU_METHOD
/begin COMPU_METHOD Fact1 "Faktor mit Auflösung 0,01 (100 mal höherer Bereich als Fact)" RAT_FUNC "%6.4" "[-]" COEFFS 0 128 0 0 0 1 /end COMPU_METHOD
/begin COMPU_METHOD Fact_WearSootIdx "Umrechnung für Ruß/Verschleißäquivalent" RAT_FUNC "%10.9" "[-]" COEFFS 0 50000000 0 0 0 1 /end COMPU_METHOD
/begin COMPU_METHOD FlConsum_ul "Verbrauchsintegral (in Mikroliter)" RAT_FUNC "%6.2" "[ul]" COEFFS 0 1 0 0 0 1 /end COMPU_METHOD
/begin COMPU_METHOD Length_mm "Länge in mm" RAT_FUNC "%6.4" "[mm]" COEFFS 0 128 0 0 0 1 /end COMPU_METHOD
/begin COMPU_METHOD OneToOne "eins zu eins (physikalischer Wert ist gleich dem internen Wert)" RAT_FUNC "%6.2" "[-]" COEFFS 0 1 0 0 0 1 /end COMPU_METHOD
/begin COMPU_METHOD Prc "Prozent, gleiche interne Auflösung wie Fact, aber Darstellung in Prozent (0...100%)" RAT_FUNC "%6.4" "[%]" COEFFS 0 100 0 0 0 1 /end COMPU_METHOD
/begin COMPU_METHOD PrcHigh "Höch prozentanteil auflösung" RAT_FUNC "%6.5" "[%]" COEFFS 0 1000 0 0 0 1 /end COMPU_METHOD
/begin COMPU_METHOD Pres_hPa "Druck (angezeigt in [hPa])" RAT_FUNC "%6.2" "[hPa]" COEFFS 0 1 0 0 0 1 /end COMPU_METHOD
/begin COMPU_METHOD Pres_SI "Druck (angezeigt in [Pa])" RAT_FUNC "%6.0" "[Pa]" COEFFS 0 0.01 0 0 0 1 /end COMPU_METHOD
/begin COMPU_METHOD Pwr_kW "Leistung in kW" RAT_FUNC "%6.4" "[kW]" COEFFS 0 100 0 0 0 1 /end COMPU_METHOD
/begin COMPU_METHOD RatVolLength "Umrechnungsformel für Liter/mm" RAT_FUNC "%6.5" "[l/mm]" COEFFS 0 8192 0 0 0 1 /end COMPU_METHOD
/begin COMPU_METHOD rRmpTrq "Drehmomentverhältnisgradient" RAT_FUNC "%6.4" "[%/s]" COEFFS 0 167.11674150914 0 0 0 1 /end COMPU_METHOD
/begin COMPU_METHOD rTrqCAN "Momentenverhältnis für CAN" RAT_FUNC "%6.3" "[%]" COEFFS 0 2.54999910750031 0 0 0 1 /end COMPU_METHOD
/begin COMPU_METHOD Temp_Cels "Temperatur dargestellt in °C (gleiche interne Darstellung wie Temp_Kelv)" RAT_FUNC "%6.1" "[deg C]" COEFFS 0 10 2731.4 0 0 1 /end COMPU_METHOD
/begin COMPU_METHOD TimeCAN_TO_ms "Umrechnung von einer Inputzeit (ms) in eine Nummer" RAT_FUNC "%6.1" "[ms]" COEFFS 0 0.05 -1 0 0 1 /end COMPU_METHOD
/begin COMPU_METHOD TimeDelay_s "Zeitkonstante T1 (in s) für PT1, DT1, etc." RAT_FUNC "%9.3" "[s]" COEFFS 0 0 1 0 0.00023283064365387 0 /end COMPU_METHOD
/begin COMPU_METHOD Time_HighRes "Höhere Auflösung für Zeit in Sekunden" RAT_FUNC "%6.3" "[ms]" COEFFS 0 8 0 0 0 1 /end COMPU_METHOD
/begin COMPU_METHOD Time_ms "Zeit in ms für Fehlerentprellung (DSM) und SW-Timer" RAT_FUNC "%6.1" "[ms]" COEFFS 0 0.1 0 0 0 1 /end COMPU_METHOD
/begin COMPU_METHOD Time_RtmLowRes "Zeit mit niedriger Auflösung für Laufzeitmessung" RAT_FUNC "%6.3" "[ms]" COEFFS 0 10 0 0 0 1 /end COMPU_METHOD
/begin COMPU_METHOD Time_s "Zeit in s für Fehlerentprellung (DSM) und SW-Timer" RAT_FUNC "%6.4" "[s]" COEFFS 0 100 0 0 0 1 /end COMPU_METHOD
/begin COMPU_METHOD Trq "Motormoment" RAT_FUNC "%6.3" "[Nm]" COEFFS 0 10 0 0 0 1 /end COMPU_METHOD
/begin COMPU_METHOD TrqPerSec "Motormomentengradient" RAT_FUNC "%6.2" "[Nm/s]" COEFFS 0 1 0 0 0 1 /end COMPU_METHOD
/begin COMPU_METHOD TrqPrp "Vortriebsmoment" RAT_FUNC "%6.2" "[Nm]" COEFFS 0 1 0 0 0 1 /end COMPU_METHOD
/begin COMPU_METHOD Vel "Fahrzeuggeschwindigkeit, gleiche interne Auflösung wie Vel_SI" RAT_FUNC "%6.4" "[km/h]" COEFFS 0 100 0 0 0 1 /end COMPU_METHOD
/begin COMPU_METHOD Vol "Volumen" RAT_FUNC "%6.4" "[l]" COEFFS 0 100 0 0 0 1 /end COMPU_METHOD
/begin COMPU_METHOD volFillLvl_ml "Umrechnungsformel für Volumen in ml" RAT_FUNC "%6.2" "[ml]" COEFFS 0 1 0 0 0 1 /end COMPU_METHOD
/begin COMPU_METHOD VolPCyl "Umrechnung für Liter pro Zylinder" RAT_FUNC "%6.2" "[l/Cyl]" COEFFS 0 1 0 0 0 1 /end COMPU_METHOD
/begin RECORD_LAYOUT Kf_Xs16_Ys16_Ws16 NO_AXIS_PTS_X 1 SWORD NO_AXIS_PTS_Y 2 SWORD AXIS_PTS_X 3 SWORD INDEX_INCR DIRECT AXIS_PTS_Y 4 SWORD INDEX_INCR DIRECT FNC_VALUES 5 SWORD COLUMN_DIR DIRECT /end RECORD_LAYOUT
/begin RECORD_LAYOUT Kwb_Ws16 FNC_VALUES 1 SWORD COLUMN_DIR DIRECT /end RECORD_LAYOUT
/begin RECORD_LAYOUT Kwb_Ws32 FNC_VALUES 1 SLONG COLUMN_DIR DIRECT /end RECORD_LAYOUT
/begin RECORD_LAYOUT Kw_Ws16 FNC_VALUES 1 SWORD COLUMN_DIR DIRECT /end RECORD_LAYOUT
/begin RECORD_LAYOUT Kw_Wu16 FNC_VALUES 1 UWORD COLUMN_DIR DIRECT /end RECORD_LAYOUT
/begin RECORD_LAYOUT Kw_Wu32 FNC_VALUES 1 ULONG COLUMN_DIR DIRECT /end RECORD_LAYOUT
/begin RECORD_LAYOUT Kw_Wu8 FNC_VALUES 1 UBYTE COLUMN_DIR DIRECT /end RECORD_LAYOUT
/end MODULE
/end PROJECT
