/* Erstellt von DAMOS++ V1.19C SunOS */
ASAP2_VERSION 1 3
/begin PROJECT C177 "EDC16CP"
/begin HEADER "" VERSION "VCP7A3" PROJECT_NO C177 /end HEADER
/begin MODULE DIM ""
/begin MOD_PAR "EDC16CP" VERSION "xxxxxx" CUSTOMER_NO "5" USER "DS/VVW" PHONE_NO "X" CPU_TYPE "GoldenOak" ECU "GRO"
 /begin MEMORY_SEGMENT Pst10000 "" RESERVED FLASH INTERN 0x10000 0x1E8 -1 -1 -1 -1 -1 /begin IF_DATA ETK ADDRESS_MAPPING 0x10000 0x10000 0x1E8 /end IF_DATA /end MEMORY_SEGMENT
 /begin MEMORY_SEGMENT Pst101E8 "" CODE FLASH INTERN 0x101E8 0x27C94 -1 -1 -1 -1 -1 /begin IF_DATA ETK ADDRESS_MAPPING 0x101E8 0x101E8 0x27C94 /end IF_DATA /end MEMORY_SEGMENT
 /begin MEMORY_SEGMENT Pst37E7C "" RESERVED FLASH INTERN 0x37E7C 0x8184 -1 -1 -1 -1 -1 /begin IF_DATA ETK ADDRESS_MAPPING 0x37E7C 0x37E7C 0x8184 /end IF_DATA /end MEMORY_SEGMENT
 /begin MEMORY_SEGMENT Pst40000 "" RESERVED FLASH INTERN 0x40000 0x58 -1 -1 -1 -1 -1 /begin IF_DATA ETK ADDRESS_MAPPING 0x40000 0x40000 0x58 /end IF_DATA /end MEMORY_SEGMENT
 /begin MEMORY_SEGMENT Pst40058 "" CODE FLASH INTERN 0x40058 0x5FF20 -1 -1 -1 -1 -1 /begin IF_DATA ETK ADDRESS_MAPPING 0x40058 0x40058 0x5FF20 /end IF_DATA /end MEMORY_SEGMENT
 /begin MEMORY_SEGMENT Pst9FF78 "" RESERVED FLASH INTERN 0x9FF78 0x88 -1 -1 -1 -1 -1 /begin IF_DATA ETK ADDRESS_MAPPING 0x9FF78 0x9FF78 0x88 /end IF_DATA /end MEMORY_SEGMENT
 /begin MEMORY_SEGMENT Pst400000 "" RESERVED FLASH INTERN 0x400000 0x4058 -1 -1 -1 -1 -1 /begin IF_DATA ETK ADDRESS_MAPPING 0x400000 0x400000 0x4058 /end IF_DATA /end MEMORY_SEGMENT
 /begin MEMORY_SEGMENT Pst404058 "" CODE FLASH INTERN 0x404058 0x7BF20 -1 -1 -1 -1 -1 /begin IF_DATA ETK ADDRESS_MAPPING 0x404058 0x404058 0x7BF20 /end IF_DATA /end MEMORY_SEGMENT
 /begin MEMORY_SEGMENT Pst47FF78 "" RESERVED FLASH INTERN 0x47FF78 0x88 -1 -1 -1 -1 -1 /begin IF_DATA ETK ADDRESS_MAPPING 0x47FF78 0x47FF78 0x88 /end IF_DATA /end MEMORY_SEGMENT
 /begin MEMORY_SEGMENT Pst180000 "" RESERVED FLASH INTERN 0x180000 0x40000 -1 -1 -1 -1 -1 /begin IF_DATA ETK ADDRESS_MAPPING 0x180000 0x180000 0x40000 /end IF_DATA /end MEMORY_SEGMENT
 /begin MEMORY_SEGMENT Dst1C0000 "" OFFLINE_DATA FLASH INTERN 0x1C0000 0x58 -1 -1 -1 -1 -1 /begin IF_DATA ETK ADDRESS_MAPPING 0x1C0000 0x11C0000 0x58 /end IF_DATA /end MEMORY_SEGMENT
 /begin MEMORY_SEGMENT Dst1C0058 "" DATA FLASH INTERN 0x1C0058 0x3DF20 -1 -1 -1 -1 -1 /begin IF_DATA ETK ADDRESS_MAPPING 0x1C0058 0x11C0058 0x3DF20 /end IF_DATA /end MEMORY_SEGMENT
 /begin MEMORY_SEGMENT Dst1FDF78 "" RESERVED FLASH INTERN 0x1FDF78 0x88 -1 -1 -1 -1 -1 /begin IF_DATA ETK ADDRESS_MAPPING 0x1FDF78 0x11FDF78 0x88 /end IF_DATA /end MEMORY_SEGMENT
 /begin MEMORY_SEGMENT ExtRam9FE000 "" VARIABLES RAM EXTERN 0x9FE000 0x2000 -1 -1 -1 -1 -1 /* AsapMLXFm - CCP_V2_3 */ /begin IF_DATA ETK ADDRESS_MAPPING 0x9FE000 0x9FE000 0x2000 /end IF_DATA /* AsapMLXFm - KWP2000 */ /* AsapMLXFm - McMess */ /end MEMORY_SEGMENT
 /begin MEMORY_SEGMENT Ram7F8000 "" VARIABLES RAM INTERN 0x7F8000 0x8000 -1 -1 -1 -1 -1 /end MEMORY_SEGMENT
 /begin MEMORY_SEGMENT Ram800000 "" VARIABLES RAM INTERN 0x800000 0x8000 -1 -1 -1 -1 -1 /end MEMORY_SEGMENT
 SYSTEM_CONSTANT "ACCD_ACTYPE_CAN" "2"
 SYSTEM_CONSTANT "ACCD_ACTYPE_DIG" "1"
 SYSTEM_CONSTANT "ACCD_ACTYPE_NOTPRESENT" "0"
 SYSTEM_CONSTANT "ACCD_PANALIN_CUR_X" "25"
 SYSTEM_CONSTANT "ACCD_PPRESLIN_CUR_X" "25"
 SYSTEM_CONSTANT "ACCD_RLIN_CUR_X" "2"
 SYSTEM_CONSTANT "ACCD_SWTACTYPE_TYPE" "2"
 SYSTEM_CONSTANT "ACCD_SWTACTYPE_VAL" "1"
 SYSTEM_CONSTANT "ACCD_SWTSIG_TYPE" "2"
 SYSTEM_CONSTANT "ACCD_SWTSIG_VAL" "0"
 SYSTEM_CONSTANT "ACCD_TIACSTRTDLY_CUR_X" "4"
 SYSTEM_CONSTANT "ACCPED_STGEARSEL_CUR_X" "7"
 SYSTEM_CONSTANT "ACCPED_TRQENGLOW_MAP_X" "16"
 SYSTEM_CONSTANT "ACCPED_TRQENGLOW_MAP_Y" "10"
 SYSTEM_CONSTANT "ACCPED_TRQENG_GMAP_X" "16"
 SYSTEM_CONSTANT "ACCPED_TRQENG_GMAP_Y" "8"
 SYSTEM_CONSTANT "ACCPED_TRQPRPSPORT_MAP_X" "12"
 SYSTEM_CONSTANT "ACCPED_TRQPRPSPORT_MAP_Y" "8"
 SYSTEM_CONSTANT "ACCPED_TRQPRP_MAP_X" "12"
 SYSTEM_CONSTANT "ACCPED_TRQPRP_MAP_Y" "8"
 SYSTEM_CONSTANT "ACCTL_TIDAMAX_MAP_X" "4"
 SYSTEM_CONSTANT "ACCTL_TIDAMAX_MAP_Y" "4"
 SYSTEM_CONSTANT "ACCTL_TIDAMIN_MAP_X" "4"
 SYSTEM_CONSTANT "ACCTL_TIDAMIN_MAP_Y" "4"
 SYSTEM_CONSTANT "ACCTL_TWTHI_CUR_X" "3"
 SYSTEM_CONSTANT "ACC_NORM_FAC" "2777777.77777778"
 SYSTEM_CONSTANT "ACC_RES" "0.001"
 SYSTEM_CONSTANT "ACC_RES_INV" "1000"
 SYSTEM_CONSTANT "ACC_REV_RES" "1"
 SYSTEM_CONSTANT "ACC_SWTAUDI_VW_TYPE" "2"
 SYSTEM_CONSTANT "ACC_SWTAUDI_VW_VAL" "1"
 SYSTEM_CONSTANT "ACC_ZERO" "0"
 SYSTEM_CONSTANT "ACTRQC_SWTCALC_ACCDP" "1"
 SYSTEM_CONSTANT "ACTRQC_SWTCALC_IATSCD" "0"
 SYSTEM_CONSTANT "ACTRQC_TRQCONV_MAP_X" "8"
 SYSTEM_CONSTANT "ACTRQC_TRQCONV_MAP_Y" "8"
 SYSTEM_CONSTANT "ADCMON_UREFLIN_CUR_X" "2"
 SYSTEM_CONSTANT "ADCMON_UTSTIMP_CUR_X" "2"
 SYSTEM_CONSTANT "ADC_RES" "1023"
 SYSTEM_CONSTANT "ADD2ASH_EXP" "0"
 SYSTEM_CONSTANT "ADDPCD_STTNKLVLLIN_CUR_X" "2"
 SYSTEM_CONSTANT "ADDPCD_TION_CUR_X" "8"
 SYSTEM_CONSTANT "ADDPMP_SWTSERVICE_TYPE" "2"
 SYSTEM_CONSTANT "ADDPMP_SWTSERVICE_VAL" "0"
 SYSTEM_CONSTANT "ADDPMP_VOLADDDEM_CUR_X" "4"
 SYSTEM_CONSTANT "AFSCD_DMAIRSUBSVAL_MAP_X" "16"
 SYSTEM_CONSTANT "AFSCD_DMAIRSUBSVAL_MAP_Y" "16"
 SYSTEM_CONSTANT "AFSCD_DMCORRAIRPERTIME_CUR_X" "25"
 SYSTEM_CONSTANT "AFSCD_DMLIN2_CUR_X" "32"
 SYSTEM_CONSTANT "AFSCD_DMLINHFM6_CUR_X" "57"
 SYSTEM_CONSTANT "AFSCD_DMLIN_CUR_X" "32"
 SYSTEM_CONSTANT "AFSCD_DOUBLE" "2"
 SYSTEM_CONSTANT "AFSCD_FACAIRPERCYLCOR2_MAP_X" "8"
 SYSTEM_CONSTANT "AFSCD_FACAIRPERCYLCOR2_MAP_Y" "8"
 SYSTEM_CONSTANT "AFSCD_FACAIRPERCYLCOR_MAP_X" "8"
 SYSTEM_CONSTANT "AFSCD_FACAIRPERCYLCOR_MAP_Y" "8"
 SYSTEM_CONSTANT "AFSCD_FACAIRRAW2_MAP_X" "10"
 SYSTEM_CONSTANT "AFSCD_FACAIRRAW2_MAP_Y" "10"
 SYSTEM_CONSTANT "AFSCD_FACAIRRAW_MAP_X" "10"
 SYSTEM_CONSTANT "AFSCD_FACAIRRAW_MAP_Y" "10"
 SYSTEM_CONSTANT "AFSCD_FACCORRVAL_MAP_X" "10"
 SYSTEM_CONSTANT "AFSCD_FACCORRVAL_MAP_Y" "12"
 SYSTEM_CONSTANT "AFSCD_FACPLSCOR2_MAP_X" "16"
 SYSTEM_CONSTANT "AFSCD_FACPLSCOR2_MAP_Y" "16"
 SYSTEM_CONSTANT "AFSCD_FACPLSCOR_MAP_X" "16"
 SYSTEM_CONSTANT "AFSCD_FACPLSCOR_MAP_Y" "16"
 SYSTEM_CONSTANT "AFSCD_MAIRPERCYLDFL2_MAP_X" "8"
 SYSTEM_CONSTANT "AFSCD_MAIRPERCYLDFL2_MAP_Y" "8"
 SYSTEM_CONSTANT "AFSCD_MAIRPERCYLDFL_MAP_X" "8"
 SYSTEM_CONSTANT "AFSCD_MAIRPERCYLDFL_MAP_Y" "8"
 SYSTEM_CONSTANT "AFSCD_MDIFFMAX_CUR_X" "6"
 SYSTEM_CONSTANT "AFSCD_PLSCOR_MAP_X" "16"
 SYSTEM_CONSTANT "AFSCD_PLSCOR_MAP_Y" "16"
 SYSTEM_CONSTANT "AFSCD_QAIRMTHRSRCHIACTV_CUR_X" "12"
 SYSTEM_CONSTANT "AFSCD_SENSSEL_SWT" "6"
 SYSTEM_CONSTANT "AFSCD_SINGLE" "1"
 SYSTEM_CONSTANT "AFSCD_SWTAIRSYS_TYPE" "0"
 SYSTEM_CONSTANT "AFSCD_SWTAIRSYS_VAL" "1"
 SYSTEM_CONSTANT "AFSCD_SWTAVR" "1"
 SYSTEM_CONSTANT "AFSCD_SWTDIR" "0"
 SYSTEM_CONSTANT "AFSCD_SWTMAX" "2"
 SYSTEM_CONSTANT "AFSCD_SWTMIN" "3"
 SYSTEM_CONSTANT "AFSCD_SWTSENSINST_TYPE" "2"
 SYSTEM_CONSTANT "AFSCD_SWTSENSINST_VAL" "1"
 SYSTEM_CONSTANT "AFSCD_SWTSENS_INST" "1"
 SYSTEM_CONSTANT "AFSCD_SWTSENS_NOTINST" "0"
 SYSTEM_CONSTANT "AFSCD_SWTSEPARATE_TYPE" "0"
 SYSTEM_CONSTANT "AFSCD_SWTSEPARATE_VAL" "0"
 SYSTEM_CONSTANT "AFSCD_SWT_HFM5" "5"
 SYSTEM_CONSTANT "AFSCD_SWT_HFM6" "6"
 SYSTEM_CONSTANT "AFSCD_TAIRTEMPCORR2_CUR_X" "25"
 SYSTEM_CONSTANT "AFSCD_TAIRTEMPCORR_CUR_X" "25"
 SYSTEM_CONSTANT "AFSCD_TLIN_CUR_X" "11"
 SYSTEM_CONSTANT "AIRCTL_ADD" "0"
 SYSTEM_CONSTANT "AIRCTL_APCOR_CUR_X" "4"
 SYSTEM_CONSTANT "AIRCTL_ATCOR_CUR_X" "10"
 SYSTEM_CONSTANT "AIRCTL_CTCOR1_CUR_X" "5"
 SYSTEM_CONSTANT "AIRCTL_CTCOR_CUR_X" "5"
 SYSTEM_CONSTANT "AIRCTL_FACATPARAD_CUR_X" "16"
 SYSTEM_CONSTANT "AIRCTL_FACBPAHOLD_CUR_X" "8"
 SYSTEM_CONSTANT "AIRCTL_FACCTLRGN1_CUR_X" "10"
 SYSTEM_CONSTANT "AIRCTL_FACCTLRGN2_CUR_X" "10"
 SYSTEM_CONSTANT "AIRCTL_FACDESRGN1_CUR_X" "10"
 SYSTEM_CONSTANT "AIRCTL_FACDESRGN2_CUR_X" "10"
 SYSTEM_CONSTANT "AIRCTL_FACDESRGN3_CUR_X" "10"
 SYSTEM_CONSTANT "AIRCTL_FACDESRGN4_CUR_X" "2"
 SYSTEM_CONSTANT "AIRCTL_FACGOVRGNRMPEGR_CUR_X" "8"
 SYSTEM_CONSTANT "AIRCTL_FACGOVRGNRMPTVA_CUR_X" "8"
 SYSTEM_CONSTANT "AIRCTL_FACMAXDEVCOR_MAP_X" "13"
 SYSTEM_CONSTANT "AIRCTL_FACMAXDEVCOR_MAP_Y" "16"
 SYSTEM_CONSTANT "AIRCTL_FACMINDEVCOR_MAP_X" "13"
 SYSTEM_CONSTANT "AIRCTL_FACMINDEVCOR_MAP_Y" "16"
 SYSTEM_CONSTANT "AIRCTL_FACNQPARAD_MAP_X" "10"
 SYSTEM_CONSTANT "AIRCTL_FACNQPARAD_MAP_Y" "10"
 SYSTEM_CONSTANT "AIRCTL_FACP3CORR_MAP_X" "10"
 SYSTEM_CONSTANT "AIRCTL_FACP3CORR_MAP_Y" "10"
 SYSTEM_CONSTANT "AIRCTL_MAIRCBVHYSHI_CUR_X" "8"
 SYSTEM_CONSTANT "AIRCTL_MAIRCBVHYSLO_CUR_X" "8"
 SYSTEM_CONSTANT "AIRCTL_MAPCORAFTERSTRT_CUR_X" "6"
 SYSTEM_CONSTANT "AIRCTL_MCOR_CUR_X" "4"
 SYSTEM_CONSTANT "AIRCTL_MDESBASEPIL_MAP_X" "16"
 SYSTEM_CONSTANT "AIRCTL_MDESBASEPIL_MAP_Y" "16"
 SYSTEM_CONSTANT "AIRCTL_MDESBASE_MAP_X" "16"
 SYSTEM_CONSTANT "AIRCTL_MDESBASE_MAP_Y" "16"
 SYSTEM_CONSTANT "AIRCTL_MDESRGN1A_MAP_X" "10"
 SYSTEM_CONSTANT "AIRCTL_MDESRGN1A_MAP_Y" "10"
 SYSTEM_CONSTANT "AIRCTL_MDESRGN1B_MAP_X" "10"
 SYSTEM_CONSTANT "AIRCTL_MDESRGN1B_MAP_Y" "10"
 SYSTEM_CONSTANT "AIRCTL_MDESRGN2A_MAP_X" "10"
 SYSTEM_CONSTANT "AIRCTL_MDESRGN2A_MAP_Y" "10"
 SYSTEM_CONSTANT "AIRCTL_MDESRGN2B_MAP_X" "10"
 SYSTEM_CONSTANT "AIRCTL_MDESRGN2B_MAP_Y" "10"
 SYSTEM_CONSTANT "AIRCTL_MDESRGN3A_MAP_X" "10"
 SYSTEM_CONSTANT "AIRCTL_MDESRGN3A_MAP_Y" "10"
 SYSTEM_CONSTANT "AIRCTL_MDESRGN3B_MAP_X" "10"
 SYSTEM_CONSTANT "AIRCTL_MDESRGN3B_MAP_Y" "10"
 SYSTEM_CONSTANT "AIRCTL_MDESRGN4A_MAP_X" "2"
 SYSTEM_CONSTANT "AIRCTL_MDESRGN4A_MAP_Y" "2"
 SYSTEM_CONSTANT "AIRCTL_MDESRGN4B_MAP_X" "2"
 SYSTEM_CONSTANT "AIRCTL_MDESRGN4B_MAP_Y" "2"
 SYSTEM_CONSTANT "AIRCTL_MLMBD" "689.655172413793"
 SYSTEM_CONSTANT "AIRCTL_MMAXDEV_MAP_X" "13"
 SYSTEM_CONSTANT "AIRCTL_MMAXDEV_MAP_Y" "16"
 SYSTEM_CONSTANT "AIRCTL_MMINDEV_MAP_X" "13"
 SYSTEM_CONSTANT "AIRCTL_MMINDEV_MAP_Y" "16"
 SYSTEM_CONSTANT "AIRCTL_MUL" "1"
 SYSTEM_CONSTANT "AIRCTL_NOVRRUN_CUR_X" "10"
 SYSTEM_CONSTANT "AIRCTL_NQAPCOR_MAP_X" "8"
 SYSTEM_CONSTANT "AIRCTL_NQAPCOR_MAP_Y" "8"
 SYSTEM_CONSTANT "AIRCTL_NQATCOR1_MAP_X" "2"
 SYSTEM_CONSTANT "AIRCTL_NQATCOR1_MAP_Y" "4"
 SYSTEM_CONSTANT "AIRCTL_NQATCOR_MAP_X" "4"
 SYSTEM_CONSTANT "AIRCTL_NQATCOR_MAP_Y" "6"
 SYSTEM_CONSTANT "AIRCTL_NQCTCOR1_MAP_X" "10"
 SYSTEM_CONSTANT "AIRCTL_NQCTCOR1_MAP_Y" "8"
 SYSTEM_CONSTANT "AIRCTL_NQCTCOR2_MAP_X" "10"
 SYSTEM_CONSTANT "AIRCTL_NQCTCOR2_MAP_Y" "8"
 SYSTEM_CONSTANT "AIRCTL_NQCTCOR3_MAP_X" "2"
 SYSTEM_CONSTANT "AIRCTL_NQCTCOR3_MAP_Y" "2"
 SYSTEM_CONSTANT "AIRCTL_NQCTCOR_MAP_X" "10"
 SYSTEM_CONSTANT "AIRCTL_NQCTCOR_MAP_Y" "8"
 SYSTEM_CONSTANT "AIRCTL_PCOR_MAP_X" "16"
 SYSTEM_CONSTANT "AIRCTL_PCOR_MAP_Y" "10"
 SYSTEM_CONSTANT "AIRCTL_QGOVOFF_CUR_X" "10"
 SYSTEM_CONSTANT "AIRCTL_QGOVON_CUR_X" "10"
 SYSTEM_CONSTANT "AIRCTL_QHIGH1_CUR_X" "10"
 SYSTEM_CONSTANT "AIRCTL_QHIGH_CUR_X" "20"
 SYSTEM_CONSTANT "AIRCTL_QLOW_CUR_X" "20"
 SYSTEM_CONSTANT "AIRCTL_QMIDDLE1_CUR_X" "10"
 SYSTEM_CONSTANT "AIRCTL_QMIDDLE_CUR_X" "20"
 SYSTEM_CONSTANT "AIRCTL_QRGN1OFF_CUR_X" "10"
 SYSTEM_CONSTANT "AIRCTL_QRGN1ON_CUR_X" "10"
 SYSTEM_CONSTANT "AIRCTL_QRGN2OFF_CUR_X" "10"
 SYSTEM_CONSTANT "AIRCTL_QRGN2ON_CUR_X" "10"
 SYSTEM_CONSTANT "AIRCTL_QRPOILCORR_CUR_X" "16"
 SYSTEM_CONSTANT "AIRCTL_RAPCOR_MAP_X" "10"
 SYSTEM_CONSTANT "AIRCTL_RAPCOR_MAP_Y" "4"
 SYSTEM_CONSTANT "AIRCTL_RCTLBASE_MAP_X" "16"
 SYSTEM_CONSTANT "AIRCTL_RCTLBASE_MAP_Y" "13"
 SYSTEM_CONSTANT "AIRCTL_RCTLRGN1A_MAP_X" "10"
 SYSTEM_CONSTANT "AIRCTL_RCTLRGN1A_MAP_Y" "10"
 SYSTEM_CONSTANT "AIRCTL_RCTLRGN2A_MAP_X" "10"
 SYSTEM_CONSTANT "AIRCTL_RCTLRGN2A_MAP_Y" "10"
 SYSTEM_CONSTANT "AIRCTL_REGR_MAP_X" "10"
 SYSTEM_CONSTANT "AIRCTL_REGR_MAP_Y" "10"
 SYSTEM_CONSTANT "AIRCTL_REVTHRES_CUR_X" "8"
 SYSTEM_CONSTANT "AIRCTL_RGOVPCOR_MAP_X" "9"
 SYSTEM_CONSTANT "AIRCTL_RGOVPCOR_MAP_Y" "9"
 SYSTEM_CONSTANT "AIRCTL_RGOVQDES_MAP_X" "10"
 SYSTEM_CONSTANT "AIRCTL_RGOVQDES_MAP_Y" "10"
 SYSTEM_CONSTANT "AIRCTL_RGOVRGN1TVAMIN_MAP_X" "8"
 SYSTEM_CONSTANT "AIRCTL_RGOVRGN1TVAMIN_MAP_Y" "8"
 SYSTEM_CONSTANT "AIRCTL_RGOVRGN2TVAMIN_MAP_X" "8"
 SYSTEM_CONSTANT "AIRCTL_RGOVRGN2TVAMIN_MAP_Y" "8"
 SYSTEM_CONSTANT "AIRCTL_RGOVRGNMIN_MAP_X" "8"
 SYSTEM_CONSTANT "AIRCTL_RGOVRGNMIN_MAP_Y" "8"
 SYSTEM_CONSTANT "AIRCTL_RGOVTENGCOR_MAP_X" "10"
 SYSTEM_CONSTANT "AIRCTL_RGOVTENGCOR_MAP_Y" "8"
 SYSTEM_CONSTANT "AIRCTL_RRGN1EGR_MAP_X" "8"
 SYSTEM_CONSTANT "AIRCTL_RRGN1EGR_MAP_Y" "10"
 SYSTEM_CONSTANT "AIRCTL_RRGN1TVA_MAP_X" "8"
 SYSTEM_CONSTANT "AIRCTL_RRGN1TVA_MAP_Y" "10"
 SYSTEM_CONSTANT "AIRCTL_RRGN2EGROPNLP_MAP_X" "8"
 SYSTEM_CONSTANT "AIRCTL_RRGN2EGROPNLP_MAP_Y" "8"
 SYSTEM_CONSTANT "AIRCTL_RRGN2EGR_MAP_X" "8"
 SYSTEM_CONSTANT "AIRCTL_RRGN2EGR_MAP_Y" "10"
 SYSTEM_CONSTANT "AIRCTL_RRGN2TVA_MAP_X" "8"
 SYSTEM_CONSTANT "AIRCTL_RRGN2TVA_MAP_Y" "10"
 SYSTEM_CONSTANT "AIRCTL_RRGNTVA_MAP_X" "8"
 SYSTEM_CONSTANT "AIRCTL_RRGNTVA_MAP_Y" "10"
 SYSTEM_CONSTANT "AIRCTL_RTENGCOR1_MAP_X" "10"
 SYSTEM_CONSTANT "AIRCTL_RTENGCOR1_MAP_Y" "8"
 SYSTEM_CONSTANT "AIRCTL_RTENGCOR_MAP_X" "10"
 SYSTEM_CONSTANT "AIRCTL_RTENGCOR_MAP_Y" "8"
 SYSTEM_CONSTANT "AIRCTL_RTRMVALCOR_CUR_X" "5"
 SYSTEM_CONSTANT "AIRCTL_RTVA_MAP_X" "10"
 SYSTEM_CONSTANT "AIRCTL_RTVA_MAP_Y" "10"
 SYSTEM_CONSTANT "AIRCTL_SWTAPCOR_TYPE" "0"
 SYSTEM_CONSTANT "AIRCTL_SWTAPCOR_VAL" "0"
 SYSTEM_CONSTANT "AIRCTL_SWTATCOR_TYPE" "0"
 SYSTEM_CONSTANT "AIRCTL_SWTATCOR_VAL" "1"
 SYSTEM_CONSTANT "AIRCTL_SWTDYNDT1ABS_DISABLE" "0"
 SYSTEM_CONSTANT "AIRCTL_SWTDYNDT1ABS_ENABLE" "1"
 SYSTEM_CONSTANT "AIRCTL_SWTDYNDT1ABS_TYPE" "2"
 SYSTEM_CONSTANT "AIRCTL_SWTDYNDT1ABS_VAL" "0"
 SYSTEM_CONSTANT "AIRCTL_SWTGOVDT1ABS_DISABLE" "0"
 SYSTEM_CONSTANT "AIRCTL_SWTGOVDT1ABS_ENABLE" "1"
 SYSTEM_CONSTANT "AIRCTL_SWTGOVDT1ABS_VAL" "0"
 SYSTEM_CONSTANT "AIRCTL_SWTGOV_DISABLE" "0"
 SYSTEM_CONSTANT "AIRCTL_SWTGOV_ENABLE" "1"
 SYSTEM_CONSTANT "AIRCTL_SWTGOV_TYPE" "2"
 SYSTEM_CONSTANT "AIRCTL_SWTGOV_VAL" "1"
 SYSTEM_CONSTANT "AIRCTL_SWTTRM_TYPE" "0"
 SYSTEM_CONSTANT "AIRCTL_SWTTRM_VAL" "0"
 SYSTEM_CONSTANT "AIRCTL_THRESLNMDDIFF_MAP_X" "6"
 SYSTEM_CONSTANT "AIRCTL_THRESLNMDDIFF_MAP_Y" "6"
 SYSTEM_CONSTANT "AIRCTL_TIBPAHOLD_CUR_X" "8"
 SYSTEM_CONSTANT "AIRCTL_TICOSTRT_CUR_X" "25"
 SYSTEM_CONSTANT "AIRCTL_TIDLY_CUR_X" "25"
 SYSTEM_CONSTANT "AIR_KG_GM" "10"
 SYSTEM_CONSTANT "AIR_MASS_MAX" "2000"
 SYSTEM_CONSTANT "AIR_MASS_MIN" "0"
 SYSTEM_CONSTANT "ALTCD_RLOADLIN_CUR_X" "25"
 SYSTEM_CONSTANT "ALT_PWRALTLOAD_MAP_X" "8"
 SYSTEM_CONSTANT "ALT_PWRALTLOAD_MAP_Y" "8"
 SYSTEM_CONSTANT "ALT_PWRCANDEF_MAP_X" "4"
 SYSTEM_CONSTANT "ALT_PWRCANDEF_MAP_Y" "8"
 SYSTEM_CONSTANT "ALT_TIDELPT_MAP_X" "4"
 SYSTEM_CONSTANT "ALT_TIDELPT_MAP_Y" "5"
 SYSTEM_CONSTANT "ALT_TILDRESPTI_CUR_X" "4"
 SYSTEM_CONSTANT "AMPC_RES" "0.1"
 SYSTEM_CONSTANT "AMPC_RES_FL" "0.1"
 SYSTEM_CONSTANT "AMPC_RES_REV" "10"
 SYSTEM_CONSTANT "AMPC_ZERO" "0"
 SYSTEM_CONSTANT "AMPT_2_RMP_AMPT_LOW" "100000"
 SYSTEM_CONSTANT "AMPT_RES" "0.1"
 SYSTEM_CONSTANT "AMPT_RES_FL" "0.1"
 SYSTEM_CONSTANT "AMPT_RES_INV" "10"
 SYSTEM_CONSTANT "AMPT_ZERO" "0"
 SYSTEM_CONSTANT "AM_RES" "0.01"
 SYSTEM_CONSTANT "AM_RES_2" "0.1"
 SYSTEM_CONSTANT "AM_RES_FL" "0.01"
 SYSTEM_CONSTANT "ANGLE_CRS_REV" "15360"
 SYSTEM_CONSTANT "ANGLE_RES" "42.6666666666667"
 SYSTEM_CONSTANT "ANGLE_RES_INC" "256"
 SYSTEM_CONSTANT "ANHR_NRM_EXP" "7"
 SYSTEM_CONSTANT "AOHTCD_HEATER12_DISABLED" "0"
 SYSTEM_CONSTANT "AOHTCD_HEATER12_ENABLED" "1"
 SYSTEM_CONSTANT "AOHTCD_TI1" "100"
 SYSTEM_CONSTANT "AOHTCD_TI2" "274"
 SYSTEM_CONSTANT "AOHTCD_TI3" "10000"
 SYSTEM_CONSTANT "AOHT_CANHEATER12" "1"
 SYSTEM_CONSTANT "AOHT_CANHEATER3" "2"
 SYSTEM_CONSTANT "AOHT_EATS" "0"
 SYSTEM_CONSTANT "AOHT_ENGOFF_AC" "4"
 SYSTEM_CONSTANT "AOHT_ENGOFF_KWH" "2"
 SYSTEM_CONSTANT "AOHT_IATS" "1"
 SYSTEM_CONSTANT "AOHT_OFF_AC" "0"
 SYSTEM_CONSTANT "AOHT_OFF_KWH" "1"
 SYSTEM_CONSTANT "AOHT_ROFF_CUR_X" "25"
 SYSTEM_CONSTANT "AOHT_RON_CUR_X" "25"
 SYSTEM_CONSTANT "AOHT_SWTCANHEATER_TYPE" "2"
 SYSTEM_CONSTANT "AOHT_SWTCANHEATER_VAL" "2"
 SYSTEM_CONSTANT "AOHT_SWTHTSHUTOFF_TYPE" "2"
 SYSTEM_CONSTANT "AOHT_SWTHTSHUTOFF_VAL" "0"
 SYSTEM_CONSTANT "AOHT_SWTSENSAIR_TYPE" "2"
 SYSTEM_CONSTANT "AOHT_SWTSENSAIR_VAL" "0"
 SYSTEM_CONSTANT "AOHT_TAIRUPLI_CUR_X" "25"
 SYSTEM_CONSTANT "AOHT_TIENGOFF_CUR_X" "4"
 SYSTEM_CONSTANT "APPCD_RLINAPP1_CUR_X" "10"
 SYSTEM_CONSTANT "APPCD_RLINAPP2_CUR_X" "10"
 SYSTEM_CONSTANT "APPCD_RLINAPP_CUR_X" "2"
 SYSTEM_CONSTANT "APPCD_SWTTYPE_DOUBLEANALOGUE" "1"
 SYSTEM_CONSTANT "APPCD_SWTTYPE_DOUBLEANALOGUENC" "2"
 SYSTEM_CONSTANT "APPCD_SWTTYPE_POTISWITCH" "0"
 SYSTEM_CONSTANT "APPCD_SWTTYPE_TYPE" "2"
 SYSTEM_CONSTANT "APPCD_SWTTYPE_VAL" "0"
 SYSTEM_CONSTANT "APPCD_USYNC_CUR_X" "5"
 SYSTEM_CONSTANT "APSCD_PCOR_MAP_X" "10"
 SYSTEM_CONSTANT "APSCD_PCOR_MAP_Y" "10"
 SYSTEM_CONSTANT "APSCD_PLIN_CUR_X" "25"
 SYSTEM_CONSTANT "APSCD_SWTSIG_TYPE" "2"
 SYSTEM_CONSTANT "APSCD_SWTSIG_VAL" "0"
 SYSTEM_CONSTANT "ASDDC_DACTGEARFAC_CUR_X" "6"
 SYSTEM_CONSTANT "ASDDC_DFACRMP_CUR_X" "6"
 SYSTEM_CONSTANT "ASDDC_DNAVRGLTDEXITNEG_CUR_X" "6"
 SYSTEM_CONSTANT "ASDDC_DNAVRGLTDEXITPOS_CUR_X" "6"
 SYSTEM_CONSTANT "ASDDC_DNAVRGLTDNEG_CUR_X" "6"
 SYSTEM_CONSTANT "ASDDC_DNAVRGLTDPOS_CUR_X" "6"
 SYSTEM_CONSTANT "ASDDC_DNINTEGLTDNEG_CUR_X" "6"
 SYSTEM_CONSTANT "ASDDC_DNINTEGLTDPOS_MAP_X" "6"
 SYSTEM_CONSTANT "ASDDC_DNINTEGLTDPOS_MAP_Y" "4"
 SYSTEM_CONSTANT "ASDDC_FACPOS_CUR_X" "3"
 SYSTEM_CONSTANT "ASDDC_GRIP_MAP_X" "16"
 SYSTEM_CONSTANT "ASDDC_GRIP_MAP_Y" "10"
 SYSTEM_CONSTANT "ASDDC_NGVNRDT1KDNEG_CUR_X" "6"
 SYSTEM_CONSTANT "ASDDC_NGVNRDT1KDPOS_CUR_X" "6"
 SYSTEM_CONSTANT "ASDDC_NGVNRIKINEG_CUR_X" "6"
 SYSTEM_CONSTANT "ASDDC_NGVNRIKIPOS_CUR_X" "6"
 SYSTEM_CONSTANT "ASDDC_NGVNRPKPNEG_CUR_X" "6"
 SYSTEM_CONSTANT "ASDDC_NGVNRPKPPOS_CUR_X" "6"
 SYSTEM_CONSTANT "ASDDC_NGVNRRSTINEG_MAP_X" "6"
 SYSTEM_CONSTANT "ASDDC_NGVNRRSTINEG_MAP_Y" "8"
 SYSTEM_CONSTANT "ASDDC_NGVNRRSTIPOS0_MAP_X" "6"
 SYSTEM_CONSTANT "ASDDC_NGVNRRSTIPOS0_MAP_Y" "6"
 SYSTEM_CONSTANT "ASDDC_NGVNRRSTIPOS1_MAP_X" "6"
 SYSTEM_CONSTANT "ASDDC_NGVNRRSTIPOS1_MAP_Y" "6"
 SYSTEM_CONSTANT "ASDDC_NGVNRRSTIPOS2_MAP_X" "6"
 SYSTEM_CONSTANT "ASDDC_NGVNRRSTIPOS2_MAP_Y" "6"
 SYSTEM_CONSTANT "ASDDC_NGVNRRSTIPOS3_MAP_X" "6"
 SYSTEM_CONSTANT "ASDDC_NGVNRRSTIPOS3_MAP_Y" "6"
 SYSTEM_CONSTANT "ASDDC_NGVNRRSTIPOS4_MAP_X" "6"
 SYSTEM_CONSTANT "ASDDC_NGVNRRSTIPOS4_MAP_Y" "6"
 SYSTEM_CONSTANT "ASDDC_NGVNRRSTIPOS5_MAP_X" "6"
 SYSTEM_CONSTANT "ASDDC_NGVNRRSTIPOS5_MAP_Y" "6"
 SYSTEM_CONSTANT "ASDDC_NLTDEXITNEG_CUR_X" "6"
 SYSTEM_CONSTANT "ASDDC_NLTDEXITPOS_CUR_X" "6"
 SYSTEM_CONSTANT "ASDDC_NMAXNLDREVLNEG_CUR_X" "6"
 SYSTEM_CONSTANT "ASDDC_NMAXNLDREVLPOS_CUR_X" "6"
 SYSTEM_CONSTANT "ASDDC_NMINNLDREVLNEG_CUR_X" "6"
 SYSTEM_CONSTANT "ASDDC_NMINNLDREVLPOS_CUR_X" "6"
 SYSTEM_CONSTANT "ASDDC_NSPOFSNEG_CUR_X" "6"
 SYSTEM_CONSTANT "ASDDC_NSPOFSPOS_MAP_X" "6"
 SYSTEM_CONSTANT "ASDDC_NSPOFSPOS_MAP_Y" "4"
 SYSTEM_CONSTANT "ASDDC_PWRONOFF_X" "2"
 SYSTEM_CONSTANT "ASDDC_STACTGEAR_CUR_X" "6"
 SYSTEM_CONSTANT "ASDDC_TIPT1NEG_CUR_X" "6"
 SYSTEM_CONSTANT "ASDDC_TIPT1POS_CUR_X" "6"
 SYSTEM_CONSTANT "ASDDC_TIRMPSTRT_CUR_X" "6"
 SYSTEM_CONSTANT "ASDDC_TRQLIM_CUR_X" "5"
 SYSTEM_CONSTANT "ASDDC_TRQPWRONOFFOFFSET_CUR_X" "3"
 SYSTEM_CONSTANT "ASDDC_TRQPWRONOFF_MAP_X" "8"
 SYSTEM_CONSTANT "ASDDC_TRQPWRONOFF_MAP_Y" "12"
 SYSTEM_CONSTANT "ASDRF_DTRQINRLTDLIM_CUR_X" "7"
 SYSTEM_CONSTANT "ASDRF_DTRQ_MAP_X" "8"
 SYSTEM_CONSTANT "ASDRF_DTRQ_MAP_Y" "12"
 SYSTEM_CONSTANT "ASDRF_FACPOS_CUR_X" "3"
 SYSTEM_CONSTANT "ASDRF_RACCPED_CUR_X" "8"
 SYSTEM_CONSTANT "ASDRF_T1GRIPPOS_MAP_X" "12"
 SYSTEM_CONSTANT "ASDRF_T1GRIPPOS_MAP_Y" "8"
 SYSTEM_CONSTANT "ASDRF_TMFWROACT" "4"
 SYSTEM_CONSTANT "ASDRF_TRQPUSHPULL_CUR_X" "12"
 SYSTEM_CONSTANT "ASD_TIME_DT_RES_FL" "1e-06"
 SYSTEM_CONSTANT "ASH2PRC_EXP" "19"
 SYSTEM_CONSTANT "ASMOD_AREFFEGR_CUR_X" "12"
 SYSTEM_CONSTANT "ASMOD_AREFFTVA_CUR_X" "10"
 SYSTEM_CONSTANT "ASMOD_CALCBACKUP" "14500"
 SYSTEM_CONSTANT "ASMOD_DMAIRCONV" "2949.12"
 SYSTEM_CONSTANT "ASMOD_DMFUELBURNED_RES" "6896.55172413793"
 SYSTEM_CONSTANT "ASMOD_DMFUEL_RES" "33333.3333333333"
 SYSTEM_CONSTANT "ASMOD_DMINDAIRREF_MAP_X" "8"
 SYSTEM_CONSTANT "ASMOD_DMINDAIRREF_MAP_Y" "8"
 SYSTEM_CONSTANT "ASMOD_DMO2_RES" "10000"
 SYSTEM_CONSTANT "ASMOD_ENGN_VOLEFF" "1000"
 SYSTEM_CONSTANT "ASMOD_ENGVOL_MAX" "20"
 SYSTEM_CONSTANT "ASMOD_ENGVOL_MIN" "0"
 SYSTEM_CONSTANT "ASMOD_ETAEGRCLG_MAP_X" "6"
 SYSTEM_CONSTANT "ASMOD_ETAEGRCLG_MAP_Y" "3"
 SYSTEM_CONSTANT "ASMOD_ETATURB_CUR_X" "8"
 SYSTEM_CONSTANT "ASMOD_FACDMCORTDIFF_CUR_X" "8"
 SYSTEM_CONSTANT "ASMOD_FACPRESLSEGRCLG_CUR_X" "3"
 SYSTEM_CONSTANT "ASMOD_FACSOICORTDIFF_CUR_X" "8"
 SYSTEM_CONSTANT "ASMOD_FACVOLEFF" "0.85"
 SYSTEM_CONSTANT "ASMOD_FACVOLEFF_MAP_X" "10"
 SYSTEM_CONSTANT "ASMOD_FACVOLEFF_MAP_Y" "10"
 SYSTEM_CONSTANT "ASMOD_FACVSACORVOLEFF_MAP_X" "10"
 SYSTEM_CONSTANT "ASMOD_FACVSACORVOLEFF_MAP_Y" "10"
 SYSTEM_CONSTANT "ASMOD_FULL" "2"
 SYSTEM_CONSTANT "ASMOD_IMPT2AMPT" "10"
 SYSTEM_CONSTANT "ASMOD_INDVOL_MAX" "50"
 SYSTEM_CONSTANT "ASMOD_INDVOL_MIN" "0"
 SYSTEM_CONSTANT "ASMOD_LAMBDAREC1" "335671.375"
 SYSTEM_CONSTANT "ASMOD_LIN" "1"
 SYSTEM_CONSTANT "ASMOD_MASS_NORM" "287.356321839081"
 SYSTEM_CONSTANT "ASMOD_NDELAY_RES" "937500"
 SYSTEM_CONSTANT "ASMOD_NO" "0"
 SYSTEM_CONSTANT "ASMOD_NTRBCHRED_MAP_X" "16"
 SYSTEM_CONSTANT "ASMOD_NTRBCHRED_MAP_Y" "16"
 SYSTEM_CONSTANT "ASMOD_ONE_R32" "1"
 SYSTEM_CONSTANT "ASMOD_PDIFFEGPIPE_CUR_X" "8"
 SYSTEM_CONSTANT "ASMOD_PHISOIREF_MAP_X" "8"
 SYSTEM_CONSTANT "ASMOD_PHISOIREF_MAP_Y" "8"
 SYSTEM_CONSTANT "ASMOD_QSWTOUTOBSVRMAX_CUR" "8"
 SYSTEM_CONSTANT "ASMOD_QSWTOUTOBSVRMIN_CUR" "8"
 SYSTEM_CONSTANT "ASMOD_RFUELBURNED_RES" "100"
 SYSTEM_CONSTANT "ASMOD_RLMBDREC" "1450"
 SYSTEM_CONSTANT "ASMOD_RO2EXHGS_RES" "10000"
 SYSTEM_CONSTANT "ASMOD_RTDIFFTURBADBT_CUR_X" "8"
 SYSTEM_CONSTANT "ASMOD_SEL" "2"
 SYSTEM_CONSTANT "ASMOD_TCLNT_CUR_X" "8"
 SYSTEM_CONSTANT "ASMOD_TCORR_MAP_X" "8"
 SYSTEM_CONSTANT "ASMOD_TCORR_MAP_Y" "8"
 SYSTEM_CONSTANT "ASMOD_TDIFFENG_MAP_X" "8"
 SYSTEM_CONSTANT "ASMOD_TDIFFENG_MAP_Y" "8"
 SYSTEM_CONSTANT "ASMOD_TDIFFLIN_RES" "1280"
 SYSTEM_CONSTANT "ASMOD_TDIFFSQ_RES" "1000"
 SYSTEM_CONSTANT "ASMOD_TDIFF_MAX" "200"
 SYSTEM_CONSTANT "ASMOD_TDIFF_MIN" "-200"
 SYSTEM_CONSTANT "ASMOD_TENGCORTDIFF_CUR_X" "8"
 SYSTEM_CONSTANT "ASMOD_TIDT1_MAX" "5"
 SYSTEM_CONSTANT "ASMOD_TIDT1_MIN" "0.05"
 SYSTEM_CONSTANT "ASMOD_TINDAIRREF_MAP_X" "10"
 SYSTEM_CONSTANT "ASMOD_TINDAIRREF_MAP_Y" "10"
 SYSTEM_CONSTANT "ASMOD_VOL_NORM" "33333.3333333333"
 SYSTEM_CONSTANT "AUDI_ACC" "2"
 SYSTEM_CONSTANT "AVPT_RES" "0.1"
 SYSTEM_CONSTANT "AVPT_RES_REV" "10"
 SYSTEM_CONSTANT "BASADJ_K2SigBlkVal0_MAP_X" "5"
 SYSTEM_CONSTANT "BASADJ_K2SigBlkVal0_MAP_Y" "10"
 SYSTEM_CONSTANT "BASADJ_K2SigBlkVal1_MAP_X" "5"
 SYSTEM_CONSTANT "BASADJ_K2SigBlkVal1_MAP_Y" "10"
 SYSTEM_CONSTANT "BASADJ_K2SigBlkVal2_MAP_X" "5"
 SYSTEM_CONSTANT "BASADJ_K2SigBlkVal2_MAP_Y" "10"
 SYSTEM_CONSTANT "BATTCD_ULIN_CUR_X" "5"
 SYSTEM_CONSTANT "BATT_FACCOR_CUR_X" "4"
 SYSTEM_CONSTANT "BNK_MAX" "2"
 SYSTEM_CONSTANT "BOTT" "0"
 SYSTEM_CONSTANT "BPACD_DCYCCONV_CUR_X" "25"
 SYSTEM_CONSTANT "BPACD_RBPAOFF" "12"
 SYSTEM_CONSTANT "BPACD_RCNV_CUR_X" "2"
 SYSTEM_CONSTANT "BPACD_RLRNLMS" "84"
 SYSTEM_CONSTANT "BPACD_RLRNUMS" "16"
 SYSTEM_CONSTANT "BPASCD_RBPAMAX" "81"
 SYSTEM_CONSTANT "BPASCD_RBPAMIN" "19"
 SYSTEM_CONSTANT "BPASCD_RDEVTEMPEXCMAX" "90.5"
 SYSTEM_CONSTANT "BPASCD_RDEVTEMPEXCMIN" "89.5"
 SYSTEM_CONSTANT "BPASCD_RLINDCYC_CUR_X" "2"
 SYSTEM_CONSTANT "BPASCD_RLMSLRNDEFMAX" "89"
 SYSTEM_CONSTANT "BPASCD_RLMSLRNDEFMIN" "87"
 SYSTEM_CONSTANT "BPASCD_RLMSLRNOKMAX" "85"
 SYSTEM_CONSTANT "BPASCD_RLMSLRNOKMIN" "83"
 SYSTEM_CONSTANT "BPASCD_RPWMDEFMAX" "9"
 SYSTEM_CONSTANT "BPASCD_RPWMDEFMIN" "7"
 SYSTEM_CONSTANT "BPASCD_RRELPOS_CUR_X" "9"
 SYSTEM_CONSTANT "BPASCD_RUMSLRNDEFMAX" "13"
 SYSTEM_CONSTANT "BPASCD_RUMSLRNDEFMIN" "11"
 SYSTEM_CONSTANT "BPASCD_RUMSLRNOKMAX" "17"
 SYSTEM_CONSTANT "BPASCD_RUMSLRNOKMIN" "15"
 SYSTEM_CONSTANT "BPSCD_PLIN_CUR_X" "25"
 SYSTEM_CONSTANT "BPSCD_SWTSIG_TYPE" "2"
 SYSTEM_CONSTANT "BPSCD_SWTSIG_VAL" "0"
 SYSTEM_CONSTANT "BRKCD_SWTSIG_TYPE" "2"
 SYSTEM_CONSTANT "BRKCD_SWTSIG_VAL" "0"
 SYSTEM_CONSTANT "BRKCD_TYPE_CAN_BRK" "1"
 SYSTEM_CONSTANT "BRKCD_TYPE_CAN_RED" "2"
 SYSTEM_CONSTANT "BRKCD_TYPE_CAN_REDBRK" "3"
 SYSTEM_CONSTANT "BRKCD_TYPE_HW" "0"
 SYSTEM_CONSTANT "BRKCD_UMNSWTLIN_CUR_X" "3"
 SYSTEM_CONSTANT "CALORY_RES" "1"
 SYSTEM_CONSTANT "CAN1_RES" "0.0001"
 SYSTEM_CONSTANT "CAN1_RES_REV" "10000"
 SYSTEM_CONSTANT "CAN_BAUDRATE" "500"
 SYSTEM_CONSTANT "CAN_RES" "0.001"
 SYSTEM_CONSTANT "CAN_RES_REV" "1000"
 SYSTEM_CONSTANT "CAP_PA_FAC" "10000"
 SYSTEM_CONSTANT "CAP_PA_MAX" "8"
 SYSTEM_CONSTANT "CAP_PA_MIN" "0"
 SYSTEM_CONSTANT "CAP_PA_ZERO" "0"
 SYSTEM_CONSTANT "CARB6_CLEAR_SINT16" "-1"
 SYSTEM_CONSTANT "CARB6_CLEAR_UINT16" "65535"
 SYSTEM_CONSTANT "CARB6_CLEAR_UINT32" "4294967295"
 SYSTEM_CONSTANT "CASCD_FACPLAUSHIGH_CUR_X" "12"
 SYSTEM_CONSTANT "CASCD_FACPLAUSLOW_CUR_X" "12"
 SYSTEM_CONSTANT "CAS_MAX" "3"
 SYSTEM_CONSTANT "CHG2CAP_PA_FAC" "100000"
 SYSTEM_CONSTANT "CHG_PA_MAX" "3000"
 SYSTEM_CONSTANT "CHG_PA_MIN" "-3000"
 SYSTEM_CONSTANT "CHG_PA_RES" "1"
 SYSTEM_CONSTANT "CHG_PA_ZERO" "0"
 SYSTEM_CONSTANT "CLG_TIMAXDYNTST_CUR_X" "10"
 SYSTEM_CONSTANT "CLS_VLTGADJCODE_MAX" "31"
 SYSTEM_CONSTANT "CLS_VLTGADJCODE_MIN" "0"
 SYSTEM_CONSTANT "CLS_VLTGADJ_MAX" "31"
 SYSTEM_CONSTANT "CLS_VLTGADJ_MIN" "0"
 SYSTEM_CONSTANT "CMBCHB_DISABLED" "0"
 SYSTEM_CONSTANT "CMBCHB_ENABLED" "3"
 SYSTEM_CONSTANT "CMBCHB_NOT_PRESSED" "2"
 SYSTEM_CONSTANT "CMBCHB_PRESSED" "1"
 SYSTEM_CONSTANT "CMBCHB_SWTMONCLUTCH_TYPE" "2"
 SYSTEM_CONSTANT "CMBCHB_SWTMONCLUTCH_VAL" "3"
 SYSTEM_CONSTANT "CODT_SWTCOTYPE_CNV" "0"
 SYSTEM_CONSTANT "CODT_SWTCOTYPE_MSFT" "1"
 SYSTEM_CONSTANT "CODT_SWTCOTYPE_TYPE" "2"
 SYSTEM_CONSTANT "CODT_SWTCOTYPE_VAL" "1"
 SYSTEM_CONSTANT "COEFFA_MAX" "159.9951171875"
 SYSTEM_CONSTANT "COEFFA_RES" "0.0048828125"
 SYSTEM_CONSTANT "COENG_APDTRQSLPLIMDWN_CUR_X" "25"
 SYSTEM_CONSTANT "COENG_APDTRQSLPLIMUP_CUR_X" "25"
 SYSTEM_CONSTANT "COENG_ATCOR_CUR_X" "10"
 SYSTEM_CONSTANT "COENG_TRQLIMBIT_CUR_X" "2"
 SYSTEM_CONSTANT "COENG_TRQLIMERR_CUR_X" "25"
 SYSTEM_CONSTANT "COENG_TRQOFFS_CUR_X" "5"
 SYSTEM_CONSTANT "CONVCD_DIGIN_PRESENT_NO" "0"
 SYSTEM_CONSTANT "CONVCD_DIGIN_PRESENT_YES" "1"
 SYSTEM_CONSTANT "CONVCD_SWTILSDIGIN_P_TYPE" "2"
 SYSTEM_CONSTANT "CONVCD_SWTILSDIGIN_P_VAL" "1"
 SYSTEM_CONSTANT "CONVCD_SWTSIG_TYPE" "2"
 SYSTEM_CONSTANT "CONVCD_SWTSIG_VAL" "0"
 SYSTEM_CONSTANT "CONV_HR2SEC" "36"
 SYSTEM_CONSTANT "CONV_KD_16_TO_KD_32" "2.00006103701895"
 SYSTEM_CONSTANT "CONV_T1_16_TO_1_T1_32" "28146638.6776064"
 SYSTEM_CONSTANT "COTSCD_TLIN_CUR_X" "25"
 SYSTEM_CONSTANT "COVEH_NRGN_CUR_X" "2"
 SYSTEM_CONSTANT "COVEH_TRQLIMSAFE_CUR_X" "25"
 SYSTEM_CONSTANT "COVEH_TRQLIM_CUR_X" "25"
 SYSTEM_CONSTANT "COVM_SWTSLIPCTL_TYPE" "2"
 SYSTEM_CONSTANT "COVM_SWTSLIPCTL_VAL" "3"
 SYSTEM_CONSTANT "COVM_TCS_OFF_DCS_OFF" "0"
 SYSTEM_CONSTANT "COVM_TCS_OFF_DCS_ON" "2"
 SYSTEM_CONSTANT "COVM_TCS_ON_DCS_OFF" "1"
 SYSTEM_CONSTANT "COVM_TCS_ON_DCS_ON" "3"
 SYSTEM_CONSTANT "CRCCD_SWTFGR_DISABLE" "0"
 SYSTEM_CONSTANT "CRCCD_SWTFGR_ENABLE" "1"
 SYSTEM_CONSTANT "CRCCD_SWTFGR_TYPE" "2"
 SYSTEM_CONSTANT "CRCCD_SWTFGR_VAL" "0"
 SYSTEM_CONSTANT "CRCCD_SWTLEARN_DISABLE" "0"
 SYSTEM_CONSTANT "CRCCD_SWTLEARN_ENABLE" "1"
 SYSTEM_CONSTANT "CRCCD_SWTLEARN_TYPE" "2"
 SYSTEM_CONSTANT "CRCCD_SWTLEARN_VAL" "0"
 SYSTEM_CONSTANT "CRCTLP_AAG_OFF" "0"
 SYSTEM_CONSTANT "CRCTLP_AAG_ON" "1"
 SYSTEM_CONSTANT "CRCTLP_SWTAAG_TYPE" "1"
 SYSTEM_CONSTANT "CRCTLP_SWTAAG_VAL" "0"
 SYSTEM_CONSTANT "CRCTL_AACC_CUR_X" "8"
 SYSTEM_CONSTANT "CRCTL_ADECDEMDECP_MAP_X" "8"
 SYSTEM_CONSTANT "CRCTL_ADECDEMDECP_MAP_Y" "8"
 SYSTEM_CONSTANT "CRCTL_ADECDEMHOLDP_CUR_X" "8"
 SYSTEM_CONSTANT "CRCTL_ADECDEMOVRDP_CUR_X" "8"
 SYSTEM_CONSTANT "CRCTL_ADECRESABVP_CUR_X" "8"
 SYSTEM_CONSTANT "CRCTL_ADEC_CUR_X" "8"
 SYSTEM_CONSTANT "CRCTL_ARESABVACT_MAP_X" "8"
 SYSTEM_CONSTANT "CRCTL_ARESABVACT_MAP_Y" "8"
 SYSTEM_CONSTANT "CRCTL_ARESBELACT_MAP_X" "8"
 SYSTEM_CONSTANT "CRCTL_ARESBELACT_MAP_Y" "8"
 SYSTEM_CONSTANT "CRCTL_CAN" "0"
 SYSTEM_CONSTANT "CRCTL_FACPARCOR_CUR_X" "8"
 SYSTEM_CONSTANT "CRCTL_FACSLPACCCOR_CUR_X" "8"
 SYSTEM_CONSTANT "CRCTL_FACSLPDECCOR_CUR_X" "8"
 SYSTEM_CONSTANT "CRCTL_FACSLPHOLDCOR_CUR_X" "8"
 SYSTEM_CONSTANT "CRCTL_FACSLPRESABVCOR_CUR_X" "8"
 SYSTEM_CONSTANT "CRCTL_FACSLPRESBELCOR_CUR_X" "8"
 SYSTEM_CONSTANT "CRCTL_RSLPRES_MAP_X" "8"
 SYSTEM_CONSTANT "CRCTL_RSLPRES_MAP_Y" "8"
 SYSTEM_CONSTANT "CRCTL_SWTCAN_VAL" "0"
 SYSTEM_CONSTANT "CRCTL_TRQSETPRECTL_MAP_X" "8"
 SYSTEM_CONSTANT "CRCTL_TRQSETPRECTL_MAP_Y" "8"
 SYSTEM_CONSTANT "CRSCD_DYNPL_HEALSEC" "0"
 SYSTEM_CONSTANT "CRSCD_FACGAPPLAUSHIGH_CUR_X" "10"
 SYSTEM_CONSTANT "CRSCD_FACGAPPLAUSLOW_CUR_X" "10"
 SYSTEM_CONSTANT "CRSCD_FACINCPLAUSHIGH_CUR_X" "10"
 SYSTEM_CONSTANT "CRSCD_FACINCPLAUSLOW_CUR_X" "10"
 SYSTEM_CONSTANT "CRSCD_PHIINCCOR_CUR_X" "12"
 SYSTEM_CONSTANT "CRSCD_STATPL_SEC" "0"
 SYSTEM_CONSTANT "CRSCD_SWTDYNPL_TYPE" "2"
 SYSTEM_CONSTANT "CRSCD_SWTDYNPL_VAL" "0"
 SYSTEM_CONSTANT "CRSCD_SWTSTATPL_TYPE" "2"
 SYSTEM_CONSTANT "CRSCD_SWTSTATPL_VAL" "0"
 SYSTEM_CONSTANT "CRS_RES" "42.6666666666667"
 SYSTEM_CONSTANT "CRS_RES_REV" "0.0234375"
 SYSTEM_CONSTANT "CRS_TO_CAS" "2"
 SYSTEM_CONSTANT "CTSCD_SWTSIG_TYPE" "2"
 SYSTEM_CONSTANT "CTSCD_SWTSIG_VAL" "0"
 SYSTEM_CONSTANT "CTSCD_TEMPDFL_FTS" "0"
 SYSTEM_CONSTANT "CTSCD_TEMPDFL_OTS" "1"
 SYSTEM_CONSTANT "CTSCD_TLIN_CUR_X" "25"
 SYSTEM_CONSTANT "CTTCTL_CTL_DISABLE" "0"
 SYSTEM_CONSTANT "CTTCTL_CTL_ENABLE" "1"
 SYSTEM_CONSTANT "CTTCTL_DCYCCTL_MAP_X" "8"
 SYSTEM_CONSTANT "CTTCTL_DCYCCTL_MAP_Y" "8"
 SYSTEM_CONSTANT "CTTCTL_SWTCTL_TYPE" "2"
 SYSTEM_CONSTANT "CTTCTL_SWTCTL_VAL" "1"
 SYSTEM_CONSTANT "CTTCTL_TBASE_MAP_X" "8"
 SYSTEM_CONSTANT "CTTCTL_TBASE_MAP_Y" "8"
 SYSTEM_CONSTANT "CTTCTL_TCLNTCOR2_MAP_X" "8"
 SYSTEM_CONSTANT "CTTCTL_TCLNTCOR2_MAP_Y" "8"
 SYSTEM_CONSTANT "CTTCTL_TCLNTCOR3_CUR_X" "5"
 SYSTEM_CONSTANT "CTTCTL_TCLNTCOR4_CUR_X" "5"
 SYSTEM_CONSTANT "CTTCTL_TCLNTCOR5_CUR_X" "5"
 SYSTEM_CONSTANT "CTTCTL_TCLNTCOR6_CUR_X" "4"
 SYSTEM_CONSTANT "CTT_MOD_DTCONSUM_CUR_X" "12"
 SYSTEM_CONSTANT "CTT_MOD_DTENV_CUR_X" "15"
 SYSTEM_CONSTANT "CTT_MOD_TCLNT_CUR_X" "8"
 SYSTEM_CONSTANT "CTT_MOD_TCORR_MAP_X" "8"
 SYSTEM_CONSTANT "CTT_MOD_TCORR_MAP_Y" "8"
 SYSTEM_CONSTANT "CURR_A_RES" "0.01"
 SYSTEM_CONSTANT "CURR_BUFC_MAX" "15000"
 SYSTEM_CONSTANT "CURR_BUFC_MIN" "200"
 SYSTEM_CONSTANT "CURR_PA_GOV_MAX" "3000"
 SYSTEM_CONSTANT "CURR_PA_GOV_MIN" "-3000"
 SYSTEM_CONSTANT "CURR_PA_MAX" "30000"
 SYSTEM_CONSTANT "CURR_PA_MIN" "-30000"
 SYSTEM_CONSTANT "CURR_PA_ZERO" "0"
 SYSTEM_CONSTANT "CURR_RES" "1"
 SYSTEM_CONSTANT "CYL_FAC_NORM" "33333"
 SYSTEM_CONSTANT "CYL_MAX" "6"
 SYSTEM_CONSTANT "CYL_NUM" "6"
 SYSTEM_CONSTANT "C_PA_RES" "0.001"
 SYSTEM_CONSTANT "DDVOL_RES" "10"
 SYSTEM_CONSTANT "DELTA_N_PER_TIME_NBR" "5"
 SYSTEM_CONSTANT "DELTA_PRES_FAC" "250000"
 SYSTEM_CONSTANT "DES_CTLCHC_PRAIL" "1"
 SYSTEM_CONSTANT "DES_CTLCHC_TACTR" "1"
 SYSTEM_CONSTANT "DES_CTLCHC_UBST" "1"
 SYSTEM_CONSTANT "DIA_RES" "0.0001"
 SYSTEM_CONSTANT "DIA_RES_REV" "10000"
 SYSTEM_CONSTANT "DIST1_RES" "500"
 SYSTEM_CONSTANT "DIST1_RES_DIR" "500"
 SYSTEM_CONSTANT "DISTM_FAC" "6366.19772367539"
 SYSTEM_CONSTANT "DISTM_FAC1" "407436654.315225"
 SYSTEM_CONSTANT "DIST_RES" "25"
 SYSTEM_CONSTANT "DIST_RES_DIR" "25"
 SYSTEM_CONSTANT "DPDIFFTMP_RES" "100"
 SYSTEM_CONSTANT "DPDIFF_RES" "0.1"
 SYSTEM_CONSTANT "DRVTRN_SWTSIG_TYPE" "2"
 SYSTEM_CONSTANT "DRVTRN_SWTSIG_VAL" "0"
 SYSTEM_CONSTANT "DTRQPRP_20MS_RES" "50"
 SYSTEM_CONSTANT "DTRQ_MAX" "2000"
 SYSTEM_CONSTANT "DTRQ_MIN" "-2000"
 SYSTEM_CONSTANT "DTRQ_RES" "0.1"
 SYSTEM_CONSTANT "DTRQ_ZERO" "0"
 SYSTEM_CONSTANT "DTY_CYC_100" "100"
 SYSTEM_CONSTANT "DTY_CYC_CAN_RES" "0.1"
 SYSTEM_CONSTANT "DTY_CYC_CAN_RES_REV" "10"
 SYSTEM_CONSTANT "DTY_CYC_FAC" "1400"
 SYSTEM_CONSTANT "DTY_CYC_MAX" "100"
 SYSTEM_CONSTANT "DTY_CYC_MIN" "0"
 SYSTEM_CONSTANT "DTY_CYC_RES" "0.01"
 SYSTEM_CONSTANT "DTY_CYC_RES_REV" "100"
 SYSTEM_CONSTANT "DTY_CYC_ZERO" "0"
 SYSTEM_CONSTANT "DT_DEN" "5"
 SYSTEM_CONSTANT "DT_DQNTD1" "512"
 SYSTEM_CONSTANT "DT_NUM" "1.43000143000143"
 SYSTEM_CONSTANT "DT_SCAL" "200"
 SYSTEM_CONSTANT "DU_INT_FAC" "4887.58553274682"
 SYSTEM_CONSTANT "DU_VBATFAC" "100"
 SYSTEM_CONSTANT "DVEL_20MS_RES" "0.5"
 SYSTEM_CONSTANT "DVOL_MAX" "3000"
 SYSTEM_CONSTANT "DVOL_MIN" "0"
 SYSTEM_CONSTANT "DVOL_RES" "0.1"
 SYSTEM_CONSTANT "DVOL_RES_FL" "0.1"
 SYSTEM_CONSTANT "DVOL_RES_INV" "10"
 SYSTEM_CONSTANT "DXS_FL" "4000000"
 SYSTEM_CONSTANT "DYN_TST_TIME_FACT" "655.36"
 SYSTEM_CONSTANT "D_FLCONS_RES" "0.01"
 SYSTEM_CONSTANT "EATSCD_SWTSIG_NOCON" "2"
 SYSTEM_CONSTANT "EATSCD_SWTSIG_TYPE" "2"
 SYSTEM_CONSTANT "EATSCD_SWTSIG_VAL" "0"
 SYSTEM_CONSTANT "EATSCD_TLIN_CUR_X" "25"
 SYSTEM_CONSTANT "EGPPCD_TLINTEMP2_CUR_X" "2"
 SYSTEM_CONSTANT "EGPPCD_TLINTEMP_CUR_X" "40"
 SYSTEM_CONSTANT "EGPP_PPSTPFLT_MAP_X" "10"
 SYSTEM_CONSTANT "EGPP_PPSTPFLT_MAP_Y" "10"
 SYSTEM_CONSTANT "EGRCD_ACTSEL_SWT" "0"
 SYSTEM_CONSTANT "EGRCD_DCYCEGR_MAP_X" "10"
 SYSTEM_CONSTANT "EGRCD_DCYCEGR_MAP_Y" "10"
 SYSTEM_CONSTANT "EGRCD_SWT_EEGR" "1"
 SYSTEM_CONSTANT "EGRCD_SWT_EGR" "0"
 SYSTEM_CONSTANT "EGRSCD_RLIN_CUR_X" "25"
 SYSTEM_CONSTANT "EGRVLV_IEFF_CUR_X" "3"
 SYSTEM_CONSTANT "EGRVLV_RGVNRMAX_CUR_X" "2"
 SYSTEM_CONSTANT "EGRVLV_RGVNRMIN_CUR_X" "2"
 SYSTEM_CONSTANT "EGSYS_CNDHTEG_CUR_X" "8"
 SYSTEM_CONSTANT "EGSYS_CPEG_MAP_X" "6"
 SYSTEM_CONSTANT "EGSYS_CPEG_MAP_Y" "6"
 SYSTEM_CONSTANT "EGSYS_CT_TUBES" "2"
 SYSTEM_CONSTANT "EGSYS_DMAIR_MAP_X" "8"
 SYSTEM_CONSTANT "EGSYS_DMAIR_MAP_Y" "8"
 SYSTEM_CONSTANT "EGSYS_DMEXHGAS_MAP_X" "10"
 SYSTEM_CONSTANT "EGSYS_DMEXHGAS_MAP_Y" "10"
 SYSTEM_CONSTANT "EGSYS_DPEXHGAS_MAP_X" "10"
 SYSTEM_CONSTANT "EGSYS_DPEXHGAS_MAP_Y" "10"
 SYSTEM_CONSTANT "EGSYS_ETACHRG_MAP_X" "8"
 SYSTEM_CONSTANT "EGSYS_ETACHRG_MAP_Y" "8"
 SYSTEM_CONSTANT "EGSYS_FACAIRMASS_CUR_X" "8"
 SYSTEM_CONSTANT "EGSYS_FACCMPRINTK_CUR_X" "8"
 SYSTEM_CONSTANT "EGSYS_FACCORRCLDENG_CUR_X" "8"
 SYSTEM_CONSTANT "EGSYS_FACSTRTDLV_CUR_X" "8"
 SYSTEM_CONSTANT "EGSYS_FACTEMPCLG_CUR_X" "8"
 SYSTEM_CONSTANT "EGSYS_FACTEMPCMB_CUR_X" "8"
 SYSTEM_CONSTANT "EGSYS_FACTIMECLG_CUR_X" "8"
 SYSTEM_CONSTANT "EGSYS_NTRBNMAX_MAP_X" "10"
 SYSTEM_CONSTANT "EGSYS_NTRBNMAX_MAP_Y" "10"
 SYSTEM_CONSTANT "EGSYS_NUPIPEENV_CUR_X" "8"
 SYSTEM_CONSTANT "EGSYS_NUPIPE_CUR_X" "8"
 SYSTEM_CONSTANT "EGSYS_NUTUBEENV_CUR_X" "8"
 SYSTEM_CONSTANT "EGSYS_NUTUBE_CUR_X" "8"
 SYSTEM_CONSTANT "EGSYS_PHISTRTDLV_MAP_X" "8"
 SYSTEM_CONSTANT "EGSYS_PHISTRTDLV_MAP_Y" "8"
 SYSTEM_CONSTANT "EGSYS_RPRES_MAP_X" "10"
 SYSTEM_CONSTANT "EGSYS_RPRES_MAP_Y" "10"
 SYSTEM_CONSTANT "EGSYS_RTEMPADBT_CUR_X" "8"
 SYSTEM_CONSTANT "EGSYS_TIAT_MAP_X" "8"
 SYSTEM_CONSTANT "EGSYS_TIAT_MAP_Y" "8"
 SYSTEM_CONSTANT "EGSYS_TMANFSTAT_MAP_X" "8"
 SYSTEM_CONSTANT "EGSYS_TMANFSTAT_MAP_Y" "8"
 SYSTEM_CONSTANT "EGSYS_TNSCEXOINCR_MAP_X" "8"
 SYSTEM_CONSTANT "EGSYS_TNSCEXOINCR_MAP_Y" "8"
 SYSTEM_CONSTANT "EGSYS_TOXICATEXOINCR_MAP_X" "8"
 SYSTEM_CONSTANT "EGSYS_TOXICATEXOINCR_MAP_Y" "8"
 SYSTEM_CONSTANT "EGSYS_VSCDYNEG_CUR_X" "8"
 SYSTEM_CONSTANT "EGSYS_VSCKINEG_CUR_X" "8"
 SYSTEM_CONSTANT "EGSYS_WTHRESLSU0_MAP_X" "10"
 SYSTEM_CONSTANT "EGSYS_WTHRESLSU0_MAP_Y" "10"
 SYSTEM_CONSTANT "EGTRMP16_MAX" "32000"
 SYSTEM_CONSTANT "EGTRMP16_MIN" "0"
 SYSTEM_CONSTANT "EGTRMP16_RES" "32000"
 SYSTEM_CONSTANT "EGTRMP32TO16_FACT" "9"
 SYSTEM_CONSTANT "EGTRMP32_MAX" "16384000"
 SYSTEM_CONSTANT "EGTRMP32_MIN" "0"
 SYSTEM_CONSTANT "EGTRMP32_RES" "16384000"
 SYSTEM_CONSTANT "EGTSWT_FACT" "16384000"
 SYSTEM_CONSTANT "EGTSWT_NRM_EXP" "14"
 SYSTEM_CONSTANT "EGTSWT_RES" "6.103515625e-08"
 SYSTEM_CONSTANT "EGT_FACT" "0"
 SYSTEM_CONSTANT "EGT_STATE" "1"
 SYSTEM_CONSTANT "EGT_SWTRGN_VAL" "0"
 SYSTEM_CONSTANT "EGT_SWT_DISABLED" "0"
 SYSTEM_CONSTANT "EGT_SWT_ENABLED" "1"
 SYSTEM_CONSTANT "EGT_SWT_VAL" "0"
 SYSTEM_CONSTANT "ENERGY_RES" "1"
 SYSTEM_CONSTANT "ENGM_DCYCMNT_MAP_X" "2"
 SYSTEM_CONSTANT "ENGM_DCYCMNT_MAP_Y" "2"
 SYSTEM_CONSTANT "ENGM_ENGMNTCTL_OFF" "0"
 SYSTEM_CONSTANT "ENGM_ENGMNTCTL_ON" "1"
 SYSTEM_CONSTANT "ENGM_NUMCYL_10" "10"
 SYSTEM_CONSTANT "ENGM_NUMCYL_12" "12"
 SYSTEM_CONSTANT "ENGM_NUMCYL_3" "3"
 SYSTEM_CONSTANT "ENGM_NUMCYL_4" "4"
 SYSTEM_CONSTANT "ENGM_NUMCYL_5" "5"
 SYSTEM_CONSTANT "ENGM_NUMCYL_6" "6"
 SYSTEM_CONSTANT "ENGM_NUMCYL_8" "8"
 SYSTEM_CONSTANT "ENGM_NUMTHRESH" "3"
 SYSTEM_CONSTANT "ENGM_N_SWT_RES" "100"
 SYSTEM_CONSTANT "ENGM_SWTENGMNTCTL_TYPE" "2"
 SYSTEM_CONSTANT "ENGM_SWTENGMNTCTL_VAL" "0"
 SYSTEM_CONSTANT "ENGM_SWTNUMCYL_TYPE" "0"
 SYSTEM_CONSTANT "ENGM_SWTNUMCYL_VAL" "6"
 SYSTEM_CONSTANT "ENGM_TRQFRCMIN_CUR_X" "25"
 SYSTEM_CONSTANT "ENGM_TRQFRC_MAP_X" "10"
 SYSTEM_CONSTANT "ENGM_TRQFRC_MAP_Y" "10"
 SYSTEM_CONSTANT "ENGPRT_FACAIROVHTPRV_MAP_X" "10"
 SYSTEM_CONSTANT "ENGPRT_FACAIROVHTPRV_MAP_Y" "10"
 SYSTEM_CONSTANT "ENGPRT_FACAPCORR_MAP_X" "10"
 SYSTEM_CONSTANT "ENGPRT_FACAPCORR_MAP_Y" "10"
 SYSTEM_CONSTANT "ENGPRT_FACBPAPINCLOADCORR_MAP_X" "4"
 SYSTEM_CONSTANT "ENGPRT_FACBPAPINCLOADCORR_MAP_Y" "5"
 SYSTEM_CONSTANT "ENGPRT_FACCTOVHTPRV_MAP_X" "6"
 SYSTEM_CONSTANT "ENGPRT_FACCTOVHTPRV_MAP_Y" "10"
 SYSTEM_CONSTANT "ENGPRT_FACFLTEMPLIM_MAP_X" "10"
 SYSTEM_CONSTANT "ENGPRT_FACFLTEMPLIM_MAP_Y" "10"
 SYSTEM_CONSTANT "ENGPRT_FACOILOVHTPRV_MAP_X" "10"
 SYSTEM_CONSTANT "ENGPRT_FACOILOVHTPRV_MAP_Y" "10"
 SYSTEM_CONSTANT "ENGPRT_FACTEMPPRETRBN_MAP_X" "8"
 SYSTEM_CONSTANT "ENGPRT_FACTEMPPRETRBN_MAP_Y" "8"
 SYSTEM_CONSTANT "ENGPRT_FACTNKTEMPLIM_MAP_X" "2"
 SYSTEM_CONSTANT "ENGPRT_FACTNKTEMPLIM_MAP_Y" "2"
 SYSTEM_CONSTANT "ENGPRT_FLTEMPVIRT_MAP_X" "3"
 SYSTEM_CONSTANT "ENGPRT_FLTEMPVIRT_MAP_Y" "5"
 SYSTEM_CONSTANT "ENGPRT_OILOVHTPREV_OFF" "0"
 SYSTEM_CONSTANT "ENGPRT_OILOVHTPREV_ON" "1"
 SYSTEM_CONSTANT "ENGPRT_QLIMP_MAP_X" "4"
 SYSTEM_CONSTANT "ENGPRT_QLIMP_MAP_Y" "25"
 SYSTEM_CONSTANT "ENGPRT_SWTOILOVHTPREV_TYPE" "2"
 SYSTEM_CONSTANT "ENGPRT_SWTOILOVHTPREV_VAL" "0"
 SYSTEM_CONSTANT "ENGPRT_SWTTEMPPRETRBN_TYPE" "2"
 SYSTEM_CONSTANT "ENGPRT_SWTTEMPPRETRBN_VAL" "0"
 SYSTEM_CONSTANT "ENGPRT_TEMPPRETRBN_MODEL" "1"
 SYSTEM_CONSTANT "ENGPRT_TEMPPRETRBN_SENSOR" "0"
 SYSTEM_CONSTANT "ENGPRT_TRQDNLIM_MAP_X" "2"
 SYSTEM_CONSTANT "ENGPRT_TRQDNLIM_MAP_Y" "2"
 SYSTEM_CONSTANT "ENGPRT_TRQFACNLIM_CUR_X" "2"
 SYSTEM_CONSTANT "ENGPRT_TRQINCLOAD_MAP_X" "11"
 SYSTEM_CONSTANT "ENGPRT_TRQINCLOAD_MAP_Y" "10"
 SYSTEM_CONSTANT "ENGPRT_TRQLIMP_MAP_X" "4"
 SYSTEM_CONSTANT "ENGPRT_TRQLIMP_MAP_Y" "25"
 SYSTEM_CONSTANT "ENGPRT_TRQLIMRVNNOPI_MAP_X" "3"
 SYSTEM_CONSTANT "ENGPRT_TRQLIMRVNNOPI_MAP_Y" "21"
 SYSTEM_CONSTANT "ENGPRT_TRQLIMRVNPI_MAP_X" "2"
 SYSTEM_CONSTANT "ENGPRT_TRQLIMRVNPI_MAP_Y" "2"
 SYSTEM_CONSTANT "ENGPRT_TRQNLIMSPR_CUR_X" "25"
 SYSTEM_CONSTANT "ENGPRT_TRQNLIM_CUR_X" "25"
 SYSTEM_CONSTANT "ENGPRT_TRQPILIM_MAP_X" "6"
 SYSTEM_CONSTANT "ENGPRT_TRQPILIM_MAP_Y" "3"
 SYSTEM_CONSTANT "ENG_CTFLD_NUM" "5"
 SYSTEM_CONSTANT "ENG_DTENG_MAP_X" "4"
 SYSTEM_CONSTANT "ENG_DTENG_MAP_Y" "6"
 SYSTEM_CONSTANT "ENG_NRGNIDLE_MAX" "1490"
 SYSTEM_CONSTANT "ENG_N_2_RMP_ENG_N_LOW" "1000000"
 SYSTEM_CONSTANT "ENG_N_HIRES" "0.03125"
 SYSTEM_CONSTANT "ENG_N_HIRES_EXP" "5"
 SYSTEM_CONSTANT "ENG_N_INT" "6000"
 SYSTEM_CONSTANT "ENG_N_MAX" "6000"
 SYSTEM_CONSTANT "ENG_N_MIN" "40"
 SYSTEM_CONSTANT "ENG_N_POLAR" "3000"
 SYSTEM_CONSTANT "ENG_N_RES" "1"
 SYSTEM_CONSTANT "ENG_N_RES_FL" "1"
 SYSTEM_CONSTANT "ENG_N_RES_INV" "1"
 SYSTEM_CONSTANT "ENG_N_STRT" "6000"
 SYSTEM_CONSTANT "ENG_N_TEST" "8000"
 SYSTEM_CONSTANT "ENG_N_ZERO" "0"
 SYSTEM_CONSTANT "ENG_TRQSPD_CUR_X" "25"
 SYSTEM_CONSTANT "ERLPCD_SWTMIL_TYPE" "2"
 SYSTEM_CONSTANT "ERLPCD_SWTMIL_VAL" "0"
 SYSTEM_CONSTANT "ERLPCD_SWTSYS_TYPE" "2"
 SYSTEM_CONSTANT "ERLPCD_SWTSYS_VAL" "0"
 SYSTEM_CONSTANT "ESCU_DES_ZERO" "0"
 SYSTEM_CONSTANT "ETA_CORR_FACT_ONE" "1"
 SYSTEM_CONSTANT "ETA_EXP" "7"
 SYSTEM_CONSTANT "ETA_RES" "0.0078125"
 SYSTEM_CONSTANT "ETA_RES_REV" "128"
 SYSTEM_CONSTANT "ETCLB_NUM_RAILP_CLB_PNT" "3"
 SYSTEM_CONSTANT "ETCLB_SWTCORACTV_TYPE" "2"
 SYSTEM_CONSTANT "ETCLB_SWTCORACTV_VAL" "1"
 SYSTEM_CONSTANT "EULER2PRES_EXP" "35"
 SYSTEM_CONSTANT "EULER2PRES_EXP1" "4"
 SYSTEM_CONSTANT "EULER2PRES_EXP2" "31"
 SYSTEM_CONSTANT "EULER_NUM_RES" "0.1"
 SYSTEM_CONSTANT "FACT1_EXP" "7"
 SYSTEM_CONSTANT "FACT1_ONE" "1"
 SYSTEM_CONSTANT "FACT1_RES" "0.0078125"
 SYSTEM_CONSTANT "FACT1_RES_REV" "128"
 SYSTEM_CONSTANT "FACT2_EXP" "4"
 SYSTEM_CONSTANT "FACT2_RES" "0.0625"
 SYSTEM_CONSTANT "FACT2_RES_REV" "16"
 SYSTEM_CONSTANT "FACTLOW_ONE" "1"
 SYSTEM_CONSTANT "FACTOR_10" "10"
 SYSTEM_CONSTANT "FACTOR_100" "100"
 SYSTEM_CONSTANT "FACT_ANG_HRES" "128"
 SYSTEM_CONSTANT "FACT_GOVILMBD_RES_REV" "64"
 SYSTEM_CONSTANT "FACT_GOVIT3_RES_REV" "512"
 SYSTEM_CONSTANT "FACT_GOVPLMBD_RES_REV" "128"
 SYSTEM_CONSTANT "FACT_GOVPT3_RES_REV" "256"
 SYSTEM_CONSTANT "FACT_HFMEXP" "14"
 SYSTEM_CONSTANT "FACT_HFMRES" "6.103515625e-05"
 SYSTEM_CONSTANT "FACT_HFMRES_REV" "16384"
 SYSTEM_CONSTANT "FACT_LAMBDAREC1" "100"
 SYSTEM_CONSTANT "FACT_LAMBDAREC2" "1000000"
 SYSTEM_CONSTANT "FACT_LAMBDAREC3" "2"
 SYSTEM_CONSTANT "FACT_NRM_EXP" "13"
 SYSTEM_CONSTANT "FACT_NRM_EXP_HIGH" "12"
 SYSTEM_CONSTANT "FACT_NRM_EXP_LOW" "10"
 SYSTEM_CONSTANT "FACT_ONE" "1"
 SYSTEM_CONSTANT "FACT_PRES_AC_HPA_RES_REV" "16384"
 SYSTEM_CONSTANT "FACT_RES" "0.0001220703125"
 SYSTEM_CONSTANT "FACT_RES_FL" "0.0001220703125"
 SYSTEM_CONSTANT "FACT_RES_HIGH" "0.0001"
 SYSTEM_CONSTANT "FACT_RES_LOW" "0.0009765625"
 SYSTEM_CONSTANT "FACT_RES_REV" "8192"
 SYSTEM_CONSTANT "FACT_RES_REV_HIGH" "10000"
 SYSTEM_CONSTANT "FACT_RES_REV_LOW" "1024"
 SYSTEM_CONSTANT "FACT_RPWR_CAN_RES_REV" "1206.37157897856"
 SYSTEM_CONSTANT "FACT_RTRQ_CAN_RES_REV" "3212.550144"
 SYSTEM_CONSTANT "FACT_TCLNT_MOD_NRM_EXP" "12"
 SYSTEM_CONSTANT "FACT_TCLNT_MOD_RES_REV" "4096"
 SYSTEM_CONSTANT "FACT_TEMP" "-2731.4"
 SYSTEM_CONSTANT "FACT_TFCT_REV" "4096"
 SYSTEM_CONSTANT "FACT_TIME2RMPTRQ" "6553.6"
 SYSTEM_CONSTANT "FACT_TINC_HRES" "256"
 SYSTEM_CONSTANT "FACT_WEARSOOTIDX_RES" "2e-08"
 SYSTEM_CONSTANT "FACT_WEARSOOTIDX_RES_REV" "50000000"
 SYSTEM_CONSTANT "FACT_WEARSOOT_RES" "0.1"
 SYSTEM_CONSTANT "FACT_ZERO" "0"
 SYSTEM_CONSTANT "FAC_AIRMASSPERTIME" "3.6"
 SYSTEM_CONSTANT "FAC_AREA" "10000"
 SYSTEM_CONSTANT "FAC_DENS" "0.348432055749129"
 SYSTEM_CONSTANT "FAC_MASSINJ_TO_QNTINJ" "10000"
 SYSTEM_CONSTANT "FAC_PERDUR_TO_RPM" "60000000"
 SYSTEM_CONSTANT "FAC_PRC" "100"
 SYSTEM_CONSTANT "FAC_PRECTL_CTLINJ" "120000"
 SYSTEM_CONSTANT "FAC_PRES" "100"
 SYSTEM_CONSTANT "FAC_PRES2TRQ_REV" "1000"
 SYSTEM_CONSTANT "FAC_PSI" "36"
 SYSTEM_CONSTANT "FAC_QNTADJ_TO_QNTINJ_0" "10"
 SYSTEM_CONSTANT "FAC_QNTADJ_TO_QNTINJ_1" "15"
 SYSTEM_CONSTANT "FAC_QNTADJ_TO_QNTINJ_2" "25"
 SYSTEM_CONSTANT "FAC_QNTADJ_TO_QNTINJ_3" "50"
 SYSTEM_CONSTANT "FAC_RPM_TO_SWTIME" "6000"
 SYSTEM_CONSTANT "FAC_USEC_TO_RPM" "60000000"
 SYSTEM_CONSTANT "FANCD_FANSHUTOFF_OFF" "0"
 SYSTEM_CONSTANT "FANCD_FANSHUTOFF_ON" "1"
 SYSTEM_CONSTANT "FANCD_SWTFANSHUTOFF_TYPE" "2"
 SYSTEM_CONSTANT "FANCD_SWTFANSHUTOFF_VAL" "1"
 SYSTEM_CONSTANT "FANCTL_CLGMODVAR_HFM" "1"
 SYSTEM_CONSTANT "FANCTL_CLGMODVAR_MBC" "0"
 SYSTEM_CONSTANT "FANCTL_CLGMODVAR_TYPE" "0"
 SYSTEM_CONSTANT "FANCTL_CLGMODVAR_VAL" "0"
 SYSTEM_CONSTANT "FANCTL_DCYCCALC_CUR_X" "25"
 SYSTEM_CONSTANT "FANCTL_DCYCFAN1PRESET3_MAP_X" "5"
 SYSTEM_CONSTANT "FANCTL_DCYCFAN1PRESET3_MAP_Y" "5"
 SYSTEM_CONSTANT "FANCTL_DCYCFAN1_MAP_X" "8"
 SYSTEM_CONSTANT "FANCTL_DCYCFAN1_MAP_Y" "8"
 SYSTEM_CONSTANT "FANCTL_DCYCFAN2PRESET3_MAP_X" "5"
 SYSTEM_CONSTANT "FANCTL_DCYCFAN2PRESET3_MAP_Y" "5"
 SYSTEM_CONSTANT "FANCTL_DCYCFAN2_CUR_X" "8"
 SYSTEM_CONSTANT "FANCTL_DTCLNTDESCORR_MAP_X" "5"
 SYSTEM_CONSTANT "FANCTL_DTCLNTDESCORR_MAP_Y" "5"
 SYSTEM_CONSTANT "FANCTL_DTCLNTDESDIFF_MAP_X" "8"
 SYSTEM_CONSTANT "FANCTL_DTCLNTDESDIFF_MAP_Y" "8"
 SYSTEM_CONSTANT "FANCTL_FACTACREQCORR_CUR_X" "6"
 SYSTEM_CONSTANT "FANCTL_FACTAPREQCORR_CUR_X" "6"
 SYSTEM_CONSTANT "FANCTL_FACTAPREQ_MAP_X" "6"
 SYSTEM_CONSTANT "FANCTL_FACTAPREQ_MAP_Y" "6"
 SYSTEM_CONSTANT "FANCTL_FACTARBASECOR_CUR_X" "4"
 SYSTEM_CONSTANT "FANCTL_FACTCORR_CUR_X" "8"
 SYSTEM_CONSTANT "FANCTL_NELMIN_CUR_X" "6"
 SYSTEM_CONSTANT "FANCTL_NFAN1BASE_MAP_X" "8"
 SYSTEM_CONSTANT "FANCTL_NFAN1BASE_MAP_Y" "8"
 SYSTEM_CONSTANT "FANCTL_NFAN2BASE_MAP_X" "8"
 SYSTEM_CONSTANT "FANCTL_NFAN2BASE_MAP_Y" "8"
 SYSTEM_CONSTANT "FANCTL_NHYDMIN_CUR_X" "6"
 SYSTEM_CONSTANT "FANCTL_PRCCANREQ_CUR_X" "5"
 SYSTEM_CONSTANT "FANCTL_PRCCLNTINC_CUR_X" "4"
 SYSTEM_CONSTANT "FANCTL_PRCCNV_MAP_X" "6"
 SYSTEM_CONSTANT "FANCTL_PRCCNV_MAP_Y" "6"
 SYSTEM_CONSTANT "FANCTL_PRCCTL_MAP_X" "8"
 SYSTEM_CONSTANT "FANCTL_PRCCTL_MAP_Y" "8"
 SYSTEM_CONSTANT "FANCTL_PRCQK_MAP_X" "5"
 SYSTEM_CONSTANT "FANCTL_PRCQK_MAP_Y" "4"
 SYSTEM_CONSTANT "FANCTL_PRCQK_X" "6"
 SYSTEM_CONSTANT "FANCTL_TARTHRES_CUR_X" "4"
 SYSTEM_CONSTANT "FANCTL_TCLNTCRIT_MAP_X" "5"
 SYSTEM_CONSTANT "FANCTL_TCLNTCRIT_MAP_Y" "5"
 SYSTEM_CONSTANT "FANCTL_TCLNTDESRAW_MAP_X" "8"
 SYSTEM_CONSTANT "FANCTL_TCLNTDESRAW_MAP_Y" "8"
 SYSTEM_CONSTANT "FANCTL_TCLNTDES_MAP_X" "8"
 SYSTEM_CONSTANT "FANCTL_TCLNTDES_MAP_Y" "8"
 SYSTEM_CONSTANT "FANCTL_TIARBASE_MAP_X" "14"
 SYSTEM_CONSTANT "FANCTL_TIARBASE_MAP_Y" "8"
 SYSTEM_CONSTANT "FANCTL_TIARCOR1_MAP_X" "8"
 SYSTEM_CONSTANT "FANCTL_TIARCOR1_MAP_Y" "8"
 SYSTEM_CONSTANT "FANCTL_TIARCOR2_MAP_X" "8"
 SYSTEM_CONSTANT "FANCTL_TIARCOR2_MAP_Y" "8"
 SYSTEM_CONSTANT "FANCTL_TIAROILCOR_CUR_X" "8"
 SYSTEM_CONSTANT "FBC_AAL0" "0.0744924388"
 SYSTEM_CONSTANT "FBC_AAL1" "0.249256558"
 SYSTEM_CONSTANT "FBC_AAL2" "0.352502005"
 SYSTEM_CONSTANT "FBC_AAL3" "0.249256558"
 SYSTEM_CONSTANT "FBC_AAL4" "0.0744924388"
 SYSTEM_CONSTANT "FBC_AAL5" "0"
 SYSTEM_CONSTANT "FBC_AAL6" "0"
 SYSTEM_CONSTANT "FBC_AAL7" "0"
 SYSTEM_CONSTANT "FBC_AAL8" "0"
 SYSTEM_CONSTANT "FBC_AALORD" "4"
 SYSTEM_CONSTANT "FBC_BPfac_MAX" "0.0122074037903989"
 SYSTEM_CONSTANT "FBC_BPfac_MIN" "-0.0122074037903989"
 SYSTEM_CONSTANT "FBC_BPfac_RES" "0.000610370189519944"
 SYSTEM_CONSTANT "FBC_BPfac_RES_FL" "0.000610370189519944"
 SYSTEM_CONSTANT "FBC_CTSEGOFFSET" "3"
 SYSTEM_CONSTANT "FBC_DBPFAC1DEN1" "1.6879"
 SYSTEM_CONSTANT "FBC_DBPFAC1DEN2" "0.949"
 SYSTEM_CONSTANT "FBC_DBPFAC2DEN1" "0.9747"
 SYSTEM_CONSTANT "FBC_DBPFAC2DEN2" "0.949"
 SYSTEM_CONSTANT "FBC_DBPFAC3DEN1" "0.000425"
 SYSTEM_CONSTANT "FBC_DBPFAC3DEN2" "0.949"
 SYSTEM_CONSTANT "FBC_DBPFAC4DEN1" "0"
 SYSTEM_CONSTANT "FBC_DBPFAC4DEN2" "0"
 SYSTEM_CONSTANT "FBC_DBPFAC5DEN1" "0"
 SYSTEM_CONSTANT "FBC_DBPFAC5DEN2" "0"
 SYSTEM_CONSTANT "FBC_DSYN" "1"
 SYSTEM_CONSTANT "FBC_NUMSEG" "2"
 SYSTEM_CONSTANT "FBC_QLIM_CUR_X" "4"
 SYSTEM_CONSTANT "FIOMAX" "8"
 SYSTEM_CONSTANT "FIR_SEQ_GEO" "1"
 SYSTEM_CONSTANT "FIR_SEQ_NUM" "0"
 SYSTEM_CONSTANT "FL2ASH_EXP" "16"
 SYSTEM_CONSTANT "FLCONS1_L_H_MIN" "0"
 SYSTEM_CONSTANT "FLCONS1_RES" "0.01"
 SYSTEM_CONSTANT "FLCONS1_RES_INV" "100"
 SYSTEM_CONSTANT "FLCONS2_RES" "1"
 SYSTEM_CONSTANT "FLCONS2_RES_1" "0.001"
 SYSTEM_CONSTANT "FLCONS2_RES_REV" "1"
 SYSTEM_CONSTANT "FLMNG_DSMOKEMAPNR_MAP_X" "2"
 SYSTEM_CONSTANT "FLMNG_FACCORAIRTEMP_CUR_X" "12"
 SYSTEM_CONSTANT "FLMNG_FACCORAP_CUR_X" "12"
 SYSTEM_CONSTANT "FLMNG_FACCORENGTEMP_CUR_X" "12"
 SYSTEM_CONSTANT "FLMNG_FACLMBDSMKSOE_CUR_X" "6"
 SYSTEM_CONSTANT "FLMNG_FULLLDRGLIKI_CUR_X" "7"
 SYSTEM_CONSTANT "FLMNG_FULLLDRGLPKP_CUR_X" "7"
 SYSTEM_CONSTANT "FLMNG_PIATCORR_MAP_X" "16"
 SYSTEM_CONSTANT "FLMNG_PIATCORR_MAP_Y" "10"
 SYSTEM_CONSTANT "FLMNG_QAFSCDSMOKE_MAP_X" "16"
 SYSTEM_CONSTANT "FLMNG_QAFSCDSMOKE_MAP_Y" "13"
 SYSTEM_CONSTANT "FLMNG_QAFSCDTENGSMOKEMAP0_MAP_X" "2"
 SYSTEM_CONSTANT "FLMNG_QAFSCDTENGSMOKEMAP0_MAP_Y" "2"
 SYSTEM_CONSTANT "FLMNG_QAFSCDTENGSMOKEMAP1_MAP_X" "2"
 SYSTEM_CONSTANT "FLMNG_QAFSCDTENGSMOKEMAP1_MAP_Y" "2"
 SYSTEM_CONSTANT "FLMNG_QAFSCDTENGSMOKEMAP2_MAP_X" "2"
 SYSTEM_CONSTANT "FLMNG_QAFSCDTENGSMOKEMAP2_MAP_Y" "2"
 SYSTEM_CONSTANT "FLMNG_QPRESSMOKE_MAP_X" "16"
 SYSTEM_CONSTANT "FLMNG_QPRESSMOKE_MAP_Y" "13"
 SYSTEM_CONSTANT "FLMNG_QTEMPFUEL_MAP_X" "10"
 SYSTEM_CONSTANT "FLMNG_QTEMPFUEL_MAP_Y" "10"
 SYSTEM_CONSTANT "FLMNG_RLMBDPARTLD_CUR_X" "12"
 SYSTEM_CONSTANT "FLMNG_RLMBDSMKEGT_MAP_X" "12"
 SYSTEM_CONSTANT "FLMNG_RLMBDSMKEGT_MAP_Y" "12"
 SYSTEM_CONSTANT "FLMNG_RLMBDSMKLIM0_MAP_X" "16"
 SYSTEM_CONSTANT "FLMNG_RLMBDSMKLIM0_MAP_Y" "13"
 SYSTEM_CONSTANT "FLMNG_RLMBDSMKLIM1_MAP_X" "16"
 SYSTEM_CONSTANT "FLMNG_RLMBDSMKLIM1_MAP_Y" "13"
 SYSTEM_CONSTANT "FLMNG_RLMBDSMKLIM2_MAP_X" "16"
 SYSTEM_CONSTANT "FLMNG_RLMBDSMKLIM2_MAP_Y" "13"
 SYSTEM_CONSTANT "FLMNG_RLMBDSMKLIMNR_CUR_X" "3"
 SYSTEM_CONSTANT "FLMNG_RLMBDSMKSOE_MAP_X" "16"
 SYSTEM_CONSTANT "FLMNG_RLMBDSMKSOE_MAP_Y" "6"
 SYSTEM_CONSTANT "FLMNG_R_STOICH" "14.5"
 SYSTEM_CONSTANT "FLMNG_SMK_NORM" "689.655172413793"
 SYSTEM_CONSTANT "FLMNG_SWTFULLLDRGL_TYPE" "2"
 SYSTEM_CONSTANT "FLMNG_SWTFULLLDRGL_VAL" "0"
 SYSTEM_CONSTANT "FLMNG_TIFULLLDRGLDEL_CUR_X" "10"
 SYSTEM_CONSTANT "FLPPCD_FLPPACT_OFF" "0"
 SYSTEM_CONSTANT "FLPPCD_FLPPACT_ON" "1"
 SYSTEM_CONSTANT "FLPPCD_SWTFLPPACT_TYPE" "1"
 SYSTEM_CONSTANT "FLPPCD_SWTFLPPACT_VAL" "1"
 SYSTEM_CONSTANT "FLSCD_VOLTOTALLIN_CUR_X" "25"
 SYSTEM_CONSTANT "FLSYS_FTS_EXISTS" "1"
 SYSTEM_CONSTANT "FLSYS_FTS_NONE" "0"
 SYSTEM_CONSTANT "FLSYS_RHOFL_CUR_X" "9"
 SYSTEM_CONSTANT "FLSYS_SWTTEMPSENSCFG_TYPE" "2"
 SYSTEM_CONSTANT "FLSYS_SWTTEMPSENSCFG_VAL" "0"
 SYSTEM_CONSTANT "FLSYS_TEMP_CTS" "1"
 SYSTEM_CONSTANT "FLSYS_TEMP_DFL" "2"
 SYSTEM_CONSTANT "FLSYS_TEMP_FTS" "0"
 SYSTEM_CONSTANT "FL_Half_L_MAX" "300"
 SYSTEM_CONSTANT "FL_Half_L_MIN" "0"
 SYSTEM_CONSTANT "FL_L_MAX" "320"
 SYSTEM_CONSTANT "FL_L_MIN" "0"
 SYSTEM_CONSTANT "FL_L_RES" "0.01"
 SYSTEM_CONSTANT "FL_L_RES_INV" "100"
 SYSTEM_CONSTANT "FL_RES" "0.5"
 SYSTEM_CONSTANT "FL_RES_INV" "2"
 SYSTEM_CONSTANT "FMA_DT1_RES" "4294.967296"
 SYSTEM_CONSTANT "FMA_FACAIRSWTOFF_CUR_X" "8"
 SYSTEM_CONSTANT "FMA_FACENGSWTOFF_CUR_X" "8"
 SYSTEM_CONSTANT "FMA_FACFLSWTOFF_CUR_X" "8"
 SYSTEM_CONSTANT "FMA_INJMASSNSLP_RES" "10"
 SYSTEM_CONSTANT "FMA_INJMASSQSLP_RES" "10"
 SYSTEM_CONSTANT "FMA_INJMASS_RES" "10"
 SYSTEM_CONSTANT "FMTC_ETABAS_MAP_X" "16"
 SYSTEM_CONSTANT "FMTC_ETABAS_MAP_Y" "16"
 SYSTEM_CONSTANT "FMTC_MAIRCOR_CUR_X" "25"
 SYSTEM_CONSTANT "FMTC_MAIROPT_MAP_X" "16"
 SYSTEM_CONSTANT "FMTC_MAIROPT_MAP_Y" "16"
 SYSTEM_CONSTANT "FMTC_PBSTCOR_CUR_X" "25"
 SYSTEM_CONSTANT "FMTC_PBSTOPT_MAP_X" "16"
 SYSTEM_CONSTANT "FMTC_PBSTOPT_MAP_Y" "16"
 SYSTEM_CONSTANT "FMTC_QBAS_MAP_X" "16"
 SYSTEM_CONSTANT "FMTC_QBAS_MAP_Y" "18"
 SYSTEM_CONSTANT "FMTC_STRTINJCORT_CUR_X" "25"
 SYSTEM_CONSTANT "FMTC_STRTINJCOR_CUR_X" "25"
 SYSTEM_CONSTANT "FMTC_STRTINJOPTCORT_CUR_X" "25"
 SYSTEM_CONSTANT "FMTC_STRTINJOPT_MAP_X" "16"
 SYSTEM_CONSTANT "FMTC_STRTINJOPT_MAP_Y" "16"
 SYSTEM_CONSTANT "FMTC_TRQ2QRGN2_MAP_X" "16"
 SYSTEM_CONSTANT "FMTC_TRQ2QRGN2_MAP_Y" "18"
 SYSTEM_CONSTANT "FMTC_TRQ2QRGN_MAP_X" "16"
 SYSTEM_CONSTANT "FMTC_TRQ2QRGN_MAP_Y" "18"
 SYSTEM_CONSTANT "FOSC" "20"
 SYSTEM_CONSTANT "FQLSCD_RLIN_CUR_X" "20"
 SYSTEM_CONSTANT "FRCSURE" "1"
 SYSTEM_CONSTANT "FRC_SWT_DISABLED" "0"
 SYSTEM_CONSTANT "FRC_SWT_ENABLED" "1"
 SYSTEM_CONSTANT "FREQU2TIME_FAC" "500000"
 SYSTEM_CONSTANT "FREQU_POLAR_MAX" "2500"
 SYSTEM_CONSTANT "FREQU_POLAR_MIN" "400"
 SYSTEM_CONSTANT "FREQU_RES" "1"
 SYSTEM_CONSTANT "FRMMNG_CANVERMAX" "45"
 SYSTEM_CONSTANT "FRMMNG_CANVERMIN" "12"
 SYSTEM_CONSTANT "FRMMNG_FACTRQINRTRQ_SLOPE_CA" "4"
 SYSTEM_CONSTANT "FRMMNG_LOIL_MAP_X" "8"
 SYSTEM_CONSTANT "FRMMNG_LOIL_MAP_Y" "8"
 SYSTEM_CONSTANT "FRMMNG_NDES_MAP_X" "6"
 SYSTEM_CONSTANT "FRMMNG_NDES_MAP_Y" "10"
 SYSTEM_CONSTANT "FRMMNG_NENGPRT_MAP_X" "10"
 SYSTEM_CONSTANT "FRMMNG_NENGPRT_MAP_Y" "10"
 SYSTEM_CONSTANT "FRMMNG_NUMTOOVRFLOWVAR" "23"
 SYSTEM_CONSTANT "FRMMNG_PRCFAN_MAX" "100"
 SYSTEM_CONSTANT "FRMMNG_STCANVER_MAX" "6"
 SYSTEM_CONSTANT "FRMMNG_STCANVER_MIN" "0"
 SYSTEM_CONSTANT "FRMMNG_TRQINRTRQ_OFFSET_CA" "4"
 SYSTEM_CONSTANT "FSYS" "56"
 SYSTEM_CONSTANT "FTSCD_TLIN_CUR_X" "25"
 SYSTEM_CONSTANT "FUELQNTCORR_PLAUSMAX" "1638.35"
 SYSTEM_CONSTANT "GEARBX_AST_OFF" "0"
 SYSTEM_CONSTANT "GEARBX_AST_ON" "1"
 SYSTEM_CONSTANT "GEARBX_NTSCLIM_CUR_X" "6"
 SYSTEM_CONSTANT "GEARBX_NUMGEAR_MAX" "6"
 SYSTEM_CONSTANT "GEARBX_NUMGEAR_MIN" "-1"
 SYSTEM_CONSTANT "GEARBX_SWTDEMTYPE_TYPE" "2"
 SYSTEM_CONSTANT "GEARBX_SWTDEMTYPE_VAL" "1"
 SYSTEM_CONSTANT "GEARBX_SWTTYPEAST_TYPE" "2"
 SYSTEM_CONSTANT "GEARBX_SWTTYPEAST_VAL" "1"
 SYSTEM_CONSTANT "GEARBX_SWTTYPE_STRLEN" "25"
 SYSTEM_CONSTANT "GEARBX_SWTTYPE_TYPE" "2"
 SYSTEM_CONSTANT "GEARBX_SWTTYPE_VAL" "0"
 SYSTEM_CONSTANT "GEARBX_TRQCANERRMAX_MAP_X" "10"
 SYSTEM_CONSTANT "GEARBX_TRQCANERRMAX_MAP_Y" "10"
 SYSTEM_CONSTANT "GEARBX_TRQMAXGEAR1_CUR_X" "15"
 SYSTEM_CONSTANT "GEARBX_TRQMAXGEAR2_CUR_X" "15"
 SYSTEM_CONSTANT "GEARBX_TRQMAXGEAR3_CUR_X" "15"
 SYSTEM_CONSTANT "GEARBX_TRQMAXGEAR4_CUR_X" "15"
 SYSTEM_CONSTANT "GEARBX_TRQMAXGEAR5_CUR_X" "15"
 SYSTEM_CONSTANT "GEARBX_TRQMAXGEAR6_CUR_X" "15"
 SYSTEM_CONSTANT "GEARBX_TRQMAXGEARR_CUR_X" "15"
 SYSTEM_CONSTANT "GEARBX_TRQMOVEOFF_CUR_X" "25"
 SYSTEM_CONSTANT "GEARBX_TSC_OFF" "0"
 SYSTEM_CONSTANT "GEARBX_TSC_ON" "1"
 SYSTEM_CONSTANT "GEARBX_TYPE_AST" "2"
 SYSTEM_CONSTANT "GEARBX_TYPE_AT" "1"
 SYSTEM_CONSTANT "GEARBX_TYPE_CVT" "3"
 SYSTEM_CONSTANT "GEARBX_TYPE_MT" "0"
 SYSTEM_CONSTANT "GLWCTL_BATTCORR" "2"
 SYSTEM_CONSTANT "GLWCTL_BATTCORR_MSG" "3"
 SYSTEM_CONSTANT "GLWCTL_DIA" "4"
 SYSTEM_CONSTANT "GLWCTL_FACGLWPWRRED_MAP_X" "6"
 SYSTEM_CONSTANT "GLWCTL_FACGLWPWRRED_MAP_Y" "6"
 SYSTEM_CONSTANT "GLWCTL_GSK2" "0"
 SYSTEM_CONSTANT "GLWCTL_GSK3" "1"
 SYSTEM_CONSTANT "GLWCTL_PREGLOWCUR" "1"
 SYSTEM_CONSTANT "GLWCTL_PREGLOWMAP" "0"
 SYSTEM_CONSTANT "GLWCTL_QPOST_CUR_X" "25"
 SYSTEM_CONSTANT "GLWCTL_ROUT_MAP_X" "10"
 SYSTEM_CONSTANT "GLWCTL_ROUT_MAP_Y" "10"
 SYSTEM_CONSTANT "GLWCTL_STINTR1_MAP_X" "16"
 SYSTEM_CONSTANT "GLWCTL_STINTR1_MAP_Y" "16"
 SYSTEM_CONSTANT "GLWCTL_STINTR2_MAP_X" "16"
 SYSTEM_CONSTANT "GLWCTL_STINTR2_MAP_Y" "16"
 SYSTEM_CONSTANT "GLWCTL_STRLYCTL_MAP_X" "16"
 SYSTEM_CONSTANT "GLWCTL_STRLYCTL_MAP_Y" "16"
 SYSTEM_CONSTANT "GLWCTL_TIDEBPRE_CUR_X" "3"
 SYSTEM_CONSTANT "GLWCTL_TIOUT1_CUR_X" "25"
 SYSTEM_CONSTANT "GLWCTL_TIPOST_CUR_X" "25"
 SYSTEM_CONSTANT "GLWCTL_TIPRE1_MAP_X" "4"
 SYSTEM_CONSTANT "GLWCTL_TIPRE1_MAP_Y" "7"
 SYSTEM_CONSTANT "GLWCTL_TIPRE2_MAP_X" "4"
 SYSTEM_CONSTANT "GLWCTL_TIPRE2_MAP_Y" "7"
 SYSTEM_CONSTANT "GLWCTL_TIPREGLOWPSH_CUR_X" "8"
 SYSTEM_CONSTANT "GLWCTL_TIPREGLOW_CUR_X" "8"
 SYSTEM_CONSTANT "GLWCTL_TITHRESFL1_CUR_X" "25"
 SYSTEM_CONSTANT "GLWCTL_WENERGPRE_CUR_X" "8"
 SYSTEM_CONSTANT "GRADTRQ_RES" "1"
 SYSTEM_CONSTANT "GRADTRQ_RES_REV" "1"
 SYSTEM_CONSTANT "HDSCD_TLIN_CUR" "4"
 SYSTEM_CONSTANT "HEAT_CAPACITY_RES" "0.1"
 SYSTEM_CONSTANT "HIGH_PREGLOW_NORM" "242.312928558422"
 SYSTEM_CONSTANT "HPUN_2PI_REV" "9.54929658551309"
 SYSTEM_CONSTANT "HPUN_DVOLPMPAGED_CUR_X" "12"
 SYSTEM_CONSTANT "HPUN_ETAPMPFLTEMP_CUR_X" "12"
 SYSTEM_CONSTANT "HPUN_ETAPMPMAXAGED_CUR_X" "12"
 SYSTEM_CONSTANT "HPUN_QBALLIM_CUR_X" "12"
 SYSTEM_CONSTANT "HPUN_QFLTEMPLIM_MAP_X" "16"
 SYSTEM_CONSTANT "HPUN_QFLTEMPLIM_MAP_Y" "16"
 SYSTEM_CONSTANT "HPUN_VOL2DVOL_RES" "6000"
 SYSTEM_CONSTANT "IATSCD_SWTSIG_TYPE" "2"
 SYSTEM_CONSTANT "IATSCD_SWTSIG_VAL" "0"
 SYSTEM_CONSTANT "IATSCD_TLIN_CUR_X" "25"
 SYSTEM_CONSTANT "IDEAL_GAS_CONSTANT" "287.5"
 SYSTEM_CONSTANT "IDEAL_GAS_CONSTANT_FL" "287"
 SYSTEM_CONSTANT "IFCtl_tAirHysHi_CUR_X" "5"
 SYSTEM_CONSTANT "IFCtl_tAirHysLo_CUR_X" "5"
 SYSTEM_CONSTANT "IFCtl_tClntThrHiHysHi_CUR_X" "5"
 SYSTEM_CONSTANT "IFCtl_tClntThrHiHysLo_CUR_X" "5"
 SYSTEM_CONSTANT "IMMCTL_LRN_REQ_REP" "1000"
 SYSTEM_CONSTANT "IMMCTL_N_TRESH2" "300"
 SYSTEM_CONSTANT "IMMCTL_PCLASS_1" "19"
 SYSTEM_CONSTANT "IMMCTL_PCLASS_10" "201"
 SYSTEM_CONSTANT "IMMCTL_PCLASS_11" "1000"
 SYSTEM_CONSTANT "IMMCTL_PCLASS_2" "200"
 SYSTEM_CONSTANT "IMMCTL_PCLASS_3" "300"
 SYSTEM_CONSTANT "IMMCTL_PCLASS_4" "490"
 SYSTEM_CONSTANT "IMMCTL_PCLASS_5" "1221"
 SYSTEM_CONSTANT "IMMCTL_PCLASS_6" "1255"
 SYSTEM_CONSTANT "IMMCTL_PCLASS_7" "5"
 SYSTEM_CONSTANT "IMMCTL_PCLASS_8" "10"
 SYSTEM_CONSTANT "IMMCTL_PCLASS_9" "181"
 SYSTEM_CONSTANT "IMMCTL_PCLASS_CUR_X" "6"
 SYSTEM_CONSTANT "IMMCTL_TI_SLOT1" "2000"
 SYSTEM_CONSTANT "IMMCTL_TI_SLOT2" "700"
 SYSTEM_CONSTANT "IMMCTL_TI_VINDISPLAY" "400"
 SYSTEM_CONSTANT "IMPT_RES" "0.01"
 SYSTEM_CONSTANT "INDSYS_FACAPCOR_CUR_X" "5"
 SYSTEM_CONSTANT "INDSYS_FACWTTEMPCOR_CUR_X" "5"
 SYSTEM_CONSTANT "INDSYS_PDIFFHIGH_CUR_X" "15"
 SYSTEM_CONSTANT "INDSYS_PDIFFLOW_CUR_X" "15"
 SYSTEM_CONSTANT "INDSYS_RAPCORVSA_MAP_X" "10"
 SYSTEM_CONSTANT "INDSYS_RAPCORVSA_MAP_Y" "10"
 SYSTEM_CONSTANT "INDSYS_RVSA_MAP_X" "16"
 SYSTEM_CONSTANT "INDSYS_RVSA_MAP_Y" "16"
 SYSTEM_CONSTANT "INDSYS_RWTTEMPCORVSA_MAP_X" "10"
 SYSTEM_CONSTANT "INDSYS_RWTTEMPCORVSA_MAP_Y" "10"
 SYSTEM_CONSTANT "INJCRV_DPHIMI1BASMAPNR_MAP_X" "6"
 SYSTEM_CONSTANT "INJCRV_FACMIAPSPHICOR_CUR_X" "8"
 SYSTEM_CONSTANT "INJCRV_FACMIAPSTCOR_MAP_X" "6"
 SYSTEM_CONSTANT "INJCRV_FACMIAPSTCOR_MAP_Y" "6"
 SYSTEM_CONSTANT "INJCRV_FACMIATSPHICOR_CUR_X" "8"
 SYSTEM_CONSTANT "INJCRV_FACMIETSPHICOR_CUR_X" "8"
 SYSTEM_CONSTANT "INJCRV_FACMIFTSRAILCOR_CUR_X" "8"
 SYSTEM_CONSTANT "INJCRV_FACMIPCRPHICOR_MAP_X" "8"
 SYSTEM_CONSTANT "INJCRV_FACMIPCRPHICOR_MAP_Y" "6"
 SYSTEM_CONSTANT "INJCRV_FACMIPRAILDIFPHICOR_CUR_X" "8"
 SYSTEM_CONSTANT "INJCRV_FACPII1QNTMIN_CUR_X" "8"
 SYSTEM_CONSTANT "INJCRV_FACPII2QNTMIN_CUR_X" "8"
 SYSTEM_CONSTANT "INJCRV_FACPII3APSQCOR_CUR_X" "2"
 SYSTEM_CONSTANT "INJCRV_FACPII3ATSQCOR_CUR_X" "2"
 SYSTEM_CONSTANT "INJCRV_FACPII3ETSQCOR_CUR_X" "2"
 SYSTEM_CONSTANT "INJCRV_FACPII3ETSSOECOR_CUR_X" "2"
 SYSTEM_CONSTANT "INJCRV_FACPII3QNTMIN_CUR_X" "8"
 SYSTEM_CONSTANT "INJCRV_FACPIIAPSQCOR2_CUR_X" "8"
 SYSTEM_CONSTANT "INJCRV_FACPIIAPSQCOR_CUR_X" "8"
 SYSTEM_CONSTANT "INJCRV_FACPIIAPSSOECOR_CUR_X" "8"
 SYSTEM_CONSTANT "INJCRV_FACPIIATSQCOR2_CUR_X" "8"
 SYSTEM_CONSTANT "INJCRV_FACPIIATSQCOR_CUR_X" "8"
 SYSTEM_CONSTANT "INJCRV_FACPIIETSQCOR2_CUR_X" "8"
 SYSTEM_CONSTANT "INJCRV_FACPIIETSQCOR_CUR_X" "8"
 SYSTEM_CONSTANT "INJCRV_FACPIIETSSOECOR_CUR_X" "8"
 SYSTEM_CONSTANT "INJCRV_FACPIIETSSOERGNCOR_CUR_X" "8"
 SYSTEM_CONSTANT "INJCRV_FACPOI1APSQCOR_CUR_X" "6"
 SYSTEM_CONSTANT "INJCRV_FACPOI1CATPHICOR_CUR_X" "6"
 SYSTEM_CONSTANT "INJCRV_FACPOI1CATQCOR_CUR_X" "6"
 SYSTEM_CONSTANT "INJCRV_FACPOI1ETSPHICOR_CUR_X" "6"
 SYSTEM_CONSTANT "INJCRV_FACPOI1ETSQCOR_CUR_X" "6"
 SYSTEM_CONSTANT "INJCRV_FACPOI2ATSQCOR_CUR_X" "6"
 SYSTEM_CONSTANT "INJCRV_FACPOI2ATSSOECOR_CUR_X" "6"
 SYSTEM_CONSTANT "INJCRV_FACPOI2EFF_MAP_X" "8"
 SYSTEM_CONSTANT "INJCRV_FACPOI2EFF_MAP_Y" "8"
 SYSTEM_CONSTANT "INJCRV_FACPOI2ETSQCOR_CUR_X" "6"
 SYSTEM_CONSTANT "INJCRV_FACPOI2ETSSOECOR_CUR_X" "6"
 SYSTEM_CONSTANT "INJCRV_FACPOPPOI2ETSCOR_CUR_X" "6"
 SYSTEM_CONSTANT "INJCRV_PHIDYNOFS_CUR_X" "12"
 SYSTEM_CONSTANT "INJCRV_PHIMI1BAS1_MAP_X" "10"
 SYSTEM_CONSTANT "INJCRV_PHIMI1BAS1_MAP_Y" "10"
 SYSTEM_CONSTANT "INJCRV_PHIMI1BAS2_MAP_X" "14"
 SYSTEM_CONSTANT "INJCRV_PHIMI1BAS2_MAP_Y" "10"
 SYSTEM_CONSTANT "INJCRV_PHIMI1BAS3_MAP_X" "14"
 SYSTEM_CONSTANT "INJCRV_PHIMI1BAS3_MAP_Y" "10"
 SYSTEM_CONSTANT "INJCRV_PHIMI1MAXP_MAP_X" "8"
 SYSTEM_CONSTANT "INJCRV_PHIMI1MAXP_MAP_Y" "8"
 SYSTEM_CONSTANT "INJCRV_PHIMI1MAXT_MAP_X" "10"
 SYSTEM_CONSTANT "INJCRV_PHIMI1MAXT_MAP_Y" "8"
 SYSTEM_CONSTANT "INJCRV_PHIMI1MAX_MAP_X" "16"
 SYSTEM_CONSTANT "INJCRV_PHIMI1MAX_MAP_Y" "12"
 SYSTEM_CONSTANT "INJCRV_PHIMI1RGNBAS1_MAP_X" "16"
 SYSTEM_CONSTANT "INJCRV_PHIMI1RGNBAS1_MAP_Y" "12"
 SYSTEM_CONSTANT "INJCRV_PHIMIAPSCOR_MAP_X" "16"
 SYSTEM_CONSTANT "INJCRV_PHIMIAPSCOR_MAP_Y" "12"
 SYSTEM_CONSTANT "INJCRV_PHIMIATSCOR_MAP_X" "16"
 SYSTEM_CONSTANT "INJCRV_PHIMIATSCOR_MAP_Y" "12"
 SYSTEM_CONSTANT "INJCRV_PHIMIETSRGNCOR_MAP_X" "16"
 SYSTEM_CONSTANT "INJCRV_PHIMIETSRGNCOR_MAP_Y" "12"
 SYSTEM_CONSTANT "INJCRV_PHIMIFTSRAILCOR_MAP_X" "12"
 SYSTEM_CONSTANT "INJCRV_PHIMIFTSRAILCOR_MAP_Y" "8"
 SYSTEM_CONSTANT "INJCRV_PHIMIPRAILDIFFCOR_MAP_X" "12"
 SYSTEM_CONSTANT "INJCRV_PHIMIPRAILDIFFCOR_MAP_Y" "8"
 SYSTEM_CONSTANT "INJCRV_PHIPII1BAS1_MAP_X" "16"
 SYSTEM_CONSTANT "INJCRV_PHIPII1BAS1_MAP_Y" "12"
 SYSTEM_CONSTANT "INJCRV_PHIPII1BAS2_MAP_X" "16"
 SYSTEM_CONSTANT "INJCRV_PHIPII1BAS2_MAP_Y" "12"
 SYSTEM_CONSTANT "INJCRV_PHIPII1BAS3_MAP_X" "16"
 SYSTEM_CONSTANT "INJCRV_PHIPII1BAS3_MAP_Y" "12"
 SYSTEM_CONSTANT "INJCRV_PHIPII1ETSCOR_MAP_X" "16"
 SYSTEM_CONSTANT "INJCRV_PHIPII1ETSCOR_MAP_Y" "12"
 SYSTEM_CONSTANT "INJCRV_PHIPII2BAS_MAP_X" "16"
 SYSTEM_CONSTANT "INJCRV_PHIPII2BAS_MAP_Y" "12"
 SYSTEM_CONSTANT "INJCRV_PHIPII2ETSCOR_MAP_X" "16"
 SYSTEM_CONSTANT "INJCRV_PHIPII2ETSCOR_MAP_Y" "12"
 SYSTEM_CONSTANT "INJCRV_PHIPII3BAS1_MAP_X" "2"
 SYSTEM_CONSTANT "INJCRV_PHIPII3BAS1_MAP_Y" "2"
 SYSTEM_CONSTANT "INJCRV_PHIPII3BAS2_MAP_X" "2"
 SYSTEM_CONSTANT "INJCRV_PHIPII3BAS2_MAP_Y" "2"
 SYSTEM_CONSTANT "INJCRV_PHIPII3ETSCOR_MAP_X" "2"
 SYSTEM_CONSTANT "INJCRV_PHIPII3ETSCOR_MAP_Y" "2"
 SYSTEM_CONSTANT "INJCRV_PHIPII3ETS_MAP_X" "2"
 SYSTEM_CONSTANT "INJCRV_PHIPII3ETS_MAP_Y" "2"
 SYSTEM_CONSTANT "INJCRV_PHIPOI1CATCOR_MAP_X" "6"
 SYSTEM_CONSTANT "INJCRV_PHIPOI1CATCOR_MAP_Y" "6"
 SYSTEM_CONSTANT "INJCRV_PHIPOI1ETSCOR_MAP_X" "6"
 SYSTEM_CONSTANT "INJCRV_PHIPOI1ETSCOR_MAP_Y" "6"
 SYSTEM_CONSTANT "INJCRV_PHIPOI1MAX_MAP_X" "8"
 SYSTEM_CONSTANT "INJCRV_PHIPOI1MAX_MAP_Y" "8"
 SYSTEM_CONSTANT "INJCRV_PHIPOI2ATSCOR_MAP_X" "16"
 SYSTEM_CONSTANT "INJCRV_PHIPOI2ATSCOR_MAP_Y" "8"
 SYSTEM_CONSTANT "INJCRV_PHIPOI2BAS_MAP_X" "10"
 SYSTEM_CONSTANT "INJCRV_PHIPOI2BAS_MAP_Y" "10"
 SYSTEM_CONSTANT "INJCRV_PHIPOI2ETSCOR_MAP_X" "16"
 SYSTEM_CONSTANT "INJCRV_PHIPOI2ETSCOR_MAP_Y" "8"
 SYSTEM_CONSTANT "INJCRV_POPPII1BAS_MAP_X" "16"
 SYSTEM_CONSTANT "INJCRV_POPPII1BAS_MAP_Y" "10"
 SYSTEM_CONSTANT "INJCRV_POPPII2BAS_MAP_X" "16"
 SYSTEM_CONSTANT "INJCRV_POPPII2BAS_MAP_Y" "10"
 SYSTEM_CONSTANT "INJCRV_POPPIIAIRCOR_CUR_X" "8"
 SYSTEM_CONSTANT "INJCRV_POPPIICTSCOR_CUR_X" "8"
 SYSTEM_CONSTANT "INJCRV_POPPOI1BAS_MAP_X" "6"
 SYSTEM_CONSTANT "INJCRV_POPPOI1BAS_MAP_Y" "6"
 SYSTEM_CONSTANT "INJCRV_POPPOI1ETSCOR_CUR_X" "6"
 SYSTEM_CONSTANT "INJCRV_POPPOI2BAS_MAP_X" "6"
 SYSTEM_CONSTANT "INJCRV_POPPOI2BAS_MAP_Y" "6"
 SYSTEM_CONSTANT "INJCRV_POPPOI2ETSCOR_MAP_X" "6"
 SYSTEM_CONSTANT "INJCRV_POPPOI2ETSCOR_MAP_Y" "6"
 SYSTEM_CONSTANT "INJCRV_QMIN1_CUR_X" "25"
 SYSTEM_CONSTANT "INJCRV_QMIN2_CUR_X" "25"
 SYSTEM_CONSTANT "INJCRV_QMIN3_CUR_X" "25"
 SYSTEM_CONSTANT "INJCRV_QMIN4_CUR_X" "25"
 SYSTEM_CONSTANT "INJCRV_QMIN5_CUR_X" "25"
 SYSTEM_CONSTANT "INJCRV_QMIN_MAP_X" "16"
 SYSTEM_CONSTANT "INJCRV_QMIN_MAP_Y" "16"
 SYSTEM_CONSTANT "INJCRV_QPII1BAS_MAP_X" "16"
 SYSTEM_CONSTANT "INJCRV_QPII1BAS_MAP_Y" "16"
 SYSTEM_CONSTANT "INJCRV_QPII1MAX_MAP_X" "16"
 SYSTEM_CONSTANT "INJCRV_QPII1MAX_MAP_Y" "10"
 SYSTEM_CONSTANT "INJCRV_QPII1RGNBAS1_MAP_X" "10"
 SYSTEM_CONSTANT "INJCRV_QPII1RGNBAS1_MAP_Y" "10"
 SYSTEM_CONSTANT "INJCRV_QPII1RGNBAS2_MAP_X" "10"
 SYSTEM_CONSTANT "INJCRV_QPII1RGNBAS2_MAP_Y" "10"
 SYSTEM_CONSTANT "INJCRV_QPII1RGNBAS3_MAP_X" "10"
 SYSTEM_CONSTANT "INJCRV_QPII1RGNBAS3_MAP_Y" "10"
 SYSTEM_CONSTANT "INJCRV_QPII2BAS_MAP_X" "16"
 SYSTEM_CONSTANT "INJCRV_QPII2BAS_MAP_Y" "16"
 SYSTEM_CONSTANT "INJCRV_QPII2MAX_MAP_X" "16"
 SYSTEM_CONSTANT "INJCRV_QPII2MAX_MAP_Y" "10"
 SYSTEM_CONSTANT "INJCRV_QPII3APSCOR_MAP_X" "2"
 SYSTEM_CONSTANT "INJCRV_QPII3APSCOR_MAP_Y" "2"
 SYSTEM_CONSTANT "INJCRV_QPII3ATSCOR_MAP_X" "2"
 SYSTEM_CONSTANT "INJCRV_QPII3ATSCOR_MAP_Y" "2"
 SYSTEM_CONSTANT "INJCRV_QPII3BAS_MAP_X" "2"
 SYSTEM_CONSTANT "INJCRV_QPII3BAS_MAP_Y" "2"
 SYSTEM_CONSTANT "INJCRV_QPII3ETSCOR_MAP_X" "2"
 SYSTEM_CONSTANT "INJCRV_QPII3ETSCOR_MAP_Y" "2"
 SYSTEM_CONSTANT "INJCRV_QPII3MAX_MAP_X" "2"
 SYSTEM_CONSTANT "INJCRV_QPII3MAX_MAP_Y" "2"
 SYSTEM_CONSTANT "INJCRV_QPIIAPSCOR_MAP_X" "16"
 SYSTEM_CONSTANT "INJCRV_QPIIAPSCOR_MAP_Y" "12"
 SYSTEM_CONSTANT "INJCRV_QPIIATSCOR_MAP_X" "16"
 SYSTEM_CONSTANT "INJCRV_QPIIATSCOR_MAP_Y" "12"
 SYSTEM_CONSTANT "INJCRV_QPIIETSCOR_MAP_X" "16"
 SYSTEM_CONSTANT "INJCRV_QPIIETSCOR_MAP_Y" "12"
 SYSTEM_CONSTANT "INJCRV_QPOI1APSCOR_MAP_X" "6"
 SYSTEM_CONSTANT "INJCRV_QPOI1APSCOR_MAP_Y" "6"
 SYSTEM_CONSTANT "INJCRV_QPOI1BAS_MAP_X" "8"
 SYSTEM_CONSTANT "INJCRV_QPOI1BAS_MAP_Y" "8"
 SYSTEM_CONSTANT "INJCRV_QPOI1CATCOR_MAP_X" "6"
 SYSTEM_CONSTANT "INJCRV_QPOI1CATCOR_MAP_Y" "6"
 SYSTEM_CONSTANT "INJCRV_QPOI1ETSCOR_MAP_X" "6"
 SYSTEM_CONSTANT "INJCRV_QPOI1ETSCOR_MAP_Y" "6"
 SYSTEM_CONSTANT "INJCRV_QPOI1MAX_MAP_X" "8"
 SYSTEM_CONSTANT "INJCRV_QPOI1MAX_MAP_Y" "8"
 SYSTEM_CONSTANT "INJCRV_QPOI2ATSCOR_MAP_X" "6"
 SYSTEM_CONSTANT "INJCRV_QPOI2ATSCOR_MAP_Y" "6"
 SYSTEM_CONSTANT "INJCRV_QPOI2BAS_MAP_X" "8"
 SYSTEM_CONSTANT "INJCRV_QPOI2BAS_MAP_Y" "8"
 SYSTEM_CONSTANT "INJCRV_QPOI2ETSCOR_MAP_X" "6"
 SYSTEM_CONSTANT "INJCRV_QPOI2ETSCOR_MAP_Y" "6"
 SYSTEM_CONSTANT "INJCRV_QPOI2MIN_CUR_X" "6"
 SYSTEM_CONSTANT "INJCRV_STPIIRLSOPRNG11_MAP_X" "16"
 SYSTEM_CONSTANT "INJCRV_STPIIRLSOPRNG11_MAP_Y" "10"
 SYSTEM_CONSTANT "INJCRV_STPIIRLSOPRNG12_MAP_X" "16"
 SYSTEM_CONSTANT "INJCRV_STPIIRLSOPRNG12_MAP_Y" "10"
 SYSTEM_CONSTANT "INJCRV_STPIIRLSOPRNG13_MAP_X" "16"
 SYSTEM_CONSTANT "INJCRV_STPIIRLSOPRNG13_MAP_Y" "10"
 SYSTEM_CONSTANT "INJCRV_STPIIRLSOPRNG21_MAP_X" "16"
 SYSTEM_CONSTANT "INJCRV_STPIIRLSOPRNG21_MAP_Y" "10"
 SYSTEM_CONSTANT "INJCRV_STPIIRLSOPRNG22_MAP_X" "16"
 SYSTEM_CONSTANT "INJCRV_STPIIRLSOPRNG22_MAP_Y" "10"
 SYSTEM_CONSTANT "INJCRV_STPIIRLSOPRNG23_MAP_X" "16"
 SYSTEM_CONSTANT "INJCRV_STPIIRLSOPRNG23_MAP_Y" "10"
 SYSTEM_CONSTANT "INJCRV_STPIIRLSOPRNG31_MAP_X" "16"
 SYSTEM_CONSTANT "INJCRV_STPIIRLSOPRNG31_MAP_Y" "10"
 SYSTEM_CONSTANT "INJCRV_STPIIRLSOPRNG32_MAP_X" "16"
 SYSTEM_CONSTANT "INJCRV_STPIIRLSOPRNG32_MAP_Y" "10"
 SYSTEM_CONSTANT "INJCRV_STPIIRLSOPRNG33_MAP_X" "16"
 SYSTEM_CONSTANT "INJCRV_STPIIRLSOPRNG33_MAP_Y" "10"
 SYSTEM_CONSTANT "INJCRV_STPIIRLSOPRNG41_MAP_X" "16"
 SYSTEM_CONSTANT "INJCRV_STPIIRLSOPRNG41_MAP_Y" "10"
 SYSTEM_CONSTANT "INJCRV_STPIIRLSOPRNG42_MAP_X" "16"
 SYSTEM_CONSTANT "INJCRV_STPIIRLSOPRNG42_MAP_Y" "10"
 SYSTEM_CONSTANT "INJCRV_STPIIRLSOPRNG43_MAP_X" "16"
 SYSTEM_CONSTANT "INJCRV_STPIIRLSOPRNG43_MAP_Y" "10"
 SYSTEM_CONSTANT "INJCRV_STPIIRLSOPRNG51_MAP_X" "16"
 SYSTEM_CONSTANT "INJCRV_STPIIRLSOPRNG51_MAP_Y" "10"
 SYSTEM_CONSTANT "INJCRV_STPIIRLSOPRNG52_MAP_X" "16"
 SYSTEM_CONSTANT "INJCRV_STPIIRLSOPRNG52_MAP_Y" "10"
 SYSTEM_CONSTANT "INJCRV_STPIIRLSOPRNG53_MAP_X" "16"
 SYSTEM_CONSTANT "INJCRV_STPIIRLSOPRNG53_MAP_Y" "10"
 SYSTEM_CONSTANT "INJCRV_STRLSGEAR1_CUR_X" "3"
 SYSTEM_CONSTANT "INJCRV_STRLSGEAR2_CUR_X" "3"
 SYSTEM_CONSTANT "INJCRV_STRLSGEAR3_CUR_X" "3"
 SYSTEM_CONSTANT "INJCRV_STRLSGEAR4_CUR_X" "3"
 SYSTEM_CONSTANT "INJCRV_STRLSGEAR5_CUR_X" "3"
 SYSTEM_CONSTANT "INJCRV_STRLSOPRNGTHRES1_MAP_X" "16"
 SYSTEM_CONSTANT "INJCRV_STRLSOPRNGTHRES1_MAP_Y" "16"
 SYSTEM_CONSTANT "INJCRV_STRLSOPRNGTHRES2_MAP_X" "16"
 SYSTEM_CONSTANT "INJCRV_STRLSOPRNGTHRES2_MAP_Y" "16"
 SYSTEM_CONSTANT "INJCRV_STRLSOPRNGTHRESRGN_MAP_X" "16"
 SYSTEM_CONSTANT "INJCRV_STRLSOPRNGTHRESRGN_MAP_Y" "16"
 SYSTEM_CONSTANT "INJCRV_SWTRLSOPRNGTHRES_MAP_X" "18"
 SYSTEM_CONSTANT "INJCRV_SWTRLSOPRNGTHRES_MAP_Y" "20"
 SYSTEM_CONSTANT "INJCRV_SWTTIPSE_TYPE" "2"
 SYSTEM_CONSTANT "INJCRV_SWTTIPSE_VAL" "0"
 SYSTEM_CONSTANT "INJCRV_TADDCORHIGH_CUR_X" "12"
 SYSTEM_CONSTANT "INJCRV_TADDCORLOW_CUR_X" "12"
 SYSTEM_CONSTANT "INJCRV_TIPII1APSCOR_MAP_X" "16"
 SYSTEM_CONSTANT "INJCRV_TIPII1APSCOR_MAP_Y" "8"
 SYSTEM_CONSTANT "INJCRV_TIPII1BAS1_MAP_X" "12"
 SYSTEM_CONSTANT "INJCRV_TIPII1BAS1_MAP_Y" "16"
 SYSTEM_CONSTANT "INJCRV_TIPII1BAS2_MAP_X" "12"
 SYSTEM_CONSTANT "INJCRV_TIPII1BAS2_MAP_Y" "16"
 SYSTEM_CONSTANT "INJCRV_TIPII1BAS3_MAP_X" "12"
 SYSTEM_CONSTANT "INJCRV_TIPII1BAS3_MAP_Y" "16"
 SYSTEM_CONSTANT "INJCRV_TIPII1ETSCOR_MAP_X" "16"
 SYSTEM_CONSTANT "INJCRV_TIPII1ETSCOR_MAP_Y" "8"
 SYSTEM_CONSTANT "INJCRV_TIPII1ETSRGNCOR_MAP_X" "12"
 SYSTEM_CONSTANT "INJCRV_TIPII1ETSRGNCOR_MAP_Y" "12"
 SYSTEM_CONSTANT "INJCRV_TIPII1RGNBAS1_MAP_X" "12"
 SYSTEM_CONSTANT "INJCRV_TIPII1RGNBAS1_MAP_Y" "12"
 SYSTEM_CONSTANT "INJCRV_TIPII2BAS_MAP_X" "12"
 SYSTEM_CONSTANT "INJCRV_TIPII2BAS_MAP_Y" "16"
 SYSTEM_CONSTANT "INJCRV_TIPII2ETSCOR_MAP_X" "16"
 SYSTEM_CONSTANT "INJCRV_TIPII2ETSCOR_MAP_Y" "8"
 SYSTEM_CONSTANT "INJCRV_TIPOI2ATSCOR_MAP_X" "16"
 SYSTEM_CONSTANT "INJCRV_TIPOI2ATSCOR_MAP_Y" "8"
 SYSTEM_CONSTANT "INJCRV_TIPOI2BAS_MAP_X" "10"
 SYSTEM_CONSTANT "INJCRV_TIPOI2BAS_MAP_Y" "10"
 SYSTEM_CONSTANT "INJCRV_TIPOI2ETSCOR_MAP_X" "16"
 SYSTEM_CONSTANT "INJCRV_TIPOI2ETSCOR_MAP_Y" "8"
 SYSTEM_CONSTANT "INJCRV_TIPOI2MAX_MAP_X" "2"
 SYSTEM_CONSTANT "INJCRV_TIPOI2MAX_MAP_Y" "2"
 SYSTEM_CONSTANT "INJCRV_TIPSE_CONST" "0"
 SYSTEM_CONSTANT "INJCRV_TIPSE_UPD" "1"
 SYSTEM_CONSTANT "INJCTL_QLIMERR_CUR_X" "25"
 SYSTEM_CONSTANT "INJTIME_MS2US_RES" "10"
 SYSTEM_CONSTANT "INJTIME_MS_RES" "0.01"
 SYSTEM_CONSTANT "INJTIME_MS_ZERO" "0"
 SYSTEM_CONSTANT "INJTIME_US_2_TIME_BUSY_FAC" "10"
 SYSTEM_CONSTANT "INJTIME_US_RES" "1"
 SYSTEM_CONSTANT "INJTIME_US_S16_MAX" "327.67"
 SYSTEM_CONSTANT "INJTIME_US_S16_MIN" "-327.67"
 SYSTEM_CONSTANT "INJTIME_US_ZERO" "0"
 SYSTEM_CONSTANT "INJUN_FACFLMASSCNV_MAP_X" "16"
 SYSTEM_CONSTANT "INJUN_FACFLMASSCNV_MAP_Y" "16"
 SYSTEM_CONSTANT "INJUN_MI" "2"
 SYSTEM_CONSTANT "INJUN_MI1" "2"
 SYSTEM_CONSTANT "INJUN_MI2" "3"
 SYSTEM_CONSTANT "INJUN_PHI_INVALID" "32767"
 SYSTEM_CONSTANT "INJUN_PII1" "4"
 SYSTEM_CONSTANT "INJUN_PII2" "5"
 SYSTEM_CONSTANT "INJUN_PII3" "6"
 SYSTEM_CONSTANT "INJUN_POI1" "0"
 SYSTEM_CONSTANT "INJUN_POI2" "1"
 SYSTEM_CONSTANT "INJUN_POI2EFF" "8"
 SYSTEM_CONSTANT "INJUN_ZFC" "9"
 SYSTEM_CONSTANT "INJVCD_BP_RCY_TST_AMPL" "7"
 SYSTEM_CONSTANT "INJVCD_BP_RCY_TST_CFG" "3"
 SYSTEM_CONSTANT "INJVCD_BP_RCY_TST_CLK" "5"
 SYSTEM_CONSTANT "INJVCD_BP_RCY_TST_DRVTIME" "4"
 SYSTEM_CONSTANT "INJVCD_BP_RCY_TST_RAM" "6"
 SYSTEM_CONSTANT "INJVCD_FKTCLSLN_CUR_X" "21"
 SYSTEM_CONSTANT "INJVCD_MI1" "6"
 SYSTEM_CONSTANT "INJVCD_MI1PII1" "7"
 SYSTEM_CONSTANT "INJVCD_MI1PII1PII2" "8"
 SYSTEM_CONSTANT "INJVCD_MI1PII1PII3" "9"
 SYSTEM_CONSTANT "INJVCD_MI1_ESTET" "3"
 SYSTEM_CONSTANT "INJVCD_PII1" "10"
 SYSTEM_CONSTANT "INJVCD_PII1PII2" "11"
 SYSTEM_CONSTANT "INJVCD_PII1_ESTET" "0"
 SYSTEM_CONSTANT "INJVCD_PII2" "12"
 SYSTEM_CONSTANT "INJVCD_PII2_ESTET" "1"
 SYSTEM_CONSTANT "INJVCD_PII3" "13"
 SYSTEM_CONSTANT "INJVCD_PII3_ESTET" "2"
 SYSTEM_CONSTANT "INJVCD_POI1" "14"
 SYSTEM_CONSTANT "INJVCD_POI1_ESTET" "4"
 SYSTEM_CONSTANT "INJVCD_POI2" "15"
 SYSTEM_CONSTANT "INJVCD_POI2_ESTET" "5"
 SYSTEM_CONSTANT "INJVCD_RETTEMPCOR_MAP_X" "8"
 SYSTEM_CONSTANT "INJVCD_RETTEMPCOR_MAP_Y" "8"
 SYSTEM_CONSTANT "INJVCD_SWTSELTEMP_ACTR" "2"
 SYSTEM_CONSTANT "INJVCD_SWTSELTEMP_CLNT" "0"
 SYSTEM_CONSTANT "INJVCD_SWTSELTEMP_FUEL" "1"
 SYSTEM_CONSTANT "INJVCD_SWTSELTEMP_TYPE" "2"
 SYSTEM_CONSTANT "INJVCD_SWTSELTEMP_VAL" "0"
 SYSTEM_CONSTANT "INJVCD_TACTR_CUR_X" "4"
 SYSTEM_CONSTANT "INJVCD_TIET2_MAP_X" "17"
 SYSTEM_CONSTANT "INJVCD_TIET2_MAP_Y" "20"
 SYSTEM_CONSTANT "INJVCD_TIET3_MAP_X" "17"
 SYSTEM_CONSTANT "INJVCD_TIET3_MAP_Y" "20"
 SYSTEM_CONSTANT "INJVCD_TIET4_MAP_X" "17"
 SYSTEM_CONSTANT "INJVCD_TIET4_MAP_Y" "20"
 SYSTEM_CONSTANT "INJVCD_TIET5_MAP_X" "17"
 SYSTEM_CONSTANT "INJVCD_TIET5_MAP_Y" "20"
 SYSTEM_CONSTANT "INJVCD_TIET6_MAP_X" "17"
 SYSTEM_CONSTANT "INJVCD_TIET6_MAP_Y" "20"
 SYSTEM_CONSTANT "INJVCD_TIETTEMPCOR_MAP_X" "8"
 SYSTEM_CONSTANT "INJVCD_TIETTEMPCOR_MAP_Y" "8"
 SYSTEM_CONSTANT "INJVCD_TIET_MAP_X" "17"
 SYSTEM_CONSTANT "INJVCD_TIET_MAP_Y" "20"
 SYSTEM_CONSTANT "INJVCD_TIPICKUPCURR_CUR_X" "2"
 SYSTEM_CONSTANT "INJVCD_UACTRLIN_CUR_X" "2"
 SYSTEM_CONSTANT "INJVCD_UBUFCLIN_CUR_X" "2"
 SYSTEM_CONSTANT "INJVCD_UCHRGACTRLIN_CUR_X" "2"
 SYSTEM_CONSTANT "INJVCD_UCY370LIN_CUR_X" "2"
 SYSTEM_CONSTANT "INJVLV_ERRMAX" "32"
 SYSTEM_CONSTANT "INJVLV_FACADDBALRLS_MAP_X" "4"
 SYSTEM_CONSTANT "INJVLV_FACADDBALRLS_MAP_Y" "4"
 SYSTEM_CONSTANT "INJVLV_FACCLSVLTGADJ_CA_X" "32"
 SYSTEM_CONSTANT "INJVLV_FACFTSWVCOR_MAP_X" "19"
 SYSTEM_CONSTANT "INJVLV_FACFTSWVCOR_MAP_Y" "8"
 SYSTEM_CONSTANT "INJVLV_FACPCORQ_CUR_X" "8"
 SYSTEM_CONSTANT "INJVLV_FACPCORTI_CUR_X" "16"
 SYSTEM_CONSTANT "INJVLV_FACPII1QNTCOR_CUR_X" "10"
 SYSTEM_CONSTANT "INJVLV_FACPRESVLTGADJ_CUR_X" "10"
 SYSTEM_CONSTANT "INJVLV_FACVOLTCOR_MAP_X" "16"
 SYSTEM_CONSTANT "INJVLV_FACVOLTCOR_MAP_Y" "10"
 SYSTEM_CONSTANT "INJVLV_FACWVCOR1_MAP_X" "20"
 SYSTEM_CONSTANT "INJVLV_FACWVCOR1_MAP_Y" "20"
 SYSTEM_CONSTANT "INJVLV_FACWVCOR2_MAP_X" "20"
 SYSTEM_CONSTANT "INJVLV_FACWVCOR2_MAP_Y" "20"
 SYSTEM_CONSTANT "INJVLV_IDCDC_CUR_X" "8"
 SYSTEM_CONSTANT "INJVLV_NUMINJCHRGBAL_MAP_X" "16"
 SYSTEM_CONSTANT "INJVLV_NUMINJCHRGBAL_MAP_Y" "16"
 SYSTEM_CONSTANT "INJVLV_PCORBASE_CUR_X" "6"
 SYSTEM_CONSTANT "INJVLV_PMIN_CUR_X" "8"
 SYSTEM_CONSTANT "INJVLV_QWVCOR1_MAP_X" "32"
 SYSTEM_CONSTANT "INJVLV_QWVCOR1_MAP_Y" "8"
 SYSTEM_CONSTANT "INJVLV_QWVCOR2_MAP_X" "80"
 SYSTEM_CONSTANT "INJVLV_QWVCOR2_MAP_Y" "16"
 SYSTEM_CONSTANT "INJVLV_QWVCOR3_MAP_X" "16"
 SYSTEM_CONSTANT "INJVLV_QWVCOR3_MAP_Y" "16"
 SYSTEM_CONSTANT "INJVLV_QWVCORNORM_CUR_X" "20"
 SYSTEM_CONSTANT "INJVLV_SELPRESS_PEAK" "1"
 SYSTEM_CONSTANT "INJVLV_SELPRESS_SETPOINT" "0"
 SYSTEM_CONSTANT "INJVLV_STQNTADJ_MAP_X" "8"
 SYSTEM_CONSTANT "INJVLV_STQNTADJ_MAP_Y" "8"
 SYSTEM_CONSTANT "INJVLV_STWVCORDISBL" "0"
 SYSTEM_CONSTANT "INJVLV_STWVCORENA" "1"
 SYSTEM_CONSTANT "INJVLV_SWTSELPRESS_TYPE" "2"
 SYSTEM_CONSTANT "INJVLV_SWTSELPRESS_VAL" "0"
 SYSTEM_CONSTANT "INJVLV_TIDIFFHYD_MAP_X" "16"
 SYSTEM_CONSTANT "INJVLV_TIDIFFHYD_MAP_Y" "16"
 SYSTEM_CONSTANT "INJVLV_TWVCOR_MAP_X" "16"
 SYSTEM_CONSTANT "INJVLV_TWVCOR_MAP_Y" "16"
 SYSTEM_CONSTANT "INJVLV_UDIFFNVCSET_CUR_X" "20"
 SYSTEM_CONSTANT "INJVLV_USETOFFSCALC_CUR_X" "25"
 SYSTEM_CONSTANT "INJVLV_USETUPPRESS_CUR_X" "3"
 SYSTEM_CONSTANT "INJVLV_WINJ_CUR_X" "2"
 SYSTEM_CONSTANT "INJ_MASSCORR_RES" "0.001"
 SYSTEM_CONSTANT "INJ_MASSCYC_MAX" "327.67"
 SYSTEM_CONSTANT "INJ_MASSCYC_MIN" "0"
 SYSTEM_CONSTANT "INJ_MASSCYC_RES" "0.01"
 SYSTEM_CONSTANT "INJ_MASSCYC_RES_INV" "100"
 SYSTEM_CONSTANT "INJ_MASSCYC_ZERO" "0"
 SYSTEM_CONSTANT "INJ_MASSINJ_MAX" "327.67"
 SYSTEM_CONSTANT "INJ_MASSINJ_MIN" "0"
 SYSTEM_CONSTANT "INJ_MASSINJ_ONE" "1"
 SYSTEM_CONSTANT "INJ_MASSINJ_RES" "0.01"
 SYSTEM_CONSTANT "INJ_MASSINJ_RES_INV" "100"
 SYSTEM_CONSTANT "INJ_MASSINJ_ZERO" "0"
 SYSTEM_CONSTANT "INJ_MASSMIN_MAX" "10"
 SYSTEM_CONSTANT "INJ_MASSNSLP_RES" "0.0001"
 SYSTEM_CONSTANT "INJ_MASSPII1_MAX" "10"
 SYSTEM_CONSTANT "INJ_MASSPII2_MAX" "10"
 SYSTEM_CONSTANT "INJ_MASSPII3_MAX" "10"
 SYSTEM_CONSTANT "INJ_MASSPOI1_MAX" "10"
 SYSTEM_CONSTANT "INJ_MASSPOI2_MAX" "10"
 SYSTEM_CONSTANT "INJ_MASSQSLP_RES" "0.01"
 SYSTEM_CONSTANT "INJ_MASS_2_RMP_INJ_MASS_LOW" "100000"
 SYSTEM_CONSTANT "INJ_MASS_MAX" "327.67"
 SYSTEM_CONSTANT "INJ_MASS_MIN" "0"
 SYSTEM_CONSTANT "INJ_MASS_MIN_LMBD" "0.1"
 SYSTEM_CONSTANT "INJ_MASS_RES" "0.01"
 SYSTEM_CONSTANT "INJ_MASS_RES_FL" "0.01"
 SYSTEM_CONSTANT "INJ_MASS_RES_FLOAT" "0.01"
 SYSTEM_CONSTANT "INJ_MASS_RES_INV" "100"
 SYSTEM_CONSTANT "INJ_MASS_ZERO" "0"
 SYSTEM_CONSTANT "INJ_QNTINJ_MAX" "100"
 SYSTEM_CONSTANT "INJ_QNTINJ_MIN" "0"
 SYSTEM_CONSTANT "INJ_QNTINJ_RES" "0.01"
 SYSTEM_CONSTANT "INJ_QNTINJ_ZERO" "0"
 SYSTEM_CONSTANT "INJ_QNT_RES" "0.1"
 SYSTEM_CONSTANT "INJ_SYS" "1"
 SYSTEM_CONSTANT "INPUT_FREQ" "55944"
 SYSTEM_CONSTANT "INTAMP_FAC_RES" "0.001"
 SYSTEM_CONSTANT "INT_MAX" "5"
 SYSTEM_CONSTANT "IVCTL_ICHRGUP_CUR_X" "25"
 SYSTEM_CONSTANT "IVCTL_IDISCHDWN_CUR_X" "25"
 SYSTEM_CONSTANT "IVCTL_TICHRGSETUP_CUR_X" "4"
 SYSTEM_CONSTANT "IVCTL_TIDISCHSETDWN_CUR_X" "4"
 SYSTEM_CONSTANT "IVCTL_USETUPPRECTL_CUR_X" "20"
 SYSTEM_CONSTANT "I_COIL_MAX" "5000"
 SYSTEM_CONSTANT "I_COIL_MIN" "0"
 SYSTEM_CONSTANT "JUL_RES" "0.1"
 SYSTEM_CONSTANT "KDINJMASS32TO15_FACT" "6"
 SYSTEM_CONSTANT "KD_1_MAX" "50"
 SYSTEM_CONSTANT "KD_1_NRM" "7"
 SYSTEM_CONSTANT "KD_LIN_16_RES" "32767"
 SYSTEM_CONSTANT "KD_PRAIL2Q_1_MAX" "0.5"
 SYSTEM_CONSTANT "KD_PRAIL2Q_1_NRM" "4"
 SYSTEM_CONSTANT "KD_RES16_REV" "1024"
 SYSTEM_CONSTANT "KD_RES16_REV_FL" "1024"
 SYSTEM_CONSTANT "KD_RES_REV" "65536"
 SYSTEM_CONSTANT "KD_RPM2NM_2_NRM" "4"
 SYSTEM_CONSTANT "KFACT_MAX" "1"
 SYSTEM_CONSTANT "KFACT_MIN" "0"
 SYSTEM_CONSTANT "KIAMPC32TO15_FACT" "3"
 SYSTEM_CONSTANT "KI_1_MAX" "250"
 SYSTEM_CONSTANT "KI_1_NRM" "6"
 SYSTEM_CONSTANT "KI_LMBD2PRC_MAX" "1000"
 SYSTEM_CONSTANT "KI_LMBD2PRC_NRM" "4"
 SYSTEM_CONSTANT "KI_PRAIL2Q_1_MAX" "2"
 SYSTEM_CONSTANT "KI_PRAIL2Q_1_NRM" "2"
 SYSTEM_CONSTANT "KI_RES_REV" "4294.967296"
 SYSTEM_CONSTANT "KI_RPM2NM_2_NRM" "4"
 SYSTEM_CONSTANT "Ki_TRQ" "1"
 SYSTEM_CONSTANT "Ki_TRQ2" "1"
 SYSTEM_CONSTANT "KOHMMULTUF2MS" "100"
 SYSTEM_CONSTANT "KPAMPC32TO15_FACT" "8"
 SYSTEM_CONSTANT "KP_1_MAX" "300"
 SYSTEM_CONSTANT "KP_1_NRM" "10"
 SYSTEM_CONSTANT "KP_LMBD2PRC_MAX" "500"
 SYSTEM_CONSTANT "KP_LMBD2PRC_NRM" "7"
 SYSTEM_CONSTANT "KP_LMBDREC2INJMASS_1_MAX" "250"
 SYSTEM_CONSTANT "KP_LMBDREC2INJMASS_1_NRM" "3"
 SYSTEM_CONSTANT "KP_LMBDREC2INJMASS_2_MAX" "250"
 SYSTEM_CONSTANT "KP_LMBDREC2INJMASS_2_NRM" "3"
 SYSTEM_CONSTANT "KP_PRAIL2Q_1_MAX" "0.2"
 SYSTEM_CONSTANT "KP_PRAIL2Q_1_NRM" "3"
 SYSTEM_CONSTANT "KP_RES_REV" "65536"
 SYSTEM_CONSTANT "KP_RPM2NM_2_NRM" "5"
 SYSTEM_CONSTANT "LAMBDAREC_RES" "0.0001"
 SYSTEM_CONSTANT "LAMBDAREC_RESVAL" "0.001"
 SYSTEM_CONSTANT "LAMBDAREC_RESVAL_FL" "0.001"
 SYSTEM_CONSTANT "LAMBDAREC_RESVAL_REV" "1000"
 SYSTEM_CONSTANT "LAMBDAREC_RES_REV" "10000"
 SYSTEM_CONSTANT "LAMBDAREC_ZERO" "0"
 SYSTEM_CONSTANT "LAMBDATEMP_RES_REV" "1000"
 SYSTEM_CONSTANT "LAMBDA_INJMASS_RES" "1450"
 SYSTEM_CONSTANT "LAMBDA_MAX" "30"
 SYSTEM_CONSTANT "LAMBDA_RES" "0.001"
 SYSTEM_CONSTANT "LAMBDA_RES2LAMBDAREC_RES" "10"
 SYSTEM_CONSTANT "LAMBDA_RES_INV" "1000"
 SYSTEM_CONSTANT "LAMBDA_RES_REV" "1000"
 SYSTEM_CONSTANT "LAMBDA_ZERO" "0"
 SYSTEM_CONSTANT "LENGTH1_RES" "0.002"
 SYSTEM_CONSTANT "LENGTH1_RES_REV" "500"
 SYSTEM_CONSTANT "LENGTH_RES" "1"
 SYSTEM_CONSTANT "LEVEL_MAX" "2"
 SYSTEM_CONSTANT "LIGOV_NCLTAIRP_MAP_X" "5"
 SYSTEM_CONSTANT "LIGOV_NCLTAIRP_MAP_Y" "4"
 SYSTEM_CONSTANT "LIGOV_NCORRFAC" "7"
 SYSTEM_CONSTANT "LIGOV_NREV_CUR_X" "25"
 SYSTEM_CONSTANT "LIGOV_NSETPOINTDAWAY_CUR_X" "4"
 SYSTEM_CONSTANT "LIGOV_NSETPOINTINIT_CUR_X" "25"
 SYSTEM_CONSTANT "LIGOV_NSETPOINTWARM_CUR_X" "4"
 SYSTEM_CONSTANT "LIGOV_NTEMP1_MAP_X" "2"
 SYSTEM_CONSTANT "LIGOV_NTEMP1_MAP_Y" "4"
 SYSTEM_CONSTANT "LIGOV_NTEMP2RGN_CUR_X" "15"
 SYSTEM_CONSTANT "LIGOV_NTEMP2_CUR_X" "25"
 SYSTEM_CONSTANT "LIGOV_PARDRIVEOFF_NOTUSED" "0"
 SYSTEM_CONSTANT "LIGOV_PARDRIVEOFF_USED" "1"
 SYSTEM_CONSTANT "LIGOV_SWTPARDRIVEOFF_TYPE" "0"
 SYSTEM_CONSTANT "LIGOV_SWTPARDRIVEOFF_VAL" "1"
 SYSTEM_CONSTANT "LIGOV_TRQINITI_CUR_X" "25"
 SYSTEM_CONSTANT "LMBDFACT_MAX" "4"
 SYSTEM_CONSTANT "LMBDFACT_MIN" "0"
 SYSTEM_CONSTANT "LMBD_SENS_AFT_TRBN" "0"
 SYSTEM_CONSTANT "LMBD_SENS_AFT_TRBN1" "1"
 SYSTEM_CONSTANT "LMBD_SENS_AFT_TRBN2" "2"
 SYSTEM_CONSTANT "LOOP_CLOSED" "1"
 SYSTEM_CONSTANT "LOOP_OPENED" "0"
 SYSTEM_CONSTANT "LSUCD_CT_ARRAY" "1"
 SYSTEM_CONSTANT "LSUCD_CT_EDC" "1"
 SYSTEM_CONSTANT "LSUCD_CT_SENSORS" "1"
 SYSTEM_CONSTANT "LSUCD_FCTRPCOMP_CUR_X" "10"
 SYSTEM_CONSTANT "LSUCD_RLMBDREC_CUR_X" "15"
 SYSTEM_CONSTANT "LSUCD_RO2_CUR_X" "15"
 SYSTEM_CONSTANT "LSUCD_SWTADPT_DISABLED" "0"
 SYSTEM_CONSTANT "LSUCD_SWTADPT_ENABLED" "1"
 SYSTEM_CONSTANT "LSUCD_SWTADPT_TYPE" "2"
 SYSTEM_CONSTANT "LSUCD_SWTADPT_VAL" "0"
 SYSTEM_CONSTANT "LSUCD_TEMPRI_CUR_X" "16"
 SYSTEM_CONSTANT "LSUCTL_DCYCSTRT_CUR_X" "5"
 SYSTEM_CONSTANT "LSU_SWT_DISABLED" "0"
 SYSTEM_CONSTANT "LSU_SWT_ENABLED" "1"
 SYSTEM_CONSTANT "LSU_SWT_TYPE" "2"
 SYSTEM_CONSTANT "LSU_SWT_VAL" "0"
 SYSTEM_CONSTANT "MAXSINT16" "32767"
 SYSTEM_CONSTANT "MAXSINT32" "2147483647"
 SYSTEM_CONSTANT "MAXUINT16" "65535"
 SYSTEM_CONSTANT "MAXUINT32" "4294967295"
 SYSTEM_CONSTANT "MAXUINT8" "255"
 SYSTEM_CONSTANT "MAX_MAP" "6"
 SYSTEM_CONSTANT "MEUNCD_DCYCSETVALLIN_CUR_X" "4"
 SYSTEM_CONSTANT "MEUNCD_FACIGOVINIT_CUR_X" "6"
 SYSTEM_CONSTANT "MEUNCD_ILIN_CUR_X" "2"
 SYSTEM_CONSTANT "MEUNCD_TIPER_CUR_X" "30"
 SYSTEM_CONSTANT "MEUN_ICNVFLOWRATE_CUR_X" "10"
 SYSTEM_CONSTANT "MILLI_FAC" "1"
 SYSTEM_CONSTANT "MILLI_RES" "4e-05"
 SYSTEM_CONSTANT "MILLI_ZERO" "0"
 SYSTEM_CONSTANT "MINSINT16" "-32768"
 SYSTEM_CONSTANT "MINSINT32" "-2147483648"
 SYSTEM_CONSTANT "MINUS_ONE" "-1"
 SYSTEM_CONSTANT "MLTOL_RES" "0.01"
 SYSTEM_CONSTANT "MLTOL_RES_NORM" "20"
 SYSTEM_CONSTANT "MNELEM_VBATAVRG" "1"
 SYSTEM_CONSTANT "MODE6_SUBTST_NUM" "10"
 SYSTEM_CONSTANT "MOMENT_INERTIA_RES" "100"
 SYSTEM_CONSTANT "MS2US" "1000"
 SYSTEM_CONSTANT "MSDIVKOHM2UF" "100"
 SYSTEM_CONSTANT "MS_ANGLE_CLS_RES" "390.625"
 SYSTEM_CONSTANT "MS_MASTER_ECU" "0"
 SYSTEM_CONSTANT "MS_SINGLE_ECU" "255"
 SYSTEM_CONSTANT "MS_SLAVE1_ECU" "1"
 SYSTEM_CONSTANT "MS_SLAVE2_ECU" "2"
 SYSTEM_CONSTANT "MS_SLAVE3_ECU" "3"
 SYSTEM_CONSTANT "MS_SLAVE4_ECU" "4"
 SYSTEM_CONSTANT "MXELEM_VBATAVRG" "10"
 SYSTEM_CONSTANT "M_ASH_MAX" "300"
 SYSTEM_CONSTANT "M_ASH_RES" "1.52587890625e-07"
 SYSTEM_CONSTANT "M_ASH_RES1" "0.1"
 SYSTEM_CONSTANT "M_ASH_RES1_REV" "10"
 SYSTEM_CONSTANT "M_ASH_RES_REV" "6553600"
 SYSTEM_CONSTANT "NODES_CTLCHC_PRAIL" "0"
 SYSTEM_CONSTANT "NODES_CTLCHC_TACTR" "0"
 SYSTEM_CONSTANT "NODES_CTLCHC_UBST" "0"
 SYSTEM_CONSTANT "NORM_CALC_DI" "64000"
 SYSTEM_CONSTANT "NORM_CALC_IVIR" "100000"
 SYSTEM_CONSTANT "NORM_CALC_MVMR" "10000"
 SYSTEM_CONSTANT "NORM_DVOLPERSTRK_X_N" "3333.33333333333"
 SYSTEM_CONSTANT "NORM_DVOL_X_DT" "360000"
 SYSTEM_CONSTANT "NORM_ETA_BY_FTRM" "128"
 SYSTEM_CONSTANT "NORM_ETA_X_ETA" "128"
 SYSTEM_CONSTANT "NORM_FAC_EQU" "10"
 SYSTEM_CONSTANT "NORM_FLCONS2" "360000"
 SYSTEM_CONSTANT "NORM_L2UL" "1000000"
 SYSTEM_CONSTANT "NORM_MS2US" "1000"
 SYSTEM_CONSTANT "NORM_N_X_R" "100"
 SYSTEM_CONSTANT "NORM_PRPTRQ2ENGTRQ" "10"
 SYSTEM_CONSTANT "NORM_PWRACS" "900"
 SYSTEM_CONSTANT "NORM_PWRENG" "900"
 SYSTEM_CONSTANT "NORM_PWRPRP" "90"
 SYSTEM_CONSTANT "NORM_PWR_BY_ETA" "128"
 SYSTEM_CONSTANT "NORM_Q_BY_FAC" "8192"
 SYSTEM_CONSTANT "NORM_Q_BY_RHO" "1000"
 SYSTEM_CONSTANT "NORM_Q_X_ETA" "1280"
 SYSTEM_CONSTANT "NORM_RMP_CORR_RES" "23592.96"
 SYSTEM_CONSTANT "NORM_RMP_C_RES" "65536"
 SYSTEM_CONSTANT "NORM_R_X_R" "100"
 SYSTEM_CONSTANT "NORM_R_X_TRQ" "100"
 SYSTEM_CONSTANT "NORM_TRQ2PRC_CAN" "254.999910750031"
 SYSTEM_CONSTANT "NORM_TRQ2TRQPRP" "1000"
 SYSTEM_CONSTANT "NORM_TRQACS" "900"
 SYSTEM_CONSTANT "NORM_TRQPRP" "90"
 SYSTEM_CONSTANT "NORM_TRQPRP2PRC_CAN" "2549.99910750031"
 SYSTEM_CONSTANT "NORM_TRQ_BY_ETA" "1280"
 SYSTEM_CONSTANT "NORM_TRQ_BY_Q" "1280"
 SYSTEM_CONSTANT "NORM_TRQ_INERTIA" "100"
 SYSTEM_CONSTANT "NORM_TRQ_X_FAC" "8192"
 SYSTEM_CONSTANT "NUM_INJ_MAX" "6"
 SYSTEM_CONSTANT "NUM_MAX_FBC_SEG" "8"
 SYSTEM_CONSTANT "NUM_POINT" "8"
 SYSTEM_CONSTANT "NUM_POLAR_MAX" "3"
 SYSTEM_CONSTANT "NUM_POLAR_MIN" "0"
 SYSTEM_CONSTANT "O2MPT_RES" "0.01"
 SYSTEM_CONSTANT "O2MPT_RES_FL" "0.01"
 SYSTEM_CONSTANT "O2_NORM" "0.21"
 SYSTEM_CONSTANT "O2_NORM_INV" "4.773"
 SYSTEM_CONSTANT "O2_RES" "1e-05"
 SYSTEM_CONSTANT "O2_RES_FL" "1e-05"
 SYSTEM_CONSTANT "O2_RES_REV" "100000"
 SYSTEM_CONSTANT "O2_RMASS_AIR" "0.2314975"
 SYSTEM_CONSTANT "O2_RMASS_AIR_FL" "0.2314975"
 SYSTEM_CONSTANT "O2_RVOL_AIR" "0.2095"
 SYSTEM_CONSTANT "O2_THRES1_ADD" "0.063"
 SYSTEM_CONSTANT "O2_THRES1_FAC" "0.7"
 SYSTEM_CONSTANT "O2_THRES2_ADD" "0.126"
 SYSTEM_CONSTANT "O2_THRES2_FAC" "0.4"
 SYSTEM_CONSTANT "ONE" "1"
 SYSTEM_CONSTANT "OTSCD_SWTSIG_TYPE" "2"
 SYSTEM_CONSTANT "OTSCD_SWTSIG_VAL" "0"
 SYSTEM_CONSTANT "OTSCD_TFLCNSMPCORCOR_CUR_X" "5"
 SYSTEM_CONSTANT "OTSCD_TIATSCOR_CUR_X" "5"
 SYSTEM_CONSTANT "OTSCD_TLIN_CUR_X" "25"
 SYSTEM_CONSTANT "OTSCD_TOIL_CUR_X" "13"
 SYSTEM_CONSTANT "OVRMON_FACBATTCOR_CUR_X" "4"
 SYSTEM_CONSTANT "OVRMON_FACINJEFF_CUR_X" "16"
 SYSTEM_CONSTANT "OVRMON_FACINJEFF_CUR_Y" "16"
 SYSTEM_CONSTANT "OVRMON_MTRQLIM_CUR_X" "16"
 SYSTEM_CONSTANT "OVRMON_QLIMENH_CUR_X" "25"
 SYSTEM_CONSTANT "OVRMON_TILIMET_CUR_X" "16"
 SYSTEM_CONSTANT "OXICCD_TLINPRE_CUR_X" "25"
 SYSTEM_CONSTANT "PCR_CURLIM" "0"
 SYSTEM_CONSTANT "PCR_DT1_MAP_X" "10"
 SYSTEM_CONSTANT "PCR_DT1_MAP_Y" "10"
 SYSTEM_CONSTANT "PCR_FACAT_CUR_X" "16"
 SYSTEM_CONSTANT "PCR_FACBALGVNRCORR_MAP_X" "9"
 SYSTEM_CONSTANT "PCR_FACBALGVNRCORR_MAP_Y" "9"
 SYSTEM_CONSTANT "PCR_FACBALGVNRI_MAP_X" "9"
 SYSTEM_CONSTANT "PCR_FACBALGVNRI_MAP_Y" "9"
 SYSTEM_CONSTANT "PCR_FACBALGVNRP_MAP_X" "9"
 SYSTEM_CONSTANT "PCR_FACBALGVNRP_MAP_Y" "9"
 SYSTEM_CONSTANT "PCR_FACBPALTCORR2_MAP_X" "10"
 SYSTEM_CONSTANT "PCR_FACBPALTCORR2_MAP_Y" "10"
 SYSTEM_CONSTANT "PCR_FACBPALTCORR_CUR_X" "10"
 SYSTEM_CONSTANT "PCR_FACBPALTCORR_MAP_X" "10"
 SYSTEM_CONSTANT "PCR_FACBPALTCORR_MAP_Y" "10"
 SYSTEM_CONSTANT "PCR_FACBPRDMCORR_MAP_X" "10"
 SYSTEM_CONSTANT "PCR_FACBPRDMCORR_MAP_Y" "10"
 SYSTEM_CONSTANT "PCR_FACCTLAT_CUR_X" "25"
 SYSTEM_CONSTANT "PCR_FACCTLRGN1_CUR_X" "16"
 SYSTEM_CONSTANT "PCR_FACCTLRGN2_CUR_X" "16"
 SYSTEM_CONSTANT "PCR_FACCTLRGN3_CUR_X" "16"
 SYSTEM_CONSTANT "PCR_FACCTLRGN4_CUR_X" "16"
 SYSTEM_CONSTANT "PCR_FACCTQ_MAP_X" "8"
 SYSTEM_CONSTANT "PCR_FACCTQ_MAP_Y" "8"
 SYSTEM_CONSTANT "PCR_FACDESRGN1_CUR_X" "16"
 SYSTEM_CONSTANT "PCR_FACDESRGN2_CUR_X" "16"
 SYSTEM_CONSTANT "PCR_FACDESRGN3_CUR_X" "16"
 SYSTEM_CONSTANT "PCR_FACDESRGN4_CUR_X" "16"
 SYSTEM_CONSTANT "PCR_FACDT1_MAP_X" "10"
 SYSTEM_CONSTANT "PCR_FACDT1_MAP_Y" "10"
 SYSTEM_CONSTANT "PCR_FACD_MAP_X" "10"
 SYSTEM_CONSTANT "PCR_FACD_MAP_Y" "10"
 SYSTEM_CONSTANT "PCR_FACI_MAP_X" "10"
 SYSTEM_CONSTANT "PCR_FACI_MAP_Y" "10"
 SYSTEM_CONSTANT "PCR_FACPALTCORR2_MAP_X" "10"
 SYSTEM_CONSTANT "PCR_FACPALTCORR2_MAP_Y" "10"
 SYSTEM_CONSTANT "PCR_FACPALTCORR_MAP_X" "10"
 SYSTEM_CONSTANT "PCR_FACPALTCORR_MAP_Y" "10"
 SYSTEM_CONSTANT "PCR_FACP_MAP_X" "10"
 SYSTEM_CONSTANT "PCR_FACP_MAP_Y" "10"
 SYSTEM_CONSTANT "PCR_FACTALTCORR_CUR_X" "10"
 SYSTEM_CONSTANT "PCR_MAPLIM" "1"
 SYSTEM_CONSTANT "PCR_NBALGOVDEVMAX_CUR_X" "2"
 SYSTEM_CONSTANT "PCR_NTRBN2_MAP_X" "10"
 SYSTEM_CONSTANT "PCR_NTRBN2_MAP_Y" "10"
 SYSTEM_CONSTANT "PCR_NTRBNMAX_CUR_X" "8"
 SYSTEM_CONSTANT "PCR_NTRBN_MAP_X" "10"
 SYSTEM_CONSTANT "PCR_NTRBN_MAP_Y" "10"
 SYSTEM_CONSTANT "PCR_PAPQCMPN_MAP_X" "9"
 SYSTEM_CONSTANT "PCR_PAPQCMPN_MAP_Y" "9"
 SYSTEM_CONSTANT "PCR_PBDESBAS_MAP_X" "16"
 SYSTEM_CONSTANT "PCR_PBDESBAS_MAP_Y" "10"
 SYSTEM_CONSTANT "PCR_PBDESMAXAP_MAP_X" "16"
 SYSTEM_CONSTANT "PCR_PBDESMAXAP_MAP_Y" "10"
 SYSTEM_CONSTANT "PCR_PBDESRGN1_MAP_X" "10"
 SYSTEM_CONSTANT "PCR_PBDESRGN1_MAP_Y" "10"
 SYSTEM_CONSTANT "PCR_PBDESRGN2_MAP_X" "10"
 SYSTEM_CONSTANT "PCR_PBDESRGN2_MAP_Y" "10"
 SYSTEM_CONSTANT "PCR_PBDESRGN3_MAP_X" "10"
 SYSTEM_CONSTANT "PCR_PBDESRGN3_MAP_Y" "10"
 SYSTEM_CONSTANT "PCR_PBDESRGN4_MAP_X" "10"
 SYSTEM_CONSTANT "PCR_PBDESRGN4_MAP_Y" "10"
 SYSTEM_CONSTANT "PCR_PBDESRGNCOR1_MAP_X" "10"
 SYSTEM_CONSTANT "PCR_PBDESRGNCOR1_MAP_Y" "10"
 SYSTEM_CONSTANT "PCR_PBDESRGNCOR2_MAP_X" "10"
 SYSTEM_CONSTANT "PCR_PBDESRGNCOR2_MAP_Y" "10"
 SYSTEM_CONSTANT "PCR_PBDESRGNCOR3_MAP_X" "10"
 SYSTEM_CONSTANT "PCR_PBDESRGNCOR3_MAP_Y" "10"
 SYSTEM_CONSTANT "PCR_PBDESRGNCOR4_MAP_X" "2"
 SYSTEM_CONSTANT "PCR_PBDESRGNCOR4_MAP_Y" "2"
 SYSTEM_CONSTANT "PCR_PBGDEVMAX_CUR_X" "10"
 SYSTEM_CONSTANT "PCR_PNQCTCMPN_MAP_X" "8"
 SYSTEM_CONSTANT "PCR_PNQCTCMPN_MAP_Y" "8"
 SYSTEM_CONSTANT "PCR_QCTL_QACT" "0"
 SYSTEM_CONSTANT "PCR_QCTL_QRAW" "1"
 SYSTEM_CONSTANT "PCR_QMINBPGOVFLT_CUR_X" "5"
 SYSTEM_CONSTANT "PCR_QNTLIM_NAVRG" "0"
 SYSTEM_CONSTANT "PCR_QRGTOFF1_CUR_X" "2"
 SYSTEM_CONSTANT "PCR_QRGTOFF2_CUR_X" "2"
 SYSTEM_CONSTANT "PCR_QRGTOFF3_CUR_X" "2"
 SYSTEM_CONSTANT "PCR_QRGTOFFRGN_CUR_X" "10"
 SYSTEM_CONSTANT "PCR_QRGTOFF_CUR_X" "25"
 SYSTEM_CONSTANT "PCR_QRGTON1_CUR_X" "2"
 SYSTEM_CONSTANT "PCR_QRGTON2_CUR_X" "2"
 SYSTEM_CONSTANT "PCR_QRGTON3_CUR_X" "2"
 SYSTEM_CONSTANT "PCR_QRGTONRGN_CUR_X" "10"
 SYSTEM_CONSTANT "PCR_QRGTON_CUR_X" "25"
 SYSTEM_CONSTANT "PCR_Q_QCURR" "0"
 SYSTEM_CONSTANT "PCR_Q_QRAW" "1"
 SYSTEM_CONSTANT "PCR_RBALGVNRMAX_MAP_X" "9"
 SYSTEM_CONSTANT "PCR_RBALGVNRMAX_MAP_Y" "9"
 SYSTEM_CONSTANT "PCR_RBALGVNRMIN_MAP_X" "9"
 SYSTEM_CONSTANT "PCR_RBALGVNRMIN_MAP_Y" "9"
 SYSTEM_CONSTANT "PCR_RBALGVNRST_MAP_X" "9"
 SYSTEM_CONSTANT "PCR_RBALGVNRST_MAP_Y" "9"
 SYSTEM_CONSTANT "PCR_RBPALTMAX_MAP_X" "10"
 SYSTEM_CONSTANT "PCR_RBPALTMAX_MAP_Y" "10"
 SYSTEM_CONSTANT "PCR_RBPCTLBAS_MAP_X" "16"
 SYSTEM_CONSTANT "PCR_RBPCTLBAS_MAP_Y" "13"
 SYSTEM_CONSTANT "PCR_RBPCTLRGN1_MAP_X" "10"
 SYSTEM_CONSTANT "PCR_RBPCTLRGN1_MAP_Y" "10"
 SYSTEM_CONSTANT "PCR_RBPCTLRGN2_MAP_X" "10"
 SYSTEM_CONSTANT "PCR_RBPCTLRGN2_MAP_Y" "10"
 SYSTEM_CONSTANT "PCR_RBPCTLRGN3_MAP_X" "10"
 SYSTEM_CONSTANT "PCR_RBPCTLRGN3_MAP_Y" "10"
 SYSTEM_CONSTANT "PCR_RBPCTLRGN4_MAP_X" "10"
 SYSTEM_CONSTANT "PCR_RBPCTLRGN4_MAP_Y" "10"
 SYSTEM_CONSTANT "PCR_RBPCTLRGNCOR1_MAP_X" "10"
 SYSTEM_CONSTANT "PCR_RBPCTLRGNCOR1_MAP_Y" "10"
 SYSTEM_CONSTANT "PCR_RBPCTLRGNCOR2_MAP_X" "10"
 SYSTEM_CONSTANT "PCR_RBPCTLRGNCOR2_MAP_Y" "10"
 SYSTEM_CONSTANT "PCR_RBPCTLRGNCOR3_MAP_X" "10"
 SYSTEM_CONSTANT "PCR_RBPCTLRGNCOR3_MAP_Y" "10"
 SYSTEM_CONSTANT "PCR_RBPCTLRGNCOR4_MAP_X" "2"
 SYSTEM_CONSTANT "PCR_RBPCTLRGNCOR4_MAP_Y" "2"
 SYSTEM_CONSTANT "PCR_RBPGOVLIN2_CUR_X" "21"
 SYSTEM_CONSTANT "PCR_RBPGOVLIN_CUR_X" "21"
 SYSTEM_CONSTANT "PCR_RBPGOVMAX_CUR_MAP_X" "16"
 SYSTEM_CONSTANT "PCR_RBPGOVMAX_MAP_X" "16"
 SYSTEM_CONSTANT "PCR_RBPGOVMAX_MAP_Y" "10"
 SYSTEM_CONSTANT "PCR_RBPGOVMIN_MAP_X" "16"
 SYSTEM_CONSTANT "PCR_RBPGOVMIN_MAP_Y" "10"
 SYSTEM_CONSTANT "PCR_RCTLAPCMPN_MAP_X" "9"
 SYSTEM_CONSTANT "PCR_RCTLAPCMPN_MAP_Y" "9"
 SYSTEM_CONSTANT "PCR_RELABS_ABS" "0"
 SYSTEM_CONSTANT "PCR_RELABS_REL" "1"
 SYSTEM_CONSTANT "PCR_SWTLIMMPCR_TYPE" "0"
 SYSTEM_CONSTANT "PCR_SWTLIMMPCR_VAL" "1"
 SYSTEM_CONSTANT "PCR_SWTQCTL_TYPE" "2"
 SYSTEM_CONSTANT "PCR_SWTQCTL_VAL" "1"
 SYSTEM_CONSTANT "PCR_SWTQ_TYPE" "2"
 SYSTEM_CONSTANT "PCR_SWTQ_VAL" "1"
 SYSTEM_CONSTANT "PCR_SWTRELABS_TYPE" "2"
 SYSTEM_CONSTANT "PCR_SWTRELABS_VAL" "0"
 SYSTEM_CONSTANT "PCR_TICOSTRT_CUR_X" "30"
 SYSTEM_CONSTANT "PCVCD_CTLSTATE_CONST" "0"
 SYSTEM_CONSTANT "PCVCD_CTLSTATE_DEP" "1"
 SYSTEM_CONSTANT "PCVCD_FACIGOVINIT_CUR_X" "6"
 SYSTEM_CONSTANT "PCVCD_ILIN_CUR_X" "2"
 SYSTEM_CONSTANT "PCVCD_SWTCTLSTATE_TYPE" "2"
 SYSTEM_CONSTANT "PCVCD_SWTCTLSTATE_VAL" "0"
 SYSTEM_CONSTANT "PCV_DVOLLEAK_CUR_X" "6"
 SYSTEM_CONSTANT "PCV_ICNVPRESS_CUR_X" "10"
 SYSTEM_CONSTANT "PERIOD_DASM_MAX" "22.2"
 SYSTEM_CONSTANT "PERIOD_DASM_MIN" "1.1"
 SYSTEM_CONSTANT "PERIOD_PWM_MAX" "11.7"
 SYSTEM_CONSTANT "PERIOD_PWM_MIN" "1.1"
 SYSTEM_CONSTANT "PERIOD_RES" "100"
 SYSTEM_CONSTANT "PERIOD_TPU_MAX" "15.3"
 SYSTEM_CONSTANT "PERIOD_TPU_MIN" "1.1"
 SYSTEM_CONSTANT "PER_CNT_MAX" "1000000"
 SYSTEM_CONSTANT "PER_DUR_ONE" "256"
 SYSTEM_CONSTANT "PER_DUR_RES" "1"
 SYSTEM_CONSTANT "PER_DUR_SHIFT" "256"
 SYSTEM_CONSTANT "PFLTCD_PLINDIFF_CUR_X" "25"
 SYSTEM_CONSTANT "PFLTCD_SWTSIGPDIFF_ADC" "0"
 SYSTEM_CONSTANT "PFLTCD_SWTSIGPDIFF_CAN" "1"
 SYSTEM_CONSTANT "PFLTCD_SWTSIGPDIFF_TYPE" "2"
 SYSTEM_CONSTANT "PFLTCD_SWTSIGPDIFF_VAL" "0"
 SYSTEM_CONSTANT "PFLTCD_TLINPRE2_CUR_X" "2"
 SYSTEM_CONSTANT "PFLTCD_TLINPRE_CUR_X" "40"
 SYSTEM_CONSTANT "PFLT_FACASHMS2LD_CUR_X" "5"
 SYSTEM_CONSTANT "PFLT_FACFLTEMP_CUR_X" "8"
 SYSTEM_CONSTANT "PFLT_FACFLTFUL_CUR_X" "8"
 SYSTEM_CONSTANT "PFLT_FACHTTRANSNOLIN_CUR_X" "8"
 SYSTEM_CONSTANT "PFLT_FACSOTSIMLMBD_X" "8"
 SYSTEM_CONSTANT "PFLT_FACSOTSIM_CUR_X" "8"
 SYSTEM_CONSTANT "PFLT_HTG_ON" "1"
 SYSTEM_CONSTANT "PFLT_NUMENGPOP_CA_X" "7"
 SYSTEM_CONSTANT "PFLT_NUMENGPOP_CA_Y" "8"
 SYSTEM_CONSTANT "PFLT_NUMFLTEMPEU_CUR_X" "16"
 SYSTEM_CONSTANT "PFLT_NUMFLTEMPRE_MAP_X" "8"
 SYSTEM_CONSTANT "PFLT_NUMFLTEMPRE_MAP_Y" "8"
 SYSTEM_CONSTANT "PFLT_NUMFLTFULEU_CUR_X" "16"
 SYSTEM_CONSTANT "PFLT_NUMFLTFULRE_MAP_X" "8"
 SYSTEM_CONSTANT "PFLT_NUMFLTFULRE_MAP_Y" "8"
 SYSTEM_CONSTANT "PFLT_PENGPRTMAX_MAP_X" "8"
 SYSTEM_CONSTANT "PFLT_PENGPRTMAX_MAP_Y" "8"
 SYSTEM_CONSTANT "PFLT_PFLTEMP_MAP_X" "8"
 SYSTEM_CONSTANT "PFLT_PFLTEMP_MAP_Y" "8"
 SYSTEM_CONSTANT "PFLT_PFLTFUL_MAP_X" "8"
 SYSTEM_CONSTANT "PFLT_PFLTFUL_MAP_Y" "8"
 SYSTEM_CONSTANT "PFLT_RASHMS2LD_CUR_X" "5"
 SYSTEM_CONSTANT "PFLT_RSOTSIMPRESLOW1_CUR_X" "5"
 SYSTEM_CONSTANT "PFLT_RSOTSIMPRESLOW2_CUR_X" "5"
 SYSTEM_CONSTANT "PFLT_RSOTSIMPRESLOW3_CUR_X" "5"
 SYSTEM_CONSTANT "PFLT_RSOTSIMPRESLOW4_CUR_X" "5"
 SYSTEM_CONSTANT "PFLT_RSOTSIMPRESSOX_CUR_X" "10"
 SYSTEM_CONSTANT "PFLT_RSOTSIM_CUR_X" "8"
 SYSTEM_CONSTANT "PFLT_RSOTSIM_MAP_X" "10"
 SYSTEM_CONSTANT "PFLT_RSOTSIM_MAP_Y" "10"
 SYSTEM_CONSTANT "PFLT_TADDPOI1_MAP_X" "8"
 SYSTEM_CONSTANT "PFLT_TADDPOI1_MAP_Y" "8"
 SYSTEM_CONSTANT "PFLT_TADDPOL2_MAP_X" "8"
 SYSTEM_CONSTANT "PFLT_TADDPOL2_MAP_Y" "8"
 SYSTEM_CONSTANT "PFLT_TEXHGSDEL_CUR_X" "8"
 SYSTEM_CONSTANT "PFLT_TEXHGSSTY_MAP_X" "8"
 SYSTEM_CONSTANT "PFLT_TEXHGSSTY_MAP_Y" "8"
 SYSTEM_CONSTANT "PFLT_TIHTTRANSDT1_CUR_X" "8"
 SYSTEM_CONSTANT "PFLT_TITHRESNORM_MAP_X" "8"
 SYSTEM_CONSTANT "PFLT_TITHRESNORM_MAP_Y" "8"
 SYSTEM_CONSTANT "PFLT_TRQINRRGNLOWMAX1_CUR_X" "12"
 SYSTEM_CONSTANT "PFLT_TRQINRRGNLOWMAX2_CUR_X" "12"
 SYSTEM_CONSTANT "PFLT_TRQINRRGNUPPMAX1_CUR_X" "12"
 SYSTEM_CONSTANT "PFLT_TRQINRRGNUPPMAX2_CUR_X" "12"
 SYSTEM_CONSTANT "PFLT_TTHRESPRE1_MAP_X" "8"
 SYSTEM_CONSTANT "PFLT_TTHRESPRE1_MAP_Y" "8"
 SYSTEM_CONSTANT "PFLT_TTHRESPRE2_MAP_X" "8"
 SYSTEM_CONSTANT "PFLT_TTHRESPRE2_MAP_Y" "8"
 SYSTEM_CONSTANT "PHASE_PERIOD_RES" "10"
 SYSTEM_CONSTANT "PHI_AMPL_ADJ" "60"
 SYSTEM_CONSTANT "PHI_COR_MAX" "10"
 SYSTEM_CONSTANT "PHI_INT_MAIN" "54"
 SYSTEM_CONSTANT "PHI_INT_PILOT" "120"
 SYSTEM_CONSTANT "PHI_INT_SEGMENT" "144"
 SYSTEM_CONSTANT "PHI_INT_UPDATE_A" "180"
 SYSTEM_CONSTANT "PHI_INT_UPDATE_B" "180"
 SYSTEM_CONSTANT "PHI_INT_UPDATE_C" "180"
 SYSTEM_CONSTANT "PHI_INT_UPDATE_D" "180"
 SYSTEM_CONSTANT "PHI_INT_UPDATE_E" "180"
 SYSTEM_CONSTANT "PHI_INT_UPDATE_F" "180"
 SYSTEM_CONSTANT "PHI_INT_UPDATE_G" "180"
 SYSTEM_CONSTANT "PHI_MI_EARL" "40"
 SYSTEM_CONSTANT "PHI_MI_LATE" "-10"
 SYSTEM_CONSTANT "PHI_OFFSET" "12"
 SYSTEM_CONSTANT "PHI_PII_EARL_ABS" "100"
 SYSTEM_CONSTANT "PHI_PII_EARL_REL" "90"
 SYSTEM_CONSTANT "PHI_PII_LATE_REL" "5"
 SYSTEM_CONSTANT "PHI_POI1_EARL" "-40"
 SYSTEM_CONSTANT "PHI_POI1_LATE" "-100"
 SYSTEM_CONSTANT "PHI_POI1_ZERO" "0"
 SYSTEM_CONSTANT "PHI_POI2_LATE" "-40"
 SYSTEM_CONSTANT "PHI_POLLING" "60"
 SYSTEM_CONSTANT "PHI_TIME_BY_N" "3906.25"
 SYSTEM_CONSTANT "PHI_ZERO" "0"
 SYSTEM_CONSTANT "PI" "3.14159265359"
 SYSTEM_CONSTANT "PIEZO_TEST" "0"
 SYSTEM_CONSTANT "PMP_QNT_MAX" "1500"
 SYSTEM_CONSTANT "PMP_QNT_RES" "0.1"
 SYSTEM_CONSTANT "PMP_QNT_ZERO" "0"
 SYSTEM_CONSTANT "PRC2DTYCYC" "1"
 SYSTEM_CONSTANT "PRC_100" "100"
 SYSTEM_CONSTANT "PRC_100_FL" "100"
 SYSTEM_CONSTANT "PRC_50" "50"
 SYSTEM_CONSTANT "PRC_HIGH_RES" "0.001"
 SYSTEM_CONSTANT "PRC_HIGH_RES_REV" "1000"
 SYSTEM_CONSTANT "PRC_RES" "0.01"
 SYSTEM_CONSTANT "PRC_RES_FL" "0.01"
 SYSTEM_CONSTANT "PRC_RES_REV" "100"
 SYSTEM_CONSTANT "PRC_SCAL_FAC" "10000"
 SYSTEM_CONSTANT "PRC_SCAL_NRM_EXP" "13"
 SYSTEM_CONSTANT "PRC_SOOT_400" "0.78125"
 SYSTEM_CONSTANT "PRC_SOOT_EXP" "9"
 SYSTEM_CONSTANT "PRC_SOOT_MAX" "0.125"
 SYSTEM_CONSTANT "PRC_SOOT_RES" "0.001953125"
 SYSTEM_CONSTANT "PRC_SOOT_RES_REV" "512"
 SYSTEM_CONSTANT "PRC_SOOT_ZERO" "0"
 SYSTEM_CONSTANT "PRC_ZERO" "0"
 SYSTEM_CONSTANT "PRC_ZERO_FL" "0"
 SYSTEM_CONSTANT "PRESCALER" "16"
 SYSTEM_CONSTANT "PRES_AC_HPA_RES" "2"
 SYSTEM_CONSTANT "PRES_AC_HPA_RES_REV" "0.5"
 SYSTEM_CONSTANT "PRES_AIR_MAX" "3500"
 SYSTEM_CONSTANT "PRES_AIR_MIN" "0"
 SYSTEM_CONSTANT "PRES_FACT_HPA_BAR" "1000"
 SYSTEM_CONSTANT "PRES_HPA_2_RMP_PRES_HPA_LOW" "10000000"
 SYSTEM_CONSTANT "PRES_HPA_BAR" "1000"
 SYSTEM_CONSTANT "PRES_HPA_NORM" "1013"
 SYSTEM_CONSTANT "PRES_HPA_RES" "1"
 SYSTEM_CONSTANT "PRES_HPA_RES_FL" "1"
 SYSTEM_CONSTANT "PRES_HPA_RES_INV" "1"
 SYSTEM_CONSTANT "PRES_RAIL_GRAD_TO_VAL" "4"
 SYSTEM_CONSTANT "PRES_RAIL_RES" "100"
 SYSTEM_CONSTANT "PRES_SI_RES" "100"
 SYSTEM_CONSTANT "PRES_TIME_RES" "400"
 SYSTEM_CONSTANT "PRPCTL_TRQAWDLIM_CUR_X" "25"
 SYSTEM_CONSTANT "PRPCTL_TRQNIVEAULIM_CUR_X" "25"
 SYSTEM_CONSTANT "PRP_CCON_OFF" "0"
 SYSTEM_CONSTANT "PRP_CCON_ON" "1"
 SYSTEM_CONSTANT "PRP_CCSEL_ACC" "1"
 SYSTEM_CONSTANT "PRP_CCSEL_CRCTL" "0"
 SYSTEM_CONSTANT "PRP_RENGLOW_CUR_X" "16"
 SYSTEM_CONSTANT "PRP_RENGLOW_MAP_X" "16"
 SYSTEM_CONSTANT "PRP_RENGLOW_MAP_Y" "16"
 SYSTEM_CONSTANT "PRP_RENG_CUR_X" "16"
 SYSTEM_CONSTANT "PRP_RENG_MAP_X" "16"
 SYSTEM_CONSTANT "PRP_RENG_MAP_Y" "16"
 SYSTEM_CONSTANT "PRP_SWTCCON_TYPE" "1"
 SYSTEM_CONSTANT "PRP_SWTCCON_VAL" "0"
 SYSTEM_CONSTANT "PRP_SWTCCSEL_TYPE" "1"
 SYSTEM_CONSTANT "PRP_SWTCCSEL_VAL" "0"
 SYSTEM_CONSTANT "PRP_TRQTHRESENG_CUR_X" "25"
 SYSTEM_CONSTANT "PWR_HIGH_RES" "0.1"
 SYSTEM_CONSTANT "PWR_HIRES" "0.5"
 SYSTEM_CONSTANT "PWR_HIRES_ZERO" "0"
 SYSTEM_CONSTANT "PWR_KW_RES" "0.01"
 SYSTEM_CONSTANT "PWR_KW_RES_INV" "100"
 SYSTEM_CONSTANT "PWR_MAX" "300000"
 SYSTEM_CONSTANT "PWR_PA_MAX" "32000"
 SYSTEM_CONSTANT "PWR_PA_RES" "1"
 SYSTEM_CONSTANT "PWR_PA_ZERO" "0"
 SYSTEM_CONSTANT "PWR_RES" "9.42477796077"
 SYSTEM_CONSTANT "PWR_ZERO" "0"
 SYSTEM_CONSTANT "QLAMBDA_RES_REV" "1000"
 SYSTEM_CONSTANT "QNTR_EXP" "10"
 SYSTEM_CONSTANT "QNTR_MAX" "24"
 SYSTEM_CONSTANT "QNTR_MIN" "0.0009765625"
 SYSTEM_CONSTANT "QNTR_RES" "0.0009765625"
 SYSTEM_CONSTANT "QNTR_RES_REV" "1024"
 SYSTEM_CONSTANT "Qp_RES" "10"
 SYSTEM_CONSTANT "RAILCD_PLIN_CUR_X" "4"
 SYSTEM_CONSTANT "RAILCD_SSPMON" "1"
 SYSTEM_CONSTANT "RAILCD_TIOFSTSTDEL_CUR_X" "6"
 SYSTEM_CONSTANT "RAIL_CALCBACK_I" "1"
 SYSTEM_CONSTANT "RAIL_DPDECMONMAX_CUR_X" "8"
 SYSTEM_CONSTANT "RAIL_DPSETPOINTINC_MAP_X" "12"
 SYSTEM_CONSTANT "RAIL_DPSETPOINTINC_MAP_Y" "8"
 SYSTEM_CONSTANT "RAIL_DP_MAX" "13000000"
 SYSTEM_CONSTANT "RAIL_DP_MIN" "0"
 SYSTEM_CONSTANT "RAIL_DP_ZERO" "0"
 SYSTEM_CONSTANT "RAIL_DVOLLEAKAGED_MAP_X" "10"
 SYSTEM_CONSTANT "RAIL_DVOLLEAKAGED_MAP_Y" "10"
 SYSTEM_CONSTANT "RAIL_DVOLLEAK_MAP_X" "10"
 SYSTEM_CONSTANT "RAIL_DVOLLEAK_MAP_Y" "10"
 SYSTEM_CONSTANT "RAIL_DVOLMEUNCTLINITI_CUR_X" "6"
 SYSTEM_CONSTANT "RAIL_DVOLMEUNCTLUPLIM_CUR_X" "16"
 SYSTEM_CONSTANT "RAIL_DVOLMEUNOVRRUN_CUR_X" "8"
 SYSTEM_CONSTANT "RAIL_DVOLPRECTLBAS_MAP_X" "16"
 SYSTEM_CONSTANT "RAIL_DVOLPRECTLBAS_MAP_Y" "16"
 SYSTEM_CONSTANT "RAIL_DVOLPRECTLOFS_MAP_X" "8"
 SYSTEM_CONSTANT "RAIL_DVOLPRECTLOFS_MAP_Y" "8"
 SYSTEM_CONSTANT "RAIL_DVOLPRECTLPOI1_MAP_X" "4"
 SYSTEM_CONSTANT "RAIL_DVOLPRECTLPOI1_MAP_Y" "4"
 SYSTEM_CONSTANT "RAIL_DVOLPRECTLPOI2_MAP_X" "4"
 SYSTEM_CONSTANT "RAIL_DVOLPRECTLPOI2_MAP_Y" "4"
 SYSTEM_CONSTANT "RAIL_DVOLSTRT_MAP_X" "8"
 SYSTEM_CONSTANT "RAIL_DVOLSTRT_MAP_Y" "8"
 SYSTEM_CONSTANT "RAIL_FACMEUNCTLDCOR_CUR_X" "4"
 SYSTEM_CONSTANT "RAIL_FACMEUNCTLICOR_CUR_X" "4"
 SYSTEM_CONSTANT "RAIL_FACMEUNCTLPCOR_CUR_X" "4"
 SYSTEM_CONSTANT "RAIL_FACSETPOINTAPSCOR_CUR_X" "8"
 SYSTEM_CONSTANT "RAIL_FACSETPOINTATSCOR_CUR_X" "8"
 SYSTEM_CONSTANT "RAIL_FACSETPOINTETSCOR_CUR_X" "8"
 SYSTEM_CONSTANT "RAIL_FACSETPOINTFTSCOR_CUR_X" "8"
 SYSTEM_CONSTANT "RAIL_FREEZE_I" "0"
 SYSTEM_CONSTANT "RAIL_MEUNCTLDKD_CUR_X" "16"
 SYSTEM_CONSTANT "RAIL_MEUNCTLIKINEG_CUR_X" "16"
 SYSTEM_CONSTANT "RAIL_MEUNCTLIKIPOS_CUR_X" "16"
 SYSTEM_CONSTANT "RAIL_MEUNCTLIKI_CUR_X" "16"
 SYSTEM_CONSTANT "RAIL_MEUNCTLPKPNEG_CUR_X" "16"
 SYSTEM_CONSTANT "RAIL_MEUNCTLPKPPOS_CUR_X" "16"
 SYSTEM_CONSTANT "RAIL_MEUNCTLPKP_CUR_X" "16"
 SYSTEM_CONSTANT "RAIL_PCVCTLDKD_CUR_X" "16"
 SYSTEM_CONSTANT "RAIL_PCVCTLIKINEG_CUR_X" "16"
 SYSTEM_CONSTANT "RAIL_PCVCTLIKIPOS_CUR_X" "16"
 SYSTEM_CONSTANT "RAIL_PCVCTLIKI_CUR_X" "16"
 SYSTEM_CONSTANT "RAIL_PCVCTLPKPNEG_CUR_X" "16"
 SYSTEM_CONSTANT "RAIL_PCVCTLPKPPOS_CUR_X" "16"
 SYSTEM_CONSTANT "RAIL_PCVCTLPKP_CUR_X" "16"
 SYSTEM_CONSTANT "RAIL_PMEUNDVTMAX_CUR_X" "16"
 SYSTEM_CONSTANT "RAIL_PMEUNDVTMIN_CUR_X" "16"
 SYSTEM_CONSTANT "RAIL_PMEUNPEAKMIN_CUR_X" "16"
 SYSTEM_CONSTANT "RAIL_PNIPCVMAX_MAP_X" "6"
 SYSTEM_CONSTANT "RAIL_PNIPCVMAX_MAP_Y" "12"
 SYSTEM_CONSTANT "RAIL_PNIPCVMIN_MAP_X" "6"
 SYSTEM_CONSTANT "RAIL_PNIPCVMIN_MAP_Y" "12"
 SYSTEM_CONSTANT "RAIL_PPCVCLOSEOFS_CUR_X" "4"
 SYSTEM_CONSTANT "RAIL_PPCVDVTMAX_CUR_X" "16"
 SYSTEM_CONSTANT "RAIL_PPCVINITI_MAP_X" "16"
 SYSTEM_CONSTANT "RAIL_PPCVINITI_MAP_Y" "16"
 SYSTEM_CONSTANT "RAIL_PPCVPEAKMIN_CUR_X" "16"
 SYSTEM_CONSTANT "RAIL_PPCVREDOFS_CUR_X" "4"
 SYSTEM_CONSTANT "RAIL_PPRECTL_MAP_X" "16"
 SYSTEM_CONSTANT "RAIL_PPRECTL_MAP_Y" "16"
 SYSTEM_CONSTANT "RAIL_PRESS_ABS" "0"
 SYSTEM_CONSTANT "RAIL_PRESS_DIF" "1"
 SYSTEM_CONSTANT "RAIL_PSETPOINTAPSCOR_MAP_X" "12"
 SYSTEM_CONSTANT "RAIL_PSETPOINTAPSCOR_MAP_Y" "8"
 SYSTEM_CONSTANT "RAIL_PSETPOINTATSCOR_MAP_X" "12"
 SYSTEM_CONSTANT "RAIL_PSETPOINTATSCOR_MAP_Y" "8"
 SYSTEM_CONSTANT "RAIL_PSETPOINTBASE_MAP_X" "16"
 SYSTEM_CONSTANT "RAIL_PSETPOINTBASE_MAP_Y" "16"
 SYSTEM_CONSTANT "RAIL_PSETPOINTBATTMIN_CUR_X" "4"
 SYSTEM_CONSTANT "RAIL_PSETPOINTETSCOR_MAP_X" "12"
 SYSTEM_CONSTANT "RAIL_PSETPOINTETSCOR_MAP_Y" "8"
 SYSTEM_CONSTANT "RAIL_PSETPOINTFTSCOR_MAP_X" "12"
 SYSTEM_CONSTANT "RAIL_PSETPOINTFTSCOR_MAP_Y" "8"
 SYSTEM_CONSTANT "RAIL_PSETPOINTMAX_MAP_X" "16"
 SYSTEM_CONSTANT "RAIL_PSETPOINTMAX_MAP_Y" "8"
 SYSTEM_CONSTANT "RAIL_PSETPOINTMIN_MAP_X" "8"
 SYSTEM_CONSTANT "RAIL_PSETPOINTMIN_MAP_Y" "16"
 SYSTEM_CONSTANT "RAIL_P_MAX" "1800000"
 SYSTEM_CONSTANT "RAIL_P_MIN" "0"
 SYSTEM_CONSTANT "RAIL_P_ZERO" "0"
 SYSTEM_CONSTANT "RAIL_QMEUNCTLTYPE_CUR_X" "8"
 SYSTEM_CONSTANT "RAIL_QPCVCTLTYPE_CUR_X" "8"
 SYSTEM_CONSTANT "RAIL_SWTPRECTL_TYPE" "2"
 SYSTEM_CONSTANT "RAIL_SWTPRECTL_VAL" "0"
 SYSTEM_CONSTANT "RAIL_SWTPRESS_TYPE" "2"
 SYSTEM_CONSTANT "RAIL_SWTPRESS_VAL" "0"
 SYSTEM_CONSTANT "RAIL_SWTWINDUP_TYPE" "2"
 SYSTEM_CONSTANT "RAIL_SWTWINDUP_VAL" "1"
 SYSTEM_CONSTANT "RAIL_TIMEUNCTLDT1_CUR_X" "16"
 SYSTEM_CONSTANT "RAIL_TIMEUNCTLPT1_CUR_X" "16"
 SYSTEM_CONSTANT "RAIL_TIMEUNRMPDUR_CUR_X" "10"
 SYSTEM_CONSTANT "RAIL_TIPCVCTLDT1_CUR_X" "16"
 SYSTEM_CONSTANT "RAIL_TIPCVRMPDUR_CUR_X" "10"
 SYSTEM_CONSTANT "RAIL_TMEUNCTLTYPE_CUR_X" "8"
 SYSTEM_CONSTANT "RAIL_TPCVCTLTYPE_CUR_X" "8"
 SYSTEM_CONSTANT "RAIL_WITHOUT_PRECTL" "0"
 SYSTEM_CONSTANT "RAIL_WITH_PRECTL" "1"
 SYSTEM_CONSTANT "RATAM_RES" "0.01"
 SYSTEM_CONSTANT "RATAM_RES_FL" "0.01"
 SYSTEM_CONSTANT "RATAM_RES_REV" "100"
 SYSTEM_CONSTANT "RATFM_ONE" "1"
 SYSTEM_CONSTANT "RATFM_RES" "0.01"
 SYSTEM_CONSTANT "RATFM_ZERO" "0"
 SYSTEM_CONSTANT "RESISTANT_KOHM_RES" "0.1"
 SYSTEM_CONSTANT "RESIST_MILLI_RES" "0.1"
 SYSTEM_CONSTANT "RESIST_MILLI_ZERO" "0"
 SYSTEM_CONSTANT "RESIST_RES" "0.1"
 SYSTEM_CONSTANT "RESIST_ZERO" "0"
 SYSTEM_CONSTANT "REV_RES_US" "1000000"
 SYSTEM_CONSTANT "REYNOLDS_NUM_RES" "10000"
 SYSTEM_CONSTANT "RHO_FUEL" "830"
 SYSTEM_CONSTANT "RHO_FUEL_RES" "0.1"
 SYSTEM_CONSTANT "RMP_AMPT_LOW_RES" "1"
 SYSTEM_CONSTANT "RMP_AMPT_LOW_RES_REV" "1"
 SYSTEM_CONSTANT "RMP_ENG_N_LOW_RES" "1"
 SYSTEM_CONSTANT "RMP_ENG_N_LOW_RES_REV" "1"
 SYSTEM_CONSTANT "RMP_FANCTL_NRM" "65536"
 SYSTEM_CONSTANT "RMP_GOV_RES_REV" "1024"
 SYSTEM_CONSTANT "RMP_INJ_MASS_LOW_RES" "0.1"
 SYSTEM_CONSTANT "RMP_INJ_MASS_LOW_RES_REV" "10"
 SYSTEM_CONSTANT "RMP_INTMIN_DT10" "6554"
 SYSTEM_CONSTANT "RMP_INTMIN_DT100" "656"
 SYSTEM_CONSTANT "RMP_INTMIN_DT20" "3277"
 SYSTEM_CONSTANT "RMP_NRM_EXP" "16"
 SYSTEM_CONSTANT "RMP_NRM_EXP16" "9"
 SYSTEM_CONSTANT "RMP_PRES_HPA_LOW_RES" "0.1"
 SYSTEM_CONSTANT "RMP_PRES_HPA_LOW_RES_REV" "10"
 SYSTEM_CONSTANT "RMP_RES" "0.0152587890625"
 SYSTEM_CONSTANT "RMP_RES16" "1.953125"
 SYSTEM_CONSTANT "RMP_RES_1" "0.001"
 SYSTEM_CONSTANT "RMP_RES_INV" "65.536"
 SYSTEM_CONSTANT "RMP_RES_LIGOV" "0.00217982700892857"
 SYSTEM_CONSTANT "ROOM_RES" "256"
 SYSTEM_CONSTANT "RTRQCAN_ZERO" "0"
 SYSTEM_CONSTANT "RTRQ_CAN_RES" "0.392157"
 SYSTEM_CONSTANT "RTRQ_CAN_RES_REV" "2.54999910750031"
 SYSTEM_CONSTANT "R_COIL_MAX" "5000"
 SYSTEM_CONSTANT "R_COIL_MIN" "0"
 SYSTEM_CONSTANT "R_RES" "1"
 SYSTEM_CONSTANT "R_STOICH_FL" "14.5"
 SYSTEM_CONSTANT "SCAL_16TO32_EXP" "4"
 SYSTEM_CONSTANT "SCAL_16TO32_FAC" "16"
 SYSTEM_CONSTANT "SEC2MS" "1000"
 SYSTEM_CONSTANT "SEC2US" "1000000"
 SYSTEM_CONSTANT "SEC_RES" "1"
 SYSTEM_CONSTANT "SIXTY" "600"
 SYSTEM_CONSTANT "SPECIFICHEAT_RES" "0.0001"
 SYSTEM_CONSTANT "SQRT_NUM_RES" "10000"
 SYSTEM_CONSTANT "SQRT_TWO_INV" "7071"
 SYSTEM_CONSTANT "SQRVLTG_S_RES" "0.1"
 SYSTEM_CONSTANT "START_CLEAR_CARB6" "-1"
 SYSTEM_CONSTANT "STOP_CLEAR_CARB6" "0"
 SYSTEM_CONSTANT "STROKE_MAX" "3276.7"
 SYSTEM_CONSTANT "STROKE_MIN" "0"
 SYSTEM_CONSTANT "STRTCD_ULINOFFRLY_CUR_X" "2"
 SYSTEM_CONSTANT "STRTCD_ULINONRLY_CUR_X" "2"
 SYSTEM_CONSTANT "STR_PER_VOL" "0.1"
 SYSTEM_CONSTANT "STR_PER_VOL_REZ" "10"
 SYSTEM_CONSTANT "STSYSCTL_NTHRESENGT_CUR_X" "7"
 SYSTEM_CONSTANT "STSYSCTL_TITHRESENGT_CUR_X" "7"
 SYSTEM_CONSTANT "STSYSCTL_TMAXNRM_MAP_X" "10"
 SYSTEM_CONSTANT "STSYSCTL_TMAXNRM_MAP_Y" "10"
 SYSTEM_CONSTANT "STSYS_NSTRTCUTOUT_MAP_X" "2"
 SYSTEM_CONSTANT "STSYS_NSTRTCUTOUT_MAP_Y" "4"
 SYSTEM_CONSTANT "STSYS_NTHRESTENG_CUR_X" "5"
 SYSTEM_CONSTANT "STSYS_NUPLITHRESTENG_CUR_X" "5"
 SYSTEM_CONSTANT "STSYS_TISHUTOFF_CUR_X" "10"
 SYSTEM_CONSTANT "STSYS_TISHUTOFF_MAP_X" "10"
 SYSTEM_CONSTANT "STSYS_TISHUTOFF_MAP_Y" "4"
 SYSTEM_CONSTANT "STSYS_TRQSTRTBAS_MAP_X" "9"
 SYSTEM_CONSTANT "STSYS_TRQSTRTBAS_MAP_Y" "10"
 SYSTEM_CONSTANT "STSYS_TRQSTRT_MAP_X" "9"
 SYSTEM_CONSTANT "STSYS_TRQSTRT_MAP_Y" "10"
 SYSTEM_CONSTANT "ST_RES_MAX" "25"
 SYSTEM_CONSTANT "ST_RES_MIN" "0"
 SYSTEM_CONSTANT "ST_RES_RES" "0.001"
 SYSTEM_CONSTANT "ST_RES_RES_INV" "1000"
 SYSTEM_CONSTANT "SVLPCD_LFILLLVL_CUR_X" "13"
 SYSTEM_CONSTANT "SVLPCD_LOILWRN_MAP_X" "13"
 SYSTEM_CONSTANT "SVLPCD_LOILWRN_MAP_Y" "13"
 SYSTEM_CONSTANT "SVLP_DOILLOAD_MAP_X" "8"
 SYSTEM_CONSTANT "SVLP_DOILLOAD_MAP_Y" "8"
 SYSTEM_CONSTANT "SVLP_DSOOTLOAD_MAP_X" "8"
 SYSTEM_CONSTANT "SVLP_DSOOTLOAD_MAP_Y" "8"
 SYSTEM_CONSTANT "SVLP_FACQI_MAP_X" "9"
 SYSTEM_CONSTANT "SVLP_FACQI_MAP_Y" "5"
 SYSTEM_CONSTANT "SVLP_PRESENT_NO" "0"
 SYSTEM_CONSTANT "SVLP_PRESENT_YES" "1"
 SYSTEM_CONSTANT "SVLP_SWTPRESENT_TYPE" "2"
 SYSTEM_CONSTANT "SVLP_SWTPRESENT_VAL" "1"
 SYSTEM_CONSTANT "SWT_DISABLED" "0"
 SYSTEM_CONSTANT "SWT_ENABLED" "1"
 SYSTEM_CONSTANT "SWT_SIG_CAN" "1"
 SYSTEM_CONSTANT "SWT_SIG_HW" "0"
 SYSTEM_CONSTANT "SWT_SSPMON1" "1"
 SYSTEM_CONSTANT "SWT_SSPMON2" "2"
 SYSTEM_CONSTANT "SWT_SSPMON3" "3"
 SYSTEM_CONSTANT "SWT_TYPE_APPL" "2"
 SYSTEM_CONSTANT "SWT_TYPE_DATASET" "0"
 SYSTEM_CONSTANT "SWT_TYPE_EEP" "1"
 SYSTEM_CONSTANT "SYS_TICK_DURATION" "286.000286000286"
 SYSTEM_CONSTANT "SY_CLASS_TAB_SIZE" "20"
 SYSTEM_CONSTANT "SY_D2CNT_SIZE" "0"
 SYSTEM_CONSTANT "SY_DFPMENV" "5"
 SYSTEM_CONSTANT "SY_DFPMFFS" "11"
 SYSTEM_CONSTANT "SY_DFPMTIM" "2"
 SYSTEM_CONSTANT "SY_DFPM_HLC_BEHAVIOUR" "1"
 SYSTEM_CONSTANT "SY_DFP_FCM_BEHAVIOUR" "1"
 SYSTEM_CONSTANT "SY_DFP_FILLFRZ_IN_FCM_BEHAVIOUR" "0"
 SYSTEM_CONSTANT "SY_DSCHED_DFP_DEF_TAB_SIZE" "10"
 SYSTEM_CONSTANT "SY_DSCHED_DFP_OK_TAB_SIZE" "20"
 SYSTEM_CONSTANT "SY_DSCHED_ENABLE" "0"
 SYSTEM_CONSTANT "SY_DSMEX" "12"
 SYSTEM_CONSTANT "SY_DSMFA" "8"
 SYSTEM_CONSTANT "SY_DSMMAST" "16"
 SYSTEM_CONSTANT "SY_DSMSLP" "8"
 SYSTEM_CONSTANT "SY_DSM_BE_LOCK_ERROR" "0"
 SYSTEM_CONSTANT "SY_DSM_BLK_CODE_ENABLE" "0"
 SYSTEM_CONSTANT "SY_DSM_CHECKSUM_ACT" "0"
 SYSTEM_CONSTANT "SY_DSM_DIS_AT_EOLTESTER" "0"
 SYSTEM_CONSTANT "SY_DSM_DUR_FCM_ENABLE" "1"
 SYSTEM_CONSTANT "SY_DSM_DUR_GLOBAL_ENABLE" "1"
 SYSTEM_CONSTANT "SY_DSM_FA_FADEMSK_ENABLE" "1"
 SYSTEM_CONSTANT "SY_DSM_HISTORYSIZE" "8"
 SYSTEM_CONSTANT "SY_DSM_INHIBIT_DELAY" "0"
 SYSTEM_CONSTANT "SY_DSM_INHIBIT_DELAY_LAMP_ENABLE" "0"
 SYSTEM_CONSTANT "SY_DSM_MASTER_SLAVE_ENABLE" "0"
 SYSTEM_CONSTANT "SY_DSM_MAST_SLA_COMP" "1"
 SYSTEM_CONSTANT "SY_DSM_NUM_COLL_MP" "26"
 SYSTEM_CONSTANT "SY_DSM_NUM_FID_COLL_MP" "26"
 SYSTEM_CONSTANT "SY_DSM_PROTECT_FCM" "1"
 SYSTEM_CONSTANT "SY_DSM_RDY_ACC" "1"
 SYSTEM_CONSTANT "SY_DSM_SHADOW_CLEAR" "1"
 SYSTEM_CONSTANT "SY_DSM_SHADOW_ENABLE" "0"
 SYSTEM_CONSTANT "SY_DSM_SHADOW_INH_BEHAVIOUR" "1"
 SYSTEM_CONSTANT "SY_DSM_SHADOW_TIMAX" "0"
 SYSTEM_CONSTANT "SY_DSM_SIZE_FCM_ENTRY" "36"
 SYSTEM_CONSTANT "SY_DSM_SUPP_16BIT_DFP" "1"
 SYSTEM_CONSTANT "SY_DSM_SYSLMP_BLK" "0"
 SYSTEM_CONSTANT "SY_DSM_VALID_PRESENT" "0"
 SYSTEM_CONSTANT "SY_DSM_VISIBILITY_SUPPORT" "0"
 SYSTEM_CONSTANT "SY_ENABLE_D2CNT" "0"
 SYSTEM_CONSTANT "SY_ENVBLOK" "2"
 SYSTEM_CONSTANT "SY_ENV_BYTE" "0"
 SYSTEM_CONSTANT "SY_ENV_WORD" "1"
 SYSTEM_CONSTANT "SY_FAULT_TYPE_CONV" "1"
 SYSTEM_CONSTANT "SY_FCMSIZE" "8"
 SYSTEM_CONSTANT "SY_FFESIZE" "0"
 SYSTEM_CONSTANT "SY_INH_POINT_APPLIC" "0"
 SYSTEM_CONSTANT "SY_SUPPORT_TRIGGER_ACTION" "0"
 SYSTEM_CONSTANT "SY_WTTLEN" "20"
 SYSTEM_CONSTANT "T15CD_ULIN_CUR_X" "5"
 SYSTEM_CONSTANT "T50CD_DIGIN_PRESENT_NO" "0"
 SYSTEM_CONSTANT "T50CD_DIGIN_PRESENT_YES" "1"
 SYSTEM_CONSTANT "T50CD_RXDIGIN_PRESENT_NO" "0"
 SYSTEM_CONSTANT "T50CD_RXDIGIN_PRESENT_YES" "1"
 SYSTEM_CONSTANT "T50CD_SWTDIGIN_PRESENT_TYPE" "2"
 SYSTEM_CONSTANT "T50CD_SWTDIGIN_PRESENT_VAL" "1"
 SYSTEM_CONSTANT "T50CD_SWTRXDIGIN_P_TYPE" "2"
 SYSTEM_CONSTANT "T50CD_SWTRXDIGIN_P_VAL" "1"
 SYSTEM_CONSTANT "TEGCO_Q_CNV" "128"
 SYSTEM_CONSTANT "TEGMOD_ALPHAEGPIPE_RES" "1280"
 SYSTEM_CONSTANT "TEGMOD_ALPHAPIPEENV_RES" "52428.8"
 SYSTEM_CONSTANT "TEGMOD_AREAPIPE_RES" "201.06192982976"
 SYSTEM_CONSTANT "TEGMOD_CMPRPWR_RES" "76747.2972710018"
 SYSTEM_CONSTANT "TEGMOD_DELTATEMP_RES" "100"
 SYSTEM_CONSTANT "TEGMOD_FACPT1_RES" "2812.5"
 SYSTEM_CONSTANT "TEGMOD_HEATFLOWKW_RES" "100000"
 SYSTEM_CONSTANT "TEGMOD_HEATFLOW_INTER_RES" "360"
 SYSTEM_CONSTANT "TEGMOD_HEATFLOW_RES" "1000"
 SYSTEM_CONSTANT "TEGMOD_HEATKJ_RES" "100"
 SYSTEM_CONSTANT "TEGMOD_HEATRANS_INTER_RES" "819.2"
 SYSTEM_CONSTANT "TEGMOD_HEATRANS_RES" "100"
 SYSTEM_CONSTANT "TEGMOD_HUBPERSEC_RES" "120"
 SYSTEM_CONSTANT "TEGMOD_INJMASSKGH_RES" "377.48736"
 SYSTEM_CONSTANT "TEGMOD_INTER1_RES" "0.01"
 SYSTEM_CONSTANT "TEGMOD_INTER_RES" "1"
 SYSTEM_CONSTANT "TEGMOD_LAMBDA_RES" "8827.58620689655"
 SYSTEM_CONSTANT "TEGMOD_PT1TIMECONST_RES" "335.54432"
 SYSTEM_CONSTANT "TEGMOD_REPIPEENV_RES" "1456.35555555556"
 SYSTEM_CONSTANT "TEGMOD_REPIPE_RES" "370.857896905592"
 SYSTEM_CONSTANT "TEGMOD_TEMPEG_INTER_RES" "3600"
 SYSTEM_CONSTANT "TEGMOD_TEMPEG_RES" "100"
 SYSTEM_CONSTANT "TEGMOD_TEMPTRBN_INTER_RES" "10485.76"
 SYSTEM_CONSTANT "TEGMOD_TEMPTRBN_RES" "9424.77796077"
 SYSTEM_CONSTANT "TEGMOD_TEMP_RES" "819.2"
 SYSTEM_CONSTANT "TEMP_CELS_RES" "0.1"
 SYSTEM_CONSTANT "TEMP_HIGH_RES" "0.01"
 SYSTEM_CONSTANT "TEMP_NULL_C" "-273.14"
 SYSTEM_CONSTANT "TEMP_NULL_F" "-459.652"
 SYSTEM_CONSTANT "TEMP_PA_MAX" "180"
 SYSTEM_CONSTANT "TEMP_PA_MIN" "-40"
 SYSTEM_CONSTANT "TEMP_PA_ZERO" "0"
 SYSTEM_CONSTANT "TEMP_RATE_TCLNT_MOD_MAX" "0.7999755859375"
 SYSTEM_CONSTANT "TEMP_RATE_TCLNT_MOD_MIN" "0"
 SYSTEM_CONSTANT "TEMP_RES" "0.1"
 SYSTEM_CONSTANT "TEMP_RES_FL" "0.1"
 SYSTEM_CONSTANT "TEMP_RES_INV" "10"
 SYSTEM_CONSTANT "TEMP_RES_TCLNT_MOD" "2.44140625e-05"
 SYSTEM_CONSTANT "TEMP_RES_TCLNT_MOD_REV" "40960"
 SYSTEM_CONSTANT "TEMP_WVCOR_MAX" "140"
 SYSTEM_CONSTANT "TEMP_WVCOR_MIN" "-40"
 SYSTEM_CONSTANT "TFCT_NRM_EXP" "12"
 SYSTEM_CONSTANT "THERMAL_COEFF_RES" "0.1"
 SYSTEM_CONSTANT "TIHR_NRM_EXP" "8"
 SYSTEM_CONSTANT "TIMEDELAY32TO15_FACT" "8"
 SYSTEM_CONSTANT "TIMEDELAY_ADC_FILTER" "2684.35456"
 SYSTEM_CONSTANT "TIMEDELAY_S_1_MIN" "4e-05"
 SYSTEM_CONSTANT "TIMEDELAY_S_1_NRM" "12"
 SYSTEM_CONSTANT "TIMEDELAY_S_2_MIN" "0.001"
 SYSTEM_CONSTANT "TIMEDELAY_S_2_NRM" "8"
 SYSTEM_CONSTANT "TIMEDELAY_S_LIN_16_MAX" "5"
 SYSTEM_CONSTANT "TIMEDELAY_S_LIN_16_MAX_ASDDC" "1.5"
 SYSTEM_CONSTANT "TIMEDELAY_S_LIN_16_MAX_ASDRF" "1.5"
 SYSTEM_CONSTANT "TIMEDELAY_S_LIN_16_REC_RES" "4294.967296"
 SYSTEM_CONSTANT "TIMEDELAY_S_LIN_16_RES" "0.000152592547379986"
 SYSTEM_CONSTANT "TIMEDELAY_S_LIN_16_RES_FL" "0.000152592547379986"
 SYSTEM_CONSTANT "TIMERMPINV_RES" "1.52587890625e-05"
 SYSTEM_CONSTANT "TIME_100ms_CYCLE" "100000"
 SYSTEM_CONSTANT "TIME_10ms_CYCLE" "10000"
 SYSTEM_CONSTANT "TIME_200ms_CYCLE" "200"
 SYSTEM_CONSTANT "TIME_20ms_CYCLE" "20000"
 SYSTEM_CONSTANT "TIME_2MS_CYCLE" "2000"
 SYSTEM_CONSTANT "TIME_40ms_CYCLE" "40000"
 SYSTEM_CONSTANT "TIME_4US_RES" "4"
 SYSTEM_CONSTANT "TIME_ADCFILT_RES" "0.003906"
 SYSTEM_CONSTANT "TIME_BUSY_GOV_MAX" "100"
 SYSTEM_CONSTANT "TIME_BUSY_GOV_MIN" "-100"
 SYSTEM_CONSTANT "TIME_BUSY_MAX" "400"
 SYSTEM_CONSTANT "TIME_BUSY_MIN" "20"
 SYSTEM_CONSTANT "TIME_BUSY_RES" "0.1"
 SYSTEM_CONSTANT "TIME_BUSY_ZERO" "0"
 SYSTEM_CONSTANT "TIME_CALC_INV" "0.65536"
 SYSTEM_CONSTANT "TIME_CONV_TICK" "8192"
 SYSTEM_CONSTANT "TIME_DEB_RES" "10"
 SYSTEM_CONSTANT "TIME_DT_10MS" "10000"
 SYSTEM_CONSTANT "TIME_DT_1SEC" "1000000"
 SYSTEM_CONSTANT "TIME_DT_MS_RES" "0.001"
 SYSTEM_CONSTANT "TIME_DT_RES" "1"
 SYSTEM_CONSTANT "TIME_DT_RES_FL" "1"
 SYSTEM_CONSTANT "TIME_ENGSPD_FLT_RES" "0.1"
 SYSTEM_CONSTANT "TIME_ENG_ON_RES" "1"
 SYSTEM_CONSTANT "TIME_ET_POLAR_MAX" "500"
 SYSTEM_CONSTANT "TIME_ET_POLAR_MIN" "200"
 SYSTEM_CONSTANT "TIME_HIGHRES_MAX" "8191.875"
 SYSTEM_CONSTANT "TIME_HIGH_RES" "0.125"
 SYSTEM_CONSTANT "TIME_HIGH_RES_REV" "8"
 SYSTEM_CONSTANT "TIME_LEAD_POLAR_MAX" "2000"
 SYSTEM_CONSTANT "TIME_LEAD_POLAR_MIN" "700"
 SYSTEM_CONSTANT "TIME_MS_100MS_RES" "100"
 SYSTEM_CONSTANT "TIME_MS_10MS" "10"
 SYSTEM_CONSTANT "TIME_MS_10MS_RES" "10"
 SYSTEM_CONSTANT "TIME_MS_20MS_RES" "20"
 SYSTEM_CONSTANT "TIME_MS_40MS_RES" "40"
 SYSTEM_CONSTANT "TIME_MS_MAX" "655140"
 SYSTEM_CONSTANT "TIME_MS_MAX32" "42949672740"
 SYSTEM_CONSTANT "TIME_MS_MIN" "60000"
 SYSTEM_CONSTANT "TIME_MS_ZERO" "0"
 SYSTEM_CONSTANT "TIME_PWM_HIGH_RES" "1e-07"
 SYSTEM_CONSTANT "TIME_RECOVERBUSOFF_MIN" "150"
 SYSTEM_CONSTANT "TIME_RED_MAX" "3600"
 SYSTEM_CONSTANT "TIME_RED_NRM" "4"
 SYSTEM_CONSTANT "TIME_RED_RES" "0.16"
 SYSTEM_CONSTANT "TIME_RES_FL" "1e-06"
 SYSTEM_CONSTANT "TIME_RMP_RES" "53687091.2"
 SYSTEM_CONSTANT "TIME_RTMHIGH_RES" "0.001"
 SYSTEM_CONSTANT "TIME_RTMHIGH_RES_REV" "1000"
 SYSTEM_CONSTANT "TIME_RTMLOW_RES" "0.1"
 SYSTEM_CONSTANT "TIME_RTMLOW_RES_REV" "10"
 SYSTEM_CONSTANT "TIME_S_MAX" "655.14"
 SYSTEM_CONSTANT "TIME_S_MAX32" "42949672.74"
 SYSTEM_CONSTANT "TIME_S_ZERO" "0"
 SYSTEM_CONSTANT "TIME_TICK" "10"
 SYSTEM_CONSTANT "TIME_TICK_1" "1"
 SYSTEM_CONSTANT "TIME_TICK_RES" "10"
 SYSTEM_CONSTANT "TIME_TICK_SEC_INV" "100"
 SYSTEM_CONSTANT "TIME_TINC_USEC_REV" "10"
 SYSTEM_CONSTANT "TIME_US_RES" "1"
 SYSTEM_CONSTANT "TIME_US_ZERO" "0"
 SYSTEM_CONSTANT "TI_PII_EARL_REL" "13000"
 SYSTEM_CONSTANT "TI_POI2_LATE_REL" "-13000"
 SYSTEM_CONSTANT "TMR_SHIFT_EXP" "13"
 SYSTEM_CONSTANT "TOXICATMOD_HEATFLOW_RES" "0.277777777777778"
 SYSTEM_CONSTANT "TRANS_R_MAX" "32767"
 SYSTEM_CONSTANT "TRANS_R_ONE" "1"
 SYSTEM_CONSTANT "TRANS_R_RES" "0.01"
 SYSTEM_CONSTANT "TRANS_R_RES_REV" "100"
 SYSTEM_CONSTANT "TRBCH_SPEED" "40000"
 SYSTEM_CONSTANT "TRNVRSACC_RES" "0.01"
 SYSTEM_CONSTANT "TRNVRSACC_RES_REV" "100"
 SYSTEM_CONSTANT "TRQDHIGH_RES" "960"
 SYSTEM_CONSTANT "TRQHIGH_RES" "5"
 SYSTEM_CONSTANT "TRQPRP_MAX" "32767"
 SYSTEM_CONSTANT "TRQPRP_MIN" "-32767"
 SYSTEM_CONSTANT "TRQPRP_RES" "1"
 SYSTEM_CONSTANT "TRQPRP_RES_REV" "1"
 SYSTEM_CONSTANT "TRQPRP_RMP_RES" "6553.6"
 SYSTEM_CONSTANT "TRQPRP_ZERO" "0"
 SYSTEM_CONSTANT "TRQXDHIGH_RES" "256"
 SYSTEM_CONSTANT "TRQ_FRC_INI" "-50"
 SYSTEM_CONSTANT "TRQ_INT_RES" "5"
 SYSTEM_CONSTANT "TRQ_INT_RES2" "1"
 SYSTEM_CONSTANT "TRQ_MAX" "1000"
 SYSTEM_CONSTANT "TRQ_MIN" "-500"
 SYSTEM_CONSTANT "TRQ_ONE" "1"
 SYSTEM_CONSTANT "TRQ_RES" "0.1"
 SYSTEM_CONSTANT "TRQ_RES_FL" "0.1"
 SYSTEM_CONSTANT "TRQ_RES_REV" "10"
 SYSTEM_CONSTANT "TRQ_RES_REZ" "10"
 SYSTEM_CONSTANT "TRQ_ZERO" "0"
 SYSTEM_CONSTANT "TR_POINT" "5"
 SYSTEM_CONSTANT "TSTTOG_K2SigBlkVal1_MAP_X" "4"
 SYSTEM_CONSTANT "TSTTOG_K2SigBlkVal2_MAP_X" "4"
 SYSTEM_CONSTANT "TSTTOG_K2SigBlkVal_MAP_X" "4"
 SYSTEM_CONSTANT "TSTTOG_NROUT" "29"
 SYSTEM_CONSTANT "TTSCD_TLIN_CUR_X" "20"
 SYSTEM_CONSTANT "TURBO_N_RES" "10"
 SYSTEM_CONSTANT "TVACD_DCYCCONV_CUR_X" "25"
 SYSTEM_CONSTANT "TWO_PI" "628.318530718"
 SYSTEM_CONSTANT "TWO_R32" "2"
 SYSTEM_CONSTANT "T_AIR_MAX" "199.86"
 SYSTEM_CONSTANT "T_AIR_MIN" "-50.14"
 SYSTEM_CONSTANT "T_CAT_MAX" "800"
 SYSTEM_CONSTANT "T_CAT_MIN" "-50"
 SYSTEM_CONSTANT "T_CLNT_DIFF_MAX" "200"
 SYSTEM_CONSTANT "T_CLNT_DIFF_MIN" "0"
 SYSTEM_CONSTANT "T_CLNT_MAX" "149.86"
 SYSTEM_CONSTANT "T_CLNT_MIN" "-50.14"
 SYSTEM_CONSTANT "T_EGAS_MAX" "999.86"
 SYSTEM_CONSTANT "T_EGAS_MIN" "-50.14"
 SYSTEM_CONSTANT "T_ENGOIL_MAX" "276.86"
 SYSTEM_CONSTANT "T_ENGOIL_MIN" "-53.14"
 SYSTEM_CONSTANT "T_ENG_MAX" "199.86"
 SYSTEM_CONSTANT "T_ENG_MIN" "-50.14"
 SYSTEM_CONSTANT "T_EXHGS_MAX" "1050"
 SYSTEM_CONSTANT "T_EXHGS_MIN" "-45"
 SYSTEM_CONSTANT "T_FUEL_MAX" "149.86"
 SYSTEM_CONSTANT "T_FUEL_MIN" "-50.14"
 SYSTEM_CONSTANT "T_LAMBDA_MAX" "-143.14"
 SYSTEM_CONSTANT "T_LAMBDA_MIN" "-263.14"
 SYSTEM_CONSTANT "T_PFLT_MAX" "999.86"
 SYSTEM_CONSTANT "T_PFLT_MIN" "-50.14"
 SYSTEM_CONSTANT "UACC_AdjValK2SigBlkVal_MAP_X" "5"
 SYSTEM_CONSTANT "UACC_AdjValK2SigBlkVal_MAP_Y" "23"
 SYSTEM_CONSTANT "UACC_EOPDK2SigBlkVal_MAP_X" "5"
 SYSTEM_CONSTANT "UACC_EOPDK2SigBlkVal_MAP_Y" "10"
 SYSTEM_CONSTANT "UACC_NUMECU_CA_X" "32"
 SYSTEM_CONSTANT "UACC_RSIGBLKGRP_MAP_X" "4"
 SYSTEM_CONSTANT "UACC_SIGNAL_MAX" "451"
 SYSTEM_CONSTANT "UBATT_ADC_REF" "20782"
 SYSTEM_CONSTANT "UBATT_MAX" "20782"
 SYSTEM_CONSTANT "UINT2CHG_PA_FAC" "4887.58553274682"
 SYSTEM_CONSTANT "UKEY_NUMCHANNEL_CA_Y" "23"
 SYSTEM_CONSTANT "UKEY_NUMPASSWD_CA_X" "10"
 SYSTEM_CONSTANT "UP" "1"
 SYSTEM_CONSTANT "US2ANGLE_FAC" "768000.000000001"
 SYSTEM_CONSTANT "USAP_MSKDATVAR" "8388607"
 SYSTEM_CONSTANT "USDIVMILLI2MS" "2500"
 SYSTEM_CONSTANT "US_ANGLE_CLS_RES" "3906.25"
 SYSTEM_CONSTANT "U_ADC_MAX" "5200"
 SYSTEM_CONSTANT "U_ADC_MIN" "0"
 SYSTEM_CONSTANT "U_ADC_REF" "5000"
 SYSTEM_CONSTANT "U_BUFC_RES" "0.01"
 SYSTEM_CONSTANT "U_EICH_REF" "1000"
 SYSTEM_CONSTANT "U_PA_RES" "0.01"
 SYSTEM_CONSTANT "U_RATED" "14000"
 SYSTEM_CONSTANT "U_RATED_PASS" "14000"
 SYSTEM_CONSTANT "U_RATED_TRUCK" "28000"
 SYSTEM_CONSTANT "U_RES" "5.0830889540567"
 SYSTEM_CONSTANT "U_TO_RESIST_RES" "0.001"
 SYSTEM_CONSTANT "U_TO_RESIST_REV_RES" "1000"
 SYSTEM_CONSTANT "V2N_NORM" "1000"
 SYSTEM_CONSTANT "V2N_RES" "1e-05"
 SYSTEM_CONSTANT "V2N_ZERO" "0"
 SYSTEM_CONSTANT "VEL2NM_RES" "8600"
 SYSTEM_CONSTANT "VEL2TRQPRP_CONV" "8192"
 SYSTEM_CONSTANT "VEL2TRQPRP_EXT" "8192"
 SYSTEM_CONSTANT "VEL2TRQPRP_RES" "0.01220703125"
 SYSTEM_CONSTANT "VELKMPH_FAC" "88.4194128288249"
 SYSTEM_CONSTANT "VEL_MAX" "300"
 SYSTEM_CONSTANT "VEL_MIN" "0"
 SYSTEM_CONSTANT "VEL_RES" "0.01"
 SYSTEM_CONSTANT "VEL_RES_REV" "100"
 SYSTEM_CONSTANT "VEL_RES_SI" "0.00277777777777778"
 SYSTEM_CONSTANT "VEL_THRES" "360000000"
 SYSTEM_CONSTANT "VEL_ZERO" "0"
 SYSTEM_CONSTANT "VLV_VEL_RES" "0.1"
 SYSTEM_CONSTANT "VN_GEAR_MAX" "6"
 SYSTEM_CONSTANT "VN_GEAR_MIN" "0"
 SYSTEM_CONSTANT "VOLCYL_RES" "1"
 SYSTEM_CONSTANT "VOLCYL_RES_REV" "1"
 SYSTEM_CONSTANT "VOLT_BATT_RES_REV" "0.0492252911173131"
 SYSTEM_CONSTANT "VOLT_BOOST_MAX" "260"
 SYSTEM_CONSTANT "VOLT_BOOST_MIN" "0"
 SYSTEM_CONSTANT "VOLT_BOOST_ZERO" "0"
 SYSTEM_CONSTANT "VOLT_BUFC_LIM" "215"
 SYSTEM_CONSTANT "VOLT_BUFC_MAX" "260"
 SYSTEM_CONSTANT "VOLT_BUFC_MIN" "0"
 SYSTEM_CONSTANT "VOLT_BUFC_ZERO" "0"
 SYSTEM_CONSTANT "VOLT_INT_FAC" "1000"
 SYSTEM_CONSTANT "VOLT_MAX" "20000"
 SYSTEM_CONSTANT "VOLT_PA_MAX" "250"
 SYSTEM_CONSTANT "VOLT_PA_MIN" "-250"
 SYSTEM_CONSTANT "VOLT_PA_OFFS_MAX" "15"
 SYSTEM_CONSTANT "VOLT_PA_OFFS_MIN" "-15"
 SYSTEM_CONSTANT "VOLT_PA_OFFS_TOLC_MAX" "5"
 SYSTEM_CONSTANT "VOLT_PA_OFFS_TOLC_MIN" "-5"
 SYSTEM_CONSTANT "VOLT_PA_ZERO" "0"
 SYSTEM_CONSTANT "VOLT_ZERO" "0"
 SYSTEM_CONSTANT "VOL_ADD_MAX" "3276.7"
 SYSTEM_CONSTANT "VOL_ADD_MAX_FINE" "2100"
 SYSTEM_CONSTANT "VOL_ADD_MAX_FIRST" "200"
 SYSTEM_CONSTANT "VOL_ADD_MAX_TEST" "2"
 SYSTEM_CONSTANT "VOL_ADD_MIN" "0"
 SYSTEM_CONSTANT "VOL_ADD_MIN_FINE" "0"
 SYSTEM_CONSTANT "VOL_ADD_RES" "0.1"
 SYSTEM_CONSTANT "VOL_ADD_RES_FINE" "0.001"
 SYSTEM_CONSTANT "VOL_ADD_RES_FINE_REZ" "1000"
 SYSTEM_CONSTANT "VOL_ADD_RES_REZ" "10"
 SYSTEM_CONSTANT "VOL_FILLLVL_RES" "1"
 SYSTEM_CONSTANT "VOL_FILLLVL_RES_REV" "1"
 SYSTEM_CONSTANT "VOL_RES" "0.01"
 SYSTEM_CONSTANT "VOL_RES_REV" "100"
 SYSTEM_CONSTANT "VSACD_DCYCCONV_CUR_X" "25"
 SYSTEM_CONSTANT "VSACD_DIAG" "1"
 SYSTEM_CONSTANT "VSACD_MAX_DTY_CYC" "100"
 SYSTEM_CONSTANT "VSACD_NODIAG" "0"
 SYSTEM_CONSTANT "VSACD_SWT_SEL" "1"
 SYSTEM_CONSTANT "VSSCD_SIG_CAN_BRK1" "1"
 SYSTEM_CONSTANT "VSSCD_SIG_CAN_DSP1" "5"
 SYSTEM_CONSTANT "VSSCD_SIG_HW" "0"
 SYSTEM_CONSTANT "VSSCD_SWTSIG_TYPE" "2"
 SYSTEM_CONSTANT "VSSCD_SWTSIG_VAL" "0"
 SYSTEM_CONSTANT "VSSCD_SWTSIG_VAL_MAX" "5"
 SYSTEM_CONSTANT "VSSCD_TIPER_MAX" "13421772.8"
 SYSTEM_CONSTANT "VW_ACC" "1"
 SYSTEM_CONSTANT "W2PWR_PA_DIV" "60"
 SYSTEM_CONSTANT "W_PA_MAX" "100"
 SYSTEM_CONSTANT "W_PA_RES" "1"
 SYSTEM_CONSTANT "W_PA_ZERO" "0"
 SYSTEM_CONSTANT "ZERO_R32" "0"
 SYSTEM_CONSTANT "ZFC_PHISET_CUR_X" "16"
 SYSTEM_CONSTANT "ZFC_SWTCLBACTV_TYPE" "2"
 SYSTEM_CONSTANT "ZFC_SWTCLBACTV_VAL" "1"
 SYSTEM_CONSTANT "ZFC_TICLDCHAM_CUR_X" "12"
 SYSTEM_CONSTANT "_PA_BRANCHTAB" "65792" /end MOD_PAR
/begin MOD_COMMON "" BYTE_ORDER MSB_FIRST ALIGNMENT_BYTE 1 ALIGNMENT_WORD 2 ALIGNMENT_LONG 4 ALIGNMENT_FLOAT32_IEEE 4 /end MOD_COMMON
/begin IF_DATA ASAP1B_Bypass
 /begin TP_BLOB 0x100 /* Bypass version */ 0x100 /end TP_BLOB
/end IF_DATA
/begin IF_DATA ASAP1B_CCP
 /begin SOURCE "segment synchronous event channel" 103 1 /begin QP_BLOB 0 LENGTH 8 CAN_ID_FIXED 0x330 FIRST_PID 0 RASTER 0 /end QP_BLOB /end SOURCE
 /begin SOURCE "10ms time synchronous event channel" 4 1 /begin QP_BLOB 1 LENGTH 12 CAN_ID_FIXED 0x340 FIRST_PID 8 RASTER 1 /end QP_BLOB /end SOURCE
 /begin SOURCE "100ms time synchronous event channel" 4 10 /begin QP_BLOB 2 LENGTH 8 CAN_ID_FIXED 0x350 FIRST_PID 20 RASTER 2 /end QP_BLOB /end SOURCE
 /begin RASTER "segment synchronous event channel" "seg_sync" 0 103 1 /end RASTER
 /begin RASTER "10ms time synchronous event channel" "10_ms" 1 4 1 /end RASTER
 /begin RASTER "100ms time synchronous event channel" "100_ms" 2 4 10 /end RASTER
 /begin SEED_KEY /* seed&key dll for CAL privilege */ "" /* seed&key dll for DAQ privilege */ "" /* seed&key dll for PGM privilege */ "" /end SEED_KEY
 /begin TP_BLOB /* CCP version */ 0x200 0x202 /* CAN msg ID - send */ 0x200 /* CAN msg ID - recv */ 0x210 /* station address */ 0x1234 /* byte order */ 1
  /begin CAN_PARAM /* crystal frequency */ 0x3E8 /* timing register 0 */ 0x40 /* timing register 1 */ 0x16 /end CAN_PARAM
  DAQ_MODE BURST CONSISTENCY DAQ
  /begin CHECKSUM_PARAM /* algorithm */ 0xC001 /* limit */ 0xFFFFFFFF CHECKSUM_CALCULATION ACTIVE_PAGE /end CHECKSUM_PARAM
  /begin DEFINED_PAGES 1 "reference page" /* address ext. */ 0x00 /* base address */ 0x1C1284 /* page length */ 0x28BD0 ROM /end DEFINED_PAGES
  /begin DEFINED_PAGES 2 "working page" /* address ext. */ 0x00 /* base address */ 0x801C1284 /* page length */ 0x28BD0 RAM RAM_INIT_BY_ECU /end DEFINED_PAGES
  OPTIONAL_CMD 0x11 /* SELECT_CAL_PAGE */ OPTIONAL_CMD 0xE /* BUILD_CHKSUM */ OPTIONAL_CMD 0x19 /* MOVE */ OPTIONAL_CMD 0x9 /* GET_ACTIVE_CAL_PAGE */ OPTIONAL_CMD 0xC /* SET_S_STATUS */ OPTIONAL_CMD 0xD /* GET_S_STATUS */ OPTIONAL_CMD 0x12 /* GET_SEED */ OPTIONAL_CMD 0x13 /* UNLOCK */ /end TP_BLOB
/end IF_DATA
/begin IF_DATA ETK
 /begin SOURCE "segment synchronous raster" 103 1 QP_BLOB 1 /* MAXNUM_A */ 200 /* DISTAB_A */ 0x11C0188 /* CHNL_A */ 0x9FE0DC /* TRG_ID_A */ 0x9FE088 /* TrgRate */ 0 0 0x0 /end SOURCE
 /begin SOURCE "10ms time synchronous raster" 4 1 QP_BLOB 2 /* MAXNUM_B */ 200 /* DISTAB_B */ 0x11C04B0 /* CHNL_B */ 0x9FE1A4 /* TRG_ID_B */ 0x9FE08C /* TrgRate */ 20 0 0x0 /end SOURCE
 /begin SOURCE "100ms time synchronous raster" 5 1 QP_BLOB 3 /* MAXNUM_C */ 100 /* DISTAB_C */ 0x11C07D8 /* CHNL_C */ 0x9FE26C /* TRG_ID_C */ 0x9FE090 100 0 0x0 /end SOURCE
 /begin SOURCE "bypass segment sync. raster" 103 1 QP_BLOB 4 /* BPMAX_S */ 28 /* BYPASS_S */ 0x11C0058 /* CHNL_S */ 0x9FE094 /* TRGID_S */ 0x9FE080 0 /* BPMAX_T */ 28 /* CHNL_T */ 0x11C0970 /end SOURCE
 /begin SOURCE "bypass 10ms time sync. raster" 4 1 QP_BLOB 5 /* BPMAX_X */ 44 /* BYPASS_X */ 0x11C00D0 /* CHNL_X */ 0x9FE0B0 /* TRGID_X */ 0x9FE084 20 /* BPMAX_Y */ 44 /* CHNL_Y */ 0x11C09B0 /end SOURCE
 /begin TP_BLOB 0x1000001 /* PBA */ 0x0 /* RESET_CFG */ 0x800
  /begin DISTAB_CFG /* DSPTAB */ 13 /* DAT_MOD */ 1 /* RFG */ 1 /* TRGSEGAD */ 0x9FE000 /* TRG_CFG */ 0x1020100 TRG_MOD 0 255 /end DISTAB_CFG
  CODE_CHK /* ChkSumData */ 0x11FDF74 /* PrgDataLen */ 0x4 /* ChkSumExtRam */ 0x9FFFF8 /* PrgExtRamLen */ 0x4 ETK_CFG 0x03 0xD2 0x4D 0xFF 0xEF 0x4E 0xDF 0xEF 0x4E 0xFF 0xFB 0xFE 0xFF 0xFF 0xFE 0xFF 0xFF 0xF0 0x0F 0xFF 0x03 0xCD 0xFF 0xFF RESERVED 0x11C0058 0xAF8 EXTERN -1 -1 -1 -1 -1 /end TP_BLOB
/end IF_DATA
/begin IF_DATA ASAP1B_KWP2000
 /begin SOURCE "timeslot" 4 1 QP_BLOB 0 BLOCKMODE 0xF0 0 20 /end SOURCE
 /begin TP_BLOB 0x101 /* ECU address on k line */ 0x10 /* requ. tester address */ 0xF1 /* ECU stimulation mode */ WuP /* byte order */ MSB_FIRST 1 DATA_ACCESS /* Flash address */ 0x000000 /* RAM address */ 0x000000 /* Data Read */ 1 /* Code Verify */ 0 /* Code Read */ 0 /* Load mode */ 1 /begin CHECKSUM 0x010201 1 1 RequestRoutineResults RNC_RESULT 0x23 /end CHECKSUM
  /begin FLASH_COPY NOFLASHBACK 3 RequestRoutineResults RAM_InitByECU 0x86 COPY_FRAME 1 RNC_RESULT 0x23 0xFB 0xFC /end FLASH_COPY
  /begin DIAG_BAUD 38400 0x86 BD_PARA 0x50 /end DIAG_BAUD
  /begin DIAG_BAUD 10400 0x86 BD_PARA 0x14 /end DIAG_BAUD
  /begin DIAG_BAUD 57600 0x86 BD_PARA 0x64 /end DIAG_BAUD
  /begin DIAG_BAUD 125000 0x86 BD_PARA 0x87 /end DIAG_BAUD
  /* Timing Parameter: p1Max p2Min p2Max p3Min p3Max p4Min */ TIME_DEF 0x0014 0x0000 0x0032 0x0003 0x0200 0x0000 TIME_DEF 0x0014 0x0000 0x0032 0x0003 0x0200 0x0001 TIME_DEF 20 0 2000 0 5000 65440 /* Seed&Key Parameter: AccMode CalcMethod Delay */ SECURITY_ACCESS 3 1 0 SECURITY_ACCESS 9 1 0 /begin PAGE_SWITCH ESCAPE_CODE ESCAPE_CODE_PARA 0x90 PAGE_CODE 0x00 0x01 /end PAGE_SWITCH /end TP_BLOB
/end IF_DATA
/begin IF_DATA ASAP1B_MCMESS
 /begin SOURCE "segment synchronous raster" 103 1 QP_BLOB ANGLE 20 /* max. number of bytes (BLKZ_W) */ /end SOURCE
 /begin SOURCE "10ms time synchronous raster" 103 1 QP_BLOB TIME 20 /* max. number of bytes (BLKZ_Z) */ /end SOURCE
 /begin SOURCE "handshake" 103 1 QP_BLOB HANDSHAKE 20 /* max. number of bytes: 0 */ /end SOURCE
 /begin TP_BLOB 0x101 KOMKEN 11 /* communication identifier */ MCTGT 0x10 /* target address */ MCINI KW2000 /* wake up method */
  /begin CHECKSUM_PARAM /* type qualifier */ 0x8001 CHECKSUM_CALCULATION ACTIVE_PAGE /end CHECKSUM_PARAM
  /begin DEFINED_PAGES 1 "reference page" FLASH NO_FLASH_BACK DEFAULT /end DEFINED_PAGES
  BYTE_ORDER MSB_FIRST THREE_BYTE_ADDRESSES /end TP_BLOB
/end IF_DATA
/begin CHARACTERISTIC ACCCD_stACCnew_Vector "Konfigurationslabel für Bypass Freischnitt" VALUE 0x1C0A18 Kw_Wu8 255.0 OneToOne 0.00 255.0 FORMAT "%5.1" /end CHARACTERISTIC
/begin CHARACTERISTIC ACCCD_stACCnew_Channel "Konfigurationslabel für Bypass Freischnitt" VALUE 0x1C0A19 Kw_Wu8 255.0 OneToOne 0.00 255.0 FORMAT "%5.1" /end CHARACTERISTIC
/begin CHARACTERISTIC ACCCD_stACC_Vector "Konfigurationslabel für Bypass Freischnitt" VALUE 0x1C0A1A Kw_Wu8 255.0 OneToOne 0.00 255.0 FORMAT "%5.1" /end CHARACTERISTIC
/begin CHARACTERISTIC ACCCD_stACC_Channel "Konfigurationslabel für Bypass Freischnitt" VALUE 0x1C0A1B Kw_Wu8 255.0 OneToOne 0.00 255.0 FORMAT "%5.1" /end CHARACTERISTIC
/begin CHARACTERISTIC ACCCD_stBrk_Vector "Konfigurationslabel für Bypass Freischnitt" VALUE 0x1C0A1C Kw_Wu8 255.0 OneToOne 0.00 255.0 FORMAT "%5.1" /end CHARACTERISTIC
/begin CHARACTERISTIC ACCCD_stBrk_Channel "Konfigurationslabel für Bypass Freischnitt" VALUE 0x1C0A1D Kw_Wu8 255.0 OneToOne 0.00 255.0 FORMAT "%5.1" /end CHARACTERISTIC
/begin CHARACTERISTIC ACCCD_tiBrkTrqDet_C "Entprellzeit der ACC Brems-Moment Erkennung" VALUE 0x1C1680 Kw_Wu16 655350.0 Time_ms 0.00 655350.0 FORMAT "%8.1" /end CHARACTERISTIC
/begin CHARACTERISTIC ACCCD_trqBrkDetUp_C "Aufwärtsrampensteigung der ACC Brems-Momenten-Anforderung" VALUE 0x1C1684 Kw_Wu32 65535949.9817 RmpTrqPrp 50.0030517578 65535999.9847 FORMAT "%13.4" EXTENDED_LIMITS 0.00 65535999.9847 /end CHARACTERISTIC
/begin CHARACTERISTIC ACCCD_trqBrkDetDwn_C "Abwärtsrampensteigung der ACC Brems-Momenten-Anforderung" VALUE 0x1C1688 Kw_Wu32 65535949.9817 RmpTrqPrp 50.0030517578 65535999.9847 FORMAT "%13.4" EXTENDED_LIMITS 0.00 65535999.9847 /end CHARACTERISTIC
/begin CHARACTERISTIC ACCCD_trqDes_Vector "Konfigurationslabel für Bypass Freischnitt" VALUE 0x1C0A1E Kw_Wu8 255.0 OneToOne 0.00 255.0 FORMAT "%5.1" /end CHARACTERISTIC
/begin CHARACTERISTIC ACCCD_trqDes_Channel "Konfigurationslabel für Bypass Freischnitt" VALUE 0x1C0A1F Kw_Wu8 255.0 OneToOne 0.00 255.0 FORMAT "%5.1" /end CHARACTERISTIC
/begin CHARACTERISTIC ACCCD_tiWrongCodedDebDef_C "Fehlerentprellzeit für falsch codiertes MSG" VALUE 0x1C168C Kw_Wu16 655350.0 Time_ms 0.00 655350.0 FORMAT "%8.1" /end CHARACTERISTIC
/begin CHARACTERISTIC ACCCD_tiWrongCodedDebOk_C "Fehlerheilungszeit für falsch codiertes MSG" VALUE 0x1C168E Kw_Wu16 655350.0 Time_ms 0.00 655350.0 FORMAT "%8.1" /end CHARACTERISTIC
/begin CHARACTERISTIC ACCD_tiDebCanSigDef_C "Fehlerdefekterkennungszeit für den CAN-Signal-Fehler" VALUE 0x1C1690 Kw_Wu16 655350.0 Time_ms 0.00 655350.0 FORMAT "%8.1" /end CHARACTERISTIC
/begin CHARACTERISTIC ACCD_tiDebCanSigOk_C "Fehlerheilungserkennungszeit für den CAN-Signal-Fehler" VALUE 0x1C1692 Kw_Wu16 655350.0 Time_ms 0.00 655350.0 FORMAT "%8.1" /end CHARACTERISTIC
/begin CHARACTERISTIC ACCD_DebNoLoadDef_C "Defektzeit für Fehler ""Endstufe im Leerlauf""" VALUE 0x1C1694 Kw_Wu16 655350.0 Time_ms 0.00 655350.0 FORMAT "%8.1" READ_ONLY /end CHARACTERISTIC
/begin CHARACTERISTIC ACCD_DebNoLoadOk_C "Heilungszeit für Fehler ""Endstufe im Leerlauf""" VALUE 0x1C1696 Kw_Wu16 655350.0 Time_ms 0.00 655350.0 FORMAT "%8.1" READ_ONLY /end CHARACTERISTIC
/begin CHARACTERISTIC ACCD_DebNoTempDef_C "Entprellzeit für NPL-Fehler Dig. Ausgang Klimakompressor defekt" VALUE 0x1C1698 Kw_Wu16 655350.0 Time_ms 0.00 655350.0 FORMAT "%8.1" /end CHARACTERISTIC
/begin CHARACTERISTIC ACCD_DebNoTempOk_C "Entprellzeit für NPL-Fehler Dig. Ausgang Klimakompressor geheilt" VALUE 0x1C169A Kw_Wu16 655350.0 Time_ms 0.00 655350.0 FORMAT "%8.1" /end CHARACTERISTIC
/begin CHARACTERISTIC ACCD_DebShortCircBatDef_C "Defektzeit für Fehler ""Kurzschluß nach BATT""" VALUE 0x1C169C Kw_Wu16 655350.0 Time_ms 0.00 655350.0 FORMAT "%8.1" /end CHARACTERISTIC
/begin CHARACTERISTIC ACCD_DebShortCircBatOk_C "Heilungszeit für Fehler ""Kurzschluß nach BATT""" VALUE 0x1C169E Kw_Wu16 655350.0 Time_ms 0.00 655350.0 FORMAT "%8.1" /end CHARACTERISTIC
/begin CHARACTERISTIC ACCD_DebShortCircGndDef_C "Defektzeit für Fehler ""Kurzschluß nach Masse""" VALUE 0x1C16A0 Kw_Wu16 655350.0 Time_ms 0.00 655350.0 FORMAT "%8.1" /end CHARACTERISTIC
/begin CHARACTERISTIC ACCD_DebShortCircGndOk_C "Heilungszeit für Fehler ""Kurzschluß nach Masse""" VALUE 0x1C16A2 Kw_Wu16 655350.0 Time_ms 0.00 655350.0 FORMAT "%8.1" /end CHARACTERISTIC
/begin CHARACTERISTIC ACCD_tiMnSwtDebNeg_C "Entprellzeit für negativen Zustand" VALUE 0x1C16A4 Kw_Wu16 655350.0 TimeDeb 0.00 655350.0 FORMAT "%8.1" /end CHARACTERISTIC
/begin CHARACTERISTIC ACCD_tiMnSwtDebPos_C "Entprellzeit für positiven Zustand" VALUE 0x1C16A6 Kw_Wu16 655350.0 TimeDeb 0.00 655350.0 FORMAT "%8.1" /end CHARACTERISTIC
/begin CHARACTERISTIC ACCD_tiDebPACMaxDef_C "Entprellzeit für Max-Fehler defekt" VALUE 0x1C16A8 Kw_Wu16 655350.0 Time_ms 0.00 655350.0 FORMAT "%8.1" /end CHARACTERISTIC
/begin CHARACTERISTIC ACCD_tiDebPACMaxOk_C "Entprellzeit für Max-Fehler geheilt" VALUE 0x1C16AA Kw_Wu16 655350.0 Time_ms 0.00 655350.0 FORMAT "%8.1" /end CHARACTERISTIC
/begin CHARACTERISTIC ACCD_tiDebPACMinDef_C "Entprellzeit für Min-Fehler defekt" VALUE 0x1C16AC Kw_Wu16 655350.0 Time_ms 0.00 655350.0 FORMAT "%8.1" /end CHARACTERISTIC
/begin CHARACTERISTIC ACCD_tiDebPACMinOk_C "Entprellzeit für Min-Fehler geheilt" VALUE 0x1C16AE Kw_Wu16 655350.0 Time_ms 0.00 655350.0 FORMAT "%8.1" /end CHARACTERISTIC
/begin CHARACTERISTIC ACCD_tiDebPACSigDef_C "Entprellzeit für Sig-Fehler defekt" VALUE 0x1C16B0 Kw_Wu16 655350.0 Time_ms 0.00 655350.0 FORMAT "%8.1" /end CHARACTERISTIC
/begin CHARACTERISTIC ACCD_tiDebPACSigOk_C "Entprellzeit für Sig-Fehler geheilt" VALUE 0x1C16B2 Kw_Wu16 655350.0 Time_ms 0.00 655350.0 FORMAT "%8.1" /end CHARACTERISTIC
/begin CHARACTERISTIC ACCD_tiRmpLo2Hi_C "pos. Rampe um Default-Wert zu erreichen" VALUE 0x1C16B4 Kw_Wu32 131071999.969 RmpPresAC_hPa 0.00 131071999.969 FORMAT "%13.3" /end CHARACTERISTIC
/begin CHARACTERISTIC ACCD_tiRmpHi2Lo_C "neg. Rampe um Default-Wert zu erreichen" VALUE 0x1C16B8 Kw_Wu32 131071999.969 RmpPresAC_hPa 0.00 131071999.969 FORMAT "%13.3" /end CHARACTERISTIC
/begin CHARACTERISTIC ACCD_stSensIDWord_C "Kennzahl zur Festlegung des Fehlerverhaltens des analogen Klimadrucks" VALUE 0x1C16BC Kw_Wu16 65535.00 OneToOne 0.00 65535.00 FORMAT "%8.2" /end CHARACTERISTIC
/begin CHARACTERISTIC ACCD_pDfl_C "Klimadruck-Vorgabewert" VALUE 0x1C16BE Kw_Ws16 131070.0 PresAC_hPa -65536.00 65534.00 FORMAT "%8.2" /end CHARACTERISTIC
/begin CHARACTERISTIC ACCD_stPwmInInv_C "PWM-Eingang invertieren (JA|NEIN)" VALUE 0x1C16C0 Kw_Wu8 1.000 OneToOne 0.00 1.000 FORMAT "%5.3" EXTENDED_LIMITS 0.00 255.0 /end CHARACTERISTIC
/begin CHARACTERISTIC ACCD_tiPwmInMinPer_C "min. Periodendauer PWM-Eingang" VALUE 0x1C16C2 Kw_Ws16 1.000000 Period 1.000000 2.000000 FORMAT "%8.6" EXTENDED_LIMITS -3276.800 3276.700 /end CHARACTERISTIC
/begin CHARACTERISTIC ACCD_tiPwmInMaxPer_C "max. Periodendauer PWM-Eingang" VALUE 0x1C16C4 Kw_Ws16 719.2000 Period 100.0000 819.2000 FORMAT "%8.4" EXTENDED_LIMITS -3276.800 3276.700 /end CHARACTERISTIC
/begin CHARACTERISTIC ACCD_dcycPwmInMin_C "minimales Tastverhältnis vom PWM-Input vom Kältemitteldruck" VALUE 0x1C16C6 Kw_Ws16 100.0000 DtyCyc 0.00 100.0000 FORMAT "%8.4" EXTENDED_LIMITS -327.6800 327.6700 /end CHARACTERISTIC
/begin CHARACTERISTIC ACCD_dcycPwmInMax_C "maximalesTastverhältnis vom PWM-Input vom Kältemitteldruck" VALUE 0x1C16C8 Kw_Ws16 100.0000 DtyCyc 0.00 100.0000 FORMAT "%8.4" EXTENDED_LIMITS -327.6800 327.6700 /end CHARACTERISTIC
/begin CHARACTERISTIC ACCD_rLin_CUR "Kennlinie zur Umwandlung des Tastverhältnisses in den Kältemitteldruck" CURVE 0x1C16CA Kl_Xs16_Ws16 1000.000 PresAC_hPa 0.00 1000.000 FORMAT "%8.3" EXTENDED_LIMITS -65536.00 65534.00
 /begin AXIS_DESCR STD_AXIS ACCD_rPwmDcycIn_mp DtyCyc 2 0.00 100.0000 FORMAT "%8.4" EXTENDED_LIMITS -327.6800 327.6700 DEPOSIT ABSOLUTE /end AXIS_DESCR
/end CHARACTERISTIC
/begin CHARACTERISTIC ACCD_stACDfl_C "Vorgabewert für ACCD_stAC" VALUE 0x1C16D4 Kw_Wu16 65535.00 OneToOne 0.00 65535.00 FORMAT "%8.2" /end CHARACTERISTIC
/begin CHARACTERISTIC ACCD_stComprDigIn_C "Dig. Eingang d. Bidirektionalen Schnittstelle invert.  (JA/NEIN)" VALUE 0x1C16D6 Kw_Wu8 1.000 OneToOne 0.00 1.000 FORMAT "%5.3" EXTENDED_LIMITS 0.00 255.0 /end CHARACTERISTIC
/begin CHARACTERISTIC ACCD_stInvOut_C "Dig. Ausgang Klimakompressor  invert.  (JA/NEIN)" VALUE 0x1C16D7 Kw_Wu8 1.000 OneToOne 0.00 1.000 FORMAT "%5.3" EXTENDED_LIMITS 0.00 255.0 /end CHARACTERISTIC
/begin CHARACTERISTIC ACCD_stMnSwtInvIn_C "Dig. Eingang inventieren? (JA/NEIN)" VALUE 0x1C16D8 Kw_Wu8 1.000 OneToOne 0.00 1.000 FORMAT "%5.3" EXTENDED_LIMITS 0.00 255.0 /end CHARACTERISTIC
/begin CHARACTERISTIC ACCD_swtACtypeVal_C "Software Schalter für AC Typen information" VALUE 0x1C16D9 Kw_Wu8 2.000 OneToOne 0.00 2.000 FORMAT "%5.3" EXTENDED_LIMITS 0.00 255.0 /end CHARACTERISTIC
/begin CHARACTERISTIC ACCD_swtACtypeType_C "Type des Softwareschalters Klimavariante" VALUE 0x1C16DA Kw_Wu8 0.00 OneToOne 2.000 2.000 FORMAT "%5.3" EXTENDED_LIMITS 0.00 255.0 /end CHARACTERISTIC
/begin CHARACTERISTIC ACCD_swtClimatronic_C "Climatronic verbaut (JA/NEIN)" VALUE 0x1C16DB Kw_Wu8 1.000 OneToOne 0.00 1.000 FORMAT "%5.3" EXTENDED_LIMITS 0.00 255.0 /end CHARACTERISTIC
/begin CHARACTERISTIC ACCD_swtComprON_C "Schalter für Plausibilitätsprüfung mit Kältemitteldruck" VALUE 0x1C16DC Kw_Wu8 1.000 OneToOne 0.00 1.000 FORMAT "%5.3" EXTENDED_LIMITS 0.00 255.0 /end CHARACTERISTIC
/begin CHARACTERISTIC ACCD_tiComprON_C "Startverzögerung für Klimakompressor ein" VALUE 0x1C16DE Kw_Wu16 655350.0 Time_ms 0.00 655350.0 FORMAT "%8.1" /end CHARACTERISTIC
/begin CHARACTERISTIC ACCD_trqComprDfl_C "AC Kompressorlast Vorgabewert" VALUE 0x1C16E0 Kw_Ws16 6553.500 Trq -3276.800 3276.700 FORMAT "%8.3" /end CHARACTERISTIC
/begin CHARACTERISTIC ACCD_trqComprHi_C "obere Hystereseschwelle für Kompressor - Statusberechnbung" VALUE 0x1C16E2 Kw_Ws16 1000.000 Trq 0.00 1000.000 FORMAT "%8.3" EXTENDED_LIMITS -3276.800 3276.700 /end CHARACTERISTIC
/begin CHARACTERISTIC ACCD_trqComprLo_C "untere Hystereseschwelle für Kompressor - Statusberechnbung" VALUE 0x1C16E4 Kw_Ws16 1000.000 Trq 0.00 1000.000 FORMAT "%8.3" EXTENDED_LIMITS -3276.800 3276.700 /end CHARACTERISTIC
/begin CHARACTERISTIC AccPed_tiDebAliveDef_C "Entprellzeit für Lebenderrkennung APP" VALUE 0x1C16E8 Kw_Wu16 655350.0 Time_ms 0.00 655350.0 FORMAT "%8.1" /end CHARACTERISTIC
/begin CHARACTERISTIC AccPed_tiDebAliveOk_C "Entprellzeit für Lebenderrkennung APP" VALUE 0x1C16EA Kw_Wu16 655350.0 Time_ms 0.00 655350.0 FORMAT "%8.1" /end CHARACTERISTIC
/begin CHARACTERISTIC AccPed_tiDebPladrLckDef_C "Entprellzeit für Erkennung APP-Gradient" VALUE 0x1C16EC Kw_Wu16 655350.0 Time_ms 0.00 655350.0 FORMAT "%8.1" /end CHARACTERISTIC
/begin CHARACTERISTIC AccPed_tiDebPladrLckOk_C "Entprellzeit für Erkennung APP-Gradient" VALUE 0x1C16EE Kw_Wu16 655350.0 Time_ms 0.00 655350.0 FORMAT "%8.1" /end CHARACTERISTIC
/begin CHARACTERISTIC AccPed_tiDebMisUseOk_C "Entprellzeit für nicht erkannten Mißbrauch" VALUE 0x1C16F0 Kw_Wu16 655350.0 Time_ms 0.00 655350.0 FORMAT "%8.1" /end CHARACTERISTIC
/begin CHARACTERISTIC AccPed_tiDebMisUseDef_C "Entprellzeit für Mißbrauchserkennung" VALUE 0x1C16F2 Kw_Wu16 655350.0 Time_ms 0.00 655350.0 FORMAT "%8.1" /end CHARACTERISTIC
/begin CHARACTERISTIC AccPed_dfacRampSlope_C "Rampensteigung der Transitionsfunktion" VALUE 0x1C16F4 Kw_Wu32 1.00000202656 RmpFactLow 0.00 1.00000202656 FORMAT "%13.11" EXTENDED_LIMITS 0.00 63999.9999851 /end CHARACTERISTIC
/begin CHARACTERISTIC AccPed_drAPPUnFltLim_C "Schwelle für Anfahrerkennung" VALUE 0x1C16F8 Kw_Ws16 5000.000 PrcPerSec 0.00 5000.000 FORMAT "%8.3" EXTENDED_LIMITS -16384.00 16383.50 /end CHARACTERISTIC
/begin CHARACTERISTIC AccPed_drLimpMax_C "Maximaler APP-Gradient im Notfahrbetrieb" VALUE 0x1C16FA Kw_Ws16 5000.000 PrcPerSec 0.00 5000.000 FORMAT "%8.3" EXTENDED_LIMITS -16384.00 16383.50 /end CHARACTERISTIC
/begin CHARACTERISTIC AccPed_drLimUp_C "positive Rampensteigung bei Erkennung oder Heilung Unplausibilität  PWG-Bremse" VALUE 0x1C16FC Kw_Wu32 655359.399872 RmpPrc 0.599975585938 655359.999847 FORMAT "%13.6" EXTENDED_LIMITS 0.00 655359.999847 /end CHARACTERISTIC
/begin CHARACTERISTIC AccPed_drLimDwn_C "negative Rampensteigung bei Unplausibilität PWG-Bremse" VALUE 0x1C1700 Kw_Wu32 655359.399872 RmpPrc 0.599975585938 655359.999847 FORMAT "%13.6" EXTENDED_LIMITS 0.00 655359.999847 /end CHARACTERISTIC
/begin CHARACTERISTIC AccPed_nErr_C "Leerlaufsolldrehzahl bei Plausibilitätsfehler" VALUE 0x1C1704 Kw_Ws16 6000.000 EngN 0.00 6000.000 FORMAT "%8.3" EXTENDED_LIMITS -32768.00 32767.00 /end CHARACTERISTIC
/begin CHARACTERISTIC AccPed_nLIMinBrk_C "APP Leerlaufsolldrehzahlvorgabe bei gedrueckter Bremse" VALUE 0x1C1706 Kw_Ws16 6000.000 EngN 0.00 6000.000 FORMAT "%8.3" EXTENDED_LIMITS -32768.00 32767.00 /end CHARACTERISTIC
/begin CHARACTERISTIC AccPed_nLIMinvHigh_C "APP Leerlaufsolldrehzahlvorgabe bei Fahrzeuggeschwindigkeit oberhalb Schwelle" VALUE 0x1C1708 Kw_Ws16 6000.000 EngN 0.00 6000.000 FORMAT "%8.3" EXTENDED_LIMITS -32768.00 32767.00 /end CHARACTERISTIC
/begin CHARACTERISTIC AccPed_nLIMinvLow_C "APP Leerlaufsolldrehzahlvorgabe bei Fahrzeuggeschwindigkeit unterhalb Schwelle" VALUE 0x1C170A Kw_Ws16 6000.000 EngN 0.00 6000.000 FORMAT "%8.3" EXTENDED_LIMITS -32768.00 32767.00 /end CHARACTERISTIC
/begin CHARACTERISTIC AccPed_nLimMisUse_C "Drehzahlschwelle für Mißbrauchserkennung" VALUE 0x1C170C Kw_Ws16 6000.000 EngN 0.00 6000.000 FORMAT "%8.3" EXTENDED_LIMITS -32768.00 32767.00 /end CHARACTERISTIC
/begin CHARACTERISTIC AccPed_nLimNMR_C "Drehzahlschwelle für nicht überwachten Betriebsbereich" VALUE 0x1C170E Kw_Ws16 6000.000 EngN 0.00 6000.000 FORMAT "%8.3" EXTENDED_LIMITS -32768.00 32767.00 /end CHARACTERISTIC
/begin CHARACTERISTIC AccPed_nLim_C "Drehzahlschwelle für Freigabe Fahrpedalprüfung" VALUE 0x1C1710 Kw_Ws16 6000.000 EngN 0.00 6000.000 FORMAT "%8.3" EXTENDED_LIMITS -32768.00 32767.00 /end CHARACTERISTIC
/begin CHARACTERISTIC AccPed_nPlaAPPBrk_C "Leerlaufdrehzahl im Falle einer Unplausibilität PWG/Bremse" VALUE 0x1C1712 Kw_Ws16 6000.000 EngN 0.00 6000.000 FORMAT "%8.3" EXTENDED_LIMITS -32768.00 32767.00 /end CHARACTERISTIC
/begin AXIS_PTS AccPed_nTrqEngX_AXIS "Gruppenstützstellen der X-Achse der Gruppenkennfelder" 0x1C1714 Eng_nAvrg GSst_Xs16 6000.000 EngN 16 0.00 6000.000 FORMAT "%8.3" EXTENDED_LIMITS -32768.00 32767.00 DEPOSIT ABSOLUTE /end AXIS_PTS
/begin CHARACTERISTIC AccPed_tiPlausBrkDebNeg_C "Entprellzeit Fehlerheilung bei Unplausibilität AccPed-Bremse" VALUE 0x1C1736 Kw_Wu16 655350.0 Time_ms 0.00 655350.0 FORMAT "%8.1" /end CHARACTERISTIC
/begin CHARACTERISTIC AccPed_tiPlausBrkDebPos_C "Entrpellzeit für Fehler bei Unplausibilität AccPed-Bremse" VALUE 0x1C1738 Kw_Wu16 655350.0 Time_ms 0.00 655350.0 FORMAT "%8.1" /end CHARACTERISTIC
/begin CHARACTERISTIC AccPed_rChkdVal_Vector "Konfigurationslabel für Bypass Freischnitt" VALUE 0x1C0A24 Kw_Wu8 255.0 OneToOne 0.00 255.0 FORMAT "%5.1" /end CHARACTERISTIC
/begin CHARACTERISTIC AccPed_rChkdVal_Channel "Konfigurationslabel für Bypass Freischnitt" VALUE 0x1C0A25 Kw_Wu8 255.0 OneToOne 0.00 255.0 FORMAT "%5.1" /end CHARACTERISTIC
/begin CHARACTERISTIC AccPed_rErrValPlaus_C "Ersatzwert PWG bei Fehler" VALUE 0x1C173A Kw_Ws16 100.0000 Prc 0.00 100.0000 FORMAT "%8.4" EXTENDED_LIMITS -327.6800 327.6700 /end CHARACTERISTIC
/begin CHARACTERISTIC AccPed_rLimpMax_C "Maximaler APP-Wert im Notfahrbetrieb" VALUE 0x1C173C Kw_Ws16 100.0000 Prc 0.00 100.0000 FORMAT "%8.4" EXTENDED_LIMITS -327.6800 327.6700 /end CHARACTERISTIC
/begin CHARACTERISTIC AccPed_rPlaMaxVal_C "Maximaler APP-Wert bei Plausibilitaetsverletzung" VALUE 0x1C173E Kw_Ws16 100.0000 Prc 0.00 100.0000 FORMAT "%8.4" EXTENDED_LIMITS -327.6800 327.6700 /end CHARACTERISTIC
/begin CHARACTERISTIC AccPed_rThPlaus_C "Schwelle für Erkennung: PWG betätigt" VALUE 0x1C1740 Kw_Ws16 100.0000 Prc 0.00 100.0000 FORMAT "%8.4" EXTENDED_LIMITS -327.6800 327.6700 /end CHARACTERISTIC
/begin CHARACTERISTIC AccPed_rThresPrpMin_C "minimaler Antriebswert" VALUE 0x1C1742 Kw_Ws16 100.0000 Prc 0.00 100.0000 FORMAT "%8.4" EXTENDED_LIMITS -327.6800 327.6700 /end CHARACTERISTIC
/begin CHARACTERISTIC AccPed_rThresPrp_C "Schwelle zwischen Schub- und Zugbetrieb" VALUE 0x1C1744 Kw_Ws16 100.0000 Prc 0.00 100.0000 FORMAT "%8.4" EXTENDED_LIMITS -327.6800 327.6700 /end CHARACTERISTIC
/begin CHARACTERISTIC AccPed_rThresSfty_C "Schwellwert für die Aktivierung der Plausibilitätsprüfung Fahrpedalstellung - Bremse (Sicherheitsfall)" VALUE 0x1C1746 Kw_Ws16 100.0000 Prc 0.00 100.0000 FORMAT "%8.4" EXTENDED_LIMITS -327.6800 327.6700 /end CHARACTERISTIC
/begin AXIS_PTS AccPed_rTrqEngY_AXIS "Gruppenstützstellen der Y-Achse der Gruppenkennfelder" 0x1C1748 AccPed_rChkdVal GSst_Xs16 100.0000 Prc 8 0.00 100.0000 FORMAT "%8.4" EXTENDED_LIMITS -327.6800 327.6700 DEPOSIT ABSOLUTE /end AXIS_PTS
/begin CHARACTERISTIC AccPed_rZero_C "PWG-Stellung, unterhalb der Schubbetrieb gelten soll" VALUE 0x1C175A Kw_Ws16 100.0000 Prc 0.00 100.0000 FORMAT "%8.4" EXTENDED_LIMITS -327.6800 327.6700 /end CHARACTERISTIC
/begin CHARACTERISTIC AccPed_stBrkPlausMSK_C "Konstante zum ausmaskieren der Bits für den Plausibilitätscheck Bremse" VALUE 0x1C175C Kw_Wu8 255.0 OneToOne 0.00 255.0 FORMAT "%5.1" /end CHARACTERISTIC
/begin CHARACTERISTIC AccPed_stGearSel_CUR "Auswahl der _MAPs AccPed_trqEng#_MAP, #={0,...,5} zur Interpolation zwischen den Gaengen" CURVE 0x1C175E Kl_Xs16_Ws16 6.000000 Map_Select 0.00 6.000000 FORMAT "%8.6" EXTENDED_LIMITS -128.0000 127.9961
 /begin AXIS_DESCR STD_AXIS AccPed_rVnTrqEngActv_mp VelToN 7 0.00 0.3276700 FORMAT "%9.7" EXTENDED_LIMITS -0.3276800 0.3276700 DEPOSIT ABSOLUTE /end AXIS_DESCR
/end CHARACTERISTIC
/begin CHARACTERISTIC AccPed_swtAliveDetEna_C "1: Lebenderkennung aktiv" VALUE 0x1C177C Kw_Wu8 1.000 OneToOne 0.00 1.000 FORMAT "%5.3" EXTENDED_LIMITS 0.00 255.0 /end CHARACTERISTIC
/begin CHARACTERISTIC AccPed_swtAppGradEna_C "Schalter zur Aktivierung der Rücksetzbedingung der APP/Bremse-Plausibilisierung durch APP-Aenderung" VALUE 0x1C177D Kw_Wu8 1.000 OneToOne 0.00 1.000 FORMAT "%5.3" EXTENDED_LIMITS 0.00 255.0 /end CHARACTERISTIC
/begin CHARACTERISTIC AccPed_swtBrkDet_C "Schalter zur Auswahl der Bremssignalerkennung" VALUE 0x1C177E Kw_Wu8 1.000 OneToOne 0.00 1.000 FORMAT "%5.3" EXTENDED_LIMITS 0.00 255.0 /end CHARACTERISTIC
/begin CHARACTERISTIC AccPed_swtMisUseEna_C "Schalter zur Aktivierung der Mißbrauchserkennung" VALUE 0x1C177F Kw_Wu8 1.000 OneToOne 0.00 1.000 FORMAT "%5.3" EXTENDED_LIMITS 0.00 255.0 /end CHARACTERISTIC
/begin CHARACTERISTIC AccPed_swtPlausCheckReqd_C "1:Freigabe der Überprüfung auf Unplausibilität" VALUE 0x1C1780 Kw_Wu8 1.000 OneToOne 0.00 1.000 FORMAT "%5.3" EXTENDED_LIMITS 0.00 255.0 /end CHARACTERISTIC
/begin CHARACTERISTIC AccPed_swtrVnFltEna_C "Zeitkonstante PT1 Filter v/n Verhältnis für die gangabhängige Berechnung des (voreilenden) Zugwunschmomentes" VALUE 0x1C1781 Kw_Wu8 1.000 OneToOne 0.00 1.000 FORMAT "%5.3" EXTENDED_LIMITS 0.00 255.0 /end CHARACTERISTIC
/begin CHARACTERISTIC AccPed_swtrVnFreeze_C "Schalter zur Aktivierung bzw. Deaktivierung des Einfrierens vom v/n-Verhältnis im Falle eines Fahrzeuggeschwindigkeitsfehlers (0" VALUE 0x1C1782 Kw_Wu8 1.000 OneToOne 0.00 1.000 FORMAT "%5.3" EXTENDED_LIMITS 0.00 255.0 /end CHARACTERISTIC
/begin CHARACTERISTIC AccPed_swtTrqRampEna_C "Status der Rampe in der Transitionsfunktion (0: Rampen deaktiviert 1: Rampen aktiviert)" VALUE 0x1C1783 Kw_Wu8 1.000 OneToOne 0.00 1.000 FORMAT "%5.3" EXTENDED_LIMITS 0.00 255.0 /end CHARACTERISTIC
/begin CHARACTERISTIC AccPed_swtTrqTransType_C "legt die Art der internen Speicherung des Fahrpedalwerts in der Transitionsfunktion fest." VALUE 0x1C1784 Kw_Wu8 1.000 OneToOne 0.00 1.000 FORMAT "%5.3" EXTENDED_LIMITS 0.00 255.0 /end CHARACTERISTIC
/begin CHARACTERISTIC AccPed_swtVehDynReqd_C "1: Berücksichtigung Fahrdynamikeingriffe aktiv" VALUE 0x1C1785 Kw_Wu8 1.000 OneToOne 0.00 1.000 FORMAT "%5.3" EXTENDED_LIMITS 0.00 255.0 /end CHARACTERISTIC
/begin CHARACTERISTIC AccPed_tiChkDebNeg_C "Entprellzeit ""Unplausibilität zurücksetzen""" VALUE 0x1C1786 Kw_Wu16 655350.0 TimeDeb 0.00 655350.0 FORMAT "%8.1" /end CHARACTERISTIC
/begin CHARACTERISTIC AccPed_tiChkDebPos_C "Entprellzeit für Erkennung auf Unplausibilität AccPed-Brk" VALUE 0x1C1788 Kw_Wu16 655350.0 TimeDeb 0.00 655350.0 FORMAT "%8.1" /end CHARACTERISTIC
/begin CHARACTERISTIC AccPed_tiDebPlaDet_C "Entprellzeit für APP/Bremse Plausibilitaetserkennung" VALUE 0x1C178A Kw_Wu16 655350.0 TimeDeb 0.00 655350.0 FORMAT "%8.1" /end CHARACTERISTIC
/begin CHARACTERISTIC AccPed_tiDebPlaRst_C "Entprellzeit für APP/Bremse Plausibilisierung ruecksetzen" VALUE 0x1C178C Kw_Wu16 655350.0 TimeDeb 0.00 655350.0 FORMAT "%8.1" /end CHARACTERISTIC
/begin CHARACTERISTIC AccPed_tiPlaAPPBrkCANwaitHW_C "Entprellzeit für die Plausibiltät Bremse - PWG bei ESP Bremseingriff" VALUE 0x1C178E Kw_Wu16 655350.0 TimeDeb 0.00 655350.0 FORMAT "%8.1" /end CHARACTERISTIC
/begin CHARACTERISTIC AccPed_tiVnTrqEngPT1_C "Zeitkonstante PT1 Filter V/n Verhaeltniss fuer die gangabh. Berechnung des (voreilenden) Zugwunschmomentes" VALUE 0x1C1790 Kw_Wu32 4294.9673 TimeDelay_s 0.0000010000000 4294.9673 FORMAT "%9.4" /end CHARACTERISTIC
/begin CHARACTERISTIC AccPed_trqDes_Vector "Bypass Label, nicht ändern!" VALUE 0x1C0A20 Kw_Wu8 255.0 OneToOne 0.00 255.0 FORMAT "%5.1" /end CHARACTERISTIC
/begin CHARACTERISTIC AccPed_trqDes_Channel "Bypass Label, nicht ändern!" VALUE 0x1C0A21 Kw_Wu8 255.0 OneToOne 0.00 255.0 FORMAT "%5.1" /end CHARACTERISTIC
/begin CHARACTERISTIC AccPed_trqEng0_GMAP "Gruppenkennfeld für AWD" MAP 0x1C1794 Gkf_Ws16 1500.000 Trq -500.0000 1000.000 FORMAT "%8.3" EXTENDED_LIMITS -3276.800 3276.700
 /begin AXIS_DESCR COM_AXIS Eng_nAvrg EngN 16 0.00 6000.000 FORMAT "%8.3" EXTENDED_LIMITS -32768.00 32767.00 AXIS_PTS_REF AccPed_nTrqEngX_AXIS /end AXIS_DESCR
 /begin AXIS_DESCR COM_AXIS AccPed_rChkdVal Prc 8 0.00 100.0000 FORMAT "%8.4" EXTENDED_LIMITS -327.6800 327.6700 AXIS_PTS_REF AccPed_rTrqEngY_AXIS /end AXIS_DESCR
/end CHARACTERISTIC
/begin CHARACTERISTIC AccPed_trqEng1_GMAP "1.Gang  (voreilendes) Zugwunschmoment aus Motor-Drehzahl und AccPed_rChkdVal (resp. APPCD_rAPP1UnFlt)" MAP 0x1C1894 Gkf_Ws16 1500.000 Trq -500.0000 1000.000 FORMAT "%8.3" EXTENDED_LIMITS -3276.800 3276.700
 /begin AXIS_DESCR COM_AXIS Eng_nAvrg EngN 16 0.00 6000.000 FORMAT "%8.3" EXTENDED_LIMITS -32768.00 32767.00 AXIS_PTS_REF AccPed_nTrqEngX_AXIS /end AXIS_DESCR
 /begin AXIS_DESCR COM_AXIS AccPed_rChkdVal Prc 8 0.00 100.0000 FORMAT "%8.4" EXTENDED_LIMITS -327.6800 327.6700 AXIS_PTS_REF AccPed_rTrqEngY_AXIS /end AXIS_DESCR
/end CHARACTERISTIC
/begin CHARACTERISTIC AccPed_trqEng2_GMAP "2.Gang  (voreilendes) Zugwunschmoment aus Motor-Drehzahl und AccPed_rChkdVal (resp. APPCD_rAPP1UnFlt)" MAP 0x1C1994 Gkf_Ws16 1500.000 Trq -500.0000 1000.000 FORMAT "%8.3" EXTENDED_LIMITS -3276.800 3276.700
 /begin AXIS_DESCR COM_AXIS Eng_nAvrg EngN 16 0.00 6000.000 FORMAT "%8.3" EXTENDED_LIMITS -32768.00 32767.00 AXIS_PTS_REF AccPed_nTrqEngX_AXIS /end AXIS_DESCR
 /begin AXIS_DESCR COM_AXIS AccPed_rChkdVal Prc 8 0.00 100.0000 FORMAT "%8.4" EXTENDED_LIMITS -327.6800 327.6700 AXIS_PTS_REF AccPed_rTrqEngY_AXIS /end AXIS_DESCR
/end CHARACTERISTIC
/begin CHARACTERISTIC AccPed_trqEng3_GMAP "3.Gang  (voreilendes) Zugwunschmoment aus Motor-Drehzahl und AccPed_rChkdVal (resp. APPCD_rAPP1UnFlt)" MAP 0x1C1A94 Gkf_Ws16 1500.000 Trq -500.0000 1000.000 FORMAT "%8.3" EXTENDED_LIMITS -3276.800 3276.700
 /begin AXIS_DESCR COM_AXIS Eng_nAvrg EngN 16 0.00 6000.000 FORMAT "%8.3" EXTENDED_LIMITS -32768.00 32767.00 AXIS_PTS_REF AccPed_nTrqEngX_AXIS /end AXIS_DESCR
 /begin AXIS_DESCR COM_AXIS AccPed_rChkdVal Prc 8 0.00 100.0000 FORMAT "%8.4" EXTENDED_LIMITS -327.6800 327.6700 AXIS_PTS_REF AccPed_rTrqEngY_AXIS /end AXIS_DESCR
/end CHARACTERISTIC
/begin CHARACTERISTIC AccPed_trqEng4_GMAP "4.Gang  (voreilendes) Zugwunschmoment aus Motor-Drehzahl und AccPed_rChkdVal (resp. APPCD_rAPP1UnFlt)" MAP 0x1C1B94 Gkf_Ws16 1500.000 Trq -500.0000 1000.000 FORMAT "%8.3" EXTENDED_LIMITS -3276.800 3276.700
 /begin AXIS_DESCR COM_AXIS Eng_nAvrg EngN 16 0.00 6000.000 FORMAT "%8.3" EXTENDED_LIMITS -32768.00 32767.00 AXIS_PTS_REF AccPed_nTrqEngX_AXIS /end AXIS_DESCR
 /begin AXIS_DESCR COM_AXIS AccPed_rChkdVal Prc 8 0.00 100.0000 FORMAT "%8.4" EXTENDED_LIMITS -327.6800 327.6700 AXIS_PTS_REF AccPed_rTrqEngY_AXIS /end AXIS_DESCR
/end CHARACTERISTIC
/begin CHARACTERISTIC AccPed_trqEng5_GMAP "5.Gang  (voreilendes) Zugwunschmoment aus Motor-Drehzahl und AccPed_rChkdVal (resp. APPCD_rAPP1UnFlt)" MAP 0x1C1C94 Gkf_Ws16 1500.000 Trq -500.0000 1000.000 FORMAT "%8.3" EXTENDED_LIMITS -3276.800 3276.700
 /begin AXIS_DESCR COM_AXIS Eng_nAvrg EngN 16 0.00 6000.000 FORMAT "%8.3" EXTENDED_LIMITS -32768.00 32767.00 AXIS_PTS_REF AccPed_nTrqEngX_AXIS /end AXIS_DESCR
 /begin AXIS_DESCR COM_AXIS AccPed_rChkdVal Prc 8 0.00 100.0000 FORMAT "%8.4" EXTENDED_LIMITS -327.6800 327.6700 AXIS_PTS_REF AccPed_rTrqEngY_AXIS /end AXIS_DESCR
/end CHARACTERISTIC
/begin CHARACTERISTIC AccPed_trqEng6_GMAP "6.Gang  (voreilendes) Zugwunschmoment aus Motor-Drehzahl und AccPed_rChkdVal (resp. APPCD_rAPP1UnFlt)" MAP 0x1C1D94 Gkf_Ws16 1500.000 Trq -500.0000 1000.000 FORMAT "%8.3" EXTENDED_LIMITS -3276.800 3276.700
 /begin AXIS_DESCR COM_AXIS Eng_nAvrg EngN 16 0.00 6000.000 FORMAT "%8.3" EXTENDED_LIMITS -32768.00 32767.00 AXIS_PTS_REF AccPed_nTrqEngX_AXIS /end AXIS_DESCR
 /begin AXIS_DESCR COM_AXIS AccPed_rChkdVal Prc 8 0.00 100.0000 FORMAT "%8.4" EXTENDED_LIMITS -327.6800 327.6700 AXIS_PTS_REF AccPed_rTrqEngY_AXIS /end AXIS_DESCR
/end CHARACTERISTIC
/begin CHARACTERISTIC AccPed_trqLead_Vector "Konfigurationslabel für Bypass" VALUE 0x1C0A22 Kw_Wu8 255.0 OneToOne 0.00 255.0 FORMAT "%5.1" /end CHARACTERISTIC
/begin CHARACTERISTIC AccPed_trqLead_Channel "Konfigurationslabel für Bypass" VALUE 0x1C0A23 Kw_Wu8 255.0 OneToOne 0.00 255.0 FORMAT "%5.1" /end CHARACTERISTIC
/begin CHARACTERISTIC AccPed_trqNMRMax_C "maximale erlaubte Momentenforderung im nicht überwachbaren Bereich des PWG" VALUE 0x1C1E94 Kw_Ws16 65535.00 TrqPrp -32768.00 32767.00 FORMAT "%8.2" /end CHARACTERISTIC
/begin CHARACTERISTIC AccPed_trqPrpSport_MAP "Kennfeld für Mastershift im Sport-Modus" MAP 0x1C1E96 Kf_Xs16_Ys16_Ws16 65535.00 TrqPrp -32768.00 32767.00 FORMAT "%8.2"
 /begin AXIS_DESCR STD_AXIS VSSCD_v Vel 12 -327.6800 327.6700 FORMAT "%8.4" DEPOSIT ABSOLUTE /end AXIS_DESCR
 /begin AXIS_DESCR STD_AXIS AccPed_rChkdVal Prc 8 -327.6800 327.6700 FORMAT "%8.4" DEPOSIT ABSOLUTE /end AXIS_DESCR
/end CHARACTERISTIC
/begin CHARACTERISTIC AccPed_trqPrp_MAP "Fahrverhaltenkennfeld als Getriebeausgangsmoment für Mastershift Antriebsstrangmanagement" MAP 0x1C1F82 Kf_Xs16_Ys16_Ws16 65535.00 TrqPrp -32768.00 32767.00 FORMAT "%8.2"
 /begin AXIS_DESCR STD_AXIS VSSCD_v Vel 12 -327.6800 327.6700 FORMAT "%8.4" DEPOSIT ABSOLUTE /end AXIS_DESCR
 /begin AXIS_DESCR STD_AXIS AccPed_rChkdVal Prc 8 -327.6800 327.6700 FORMAT "%8.4" DEPOSIT ABSOLUTE /end AXIS_DESCR
/end CHARACTERISTIC
/begin CHARACTERISTIC AccPed_vLim_C "Geschwindigkeitsschwelle für Freigabe Fahrpedalprüfung" VALUE 0x1C206E Kw_Ws16 300.0000 Vel 0.00 300.0000 FORMAT "%8.4" EXTENDED_LIMITS -327.6800 327.6700 /end CHARACTERISTIC
/begin CHARACTERISTIC AccPed_vThresLI_C "Geschwindigkeitschschwelle für Leerlaufsolldrehzahlauswahl" VALUE 0x1C2072 Kw_Ws16 300.0000 Vel 0.00 300.0000 FORMAT "%8.4" EXTENDED_LIMITS -327.6800 327.6700 /end CHARACTERISTIC
/begin CHARACTERISTIC ACC_tiDebStEPBInAct_C "Entprellzeit (fallende Flanke) für Entprellung der Statusmeldung der elektrischen Parkbremse (EPB)" VALUE 0x1C1660 Kw_Wu16 655350.0 TimeDeb 0.00 655350.0 FORMAT "%8.1" /end CHARACTERISTIC
/begin CHARACTERISTIC ACC_tiDebStEPBAct_C "Entprellzeit (steigende Flanke) für Entprellung der Statusmeldung der elektrischen Parkbremse (EPB)" VALUE 0x1C1662 Kw_Wu16 655350.0 TimeDeb 0.00 655350.0 FORMAT "%8.1" /end CHARACTERISTIC
/begin CHARACTERISTIC ACC_tiDebSwtPlInAct_C "Entprellung für die fallende Flanke of CC-Panel Main switch" VALUE 0x1C1664 Kw_Wu16 655350.0 TimeDeb 0.00 655350.0 FORMAT "%8.1" /end CHARACTERISTIC
/begin CHARACTERISTIC ACC_tiDebSwtPlAct_C "Entprellung für die steigende Flanke der CC - Panel Main switch Plausibilität" VALUE 0x1C1666 Kw_Wu16 655350.0 TimeDeb 0.00 655350.0 FORMAT "%8.1" /end CHARACTERISTIC
/begin CHARACTERISTIC ACC_tiDebTrqRelInAct_C "Entprellzeit für fallende Flanke bei Momentenfehler" VALUE 0x1C1668 Kw_Wu16 655350.0 TimeDeb 0.00 655350.0 FORMAT "%8.1" /end CHARACTERISTIC
/begin CHARACTERISTIC ACC_tiDebTrqRelAct_C "Entprellzeit für die steigende Flanke bei Momentenfehler" VALUE 0x1C166A Kw_Wu16 655350.0 TimeDeb 0.00 655350.0 FORMAT "%8.1" /end CHARACTERISTIC
/begin CHARACTERISTIC ACC_stACCVer_C "Auswahlvariable für AUDI_ACC(2) und VW_ACC(1)" VALUE 0x1C166C Kw_Wu8 1.000 OneToOne 1.000 2.000 FORMAT "%5.3" EXTENDED_LIMITS 0.00 255.0 /end CHARACTERISTIC
/begin CHARACTERISTIC ACC_tiBrkDrvCut_C "Zeit für Fahrebremsung um ACC abzuschalten" VALUE 0x1C166E Kw_Wu16 655350.0 Time_ms 0.00 655350.0 FORMAT "%8.1" /end CHARACTERISTIC
/begin CHARACTERISTIC ACC_tiBrkDrvDef_C "Zeit für Fahrerbremsung um ACC zu sperren" VALUE 0x1C1670 Kw_Wu16 655350.0 Time_ms 0.00 655350.0 FORMAT "%8.1" /end CHARACTERISTIC
/begin CHARACTERISTIC ACC_tiDebActToOvrRide_C "Entprellung für die steigende Flanke der Änderung in ACC_stCrCtl" VALUE 0x1C1672 Kw_Wu16 655350.0 Time_ms 0.00 655350.0 FORMAT "%8.1" /end CHARACTERISTIC
/begin CHARACTERISTIC ACC_tiDebBrkAct_C "Verzögerung für den Bremsen-Schalter" VALUE 0x1C1674 Kw_Wu16 655350.0 Time_ms 0.00 655350.0 FORMAT "%8.1" /end CHARACTERISTIC
/begin CHARACTERISTIC ACC_tiDebLockOffAct_C "Verzögerung für den CC Lock-Off button" VALUE 0x1C1676 Kw_Wu16 655350.0 Time_ms 0.00 655350.0 FORMAT "%8.1" /end CHARACTERISTIC
/begin CHARACTERISTIC ACC_tiDebOvrRideToAct_C "Entprellung für die fallende Flanke der Anderung des Zustandes in ACC_stCrCtl" VALUE 0x1C1678 Kw_Wu16 655350.0 Time_ms 0.00 655350.0 FORMAT "%8.1" /end CHARACTERISTIC
/begin CHARACTERISTIC ACC_tiDebTipOffAct_C "Verzögerung für den CC Tip-Off button" VALUE 0x1C167A Kw_Wu16 655350.0 Time_ms 0.00 655350.0 FORMAT "%8.1" /end CHARACTERISTIC
/begin CHARACTERISTIC ACC_trqDesMax_C "ACC-Momentenbegrenzung bei ACC-Bremsung" VALUE 0x1C167C Kw_Ws16 65535.00 TrqPrp -32768.00 32767.00 FORMAT "%8.2" /end CHARACTERISTIC
/begin CHARACTERISTIC ACC_trqDesOffset_C "Schwelle für die Erkennung auf ""Übertreten""" VALUE 0x1C167E Kw_Ws16 65535.00 TrqPrp -32768.00 32767.00 FORMAT "%8.2" /end CHARACTERISTIC
/begin CHARACTERISTIC AC_pwrAdjValDef_C "Standardwert für Abgleich Leistungsanforderung Klimakompressor" VALUE 0x1C1658 Kw_Ws16 0.00 Fact 1.000000 1.000000 FORMAT "%8.6" EXTENDED_LIMITS -4.000000 3.999878 /end CHARACTERISTIC
/begin CHARACTERISTIC AC_pwrAdjValMax_C "Maximalwert für Abgleich Leistungsanforderung Klimakompressor" VALUE 0x1C165A Kw_Ws16 3.199951 Fact 0.00 3.199951 FORMAT "%8.6" EXTENDED_LIMITS -4.000000 3.999878 /end CHARACTERISTIC
/begin CHARACTERISTIC AC_pwrAdjValMin_C "Minimalwert für Abgleich Leistungsanforderung Klimakompressor" VALUE 0x1C165C Kw_Ws16 3.199951 Fact 0.00 3.199951 FORMAT "%8.6" EXTENDED_LIMITS -4.000000 3.999878 /end CHARACTERISTIC
/begin CHARACTERISTIC AC_rTrans_C "Übersetzung des Klimakompressorantriebs" VALUE 0x1C165E Kw_Ws16 427.6800 TransR -327.6800 100.0000 FORMAT "%8.4" EXTENDED_LIMITS -327.6800 327.6700 /end CHARACTERISTIC
/begin MEASUREMENT ACCCD_stACC "Ausgewerteter empfangener Zustand des ACC-SG" UBYTE OneToOne 1 100 0.00 255.0 FORMAT "%5.1" ECU_ADDRESS 0x7F92E0 /end MEASUREMENT
/begin MEASUREMENT ACCCD_stACCByp_mp "Messpunkt für Bypass Freischnitt" UBYTE OneToOne 1 100 0.00 255.0 FORMAT "%5.1" ECU_ADDRESS 0x801E14 /end MEASUREMENT
/begin MEASUREMENT ACCCD_stACCnew "neuer gewünschter Zustand des ACC-Zustandsautomaten" UBYTE OneToOne 1 100 0.00 255.0 FORMAT "%5.1" ECU_ADDRESS 0x7F92E1 /end MEASUREMENT
/begin MEASUREMENT ACCCD_stACCnewByp_mp "Meßpunkt für Bypass Freischnitt" UBYTE OneToOne 1 100 0.00 255.0 FORMAT "%5.1" ECU_ADDRESS 0x801E15 /end MEASUREMENT
/begin MEASUREMENT ACCCD_stBrk "Ausgewerteter empfangener Zustand des Bremsboosters" UBYTE OneToOne 1 100 0.00 255.0 FORMAT "%5.1" ECU_ADDRESS 0x7F92E2 /end MEASUREMENT
/begin MEASUREMENT ACCCD_stBrkByp_mp "Meßpunkt für Bypass Freischnitt" UBYTE OneToOne 1 100 0.00 255.0 FORMAT "%5.1" ECU_ADDRESS 0x801E16 /end MEASUREMENT
/begin MEASUREMENT ACCCD_stBrkTrqDet_mp "Status ACC Brems-Moment Zustandsautomat" UBYTE OneToOne 1 100 0.00 255.0 FORMAT "%5.1" ECU_ADDRESS 0x801E17 /end MEASUREMENT
/begin MEASUREMENT ACCCD_trqDes "Ausgewertete empfangene Momentenanforderung des ACC-SG" SWORD TrqPrp 1 100 -32768.00 32767.00 FORMAT "%8.2" ECU_ADDRESS 0x7F9542 /end MEASUREMENT
/begin MEASUREMENT ACCCD_trqDesByp_mp "Meßpunkt für Bypass Freischnitt" SWORD TrqPrp 1 100 -32768.00 32767.00 FORMAT "%8.2" ECU_ADDRESS 0x801E18 /end MEASUREMENT
/begin MEASUREMENT ACCCD_trqdiffRmpState_mp "ACC Brems-Moment-Anforderung -> Zustandsvariable der Rampe" SWORD TrqPrp 1 100 -32768.00 32767.00 FORMAT "%8.2" ECU_ADDRESS 0x801E1A /end MEASUREMENT
/begin MEASUREMENT ACCD_p "entprellter Klimakompressordruck" SWORD PresAC_hPa 1 100 -65536.00 65534.00 FORMAT "%8.2" ECU_ADDRESS 0x7F9544 /end MEASUREMENT
/begin MEASUREMENT ACCD_pPwmFlt_mp "phys. Kältemitteldruck ohne Fehlerbehandlung" SWORD PresAC_hPa 1 100 -65536.00 65534.00 FORMAT "%8.2" ECU_ADDRESS 0x801E1C /end MEASUREMENT
/begin MEASUREMENT ACCD_rHWEOut_mp "Ausgang des Klimakompressors und des Testsignals vom Tester" UBYTE OneToOne 1 100 0.00 255.0 FORMAT "%5.1" ECU_ADDRESS 0x801E1E /end MEASUREMENT
/begin MEASUREMENT ACCD_rPwmDcycIn_mp "Tastverhältnis Kältemitteldruck" SWORD DtyCyc 1 100 -327.6800 327.6700 FORMAT "%8.4" ECU_ADDRESS 0x801E20 /end MEASUREMENT
/begin MEASUREMENT ACCD_stAC "Statusinformationen AC" UWORD OneToOne 1 100 0.00 65535.00 FORMAT "%8.2" ECU_ADDRESS 0x7F9546 /end MEASUREMENT
/begin MEASUREMENT ACCD_stComprDig "rückgelesener Kompressorstatus" UBYTE OneToOne 1 100 0.00 255.0 FORMAT "%5.1" ECU_ADDRESS 0x7F92E3 /end MEASUREMENT
/begin MEASUREMENT ACCD_stComprON "Status Klimakompressor (EIN/AUS)" UBYTE OneToOne 1 100 0.00 255.0 FORMAT "%5.1" ECU_ADDRESS 0x7F92E4 /end MEASUREMENT
/begin MEASUREMENT ACCD_stMnSwtDebVal "entprellter Klimaanlagen-Hauptschalter" UBYTE OneToOne 1 100 0.00 255.0 FORMAT "%5.1" ECU_ADDRESS 0x7F92E5 /end MEASUREMENT
/begin MEASUREMENT ACCD_stMnSwtRawVal "Rohwert vom Zustand des Klimakompressor-Hauptschalters" UBYTE OneToOne 1 100 0.00 255.0 FORMAT "%5.1" ECU_ADDRESS 0x7F92E6 /end MEASUREMENT
/begin MEASUREMENT ACCD_stPDefVal "Status ob ACCD_p auf Vorgabewert geht" UBYTE OneToOne 1 100 0.00 255.0 FORMAT "%5.1" ECU_ADDRESS 0x7F92E7 /end MEASUREMENT
/begin MEASUREMENT ACCD_swtACPresent "Klimaanlage verbaut (Ja/Nein)" UBYTE OneToOne 1 100 0.00 255.0 FORMAT "%5.1" ECU_ADDRESS 0x7F92E8 /end MEASUREMENT
/begin MEASUREMENT ACCD_swtACtype "Schalter gibt an, ob und wie Klimaanlage verbaut ist" UBYTE OneToOne 1 100 0.00 255.0 FORMAT "%5.1" ECU_ADDRESS 0x7F92E9 /end MEASUREMENT
/begin MEASUREMENT ACCD_swtClimatronic "Climatronic im Fzg. verbaut? (JA/NEIN)" UBYTE OneToOne 1 100 0.00 255.0 FORMAT "%5.1" ECU_ADDRESS 0x7F92EA /end MEASUREMENT
/begin MEASUREMENT ACCD_trqCompr "AC Kompressorlast" SWORD Trq 1 100 -3276.800 3276.700 FORMAT "%8.3" ECU_ADDRESS 0x7F9548 /end MEASUREMENT
/begin MEASUREMENT AccPed_facMapSel_mp "restlicher Ausgangswert der Kennlinie zur Gangauswahl" SWORD Fact 1 100 -4.000000 3.999878 FORMAT "%8.6" ECU_ADDRESS 0x801E2C /end MEASUREMENT
/begin MEASUREMENT AccPed_facTrqDesSwtIn_mp "Intern gespeicherter Faktor der Transitionsfunktion" SWORD FactLow 1 100 -32.00000 31.99902 FORMAT "%8.5" ECU_ADDRESS 0x801E2E /end MEASUREMENT
/begin MEASUREMENT AccPed_facTrqDesSwtOut_mp "Faktor zur Berechnung des Ausgangs der Transitionsfunktion" SWORD FactLow 1 100 -32.00000 31.99902 FORMAT "%8.5" ECU_ADDRESS 0x801E30 /end MEASUREMENT
/begin MEASUREMENT AccPed_facTrqLeadSwtIn_mp "Intern gespeicherter Faktor der Transitionsfunktion (Lead-Pfad)" SWORD FactLow 1 100 -32.00000 31.99902 FORMAT "%8.5" ECU_ADDRESS 0x801E32 /end MEASUREMENT
/begin MEASUREMENT AccPed_facTrqLeadSwtOut_mp "Faktor zur Berechnung des Ausgangs der Transitionsfunktion (Lead-Pfad)" SWORD FactLow 1 100 -32.00000 31.99902 FORMAT "%8.5" ECU_ADDRESS 0x801E34 /end MEASUREMENT
/begin MEASUREMENT AccPed_nMin "Leerlaufsolldrehzahl PWG" SWORD EngN 1 100 -32768.00 32767.00 FORMAT "%8.2" ECU_ADDRESS 0x7F95D4 /end MEASUREMENT
/begin MEASUREMENT AccPed_numMapSel_mp "Faktor zur Berechnung des Ausgangs der Transitionsfunktion (Lead-Pfad)" UBYTE OneToOne 1 100 0.00 255.0 FORMAT "%5.1" ECU_ADDRESS 0x801E36 /end MEASUREMENT
/begin MEASUREMENT AccPed_numTrqAct_mp "Fahrverhaltennummer" UBYTE OneToOne 1 100 0.00 255.0 FORMAT "%5.1" ECU_ADDRESS 0x801E37 /end MEASUREMENT
/begin MEASUREMENT AccPed_numTrqVar_mp "Variante zur Auswahl des Fahrverhaltens" UBYTE OneToOne 1 100 0.00 255.0 FORMAT "%5.1" ECU_ADDRESS 0x801E38 /end MEASUREMENT
/begin MEASUREMENT AccPed_rAPPunLim_mp "APP-Wert ohne Begrenzung durch APP-Lebenderkennung" SWORD Prc 1 100 -327.6800 327.6700 FORMAT "%8.4" ECU_ADDRESS 0x801E86 /end MEASUREMENT
/begin MEASUREMENT AccPed_rChkdVal "PWG-Stellung nach Überwachung" SWORD Prc 1 100 -327.6800 327.6700 FORMAT "%8.4" ECU_ADDRESS 0x7F95D6 /end MEASUREMENT
/begin MEASUREMENT AccPed_rChkdValByp_mp "Meßpunkt für Bypass Freischnitt" SWORD Prc 1 100 -327.6800 327.6700 FORMAT "%8.4" ECU_ADDRESS 0x801E88 /end MEASUREMENT
/begin MEASUREMENT AccPed_rPla_mp "Begrenzter APP-Wert nach Plausibilitätsprüfung APP/Bremse" SWORD Prc 1 100 -327.6800 327.6700 FORMAT "%8.4" ECU_ADDRESS 0x801E8A /end MEASUREMENT
/begin MEASUREMENT AccPed_rThresPrp "Schwelle zwischen Schub- und Zugbetrieb" SWORD Prc 1 100 -327.6800 327.6700 FORMAT "%8.4" ECU_ADDRESS 0x7F95D8 /end MEASUREMENT
/begin MEASUREMENT AccPed_rThresPrpMin "Minimaler Antriebswert Fahrpedal" SWORD Prc 1 100 -327.6800 327.6700 FORMAT "%8.4" ECU_ADDRESS 0x7F95DA /end MEASUREMENT
/begin MEASUREMENT AccPed_rTrqDesSwtIn_mp "Intern gespeicherte Fahrpedalstellung der Transitionsfunktion" SWORD Prc 1 100 -327.6800 327.6700 FORMAT "%8.4" ECU_ADDRESS 0x801E3A /end MEASUREMENT
/begin MEASUREMENT AccPed_rTrqDesSwtOut_mp "Aktualisierter Fahrpedalwert" SWORD Prc 1 100 -327.6800 327.6700 FORMAT "%8.4" ECU_ADDRESS 0x801E3C /end MEASUREMENT
/begin MEASUREMENT AccPed_rTrqLeadSwtIn_mp "Intern gespeicherte Fahrpedalstellung der Transitionsfunktion (Lead-Pfad)" SWORD Prc 1 100 -327.6800 327.6700 FORMAT "%8.4" ECU_ADDRESS 0x801E3E /end MEASUREMENT
/begin MEASUREMENT AccPed_rTrqLeadSwtOut_mp "Aktualisierter Fahrpedalwert (Lead-Pfad)" SWORD Prc 1 100 -327.6800 327.6700 FORMAT "%8.4" ECU_ADDRESS 0x801E40 /end MEASUREMENT
/begin MEASUREMENT AccPed_rVnTrqEngActv_mp "Aktives V/n Verhaeltnis zur Gangauswahl ueber Kennlinie" SWORD VelToN 1 100 -0.3276800 0.3276700 FORMAT "%9.7" ECU_ADDRESS 0x801E42 /end MEASUREMENT
/begin MEASUREMENT AccPed_rVnTrqEngPT1_mp "Zusaetzlich PT1 gefiltertes V/n Verhaeltnis" SWORD VelToN 1 100 -0.3276800 0.3276700 FORMAT "%9.7" ECU_ADDRESS 0x801E44 /end MEASUREMENT
/begin MEASUREMENT AccPed_rZero "PWG-Stellung, unterhalb der Schubbetrieb gelten soll" SWORD Prc 1 100 -327.6800 327.6700 FORMAT "%8.4" ECU_ADDRESS 0x7F95DC /end MEASUREMENT
/begin MEASUREMENT AccPed_stAPPalive_mp "Status der APP-Lebenderkennung" UBYTE OneToOne 1 100 0.00 255.0 FORMAT "%5.1" ECU_ADDRESS 0x801E8C /end MEASUREMENT
/begin MEASUREMENT AccPed_stBrk "Bremsinformation zur Plausiblitätsprüfung" UBYTE OneToOne 1 100 0.00 255.0 FORMAT "%5.1" ECU_ADDRESS 0x7F9312 /end MEASUREMENT
/begin MEASUREMENT AccPed_stCoType "Status Mastershift (0:Konventionall 1:Mastershift)" UBYTE OneToOne 1 100 0.00 255.0 FORMAT "%5.1" ECU_ADDRESS 0x7F9313 /end MEASUREMENT
/begin MEASUREMENT AccPed_stError "Fehlerzustand in AccPed" UBYTE OneToOne 1 100 0.00 255.0 FORMAT "%5.1" ECU_ADDRESS 0x7F9314 /end MEASUREMENT
/begin MEASUREMENT AccPed_stMisUse_mp "Status der Mißbrauchserkennung" UBYTE OneToOne 1 100 0.00 255.0 FORMAT "%5.1" ECU_ADDRESS 0x801E8D /end MEASUREMENT
/begin MEASUREMENT AccPed_stNotDirect_mp "Status ""Rampe bei Heilung verwenden""" UBYTE OneToOne 1 100 0.00 255.0 FORMAT "%5.1" ECU_ADDRESS 0x801E8E /end MEASUREMENT
/begin MEASUREMENT AccPed_stPlaAPPBrk "Status der Plausibilitätsprüfung APP/Bremse" UBYTE OneToOne 1 100 0.00 255.0 FORMAT "%5.1" ECU_ADDRESS 0x7F9315 /end MEASUREMENT
/begin MEASUREMENT AccPed_stPlaAPPBrkDet_mp "Status der Erkennung auf Plausibilitätsverletzung APP/Bremse" UBYTE OneToOne 1 100 0.00 255.0 FORMAT "%5.1" ECU_ADDRESS 0x801E8F /end MEASUREMENT
/begin MEASUREMENT AccPed_stPlaAPPBrkRst_mp "Status Rücksetzen einer Plausibilitätsverletzung APP/Bremse" UBYTE OneToOne 1 100 0.00 255.0 FORMAT "%5.1" ECU_ADDRESS 0x801E90 /end MEASUREMENT
/begin MEASUREMENT AccPed_stPlausBrkRls_mp "Status der Überwachungsbedingungen für die Plausibilitätsprüfung Fahrpedalstellung - Bremse" UBYTE OneToOne 1 100 0.00 255.0 FORMAT "%5.1" ECU_ADDRESS 0x801E91 /end MEASUREMENT
/begin MEASUREMENT AccPed_stPlausCheckReqd "Statusanzeige für erforderlichen Plausibilitätscheck zwischen AccPed und Bremse" UBYTE OneToOne 1 100 0.00 255.0 FORMAT "%5.1" ECU_ADDRESS 0x7F9316 /end MEASUREMENT
/begin MEASUREMENT AccPed_stSport_mp "Status Mastershift (0: Konventionell 1:Mastershift)" UBYTE OneToOne 1 100 0.00 255.0 FORMAT "%5.1" ECU_ADDRESS 0x801E46 /end MEASUREMENT
/begin MEASUREMENT AccPed_swtTrqTrans_mp "Schalter-Status der Transitionsfunktion  (0: AccPed_trqDesSwtInNew_mp ausgewählt 1: AccPed_trqDesSwtInFreeze_mp ausgewählt)" UBYTE OneToOne 1 100 0.00 255.0 FORMAT "%5.1" ECU_ADDRESS 0x801E47 /end MEASUREMENT
/begin MEASUREMENT AccPed_trqDes "Fahrerwunsch Rohwert" SWORD TrqPrp 1 100 -32768.00 32767.00 FORMAT "%8.2" ECU_ADDRESS 0x7F95DE /end MEASUREMENT
/begin MEASUREMENT AccPed_trqDesDrvDem_mp "Rohwert Fahrerwunsch nach Überlagerung von Zug- und Schubbeitrag" SWORD TrqPrp 1 100 -32768.00 32767.00 FORMAT "%8.2" ECU_ADDRESS 0x801E22 /end MEASUREMENT
/begin MEASUREMENT AccPed_trqDesEngLow_mp "Wunschmoment für konventionellen Fahrmodus mit Automatikgetriebe und AWD aktiv" SWORD TrqPrp 1 100 -32768.00 32767.00 FORMAT "%8.2" ECU_ADDRESS 0x801E48 /end MEASUREMENT
/begin MEASUREMENT AccPed_trqDesEngNormal_mp "Wunschmoment für konventionellen Fahrmodus mit Automatikgetriebe" SWORD TrqPrp 1 100 -32768.00 32767.00 FORMAT "%8.2" ECU_ADDRESS 0x801E4A /end MEASUREMENT
/begin MEASUREMENT AccPed_trqDesEngSport_mp "Wunschmoment für konventionellen Fahrmodus mit Automatikgetriebe und Sportmodus" SWORD TrqPrp 1 100 -32768.00 32767.00 FORMAT "%8.2" ECU_ADDRESS 0x801E4C /end MEASUREMENT
/begin MEASUREMENT AccPed_trqDesEng_mp "Ausgangsmoment  für konventionellen Fahrmodus mit Automatikgetriebe" SWORD TrqPrp 1 100 -32768.00 32767.00 FORMAT "%8.2" ECU_ADDRESS 0x801E4E /end MEASUREMENT
/begin MEASUREMENT AccPed_trqDesOvrRun_mp "Fahrerwunsch Schubbetrieb für Sollwert" SWORD TrqPrp 1 100 -32768.00 32767.00 FORMAT "%8.2" ECU_ADDRESS 0x801E24 /end MEASUREMENT
/begin MEASUREMENT AccPed_trqDesPrpSport_mp "Ausgangsmoment für Mastershift (Sport Modus)" SWORD TrqPrp 1 100 -32768.00 32767.00 FORMAT "%8.2" ECU_ADDRESS 0x801E50 /end MEASUREMENT
/begin MEASUREMENT AccPed_trqDesPrp_mp "Ausgangsmoment für Mastershift" SWORD TrqPrp 1 100 -32768.00 32767.00 FORMAT "%8.2" ECU_ADDRESS 0x801E52 /end MEASUREMENT
/begin MEASUREMENT AccPed_trqDesPull "Fahrerwunsch Zugbetrieb für Sollwert" SWORD TrqPrp 1 100 -32768.00 32767.00 FORMAT "%8.2" ECU_ADDRESS 0x7F95E0 /end MEASUREMENT
/begin MEASUREMENT AccPed_trqDesSwtOut_mp "Ausgangsmoment der Transitionsfunktion" SWORD TrqPrp 1 100 -32768.00 32767.00 FORMAT "%8.2" ECU_ADDRESS 0x801E54 /end MEASUREMENT
/begin MEASUREMENT AccPed_trqDesTransFreeze_mp "Eingang 2 der Transitionsfunktion" SWORD TrqPrp 1 100 -32768.00 32767.00 FORMAT "%8.2" ECU_ADDRESS 0x801E56 /end MEASUREMENT
/begin MEASUREMENT AccPed_trqDesTransNew_mp "Eingang 1 der Transitionsfunktion" SWORD TrqPrp 1 100 -32768.00 32767.00 FORMAT "%8.2" ECU_ADDRESS 0x801E58 /end MEASUREMENT
/begin MEASUREMENT AccPed_trqDesUnLim_mp "Fahrerwunsch Sollwert vor Begrenzung" SWORD TrqPrp 1 100 -32768.00 32767.00 FORMAT "%8.2" ECU_ADDRESS 0x801E26 /end MEASUREMENT
/begin MEASUREMENT AccPed_trqFrcMin_mp "Meßpunkt des minimalen Reibungsmoments" SWORD TrqPrp 1 100 -32768.00 32767.00 FORMAT "%8.2" ECU_ADDRESS 0x801E28 /end MEASUREMENT
/begin MEASUREMENT AccPed_trqInrDesEngLow_mp "Innere Wunschmoment für konventionellen Fahrmodus mit Automatikgetriebe und AWD aktiv" SWORD Trq 1 100 -3276.800 3276.700 FORMAT "%8.3" ECU_ADDRESS 0x801E5A /end MEASUREMENT
/begin MEASUREMENT AccPed_trqInrDesEngNormal_mp "Innere Wunschmoment für konventionellen Fahrmodus mit Automatikgetriebe" SWORD Trq 1 100 -3276.800 3276.700 FORMAT "%8.3" ECU_ADDRESS 0x801E5C /end MEASUREMENT
/begin MEASUREMENT AccPed_trqInrDesEngSport_mp "Innere Wunschmoment für konventionellen Fahrmodus mit Automatikgetriebe und Sportmodus" SWORD Trq 1 100 -3276.800 3276.700 FORMAT "%8.3" ECU_ADDRESS 0x801E5E /end MEASUREMENT
/begin MEASUREMENT AccPed_trqInrDesEng_mp "Innere Ausgangsmoment  für konventionellen Fahrmodus mit Automatikgetriebe" SWORD Trq 1 100 -3276.800 3276.700 FORMAT "%8.3" ECU_ADDRESS 0x801E60 /end MEASUREMENT
/begin MEASUREMENT AccPed_trqInrDesSig "Fahrerwunsch in innerem Moment" SWORD Trq 1 100 -3276.800 3276.700 FORMAT "%8.3" ECU_ADDRESS 0x7F95E2 /end MEASUREMENT
/begin MEASUREMENT AccPed_trqInrLeadEngLow_mp "Wunschmoment für konventionellen Fahrmodus mit Automatikgetriebe und AWD aktiv (Lead-Pfad)" SWORD Trq 1 100 -3276.800 3276.700 FORMAT "%8.3" ECU_ADDRESS 0x801E62 /end MEASUREMENT
/begin MEASUREMENT AccPed_trqInrLeadEngNormal_mp "Wunschmoment für konventionellen Fahrmodus mit Automatikgetriebe (Lead-Pfad)" SWORD Trq 1 100 -3276.800 3276.700 FORMAT "%8.3" ECU_ADDRESS 0x801E64 /end MEASUREMENT
/begin MEASUREMENT AccPed_trqInrLeadEngSport_mp "Innere Wunschmoment für konventionellen Fahrmodus mit Automatikgetriebe und Sportmodus (Lead-Pfad)" SWORD Trq 1 100 -3276.800 3276.700 FORMAT "%8.3" ECU_ADDRESS 0x801E66 /end MEASUREMENT
/begin MEASUREMENT AccPed_trqInrLeadEng_mp "Innere Ausgangsmoment  für konventionellen Fahrmodus mit Automatikgetriebe (Lead-Pfad)" SWORD Trq 1 100 -3276.800 3276.700 FORMAT "%8.3" ECU_ADDRESS 0x801E68 /end MEASUREMENT
/begin MEASUREMENT AccPed_trqLead "Vorhaltmoment des Fahrpedals (schneller Fahrerwunsch)" SWORD TrqPrp 1 100 -32768.00 32767.00 FORMAT "%8.2" ECU_ADDRESS 0x7F95E4 /end MEASUREMENT
/begin MEASUREMENT AccPed_trqLeadByp_mp "Bypass - Label für AccPed_trqLead" SWORD TrqPrp 1 100 -32768.00 32767.00 FORMAT "%8.2" ECU_ADDRESS 0x801E6A /end MEASUREMENT
/begin MEASUREMENT AccPed_trqLeadDrvDem_mp "Rohwert Fahrerwunschvorhalt nach Überlagerung von Zug- und Schubbeitrag" SWORD TrqPrp 1 100 -32768.00 32767.00 FORMAT "%8.2" ECU_ADDRESS 0x801E6C /end MEASUREMENT
/begin MEASUREMENT AccPed_trqLeadEngLow_mp "Wunschmoment für konventionellen Fahrmodus mit Automatikgetriebe und AWD aktiv (Lead-Pfad)" SWORD TrqPrp 1 100 -32768.00 32767.00 FORMAT "%8.2" ECU_ADDRESS 0x801E6E /end MEASUREMENT
/begin MEASUREMENT AccPed_trqLeadEngNormal_mp "Wunschmoment für konventionellen Fahrmodus mit Automatikgetriebe (Lead-Pfad)" SWORD TrqPrp 1 100 -32768.00 32767.00 FORMAT "%8.2" ECU_ADDRESS 0x801E70 /end MEASUREMENT
/begin MEASUREMENT AccPed_trqLeadEngSport_mp "Wunschmoment für konventionellen Fahrmodus mit Automatikgetriebe (Lead-Pfad)" SWORD TrqPrp 1 100 -32768.00 32767.00 FORMAT "%8.2" ECU_ADDRESS 0x801E72 /end MEASUREMENT
/begin MEASUREMENT AccPed_trqLeadEng_mp "Ausgangsmoment  für konventionellen Fahrmodus mit Automatikgetriebe (Lead-Pfad)" SWORD TrqPrp 1 100 -32768.00 32767.00 FORMAT "%8.2" ECU_ADDRESS 0x801E74 /end MEASUREMENT
/begin MEASUREMENT AccPed_trqLeadOvrRun_mp "Fahrerwunsch Schubbetrieb für Vorhaltewert" SWORD TrqPrp 1 100 -32768.00 32767.00 FORMAT "%8.2" ECU_ADDRESS 0x801E76 /end MEASUREMENT
/begin MEASUREMENT AccPed_trqLeadPrpSport_mp "Ausgangsmoment für Mastershift (Lead-Pfad)" SWORD TrqPrp 1 100 -32768.00 32767.00 FORMAT "%8.2" ECU_ADDRESS 0x801E78 /end MEASUREMENT
/begin MEASUREMENT AccPed_trqLeadPrp_mp "Ausgangsmoment für Mastershift (Lead-Pfad)" SWORD TrqPrp 1 100 -32768.00 32767.00 FORMAT "%8.2" ECU_ADDRESS 0x801E7A /end MEASUREMENT
/begin MEASUREMENT AccPed_trqLeadPull_mp "Fahrerwunsch Zugbetrieb für Vorhaltewert" SWORD TrqPrp 1 100 -32768.00 32767.00 FORMAT "%8.2" ECU_ADDRESS 0x801E7C /end MEASUREMENT
/begin MEASUREMENT AccPed_trqLeadSwtOut_mp "Ausgangsmoment der Transitionsfunktion (Lead-Pfad)" SWORD TrqPrp 1 100 -32768.00 32767.00 FORMAT "%8.2" ECU_ADDRESS 0x801E7E /end MEASUREMENT
/begin MEASUREMENT AccPed_trqLeadTransFreeze_mp "Eingang 2 der Transitionsfunktion (Lead-Pfad)" SWORD TrqPrp 1 100 -32768.00 32767.00 FORMAT "%8.2" ECU_ADDRESS 0x801E80 /end MEASUREMENT
/begin MEASUREMENT AccPed_trqLeadTransNew_mp "Eingang 1 der Transitionsfunktion (Lead-Pfad)" SWORD TrqPrp 1 100 -32768.00 32767.00 FORMAT "%8.2" ECU_ADDRESS 0x801E82 /end MEASUREMENT
/begin MEASUREMENT AccPed_trqLeadUnLim_mp "Fahrerwunsch Vorhalt vor Begrenzung" SWORD TrqPrp 1 100 -32768.00 32767.00 FORMAT "%8.2" ECU_ADDRESS 0x801E84 /end MEASUREMENT
/begin MEASUREMENT AccPed_trqLiLtd_mp "Meßpunkt des LiGov Getriebeausgangsmoments" SWORD TrqPrp 1 100 -32768.00 32767.00 FORMAT "%8.2" ECU_ADDRESS 0x801E2A /end MEASUREMENT
/begin FUNCTION ac ""
 /begin DEF_CHARACTERISTIC AC_pwrAdjValDef_C AC_pwrAdjValMax_C AC_pwrAdjValMin_C AC_rTrans_C /end DEF_CHARACTERISTIC
/end FUNCTION
/begin FUNCTION acc "Fahrzeugbeschleunigung"
 /begin DEF_CHARACTERISTIC ACC_tiDebStEPBInAct_C ACC_tiDebStEPBAct_C ACC_tiDebSwtPlInAct_C ACC_tiDebSwtPlAct_C ACC_tiDebTrqRelInAct_C ACC_tiDebTrqRelAct_C ACC_stACCVer_C ACC_tiBrkDrvCut_C ACC_tiBrkDrvDef_C ACC_tiDebActToOvrRide_C ACC_tiDebBrkAct_C ACC_tiDebLockOffAct_C ACC_tiDebOvrRideToAct_C ACC_tiDebTipOffAct_C ACC_trqDesMax_C ACC_trqDesOffset_C /end DEF_CHARACTERISTIC
/end FUNCTION
/begin FUNCTION acccd_co "Koordinator für die adaptive Fahrgeschwindigkeitsregelung"
 /begin DEF_CHARACTERISTIC ACCCD_tiBrkTrqDet_C ACCCD_trqBrkDetUp_C ACCCD_trqBrkDetDwn_C ACCCD_tiWrongCodedDebDef_C ACCCD_tiWrongCodedDebOk_C /end DEF_CHARACTERISTIC
/end FUNCTION
/begin FUNCTION acccd_co_msg "" /begin OUT_MEASUREMENT ACCCD_stACC ACCCD_stACCnew ACCCD_stBrk ACCCD_trqDes /end OUT_MEASUREMENT /end FUNCTION
/begin FUNCTION acccd_co_uic ""
 /begin DEF_CHARACTERISTIC ACCCD_stACCnew_Vector ACCCD_stACCnew_Channel ACCCD_stACC_Vector ACCCD_stACC_Channel ACCCD_stBrk_Vector ACCCD_stBrk_Channel ACCCD_trqDes_Vector ACCCD_trqDes_Channel /end DEF_CHARACTERISTIC
 /begin OUT_MEASUREMENT ACCCD_stACCByp_mp ACCCD_stACCnewByp_mp ACCCD_stBrkByp_mp ACCCD_stBrkTrqDet_mp ACCCD_trqDesByp_mp ACCCD_trqdiffRmpState_mp /end OUT_MEASUREMENT
/end FUNCTION
/begin FUNCTION accd "Komponententreiber Klimaanlage"
 /begin DEF_CHARACTERISTIC ACCD_tiDebCanSigDef_C ACCD_tiDebCanSigOk_C ACCD_DebNoLoadDef_C ACCD_DebNoLoadOk_C ACCD_DebNoTempDef_C ACCD_DebNoTempOk_C ACCD_DebShortCircBatDef_C ACCD_DebShortCircBatOk_C ACCD_DebShortCircGndDef_C ACCD_DebShortCircGndOk_C ACCD_tiMnSwtDebNeg_C ACCD_tiMnSwtDebPos_C ACCD_tiDebPACMaxDef_C ACCD_tiDebPACMaxOk_C ACCD_tiDebPACMinDef_C ACCD_tiDebPACMinOk_C ACCD_tiDebPACSigDef_C ACCD_tiDebPACSigOk_C ACCD_tiRmpLo2Hi_C ACCD_tiRmpHi2Lo_C ACCD_stSensIDWord_C ACCD_pDfl_C ACCD_stPwmInInv_C ACCD_tiPwmInMinPer_C ACCD_tiPwmInMaxPer_C ACCD_dcycPwmInMin_C ACCD_dcycPwmInMax_C ACCD_rLin_CUR ACCD_stACDfl_C ACCD_stComprDigIn_C ACCD_stInvOut_C ACCD_stMnSwtInvIn_C ACCD_swtACtypeVal_C ACCD_swtACtypeType_C ACCD_swtClimatronic_C ACCD_swtComprON_C ACCD_tiComprON_C ACCD_trqComprDfl_C ACCD_trqComprHi_C ACCD_trqComprLo_C /end DEF_CHARACTERISTIC
 /begin IN_MEASUREMENT ACCD_rPwmDcycIn_mp /end IN_MEASUREMENT
/end FUNCTION
/begin FUNCTION accd_msg ""
 /begin OUT_MEASUREMENT ACCD_p ACCD_stAC ACCD_stComprDig ACCD_stComprON ACCD_stMnSwtDebVal ACCD_stMnSwtRawVal ACCD_stPDefVal ACCD_swtACPresent ACCD_swtACtype ACCD_swtClimatronic ACCD_trqCompr /end OUT_MEASUREMENT
/end FUNCTION
/begin FUNCTION accd_uic "" /begin OUT_MEASUREMENT ACCD_pPwmFlt_mp ACCD_rHWEOut_mp ACCD_rPwmDcycIn_mp /end OUT_MEASUREMENT /end FUNCTION
/begin FUNCTION accd_var "" /end FUNCTION
/begin FUNCTION accd_var_msg "" /end FUNCTION
/begin FUNCTION accped "Fahrpedal"
 /begin DEF_CHARACTERISTIC AccPed_tiDebAliveDef_C AccPed_tiDebAliveOk_C AccPed_tiDebPladrLckDef_C AccPed_tiDebPladrLckOk_C AccPed_tiDebMisUseOk_C AccPed_tiDebMisUseDef_C AccPed_dfacRampSlope_C AccPed_drAPPUnFltLim_C AccPed_drLimpMax_C AccPed_drLimUp_C AccPed_drLimDwn_C AccPed_nErr_C AccPed_nLIMinBrk_C AccPed_nLIMinvHigh_C AccPed_nLIMinvLow_C AccPed_nLimMisUse_C AccPed_nLimNMR_C AccPed_nLim_C AccPed_nPlaAPPBrk_C AccPed_nTrqEngX_AXIS AccPed_tiPlausBrkDebNeg_C AccPed_tiPlausBrkDebPos_C AccPed_rErrValPlaus_C AccPed_rLimpMax_C AccPed_rPlaMaxVal_C AccPed_rThPlaus_C AccPed_rThresPrpMin_C AccPed_rThresPrp_C AccPed_rThresSfty_C AccPed_rTrqEngY_AXIS AccPed_rZero_C AccPed_stBrkPlausMSK_C AccPed_stGearSel_CUR AccPed_swtAliveDetEna_C AccPed_swtAppGradEna_C AccPed_swtBrkDet_C AccPed_swtMisUseEna_C AccPed_swtPlausCheckReqd_C AccPed_swtrVnFltEna_C AccPed_swtrVnFreeze_C AccPed_swtTrqRampEna_C AccPed_swtTrqTransType_C AccPed_swtVehDynReqd_C AccPed_tiChkDebNeg_C AccPed_tiChkDebPos_C AccPed_tiDebPlaDet_C AccPed_tiDebPlaRst_C AccPed_tiPlaAPPBrkCANwaitHW_C AccPed_tiVnTrqEngPT1_C AccPed_trqEng0_GMAP AccPed_trqEng1_GMAP AccPed_trqEng2_GMAP AccPed_trqEng3_GMAP AccPed_trqEng4_GMAP AccPed_trqEng5_GMAP AccPed_trqEng6_GMAP AccPed_trqNMRMax_C AccPed_trqPrpSport_MAP AccPed_trqPrp_MAP AccPed_vLim_C AccPed_vThresLI_C /end DEF_CHARACTERISTIC
 /begin IN_MEASUREMENT AccPed_rChkdVal AccPed_rVnTrqEngActv_mp Eng_nAvrg VSSCD_v /end IN_MEASUREMENT
/end FUNCTION
/begin FUNCTION accped_drvdemlead_uic "" /begin DEF_CHARACTERISTIC AccPed_trqLead_Vector AccPed_trqLead_Channel /end DEF_CHARACTERISTIC
 /begin OUT_MEASUREMENT AccPed_facMapSel_mp AccPed_facTrqDesSwtIn_mp AccPed_facTrqDesSwtOut_mp AccPed_facTrqLeadSwtIn_mp AccPed_facTrqLeadSwtOut_mp AccPed_numMapSel_mp AccPed_numTrqAct_mp AccPed_numTrqVar_mp AccPed_rTrqDesSwtIn_mp AccPed_rTrqDesSwtOut_mp AccPed_rTrqLeadSwtIn_mp AccPed_rTrqLeadSwtOut_mp AccPed_rVnTrqEngActv_mp AccPed_rVnTrqEngPT1_mp AccPed_stSport_mp AccPed_swtTrqTrans_mp AccPed_trqDesEngLow_mp AccPed_trqDesEngNormal_mp AccPed_trqDesEngSport_mp AccPed_trqDesEng_mp AccPed_trqDesPrpSport_mp AccPed_trqDesPrp_mp AccPed_trqDesSwtOut_mp AccPed_trqDesTransFreeze_mp AccPed_trqDesTransNew_mp AccPed_trqInrDesEngLow_mp AccPed_trqInrDesEngNormal_mp AccPed_trqInrDesEngSport_mp AccPed_trqInrDesEng_mp AccPed_trqInrLeadEngLow_mp AccPed_trqInrLeadEngNormal_mp AccPed_trqInrLeadEngSport_mp AccPed_trqInrLeadEng_mp AccPed_trqLeadByp_mp AccPed_trqLeadDrvDem_mp AccPed_trqLeadEngLow_mp AccPed_trqLeadEngNormal_mp AccPed_trqLeadEngSport_mp AccPed_trqLeadEng_mp AccPed_trqLeadOvrRun_mp AccPed_trqLeadPrpSport_mp AccPed_trqLeadPrp_mp AccPed_trqLeadPull_mp AccPed_trqLeadSwtOut_mp AccPed_trqLeadTransFreeze_mp AccPed_trqLeadTransNew_mp AccPed_trqLeadUnLim_mp /end OUT_MEASUREMENT
/end FUNCTION
/begin FUNCTION accped_drvdem_uic "" /begin DEF_CHARACTERISTIC AccPed_trqDes_Vector AccPed_trqDes_Channel /end DEF_CHARACTERISTIC
 /begin OUT_MEASUREMENT AccPed_trqDesDrvDem_mp AccPed_trqDesOvrRun_mp AccPed_trqDesUnLim_mp AccPed_trqFrcMin_mp AccPed_trqLiLtd_mp /end OUT_MEASUREMENT
/end FUNCTION
/begin FUNCTION accped_msg ""
 /begin OUT_MEASUREMENT AccPed_nMin AccPed_rChkdVal AccPed_rThresPrp AccPed_rThresPrpMin AccPed_rZero AccPed_stBrk AccPed_stCoType AccPed_stError AccPed_stPlaAPPBrk AccPed_stPlausCheckReqd AccPed_trqDes AccPed_trqDesPull AccPed_trqInrDesSig AccPed_trqLead /end OUT_MEASUREMENT
/end FUNCTION
/begin FUNCTION accped_uic "" /begin DEF_CHARACTERISTIC AccPed_rChkdVal_Vector AccPed_rChkdVal_Channel /end DEF_CHARACTERISTIC
 /begin OUT_MEASUREMENT AccPed_rAPPunLim_mp AccPed_rChkdValByp_mp AccPed_rPla_mp AccPed_stAPPalive_mp AccPed_stMisUse_mp AccPed_stNotDirect_mp AccPed_stPlaAPPBrkDet_mp AccPed_stPlaAPPBrkRst_mp AccPed_stPlausBrkRls_mp /end OUT_MEASUREMENT
/end FUNCTION
/begin COMPU_METHOD DtyCyc "Tastverhaeltnis" RAT_FUNC "%6.4" "[%]" COEFFS 0 100 0 0 0 1 /end COMPU_METHOD
/begin COMPU_METHOD EngN "Motordrehzahl" RAT_FUNC "%6.2" "[rpm]" COEFFS 0 1 0 0 0 1 /end COMPU_METHOD
/begin COMPU_METHOD Fact "Faktor mit Auflösung 1 / 8192, hauptsächlich für einen Faktorenbereich 0...1 verwendet" RAT_FUNC "%6.5" "[-]" COEFFS 0 8192 0 0 0 1 /end COMPU_METHOD
/begin COMPU_METHOD FactLow "Faktor mit Auflösung 1/1024, hauptsächlich für einen Faktorenbereich 1...50 verwendet" RAT_FUNC "%6.5" "[-]" COEFFS 0 1024 0 0 0 1 /end COMPU_METHOD
/begin COMPU_METHOD Map_Select "Umsetzungsfaktor von Kennfeldern fuer vierdimensionale Raeume" RAT_FUNC "%6.4" "[-]" COEFFS 0 256 0 0 0 1 /end COMPU_METHOD
/begin COMPU_METHOD OneToOne "eins zu eins (physikalischer Wert ist gleich dem internen Wert)" RAT_FUNC "%6.2" "[-]" COEFFS 0 1 0 0 0 1 /end COMPU_METHOD
/begin COMPU_METHOD Period "Periodendauer" RAT_FUNC "%6.3" "[ms]" COEFFS 0 10 0 0 0 1 /end COMPU_METHOD
/begin COMPU_METHOD Prc "Prozent, gleiche interne Auflösung wie Fact, aber Darstellung in Prozent (0...100%)" RAT_FUNC "%6.4" "[%]" COEFFS 0 100 0 0 0 1 /end COMPU_METHOD
/begin COMPU_METHOD PrcPerSec "Prozentänderung pro Sekunde für 20ms-Tasks" RAT_FUNC "%6.3" "[%/s]" COEFFS 0 2 0 0 0 1 /end COMPU_METHOD
/begin COMPU_METHOD PresAC_hPa "Druck (Klimatisierung) angezeigt in [hPa]" RAT_FUNC "%6.2" "[hPa]" COEFFS 0 0.5 0 0 0 1 /end COMPU_METHOD
/begin COMPU_METHOD RmpFactLow "Ramp Factor (Low) Umrechnung" RAT_FUNC "%7.6" "[Fact/s]" COEFFS 0 67108.864 0 0 0 1 /end COMPU_METHOD
/begin COMPU_METHOD RmpPrc "Prozent Rampengradient" RAT_FUNC "%6.5" "[%/s]" COEFFS 0 6553.6 0 0 0 1 /end COMPU_METHOD
/begin COMPU_METHOD RmpPresAC_hPa "Rampenanstieg für Klimaanlagendruck angezeigt in [hPa/s]" RAT_FUNC "%6.4" "[hPa/s]" COEFFS 0 32.768 0 0 0 1 /end COMPU_METHOD
/begin COMPU_METHOD RmpTrqPrp "Rampenanstieg für Vortriebsmoment [Nm/s]" RAT_FUNC "%6.4" "[Nm/s]" COEFFS 0 65.536 0 0 0 1 /end COMPU_METHOD
/begin COMPU_METHOD TimeDeb "Entprellzeit in Millisekunden für Libraryfunktion Debounce" RAT_FUNC "%6.1" "[ms]" COEFFS 0 0.1 0 0 0 1 /end COMPU_METHOD
/begin COMPU_METHOD TimeDelay_s "Zeitkonstante T1 (in s) für PT1, DT1, etc." RAT_FUNC "%9.3" "[s]" COEFFS 0 0 1 0 0.00023283064365387 0 /end COMPU_METHOD
/begin COMPU_METHOD Time_ms "Zeit in ms für Fehlerentprellung (DSM) und SW-Timer" RAT_FUNC "%6.1" "[ms]" COEFFS 0 0.1 0 0 0 1 /end COMPU_METHOD
/begin COMPU_METHOD TransR "Übersetzungsverhältnis (Getriebe etc.)" RAT_FUNC "%6.4" "[-]" COEFFS 0 100 0 0 0 1 /end COMPU_METHOD
/begin COMPU_METHOD Trq "Motormoment" RAT_FUNC "%6.3" "[Nm]" COEFFS 0 10 0 0 0 1 /end COMPU_METHOD
/begin COMPU_METHOD TrqPrp "Vortriebsmoment" RAT_FUNC "%6.2" "[Nm]" COEFFS 0 1 0 0 0 1 /end COMPU_METHOD
/begin COMPU_METHOD Vel "Fahrzeuggeschwindigkeit, gleiche interne Auflösung wie Vel_SI" RAT_FUNC "%6.4" "[km/h]" COEFFS 0 100 0 0 0 1 /end COMPU_METHOD
/begin COMPU_METHOD VelToN "Verhältnis Fahrzeuggeschwindigkeit zu Motordrehzahl v/n" RAT_FUNC "%8.7" "[(km/h)/rpm]" COEFFS 0 100000 0 0 0 1 /end COMPU_METHOD
/begin RECORD_LAYOUT Gkf_Ws16 FNC_VALUES 1 SWORD COLUMN_DIR DIRECT /end RECORD_LAYOUT
/begin RECORD_LAYOUT GSst_Xs16 NO_AXIS_PTS_X 1 SWORD AXIS_PTS_X 2 SWORD INDEX_INCR DIRECT /end RECORD_LAYOUT
/begin RECORD_LAYOUT Kf_Xs16_Ys16_Ws16 NO_AXIS_PTS_X 1 SWORD NO_AXIS_PTS_Y 2 SWORD AXIS_PTS_X 3 SWORD INDEX_INCR DIRECT AXIS_PTS_Y 4 SWORD INDEX_INCR DIRECT FNC_VALUES 5 SWORD COLUMN_DIR DIRECT /end RECORD_LAYOUT
/begin RECORD_LAYOUT Kl_Xs16_Ws16 NO_AXIS_PTS_X 1 SWORD AXIS_PTS_X 2 SWORD INDEX_INCR DIRECT FNC_VALUES 3 SWORD COLUMN_DIR DIRECT /end RECORD_LAYOUT
/begin RECORD_LAYOUT Kw_Ws16 FNC_VALUES 1 SWORD COLUMN_DIR DIRECT /end RECORD_LAYOUT
/begin RECORD_LAYOUT Kw_Wu16 FNC_VALUES 1 UWORD COLUMN_DIR DIRECT /end RECORD_LAYOUT
/begin RECORD_LAYOUT Kw_Wu32 FNC_VALUES 1 ULONG COLUMN_DIR DIRECT /end RECORD_LAYOUT
/begin RECORD_LAYOUT Kw_Wu8 FNC_VALUES 1 UBYTE COLUMN_DIR DIRECT /end RECORD_LAYOUT
/end MODULE
/end PROJECT
